VERSION ""

NS_ :

BS_:

BU_: PowertrainControlModule AtmosphericSensor SafetyRestraintSystem2 Aftertreatment_2_GasOutlet Aftertreatment_2_GasIntake DieselPartFilterControl Turbocharger SafetyRestraintSystem1 CabDisplay2 Aftertreatment_1_GasOutlet Aftertreatment_1_GasIntake OnBoardDataLogger OffBoardDiagnosticTool2 OffBoardDiagnosticTool1 FileServer ParkingBrakeController SeatController2 FanDriveController SteeringColumnUnit CommunicationUnitRadio CommunicationUnitSatellite CommunicationUnitCellular PropulsionBatteryCharger ChassisController2 ChassisController1 EngineValveControl AuxiliaryHeater2 AuxiliaryHeater1 ClutchUnit RampControl InformationSystem1 SuspensionSystemController2 OilSensor VehicleDynamicStability ExhaustEmissionController TransmissionDisplay2 TransmissionDisplay1 ClimateControl2 WaterPumpController RearAxleSteeringController LightingOperatorControl SeatController1 IgnitionController2 IgnitionController1 TirePressureController CabController2 CabController1 PneumaticSystemController SuspensionSystemController1 HydraulicPumpController EnduranceBrakingSystem RetarderExhaustEngine2 OnBoardDiagnosticUnit HeadwayController RetarderExhaustEngine1 CabDisplay1 ManagementComputer VirtualTerminal OffVehicleGateway PowerTakeOffFront HitchControl AuxiliaryValveControl BodyController TractorTrailerBridge1 StarterSystem ElectricalSystem VehicleSecurity VehicleNavigation AerodynamicControl ElectricalChargingSystem ClimateControl1 TripRecorder InstrumentCluster SuspensionDriveAxle2 SuspensionDriveAxle1 SuspensionSteerAxle SteeringController FuelSystem CruiseControl RetarderDriveline RetarderEngine BrakesDriveAxle2 BrakesDriveAxle1 BrakesSystemController BrakesSteerAxle AxleDrive2 AxleDrive1 AxleSteering PowerTakeOff ShiftConsoleSecondary ShiftConsolePrimary Transmission2 Transmission1 Engine2 Engine1

BO_ 3221225472 VECTOR__INDEPENDENT_SIG_MSG: 0 Vector__XXX
 SG_ Jystck6GrpXAxsLvrLftNgtvPsStatus : 0|2@1+ (1,0) [0|3] "" Vector__XXX
 SG_ Jystck6GripXAxisNeutralPosStatus : 0|2@1+ (1,0) [0|3] "" Vector__XXX
 SG_ Joystick5Button13PressedStatus : 0|2@1+ (1,0) [0|3] "" Vector__XXX
 SG_ Joystick5Button14PressedStatus : 0|2@1+ (1,0) [0|3] "" Vector__XXX
 SG_ Joystick5Button15PressedStatus : 0|2@1+ (1,0) [0|3] "" Vector__XXX
 SG_ Joystick5Button16PressedStatus : 0|2@1+ (1,0) [0|3] "" Vector__XXX
 SG_ Jystick5GripXAxisDetentPosStatus : 0|2@1+ (1,0) [0|3] "" Vector__XXX
 SG_ Jystick5GripYAxisDetentPosStatus : 0|2@1+ (1,0) [0|3] "" Vector__XXX
 SG_ Jystick5ThetaAxisDetentPosStatus : 0|2@1+ (1,0) [0|3] "" Vector__XXX
 SG_ Joystick5ThetaAxisPos : 0|10@1+ (0.1,0) [0|102] "%" Vector__XXX
 SG_ Jystck5ThtAxsClckwsPstvPosStatus : 0|2@1+ (1,0) [0|3] "" Vector__XXX
 SG_ Jystck5ThtAxsCntrClckwsNgtvPsStt : 0|2@1+ (1,0) [0|3] "" Vector__XXX
 SG_ Jystck5ThetaAxisNeutralPosStatus : 0|2@1+ (1,0) [0|3] "" Vector__XXX
 SG_ Joystick5GripYAxisPos : 0|10@1+ (0.1,0) [0|102] "%" Vector__XXX
 SG_ Jystck5GrpYAxsLvrFrwrdPstvPsStts : 0|2@1+ (1,0) [0|3] "" Vector__XXX
 SG_ Jystck5GrpYAxsLvrBckNgtvPsStatus : 0|2@1+ (1,0) [0|3] "" Vector__XXX
 SG_ Jystck5GripYAxisNeutralPosStatus : 0|2@1+ (1,0) [0|3] "" Vector__XXX
 SG_ Joystick5GripXAxisPos : 0|10@1+ (0.1,0) [0|102] "%" Vector__XXX
 SG_ Jystck5GrpXAxsLvrRghtPstvPsSttus : 0|2@1+ (1,0) [0|3] "" Vector__XXX
 SG_ Jystck5GrpXAxsLvrLftNgtvPsStatus : 0|2@1+ (1,0) [0|3] "" Vector__XXX
 SG_ Jystck5GripXAxisNeutralPosStatus : 0|2@1+ (1,0) [0|3] "" Vector__XXX
 SG_ Joystick4Button13PressedStatus : 0|2@1+ (1,0) [0|3] "" Vector__XXX
 SG_ Joystick4Button14PressedStatus : 0|2@1+ (1,0) [0|3] "" Vector__XXX
 SG_ Joystick4Button15PressedStatus : 0|2@1+ (1,0) [0|3] "" Vector__XXX
 SG_ Joystick4Button16PressedStatus : 0|2@1+ (1,0) [0|3] "" Vector__XXX
 SG_ Jystick4GripXAxisDetentPosStatus : 0|2@1+ (1,0) [0|3] "" Vector__XXX
 SG_ Jystick4GripYAxisDetentPosStatus : 0|2@1+ (1,0) [0|3] "" Vector__XXX
 SG_ Jystick4ThetaAxisDetentPosStatus : 0|2@1+ (1,0) [0|3] "" Vector__XXX
 SG_ Joystick4ThetaAxisPos : 0|10@1+ (0.1,0) [0|102] "%" Vector__XXX
 SG_ Jystck4ThtAxsClckwsPstvPosStatus : 0|2@1+ (1,0) [0|3] "" Vector__XXX
 SG_ Jystck4ThtAxsCntrClckwsNgtvPsStt : 0|2@1+ (1,0) [0|3] "" Vector__XXX
 SG_ Jystck4ThetaAxisNeutralPosStatus : 0|2@1+ (1,0) [0|3] "" Vector__XXX
 SG_ Joystick4GripYAxisPos : 0|10@1+ (0.1,0) [0|102] "%" Vector__XXX
 SG_ Jystck4GrpYAxsLvrFrwrdPstvPsStts : 0|2@1+ (1,0) [0|3] "" Vector__XXX
 SG_ Jystck4GrpYAxsLvrBckNgtvPsStatus : 0|2@1+ (1,0) [0|3] "" Vector__XXX
 SG_ Jystck4GripYAxisNeutralPosStatus : 0|2@1+ (1,0) [0|3] "" Vector__XXX
 SG_ Joystick4GripXAxisPos : 0|10@1+ (0.1,0) [0|102] "%" Vector__XXX
 SG_ Jystck4GrpXAxsLvrRghtPstvPsSttus : 0|2@1+ (1,0) [0|3] "" Vector__XXX
 SG_ Jystck4GrpXAxsLvrLftNgtvPsStatus : 0|2@1+ (1,0) [0|3] "" Vector__XXX
 SG_ Jystck4GripXAxisNeutralPosStatus : 0|2@1+ (1,0) [0|3] "" Vector__XXX
 SG_ Joystick10Button13PressedStatus : 0|2@1+ (1,0) [0|3] "" Vector__XXX
 SG_ Joystick10Button14PressedStatus : 0|2@1+ (1,0) [0|3] "" Vector__XXX
 SG_ Joystick10Button15PressedStatus : 0|2@1+ (1,0) [0|3] "" Vector__XXX
 SG_ Joystick10Button16PressedStatus : 0|2@1+ (1,0) [0|3] "" Vector__XXX
 SG_ Jystck10GripXAxisDetentPosStatus : 0|2@1+ (1,0) [0|3] "" Vector__XXX
 SG_ Jystck10GripYAxisDetentPosStatus : 0|2@1+ (1,0) [0|3] "" Vector__XXX
 SG_ Jystck10ThetaAxisDetentPosStatus : 0|2@1+ (1,0) [0|3] "" Vector__XXX
 SG_ Joystick10ThetaAxisPos : 0|10@1+ (0.1,0) [0|102] "%" Vector__XXX
 SG_ Jystck10ThtAxsClckwsPstvPsStatus : 0|2@1+ (1,0) [0|3] "" Vector__XXX
 SG_ Jystck10ThtAxsCntrClckwsNgtvPsSt : 0|2@1+ (1,0) [0|3] "" Vector__XXX
 SG_ Jystck10ThtaAxisNeutralPosStatus : 0|2@1+ (1,0) [0|3] "" Vector__XXX
 SG_ Joystick10GripYAxisPos : 0|10@1+ (0.1,0) [0|102] "%" Vector__XXX
 SG_ Jystck10GrpYAxsLvrFrwrdPstvPsStt : 0|2@1+ (1,0) [0|3] "" Vector__XXX
 SG_ Jystck10GrpYAxsLvrBckNgtvPsSttus : 0|2@1+ (1,0) [0|3] "" Vector__XXX
 SG_ Jystck10GrpYAxisNeutralPosStatus : 0|2@1+ (1,0) [0|3] "" Vector__XXX
 SG_ Joystick10GripXAxisPos : 0|10@1+ (0.1,0) [0|102] "%" Vector__XXX
 SG_ Jystck10GrpXAxsLvrRghtPstvPsStts : 0|2@1+ (1,0) [0|3] "" Vector__XXX
 SG_ Jystck10GrpXAxsLvrLftNgtvPsSttus : 0|2@1+ (1,0) [0|3] "" Vector__XXX
 SG_ Jystck10GrpXAxisNeutralPosStatus : 0|2@1+ (1,0) [0|3] "" Vector__XXX
 SG_ FuelTankTransferPumpPress : 0|16@1+ (0.1,0) [0|6425.5] "kPa" Vector__XXX
 SG_ FuelTankTransferPump : 0|2@1+ (1,0) [0|3] "" Vector__XXX
 SG_ EngFuelFilterIntakeAbsPress : 0|8@1+ (2,0) [0|500] "kPa" Vector__XXX
 SG_ EngFuelDeliveryPress : 0|16@1+ (0.1,0) [0|6425.5] "kPa" Vector__XXX
 SG_ EngOilPress : 0|16@1+ (0.1,0) [0|6425.5] "kPa" Vector__XXX
 SG_ EngExhstGsRcrcltn1OutletAbsPress : 0|16@1+ (0.1,0) [0|6425.5] "kPa" Vector__XXX
 SG_ EngExhstGsRcrcltn1IntakeAbsPress : 0|16@1+ (0.1,0) [0|6425.5] "kPa" Vector__XXX
 SG_ EngCoolantPress2 : 0|8@1+ (2,0) [0|500] "kPa" Vector__XXX
 SG_ EngExhstGsRcrcltn2IntakeAbsPress : 0|16@1+ (0.1,0) [0|6425.5] "kPa" Vector__XXX
 SG_ EngExhstGsRcrcltn2OutletAbsPress : 0|16@1+ (0.1,0) [0|6425.5] "kPa" Vector__XXX
 SG_ EngExhstGsRcrclation2IntakePress : 0|8@1+ (2,0) [0|500] "kPa" Vector__XXX
 SG_ EngExhstGsRcirculation2DiffPress : 0|16@1+ (0.0078125,-250) [-250|251.99] "kPa" Vector__XXX
 SG_ CmmndedEngFuelInjectionCtrlPress : 0|16@1+ (0.00390625,0) [0|250.996] "MPa" Vector__XXX
 SG_ CommandedEngFuelRailPress : 0|16@1+ (0.00390625,0) [0|250.996] "MPa" Vector__XXX
 SG_ EngExhstGsRcirculation2Valve2Pos : 0|16@1+ (0.0025,0) [0|160.6375] "%" Vector__XXX
 SG_ EngExhstGsRecirculation2ValvePos : 0|16@1+ (0.0025,0) [0|160.6375] "%" Vector__XXX
 SG_ EngExhstGsRcrcltn2Valve2PosError : 0|16@1+ (0.004,-125) [-125|132.02] "%" Vector__XXX
 SG_ EngExhstGsRcrcltn2Valve1PosError : 0|16@1+ (0.004,-125) [-125|132.02] "%" Vector__XXX
 SG_ EngExhstGsRcrculation2Valve2Ctrl : 0|16@1+ (0.0025,0) [0|160.6375] "%" Vector__XXX
 SG_ EngExhstGsRcirculation2ValveCtrl : 0|16@1+ (0.0025,0) [0|160.6375] "%" Vector__XXX
 SG_ EGR2CoolerBypassActuatorPos : 0|8@1+ (0.4,0) [0|100] "%" Vector__XXX
 SG_ EngExhstGsRcrcltn2ClerEfficiency : 0|8@1+ (0.4,0) [0|100] "%" Vector__XXX
 SG_ EngExhstGsRcrcltn2ClrIntkGsAbsPr : 0|16@1+ (0.5,0) [0|32127.5] "kPa" Vector__XXX
 SG_ EngExhstGsRcrcltn2ClerIntakeTemp : 0|16@1+ (0.03125,-273) [-273|1734.96875] "°C" Vector__XXX
 SG_ EngFrictionPercentTorquePoint7 : 0|8@1+ (1,-125) [0|125] "%" Vector__XXX
 SG_ EngFrictionPercentTorquePoint6 : 0|8@1+ (1,-125) [0|125] "%" Vector__XXX
 SG_ EngFrictionPercentTorquePoint5 : 0|8@1+ (1,-125) [0|125] "%" Vector__XXX
 SG_ EngFrictionPercentTorquePoint4 : 0|8@1+ (1,-125) [0|125] "%" Vector__XXX
 SG_ EngFrictionPercentTorquePoint3 : 0|8@1+ (1,-125) [0|125] "%" Vector__XXX
 SG_ EngFrictionPercentTorquePoint2 : 0|8@1+ (1,-125) [0|125] "%" Vector__XXX
 SG_ EngFrctnPrcentTorqueAtIdlePoint1 : 0|8@1+ (1,-125) [0|125] "%" Vector__XXX
 SG_ DslPrtcltFltrActvRgnrtnInhbt5629 : 0|2@1+ (1,0) [0|3] "" Vector__XXX
 SG_ AFT1DPFCondNotMetForActiveRegen : 0|2@1+ (1,0) [0|3] "" Vector__XXX
 SG_ HydrocarbonDoserPurgingEnable : 0|2@1+ (1,0) [0|3] "" Vector__XXX
 SG_ DslPrtcltFltrActvRgnrtnFrcdSttus : 0|3@1+ (1,0) [0|7] "" Vector__XXX
 SG_ ExhaustSystemHighTempLampCmd : 0|3@1+ (1,0) [0|7] "" Vector__XXX
 SG_ DslPrtcltFltrAtmtcActvRgnrtnIntt : 0|2@1+ (1,0) [0|3] "" Vector__XXX
 SG_ DslPrtcltFltrActvRgnrtnInhbt3717 : 0|2@1+ (1,0) [0|3] "" Vector__XXX
 SG_ DslPrtcltFltrActvRgnrtnInhbtdDTE : 0|2@1+ (1,0) [0|3] "" Vector__XXX
 SG_ DslPrtcltFltrActvRgnrtnInhbt3715 : 0|2@1+ (1,0) [0|3] "" Vector__XXX
 SG_ DslPrtcltFltrActvRgnrtnInhbtdDTT : 0|2@1+ (1,0) [0|3] "" Vector__XXX
 SG_ DslPrtcltFltrActvRgnrtnInhbt3713 : 0|2@1+ (1,0) [0|3] "" Vector__XXX
 SG_ DslPrtcltFltrActvRgnrtnInhbt3712 : 0|2@1+ (1,0) [0|3] "" Vector__XXX
 SG_ DslPrtcltFltrActvRgnrtnInhbtdDTL : 0|2@1+ (1,0) [0|3] "" Vector__XXX
 SG_ DslPrtcltFltrActvRgnrtnInhbt3710 : 0|2@1+ (1,0) [0|3] "" Vector__XXX
 SG_ DslPrtcltFltrActvRgnrtnInhbtdDTV : 0|2@1+ (1,0) [0|3] "" Vector__XXX
 SG_ DslPrtcltFltrActvRgnrtnInhbtdDTO : 0|2@1+ (1,0) [0|3] "" Vector__XXX
 SG_ DslPrtcltFltrActvRgnrtnInhbtdDTA : 0|2@1+ (1,0) [0|3] "" Vector__XXX
 SG_ DslPrtcltFltrActvRgnrtnInhbtdDTP : 0|2@1+ (1,0) [0|3] "" Vector__XXX
 SG_ DslPrtcltFltrActvRgnrtnInhbtdDTS : 0|2@1+ (1,0) [0|3] "" Vector__XXX
 SG_ DslPrtcltFltrActvRgnrtnInhbtdDTC : 0|2@1+ (1,0) [0|3] "" Vector__XXX
 SG_ DslPrtcltFltrActvRgnrtnInhbtdDTI : 0|2@1+ (1,0) [0|3] "" Vector__XXX
 SG_ DslPrtcltFltrActvRgnrtnInhbtdStt : 0|2@1+ (1,0) [0|3] "" Vector__XXX
 SG_ AFTDPFStatus : 0|3@1+ (1,0) [0|7] "" Vector__XXX
 SG_ AFTDPFActiveRegenStatus : 0|2@1+ (1,0) [0|3] "" Vector__XXX
 SG_ AFTDPFPassiveRegenStatus : 0|2@1+ (1,0) [0|3] "" Vector__XXX
 SG_ DieselParticulateFilterLampCmd : 0|3@1+ (1,0) [0|7] "" Vector__XXX
 SG_ AFT2DPFSootSignalMin : 0|16@1+ (0.0025,0) [0|160.6375] "%" Vector__XXX
 SG_ AFT2DPFSootSignalMax : 0|16@1+ (0.0025,0) [0|160.6375] "%" Vector__XXX
 SG_ AFT2DPFSootSignalStdDeviation : 0|16@1+ (0.0025,0) [0|160.6375] "%" Vector__XXX
 SG_ DslPrtcltFltr2StSnsrECUIntrnlTmp : 0|8@1+ (1,-40) [-40|210] "°C" Vector__XXX
 SG_ AFT2DPFSootSnsrPreliminaryFMI : 0|5@1+ (1,0) [0|31] "" Vector__XXX
 SG_ AFT2DPFMedianSootSignal : 0|16@1+ (0.0025,0) [0|160.6375] "%" Vector__XXX
 SG_ AFT2DPFMeanSootSignal : 0|16@1+ (0.0025,0) [0|160.6375] "%" Vector__XXX
 SG_ AFT2DPFSootDensity : 0|8@1+ (0.08,0) [0|20] "g/L" Vector__XXX
 SG_ AFT2DPFSootMass : 0|8@1+ (4,0) [0|1000] "g" Vector__XXX
 SG_ AFT1DPFSootSignalMin : 0|16@1+ (0.0025,0) [0|160.6375] "%" Vector__XXX
 SG_ AFT1DPFSootSignalMax : 0|16@1+ (0.0025,0) [0|160.6375] "%" Vector__XXX
 SG_ AFT1DPFSootSignalStdDeviation : 0|16@1+ (0.0025,0) [0|160.6375] "%" Vector__XXX
 SG_ DslPrtcltFltr1StSnsrECUIntrnlTmp : 0|8@1+ (1,-40) [-40|210] "°C" Vector__XXX
 SG_ AFT1DPFSootSnsrPreliminaryFMI : 0|5@1+ (1,0) [0|31] "" Vector__XXX
 SG_ AFT1DPFMedianSootSignal : 0|16@1+ (0.0025,0) [0|160.6375] "%" Vector__XXX
 SG_ AFT1DPFMeanSootSignal : 0|16@1+ (0.0025,0) [0|160.6375] "%" Vector__XXX
 SG_ AFT1DPFSootDensity : 0|8@1+ (0.08,0) [0|20] "g/L" Vector__XXX
 SG_ AFT1DPFSootMass : 0|8@1+ (4,0) [0|1000] "g" Vector__XXX
 SG_ HillHolderLampData : 0|2@1+ (1,0) [0|3] "" Vector__XXX
 SG_ VehicleBatteryChargingLampData : 0|2@1+ (1,0) [0|3] "" Vector__XXX
 SG_ VehicleHVACRecirculationLampData : 0|2@1+ (1,0) [0|3] "" Vector__XXX
 SG_ VehicleAirPressLowLampData : 0|2@1+ (1,0) [0|3] "" Vector__XXX
 SG_ VehicleFuelLevelLowLampData : 0|2@1+ (1,0) [0|3] "" Vector__XXX
 SG_ VehicleBatteryVoltageLowLampData : 0|2@1+ (1,0) [0|3] "" Vector__XXX
 SG_ VhclAcclerationRateLimitLampData : 0|2@1+ (1,0) [0|3] "" Vector__XXX
 SG_ EngSpeedVeryHighLampData : 0|2@1+ (1,0) [0|3] "" Vector__XXX
 SG_ EngSpeedHighLampData : 0|2@1+ (1,0) [0|3] "" Vector__XXX
 SG_ EngCtrlMdule3ReadyForUseLampData : 0|2@1+ (1,0) [0|3] "" Vector__XXX
 SG_ EngCtrlMdule2ReadyForUseLampData : 0|2@1+ (1,0) [0|3] "" Vector__XXX
 SG_ EngCtrlMdule1ReadyForUseLampData : 0|2@1+ (1,0) [0|3] "" Vector__XXX
 SG_ EngWaitToStartLampData : 0|2@1+ (1,0) [0|3] "" Vector__XXX
 SG_ EngFuelFilterRestrictedLampData : 0|2@1+ (1,0) [0|3] "" Vector__XXX
 SG_ EngAirFilterRestrictionLampData : 0|2@1+ (1,0) [0|3] "" Vector__XXX
 SG_ EngIdleManagementActiveLampData : 0|2@1+ (1,0) [0|3] "" Vector__XXX
 SG_ EngCoolantLevelLowLampData : 0|2@1+ (1,0) [0|3] "" Vector__XXX
 SG_ EngCoolantTempHighLampData : 0|2@1+ (1,0) [0|3] "" Vector__XXX
 SG_ EngOilPressLowLampData : 0|2@1+ (1,0) [0|3] "" Vector__XXX
 SG_ CmprssnBrkEnblSwtchIndctrLmpData : 0|2@1+ (1,0) [0|3] "" Vector__XXX
 SG_ EngBrakeActiveLampData : 0|2@1+ (1,0) [0|3] "" Vector__XXX
 SG_ OBDMalfunctionIndicatorLampData : 0|2@1+ (1,0) [0|3] "" Vector__XXX
 SG_ EngRedStopLampData : 0|2@1+ (1,0) [0|3] "" Vector__XXX
 SG_ EngAmberWarningLampData : 0|2@1+ (1,0) [0|3] "" Vector__XXX
 SG_ EngProtectLampData : 0|2@1+ (1,0) [0|3] "" Vector__XXX
 SG_ HillHolderLampCmd : 0|2@1+ (1,0) [0|3] "" Vector__XXX
 SG_ VehicleBatteryChargingLampCmd : 0|2@1+ (1,0) [0|3] "" Vector__XXX
 SG_ VehicleHVACRecirculationLampCmd : 0|2@1+ (1,0) [0|3] "" Vector__XXX
 SG_ VehicleAirPressLowLampCmd : 0|2@1+ (1,0) [0|3] "" Vector__XXX
 SG_ VehicleFuelLevelLowLampCmd : 0|2@1+ (1,0) [0|3] "" Vector__XXX
 SG_ VehicleBatteryVoltageLowLampCmd : 0|2@1+ (1,0) [0|3] "" Vector__XXX
 SG_ TextDisplayIndex : 0|8@1+ (1,0) [0|200] "" Vector__XXX
 SG_ TextDisplayInstructions : 0|4@1+ (1,0) [0|15] "" Vector__XXX
 SG_ RetractStatusOfRamp5 : 0|2@1+ (1,0) [0|3] "" Vector__XXX
 SG_ RetractStatusOfRamp4 : 0|2@1+ (1,0) [0|3] "" Vector__XXX
 SG_ MovementStatusOfRamp5 : 0|2@1+ (1,0) [0|3] "" Vector__XXX
 SG_ MovementStatusOfRamp4 : 0|2@1+ (1,0) [0|3] "" Vector__XXX
 SG_ EnableStatusOfRamp5 : 0|2@1+ (1,0) [0|3] "" Vector__XXX
 SG_ EnableStatusOfRamp4 : 0|2@1+ (1,0) [0|3] "" Vector__XXX
 SG_ MovementStatusOfRamp3 : 0|2@1+ (1,0) [0|3] "" Vector__XXX
 SG_ EnableStatusOfRamp3 : 0|2@1+ (1,0) [0|3] "" Vector__XXX
 SG_ RetractStatusOfRamp3 : 0|2@1+ (1,0) [0|3] "" Vector__XXX
 SG_ MovementStatusOfRamp2 : 0|2@1+ (1,0) [0|3] "" Vector__XXX
 SG_ EnableStatusOfRamp2 : 0|2@1+ (1,0) [0|3] "" Vector__XXX
 SG_ RetractStatusOfRamp2 : 0|2@1+ (1,0) [0|3] "" Vector__XXX
 SG_ MovementStatusOfRamp1 : 0|2@1+ (1,0) [0|3] "" Vector__XXX
 SG_ EnableStatusOfRamp1 : 0|2@1+ (1,0) [0|3] "" Vector__XXX
 SG_ RetractStatusOfRamp1 : 0|2@1+ (1,0) [0|3] "" Vector__XXX
 SG_ EngConfigIdentification : 0|16@1+ (1,0) [0|64255] "" Vector__XXX
 SG_ NmbrOfCmbstionCyclesForAveraging : 0|8@1+ (1,0) [1|250] "" Vector__XXX
 SG_ MaxCrankAttemptsPerStartAttempt : 0|8@1+ (1,0) [0|250] "" Vector__XXX
 SG_ CommandedEngIntakeManifoldPress : 0|16@1+ (0.125,0) [0|8031.875] "kPa" Vector__XXX
 SG_ EngCrnkcsBrtherOilSeparatorSpeed : 0|16@1+ (1,0) [0|64255] "rpm" Vector__XXX
 SG_ EngExhstGsRcirculation1Valve2Pos : 0|16@1+ (0.0025,0) [0|160.6375] "%" Vector__XXX
 SG_ EngExhstGsRecirculation1ValvePos : 0|16@1+ (0.0025,0) [0|160.6375] "%" Vector__XXX
 SG_ EngExhstGsRcrcltn1ClerEfficiency : 0|8@1+ (0.4,0) [0|100] "%" Vector__XXX
 SG_ EngExhstGsRcrcltn1ClrIntkGsAbsPr : 0|16@1+ (0.5,0) [0|32127.5] "kPa" Vector__XXX
 SG_ EngExhstGsRcrcltn1ClerIntakeTemp : 0|16@1+ (0.03125,-273) [-273|1734.96875] "°C" Vector__XXX
 SG_ EngExhstGsRcrculation1Valve2Ctrl : 0|16@1+ (0.0025,0) [0|160.6375] "%" Vector__XXX
 SG_ EngIntkVlvActtionOilPressForCyl4 : 0|16@1+ (0.1,0) [0|6425.5] "kPa" Vector__XXX
 SG_ EngIntkVlvActtionOilPressForCyl3 : 0|16@1+ (0.1,0) [0|6425.5] "kPa" Vector__XXX
 SG_ EngIntkVlvActtionOilPressForCyl2 : 0|16@1+ (0.1,0) [0|6425.5] "kPa" Vector__XXX
 SG_ EngIntkVlvActtionOilPressForCyl1 : 0|16@1+ (0.1,0) [0|6425.5] "kPa" Vector__XXX
 SG_ EngIntkVlvActtionOilPressForCyl8 : 0|16@1+ (0.1,0) [0|6425.5] "kPa" Vector__XXX
 SG_ EngIntkVlvActtionOilPressForCyl7 : 0|16@1+ (0.1,0) [0|6425.5] "kPa" Vector__XXX
 SG_ EngIntkVlvActtionOilPressForCyl6 : 0|16@1+ (0.1,0) [0|6425.5] "kPa" Vector__XXX
 SG_ EngIntkVlvActtionOilPressForCyl5 : 0|16@1+ (0.1,0) [0|6425.5] "kPa" Vector__XXX
 SG_ EngIntkVlvActtonOilPressForCyl12 : 0|16@1+ (0.1,0) [0|6425.5] "kPa" Vector__XXX
 SG_ EngIntkVlvActtonOilPressForCyl11 : 0|16@1+ (0.1,0) [0|6425.5] "kPa" Vector__XXX
 SG_ EngIntkVlvActtonOilPressForCyl10 : 0|16@1+ (0.1,0) [0|6425.5] "kPa" Vector__XXX
 SG_ EngIntkVlvActtionOilPressForCyl9 : 0|16@1+ (0.1,0) [0|6425.5] "kPa" Vector__XXX
 SG_ EngIntkVlvActtonOilPressForCyl16 : 0|16@1+ (0.1,0) [0|6425.5] "kPa" Vector__XXX
 SG_ EngIntkVlvActtonOilPressForCyl15 : 0|16@1+ (0.1,0) [0|6425.5] "kPa" Vector__XXX
 SG_ EngIntkVlvActtonOilPressForCyl14 : 0|16@1+ (0.1,0) [0|6425.5] "kPa" Vector__XXX
 SG_ EngIntkVlvActtonOilPressForCyl13 : 0|16@1+ (0.1,0) [0|6425.5] "kPa" Vector__XXX
 SG_ EngIntkVlvActtonOilPressForCyl20 : 0|16@1+ (0.1,0) [0|6425.5] "kPa" Vector__XXX
 SG_ EngIntkVlvActtonOilPressForCyl19 : 0|16@1+ (0.1,0) [0|6425.5] "kPa" Vector__XXX
 SG_ EngIntkVlvActtonOilPressForCyl18 : 0|16@1+ (0.1,0) [0|6425.5] "kPa" Vector__XXX
 SG_ EngIntkVlvActtonOilPressForCyl17 : 0|16@1+ (0.1,0) [0|6425.5] "kPa" Vector__XXX
 SG_ EGR1CoolerBypassActuatorPostion : 0|8@1+ (0.4,0) [0|100] "%" Vector__XXX
 SG_ EngSparkPlug4 : 0|16@1+ (1,0) [0|64255] "V" Vector__XXX
 SG_ EngSparkPlug3 : 0|16@1+ (1,0) [0|64255] "V" Vector__XXX
 SG_ EngSparkPlug2 : 0|16@1+ (1,0) [0|64255] "V" Vector__XXX
 SG_ EngSparkPlug1 : 0|16@1+ (1,0) [0|64255] "V" Vector__XXX
 SG_ EngSparkPlug8 : 0|16@1+ (1,0) [0|64255] "V" Vector__XXX
 SG_ EngSparkPlug7 : 0|16@1+ (1,0) [0|64255] "V" Vector__XXX
 SG_ EngSparkPlug6 : 0|16@1+ (1,0) [0|64255] "V" Vector__XXX
 SG_ EngSparkPlug5 : 0|16@1+ (1,0) [0|64255] "V" Vector__XXX
 SG_ EngSparkPlug12 : 0|16@1+ (1,0) [0|64255] "V" Vector__XXX
 SG_ EngSparkPlug11 : 0|16@1+ (1,0) [0|64255] "V" Vector__XXX
 SG_ EngSparkPlug10 : 0|16@1+ (1,0) [0|64255] "V" Vector__XXX
 SG_ EngSparkPlug9 : 0|16@1+ (1,0) [0|64255] "V" Vector__XXX
 SG_ EngSparkPlug16 : 0|16@1+ (1,0) [0|64255] "V" Vector__XXX
 SG_ EngSparkPlug15 : 0|16@1+ (1,0) [0|64255] "V" Vector__XXX
 SG_ EngSparkPlug14 : 0|16@1+ (1,0) [0|64255] "V" Vector__XXX
 SG_ EngSparkPlug13 : 0|16@1+ (1,0) [0|64255] "V" Vector__XXX
 SG_ EngSparkPlug20 : 0|16@1+ (1,0) [0|64255] "V" Vector__XXX
 SG_ EngSparkPlug19 : 0|16@1+ (1,0) [0|64255] "V" Vector__XXX
 SG_ EngSparkPlug18 : 0|16@1+ (1,0) [0|64255] "V" Vector__XXX
 SG_ EngSparkPlug17 : 0|16@1+ (1,0) [0|64255] "V" Vector__XXX
 SG_ EngSparkPlug24 : 0|16@1+ (1,0) [0|64255] "V" Vector__XXX
 SG_ EngSparkPlug23 : 0|16@1+ (1,0) [0|64255] "V" Vector__XXX
 SG_ EngSparkPlug22 : 0|16@1+ (1,0) [0|64255] "V" Vector__XXX
 SG_ EngSparkPlug21 : 0|16@1+ (1,0) [0|64255] "V" Vector__XXX
 SG_ LaneDepartureWarningEnableCmd : 0|2@1+ (1,0) [0|3] "" Vector__XXX
 SG_ J2012DTCOccurrenceCount : 0|7@1+ (1,0) [0|126] "" Vector__XXX
 SG_ J2012DTCStatus : 0|1@1+ (1,0) [0|1] "" Vector__XXX
 SG_ J2012DTC : 0|40@1+ (1,0) [0|255] "" Vector__XXX
 SG_ NumberOfJ2012DTCs : 0|8@1+ (1,0) [0|250] "" Vector__XXX
 SG_ SteerAngleSensorCalibrated : 0|2@1+ (1,0) [0|3] "" Vector__XXX
 SG_ SteerAngleSensorActiveMode : 0|2@1+ (1,0) [0|3] "" Vector__XXX
 SG_ SteerWheelAngleRange : 0|16@1+ (0.0009765625,-31.374) [0|31.374] "rad" Vector__XXX
 SG_ SteerWheelAngleRangeCounterType : 0|2@1+ (1,0) [0|3] "" Vector__XXX
 SG_ SteerWheelAngleRangeCounter : 0|6@1+ (1,-32) [-32|29] "ranges" Vector__XXX
 SG_ SteerWheelAngle : 0|16@1+ (0.0009765625,-31.374) [-31.374|31.374] "rad" Vector__XXX
 SG_ SysSulfationLvl : 0|8@1+ (1,0) [0|250] "%" Vector__XXX
 SG_ SCROpIndActiveTraveledDist : 0|16@1+ (1,0) [0|64255] "km" Vector__XXX
 SG_ ConversionEfficiency : 0|8@1+ (0.4,0) [0|100] "%" Vector__XXX
 SG_ CommandedDEFConsumption : 0|16@1+ (0.05,0) [0|3212.75] "L/h" Vector__XXX
 SG_ DEFAvgConsumption : 0|16@1+ (0.05,0) [0|3212.75] "L/h" Vector__XXX
 SG_ TransferCaseStatus : 0|3@1+ (1,0) [0|7] "" Vector__XXX
 SG_ TransOilLevel2MeasurementStatus : 0|4@1+ (1,0) [0|15] "" Vector__XXX
 SG_ TransOilLevel2CountdownTimer : 0|4@1+ (1,0) [0|13] "" Vector__XXX
 SG_ TransOilLevel2High_Low : 0|8@1+ (0.5,-62.5) [-62.5|62.5] "L" Vector__XXX
 SG_ TransOilTemp2 : 0|16@1+ (0.03125,-273) [-273|1734.96875] "°C" Vector__XXX
 SG_ TransOilLifeRemaining : 0|8@1+ (0.4,0) [0|100] "%" Vector__XXX
 SG_ TrnsTorqueConverterOilOutletTemp : 0|16@1+ (0.03125,-273) [-273|1734.96875] "°C" Vector__XXX
 SG_ TransOverheatIndicator : 0|2@1+ (1,0) [0|3] "" Vector__XXX
 SG_ TransOilLevelSwitch : 0|2@1+ (1,0) [0|3] "" Vector__XXX
 SG_ TransOilFilterRestrictionSwitch : 0|2@1+ (1,0) [0|3] "" Vector__XXX
 SG_ VehicleRoll : 0|16@1+ (0.0078125,-200) [-90|90] "deg" Vector__XXX
 SG_ TotalEngCruiseTime : 0|32@1+ (0.05,0) [0|210554060.75] "h" Vector__XXX
 SG_ TotalDriveAverageLoadFactor : 0|8@1+ (0.4,0) [0|100] "%" Vector__XXX
 SG_ TripDriveAverageLoadFactor : 0|8@1+ (0.4,0) [0|100] "%" Vector__XXX
 SG_ TripAverageEngSpeed : 0|16@1+ (0.125,0) [0|8031.875] "rpm" Vector__XXX
 SG_ TripMaxEngSpeed : 0|16@1+ (0.125,0) [0|8031.875] "rpm" Vector__XXX
 SG_ ImplementRearWorkLight : 0|2@1+ (1,0) [0|3] "" Vector__XXX
 SG_ ImplLeftFacingWorkLight : 0|2@1+ (1,0) [0|3] "" Vector__XXX
 SG_ ImplRightForwardWorkLight : 0|2@1+ (1,0) [0|3] "" Vector__XXX
 SG_ ImplLeftForwardWorkLight : 0|2@1+ (1,0) [0|3] "" Vector__XXX
 SG_ ImplRightFacingWorkLight : 0|2@1+ (1,0) [0|3] "" Vector__XXX
 SG_ ImplementOEMOption1Light : 0|2@1+ (1,0) [0|3] "" Vector__XXX
 SG_ ImplementOEMOption2Light : 0|2@1+ (1,0) [0|3] "" Vector__XXX
 SG_ TrctorFrontHighMdWkLights : 0|2@1+ (1,0) [0|3] "" Vector__XXX
 SG_ TractorFrontLowMdWkLights : 0|2@1+ (1,0) [0|3] "" Vector__XXX
 SG_ TractorSideHighMdWkLights : 0|2@1+ (1,0) [0|3] "" Vector__XXX
 SG_ TractorSideLowMdWkLights : 0|2@1+ (1,0) [0|3] "" Vector__XXX
 SG_ TractorRearHighMdWkLights : 0|2@1+ (1,0) [0|3] "" Vector__XXX
 SG_ TractorRearLowMdWkLights : 0|2@1+ (1,0) [0|3] "" Vector__XXX
 SG_ TrctorUndersideMdWkLights : 0|2@1+ (1,0) [0|3] "" Vector__XXX
 SG_ RearFogLights : 0|2@1+ (1,0) [0|3] "" Vector__XXX
 SG_ TractorMarkerLight : 0|2@1+ (1,0) [0|3] "" Vector__XXX
 SG_ ImplementMarkerLight : 0|2@1+ (1,0) [0|3] "" Vector__XXX
 SG_ TractorClearanceLight : 0|2@1+ (1,0) [0|3] "" Vector__XXX
 SG_ ImplementClearanceLight : 0|2@1+ (1,0) [0|3] "" Vector__XXX
 SG_ LeftStopLight : 0|2@1+ (1,0) [0|3] "" Vector__XXX
 SG_ RightStopLight : 0|2@1+ (1,0) [0|3] "" Vector__XXX
 SG_ CenterStopLight : 0|2@1+ (1,0) [0|3] "" Vector__XXX
 SG_ BackUpLightAndAlarmHorn : 0|2@1+ (1,0) [0|3] "" Vector__XXX
 SG_ LeftTurnSignalLights : 0|2@1+ (1,0) [0|3] "" Vector__XXX
 SG_ RightTurnSignalLights : 0|2@1+ (1,0) [0|3] "" Vector__XXX
 SG_ RotatingBeaconLight : 0|2@1+ (1,0) [0|3] "" Vector__XXX
 SG_ TractorFrontFogLights : 0|2@1+ (1,0) [0|3] "" Vector__XXX
 SG_ HighBeamHeadLight : 0|2@1+ (1,0) [0|3] "" Vector__XXX
 SG_ LowBeamHeadLight : 0|2@1+ (1,0) [0|3] "" Vector__XXX
 SG_ AltBeamHeadLight : 0|2@1+ (1,0) [0|3] "" Vector__XXX
 SG_ RunningLight : 0|2@1+ (1,0) [0|3] "" Vector__XXX
 SG_ ImplementRearWorkLightCmd : 0|2@1+ (1,0) [0|3] "" Vector__XXX
 SG_ ImplLeftFacingWorkLightCmd : 0|2@1+ (1,0) [0|3] "" Vector__XXX
 SG_ ImplRightFwdWorkLightCmd : 0|2@1+ (1,0) [0|3] "" Vector__XXX
 SG_ LightingDataRqCmd : 0|2@1+ (1,0) [0|3] "" Vector__XXX
 SG_ ImplLeftForwardWorkLightCmd : 0|2@1+ (1,0) [0|3] "" Vector__XXX
 SG_ ImplRightFacingWorkLightCmd : 0|2@1+ (1,0) [0|3] "" Vector__XXX
 SG_ ImplOEMOption1LightCmd : 0|2@1+ (1,0) [0|3] "" Vector__XXX
 SG_ ImplOEMOption2LightCmd : 0|2@1+ (1,0) [0|3] "" Vector__XXX
 SG_ TrctrFrntHghMdWkLightsCmd : 0|2@1+ (1,0) [0|3] "" Vector__XXX
 SG_ TrctrFrntLowMdWkLightsCmd : 0|2@1+ (1,0) [0|3] "" Vector__XXX
 SG_ TrctrSdeHighMdWkLightsCmd : 0|2@1+ (1,0) [0|3] "" Vector__XXX
 SG_ TrctrSideLowMdWkLightsCmd : 0|2@1+ (1,0) [0|3] "" Vector__XXX
 SG_ TrctrRarHighMdWkLightsCmd : 0|2@1+ (1,0) [0|3] "" Vector__XXX
 SG_ TrctrRearLowMdWkLightsCmd : 0|2@1+ (1,0) [0|3] "" Vector__XXX
 SG_ TrctrUndrsdeMdWkLightsCmd : 0|2@1+ (1,0) [0|3] "" Vector__XXX
 SG_ RearFogLightsCmd : 0|2@1+ (1,0) [0|3] "" Vector__XXX
 SG_ TractorMarkerLightCmd : 0|2@1+ (1,0) [0|3] "" Vector__XXX
 SG_ ImplementMarkerLightCmd : 0|2@1+ (1,0) [0|3] "" Vector__XXX
 SG_ TractorClearanceLightCmd : 0|2@1+ (1,0) [0|3] "" Vector__XXX
 SG_ ImplementClearanceLightCmd : 0|2@1+ (1,0) [0|3] "" Vector__XXX
 SG_ LeftStopLightCmd : 0|2@1+ (1,0) [0|3] "" Vector__XXX
 SG_ RightStopLightCmd : 0|2@1+ (1,0) [0|3] "" Vector__XXX
 SG_ CenterStopLightCmd : 0|2@1+ (1,0) [0|3] "" Vector__XXX
 SG_ BackUpLightAndAlarmHornCmd : 0|2@1+ (1,0) [0|3] "" Vector__XXX
 SG_ LeftTurnSignalLightsCmd : 0|2@1+ (1,0) [0|3] "" Vector__XXX
 SG_ RightTurnSignalLightsCmd : 0|2@1+ (1,0) [0|3] "" Vector__XXX
 SG_ RotatingBeaconLightCmd : 0|2@1+ (1,0) [0|3] "" Vector__XXX
 SG_ TractorFrontFogLightsCmd : 0|2@1+ (1,0) [0|3] "" Vector__XXX
 SG_ HighBeamHeadLightCmd : 0|2@1+ (1,0) [0|3] "" Vector__XXX
 SG_ LowBeamHeadLightCmd : 0|2@1+ (1,0) [0|3] "" Vector__XXX
 SG_ AltBeamHeadLightCmd : 0|2@1+ (1,0) [0|3] "" Vector__XXX
 SG_ RunningLightCmd : 0|2@1+ (1,0) [0|3] "" Vector__XXX
 SG_ LandLevelingSystemEnableStatus : 0|2@1+ (1,0) [0|3] "" Vector__XXX
 SG_ BladeCtrlModeRight : 0|4@1+ (1,0) [0|15] "" Vector__XXX
 SG_ BladeCtrlModeLeft : 0|4@1+ (1,0) [0|15] "" Vector__XXX
 SG_ BladeCtrlMode : 0|8@1+ (1,0) [0|255] "" Vector__XXX
 SG_ BladeDurationAndDirection : 0|16@1+ (0.1,-3276.8) [-3276.8|3148.7] "sec" Vector__XXX
 SG_ EngActualIgntTiming : 0|16@1+ (0.0078125,-200) [-200|301.99] "deg" Vector__XXX
 SG_ EngDesiredIgntTiming3 : 0|16@1+ (0.0078125,-200) [-200|301.99] "deg" Vector__XXX
 SG_ EngDesiredIgntTiming2 : 0|16@1+ (0.0078125,-200) [-200|301.99] "deg" Vector__XXX
 SG_ EngDesiredIgntTiming1 : 0|16@1+ (0.0078125,-200) [-200|301.99] "deg" Vector__XXX
 SG_ EngCyl20IgntTiming : 0|16@1+ (0.0078125,-200) [-200|301.99] "deg" Vector__XXX
 SG_ EngCyl19IgntTiming : 0|16@1+ (0.0078125,-200) [-200|301.99] "deg" Vector__XXX
 SG_ EngCyl18IgntTiming : 0|16@1+ (0.0078125,-200) [-200|301.99] "deg" Vector__XXX
 SG_ EngCyl17IgntTiming : 0|16@1+ (0.0078125,-200) [-200|301.99] "deg" Vector__XXX
 SG_ EngCyl16IgntTiming : 0|16@1+ (0.0078125,-200) [-200|301.99] "deg" Vector__XXX
 SG_ EngCyl15IgntTiming : 0|16@1+ (0.0078125,-200) [-200|301.99] "deg" Vector__XXX
 SG_ EngCyl14IgntTiming : 0|16@1+ (0.0078125,-200) [-200|301.99] "deg" Vector__XXX
 SG_ EngCyl13IgntTiming : 0|16@1+ (0.0078125,-200) [-200|301.99] "deg" Vector__XXX
 SG_ EngCyl12IgntTiming : 0|16@1+ (0.0078125,-200) [-200|301.99] "deg" Vector__XXX
 SG_ EngCyl11IgntTiming : 0|16@1+ (0.0078125,-200) [-200|301.99] "deg" Vector__XXX
 SG_ EngCyl10IgntTiming : 0|16@1+ (0.0078125,-200) [-200|301.99] "deg" Vector__XXX
 SG_ EngCyl9IgntTiming : 0|16@1+ (0.0078125,-200) [-200|301.99] "deg" Vector__XXX
 SG_ EngCyl8IgntTiming : 0|16@1+ (0.0078125,-200) [-200|301.99] "deg" Vector__XXX
 SG_ EngCyl7IgntTiming : 0|16@1+ (0.0078125,-200) [-200|301.99] "deg" Vector__XXX
 SG_ EngCyl6IgntTiming : 0|16@1+ (0.0078125,-200) [-200|301.99] "deg" Vector__XXX
 SG_ EngCyl5IgntTiming : 0|16@1+ (0.0078125,-200) [-200|301.99] "deg" Vector__XXX
 SG_ EngCyl4IgntTiming : 0|16@1+ (0.0078125,-200) [-200|301.99] "deg" Vector__XXX
 SG_ EngCyl3IgntTiming : 0|16@1+ (0.0078125,-200) [-200|301.99] "deg" Vector__XXX
 SG_ EngCyl2IgntTiming : 0|16@1+ (0.0078125,-200) [-200|301.99] "deg" Vector__XXX
 SG_ EngCyl1IgntTiming : 0|16@1+ (0.0078125,-200) [-200|301.99] "deg" Vector__XXX
 SG_ EngCyl20IgntTransSecondOutput : 0|8@1+ (1,-125) [-125|125] "%" Vector__XXX
 SG_ EngCyl19IgntTransSecondOutput : 0|8@1+ (1,-125) [-125|125] "%" Vector__XXX
 SG_ EngCyl18IgntTransSecondOutput : 0|8@1+ (1,-125) [-125|125] "%" Vector__XXX
 SG_ EngCyl17IgntTransSecondOutput : 0|8@1+ (1,-125) [-125|125] "%" Vector__XXX
 SG_ EngCyl16IgntTransSecondOutput : 0|8@1+ (1,-125) [-125|125] "%" Vector__XXX
 SG_ EngCyl15IgntTransSecondOutput : 0|8@1+ (1,-125) [-125|125] "%" Vector__XXX
 SG_ EngCyl14IgntTransSecondOutput : 0|8@1+ (1,-125) [-125|125] "%" Vector__XXX
 SG_ EngCyl13IgntTransSecondOutput : 0|8@1+ (1,-125) [-125|125] "%" Vector__XXX
 SG_ EngCyl12IgntTransSecondOutput : 0|8@1+ (1,-125) [-125|125] "%" Vector__XXX
 SG_ EngCyl11IgntTransSecondOutput : 0|8@1+ (1,-125) [-125|125] "%" Vector__XXX
 SG_ EngCyl10IgntTransSecondOutput : 0|8@1+ (1,-125) [-125|125] "%" Vector__XXX
 SG_ EngCyl9IgntTransSecondOutput : 0|8@1+ (1,-125) [-125|125] "%" Vector__XXX
 SG_ EngCyl8IgntTransSecondOutput : 0|8@1+ (1,-125) [-125|125] "%" Vector__XXX
 SG_ EngCyl7IgntTransSecondOutput : 0|8@1+ (1,-125) [-125|125] "%" Vector__XXX
 SG_ EngCyl6IgntTransSecondOutput : 0|8@1+ (1,-125) [-125|125] "%" Vector__XXX
 SG_ EngCyl5IgntTransSecondOutput : 0|8@1+ (1,-125) [-125|125] "%" Vector__XXX
 SG_ EngCyl4IgntTransSecondOutput : 0|8@1+ (1,-125) [-125|125] "%" Vector__XXX
 SG_ EngCyl3IgntTransSecondOutput : 0|8@1+ (1,-125) [-125|125] "%" Vector__XXX
 SG_ EngCyl2IgntTransSecondOutput : 0|8@1+ (1,-125) [-125|125] "%" Vector__XXX
 SG_ EngCyl1IgntTransSecondOutput : 0|8@1+ (1,-125) [-125|125] "%" Vector__XXX
 SG_ EngOprtrPrmryIntrmdtSpdSlctState : 0|4@1+ (1,0) [0|15] "" Vector__XXX
 SG_ EngOprtrPrmryIntrmdteSpeedSelect : 0|4@1+ (1,0) [0|15] "" Vector__XXX
 SG_ EngTotalIdleHours : 0|32@1+ (0.05,0) [0|210554060.75] "h" Vector__XXX
 SG_ EngTotalIdleFuelUsed : 0|32@1+ (0.5,0) [0|2105540607.5] "L" Vector__XXX
 SG_ EngIntakeManifold6Temp : 0|8@1+ (1,-40) [-40|210] "°C" Vector__XXX
 SG_ EngIntakeManifold5Temp : 0|8@1+ (1,-40) [-40|210] "°C" Vector__XXX
 SG_ EngIntakeManifold4Temp : 0|8@1+ (1,-40) [-40|210] "°C" Vector__XXX
 SG_ EngIntakeManifold3Temp : 0|8@1+ (1,-40) [-40|210] "°C" Vector__XXX
 SG_ EngIntakeManifold2Temp : 0|8@1+ (1,-40) [-40|210] "°C" Vector__XXX
 SG_ EngTurbo4BoostPress : 0|16@1+ (0.125,0) [0|8031.875] "kPa" Vector__XXX
 SG_ EngTurbo3BoostPress : 0|16@1+ (0.125,0) [0|8031.875] "kPa" Vector__XXX
 SG_ EngTurbo2BoostPress : 0|16@1+ (0.125,0) [0|8031.875] "kPa" Vector__XXX
 SG_ SteerWheelAngle : 0|16@1+ (0.0009765625,-31.374) [-31.374|31.374] "rad" Vector__XXX
 SG_ EngOilPress : 0|8@1+ (4,0) [0|1000] "kPa" Vector__XXX
 SG_ EngFuelDeliveryPress : 0|8@1+ (4,0) [0|1000] "kPa" Vector__XXX
 SG_ EngCoolantPress2 : 0|8@1+ (4,0) [0|1000] "kPa" Vector__XXX
 SG_ ConversionEfficiency : 0|8@1+ (0.4,0) [0|100] "%" Vector__XXX
 SG_ CommandedDEFConsumption : 0|16@1+ (0.05,0) [0|3212.75] "L/h" Vector__XXX
 SG_ DEFAvgConsumption : 0|16@1+ (0.05,0) [0|3212.75] "L/h" Vector__XXX

CM_ SG_ 3221225472 Jystck6GrpXAxsLvrLftNgtvPsStatus "Reports when the current joystick grip position is on the negative travel side (back, left, counterclockwise, down) relative to the neutral position for that axis of travel.
00 Not on negative side of Neutral
01 On negative side of Neutral
10 ...";
CM_ SG_ 3221225472 Jystck6GripXAxisNeutralPosStatus "Reports when the current joystick grip position is in the neutral position for that axis of travel.  The neutral position measurement must be determined from some mechanism other than the axis position measurement device.
00 Not in Neutral Position
 ...";
CM_ SG_ 3221225472 Joystick5Button13PressedStatus "Reports when the joystick button has been pressed.

00 Button not pressed
01 Button pressed
10 Error Indicator
11 Not Available";
CM_ SG_ 3221225472 Joystick5Button14PressedStatus "Reports when the joystick button has been pressed.

00 Button not pressed
01 Button pressed
10 Error Indicator
11 Not Available";
CM_ SG_ 3221225472 Joystick5Button15PressedStatus "Reports when the joystick button has been pressed.

00 Button not pressed
01 Button pressed
10 Error Indicator
11 Not Available";
CM_ SG_ 3221225472 Joystick5Button16PressedStatus "Reports when the joystick button has been pressed.

00 Button not pressed
01 Button pressed
10 Error Indicator
11 Not Available";
CM_ SG_ 3221225472 Jystick5GripXAxisDetentPosStatus "Reports when the current joystick grip position is in the detent position for that axis of travel.

00 Not in the Detent Position
01 In the Detent Position
10 Error Indicator
11 Not Available";
CM_ SG_ 3221225472 Jystick5GripYAxisDetentPosStatus "Reports when the current joystick grip position is in the detent position for that axis of travel.

00 Not in the Detent Position
01 In the Detent Position
10 Error Indicator
11 Not Available";
CM_ SG_ 3221225472 Jystick5ThetaAxisDetentPosStatus "Reports when the current joystick position is in the detent position for that axis of travel.

00 Not in the Detent Position
01 In the Detent Position
10 Error Indicator
11 Not Available";
CM_ SG_ 3221225472 Joystick5ThetaAxisPos "The position of the joystick in the relative motion of travel from the neutral position.  Position value of 0 is Neutral and position value 1000 (100%) is the end of linear zone.  Value of 1022 indicates an error has occurred.";
CM_ SG_ 3221225472 Jystck5ThtAxsClckwsPstvPosStatus "Reports when the current joystick position is on the positive travel side (forward, right, clockwise, up) relative to the neutral position for that axis of travel.
00 Not on Positive side of Neutral
01 On positive side of Neutral
10 Error ...";
CM_ SG_ 3221225472 Jystck5ThtAxsCntrClckwsNgtvPsStt "Reports when the current joystick position is on the negative travel side (back, left, counterclockwise, down) relative to the neutral position for that axis of travel.
00 Not on negative side of Neutral
01 On negative side of Neutral
10 Error ...";
CM_ SG_ 3221225472 Jystck5ThetaAxisNeutralPosStatus "Reports when the current joystick position is in the neutral position for that axis of travel.  The neutral position measurement must be determined from some mechanism other than the axis position measurement device.
00 Not in Neutral Position
01 ...";
CM_ SG_ 3221225472 Joystick5GripYAxisPos "The position of the joystick grip in the relative motion of travel from the neutral position.  Position value of 0 is Neutral and position value 1000 (100%) is the end of linear zone.  Value of 1022 indicates an error has occurred.";
CM_ SG_ 3221225472 Jystck5GrpYAxsLvrFrwrdPstvPsStts "Reports when the current joystick grip position is on the positive travel side (forward, right, clockwise, up) relative to the neutral position for that axis of travel.
00 Not on Positive side of Neutral
01 On positive side of Neutral
10 Error ...";
CM_ SG_ 3221225472 Jystck5GrpYAxsLvrBckNgtvPsStatus "Reports when the current joystick grip position is on the negative travel side (back, left, counterclockwise, down) relative to the neutral position for that axis of travel.
00 Not on negative side of Neutral
01 On negative side of Neutral
10 ...";
CM_ SG_ 3221225472 Jystck5GripYAxisNeutralPosStatus "Reports when the current joystick grip position is in the neutral position for that axis of travel.  The neutral position measurement must be determined from some mechanism other than the axis position measurement device.
00 Not in Neutral Position
 ...";
CM_ SG_ 3221225472 Joystick5GripXAxisPos "The position of the joystick grip in the relative motion of travel from the neutral position.  Position value of 0 is Neutral and position value 1000 (100%) is the end of linear zone.  Value of 1022 indicates an error has occurred.";
CM_ SG_ 3221225472 Jystck5GrpXAxsLvrRghtPstvPsSttus "Reports when the current joystick grip position is on the positive travel side (forward, right, clockwise, up) relative to the neutral position for that axis of travel.
00 Not on Positive side of Neutral
01 On positive side of Neutral
10 Error ...";
CM_ SG_ 3221225472 Jystck5GrpXAxsLvrLftNgtvPsStatus "Reports when the current joystick grip position is on the negative travel side (back, left, counterclockwise, down) relative to the neutral position for that axis of travel.
00 Not on negative side of Neutral
01 On negative side of Neutral
10 ...";
CM_ SG_ 3221225472 Jystck5GripXAxisNeutralPosStatus "Reports when the current joystick grip position is in the neutral position for that axis of travel.  The neutral position measurement must be determined from some mechanism other than the axis position measurement device.
00 Not in Neutral Position
 ...";
CM_ SG_ 3221225472 Joystick4Button13PressedStatus "Reports when the joystick button has been pressed.

00 Button not pressed
01 Button pressed
10 Error Indicator
11 Not Available";
CM_ SG_ 3221225472 Joystick4Button14PressedStatus "Reports when the joystick button has been pressed.

00 Button not pressed
01 Button pressed
10 Error Indicator
11 Not Available";
CM_ SG_ 3221225472 Joystick4Button15PressedStatus "Reports when the joystick button has been pressed.

00 Button not pressed
01 Button pressed
10 Error Indicator
11 Not Available";
CM_ SG_ 3221225472 Joystick4Button16PressedStatus "Reports when the joystick button has been pressed.

00 Button not pressed
01 Button pressed
10 Error Indicator
11 Not Available";
CM_ SG_ 3221225472 Jystick4GripXAxisDetentPosStatus "Reports when the current joystick grip position is in the detent position for that axis of travel.

00 Not in the Detent Position
01 In the Detent Position
10 Error Indicator
11 Not Available";
CM_ SG_ 3221225472 Jystick4GripYAxisDetentPosStatus "Reports when the current joystick grip position is in the detent position for that axis of travel.

00 Not in the Detent Position
01 In the Detent Position
10 Error Indicator
11 Not Available";
CM_ SG_ 3221225472 Jystick4ThetaAxisDetentPosStatus "Reports when the current joystick position is in the detent position for that axis of travel.

00 Not in the Detent Position
01 In the Detent Position
10 Error Indicator
11 Not Available";
CM_ SG_ 3221225472 Joystick4ThetaAxisPos "The position of the joystick in the relative motion of travel from the neutral position.  Position value of 0 is Neutral and position value 1000 (100%) is the end of linear zone.  Value of 1022 indicates an error has occurred.";
CM_ SG_ 3221225472 Jystck4ThtAxsClckwsPstvPosStatus "Reports when the current joystick position is on the positive travel side (forward, right, clockwise, up) relative to the neutral position for that axis of travel.
00 Not on Positive side of Neutral
01 On positive side of Neutral
10 Error ...";
CM_ SG_ 3221225472 Jystck4ThtAxsCntrClckwsNgtvPsStt "Reports when the current joystick position is on the negative travel side (back, left, counterclockwise, down) relative to the neutral position for that axis of travel.
00 Not on negative side of Neutral
01 On negative side of Neutral
10 Error ...";
CM_ SG_ 3221225472 Jystck4ThetaAxisNeutralPosStatus "Reports when the current joystick position is in the neutral position for that axis of travel.  The neutral position measurement must be determined from some mechanism other than the axis position measurement device.
00 Not in Neutral Position
01 ...";
CM_ SG_ 3221225472 Joystick4GripYAxisPos "The position of the joystick grip in the relative motion of travel from the neutral position.  Position value of 0 is Neutral and position value 1000 (100%) is the end of linear zone.  Value of 1022 indicates an error has occurred.";
CM_ SG_ 3221225472 Jystck4GrpYAxsLvrFrwrdPstvPsStts "Reports when the current joystick grip position is on the positive travel side (forward, right, clockwise, up) relative to the neutral position for that axis of travel.
00 Not on Positive side of Neutral
01 On positive side of Neutral
10 Error ...";
CM_ SG_ 3221225472 Jystck4GrpYAxsLvrBckNgtvPsStatus "Reports when the current joystick grip position is on the negative travel side (back, left, counterclockwise, down) relative to the neutral position for that axis of travel.
00 Not on negative side of Neutral
01 On negative side of Neutral
10 ...";
CM_ SG_ 3221225472 Jystck4GripYAxisNeutralPosStatus "Reports when the current joystick grip position is in the neutral position for that axis of travel.  The neutral position measurement must be determined from some mechanism other than the axis position measurement device.
00 Not in Neutral Position
 ...";
CM_ SG_ 3221225472 Joystick4GripXAxisPos "The position of the joystick grip in the relative motion of travel from the neutral position.  Position value of 0 is Neutral and position value 1000 (100%) is the end of linear zone.  Value of 1022 indicates an error has occurred.";
CM_ SG_ 3221225472 Jystck4GrpXAxsLvrRghtPstvPsSttus "Reports when the current joystick grip position is on the positive travel side (forward, right, clockwise, up) relative to the neutral position for that axis of travel.
00 Not on Positive side of Neutral
01 On positive side of Neutral
10 Error ...";
CM_ SG_ 3221225472 Jystck4GrpXAxsLvrLftNgtvPsStatus "Reports when the current joystick grip position is on the negative travel side (back, left, counterclockwise, down) relative to the neutral position for that axis of travel.
00 Not on negative side of Neutral
01 On negative side of Neutral
10 ...";
CM_ SG_ 3221225472 Jystck4GripXAxisNeutralPosStatus "Reports when the current joystick grip position is in the neutral position for that axis of travel.  The neutral position measurement must be determined from some mechanism other than the axis position measurement device.
00 Not in Neutral Position
 ...";
CM_ SG_ 3221225472 Joystick10Button13PressedStatus "Reports when the joystick button has been pressed.

00 Button not pressed
01 Button pressed
10 Error Indicator
11 Not Available";
CM_ SG_ 3221225472 Joystick10Button14PressedStatus "Reports when the joystick button has been pressed.

00 Button not pressed
01 Button pressed
10 Error Indicator
11 Not Available";
CM_ SG_ 3221225472 Joystick10Button15PressedStatus "Reports when the joystick button has been pressed.

00 Button not pressed
01 Button pressed
10 Error Indicator
11 Not Available";
CM_ SG_ 3221225472 Joystick10Button16PressedStatus "Reports when the joystick button has been pressed.

00 Button not pressed
01 Button pressed
10 Error Indicator
11 Not Available";
CM_ SG_ 3221225472 Jystck10GripXAxisDetentPosStatus "Reports when the current joystick grip position is in the detent position for that axis of travel.

00 Not in the Detent Position
01 In the Detent Position
10 Error Indicator
11 Not Available";
CM_ SG_ 3221225472 Jystck10GripYAxisDetentPosStatus "Reports when the current joystick grip position is in the detent position for that axis of travel.

00 Not in the Detent Position
01 In the Detent Position
10 Error Indicator
11 Not Available";
CM_ SG_ 3221225472 Jystck10ThetaAxisDetentPosStatus "Reports when the current joystick position is in the detent position for that axis of travel.

00 Not in the Detent Position
01 In the Detent Position
10 Error Indicator
11 Not Available";
CM_ SG_ 3221225472 Joystick10ThetaAxisPos "The position of the joystick in the relative motion of travel from the neutral position.  Position value of 0 is Neutral and position value 1000 (100%) is the end of linear zone.  Value of 1022 indicates an error has occurred.";
CM_ SG_ 3221225472 Jystck10ThtAxsClckwsPstvPsStatus "Reports when the current joystick position is on the positive travel side (forward, right, clockwise, up) relative to the neutral position for that axis of travel.
00 Not on Positive side of Neutral
01 On positive side of Neutral
10 Error ...";
CM_ SG_ 3221225472 Jystck10ThtAxsCntrClckwsNgtvPsSt "Reports when the current joystick position is on the negative travel side (back, left, counterclockwise, down) relative to the neutral position for that axis of travel.
00 Not on negative side of Neutral
01 On negative side of Neutral
10 Error ...";
CM_ SG_ 3221225472 Jystck10ThtaAxisNeutralPosStatus "Reports when the current joystick position is in the neutral position for that axis of travel.  The neutral position measurement must be determined from some mechanism other than the axis position measurement device.
00 Not in Neutral Position
01 ...";
CM_ SG_ 3221225472 Joystick10GripYAxisPos "The position of the joystick grip in the relative motion of travel from the neutral position.  Position value of 0 is Neutral and position value 1000 (100%) is the end of linear zone.  Value of 1022 indicates an error has occurred.";
CM_ SG_ 3221225472 Jystck10GrpYAxsLvrFrwrdPstvPsStt "Reports when the current joystick grip position is on the positive travel side (forward, right, clockwise, up) relative to the neutral position for that axis of travel.
00 Not on Positive side of Neutral
01 On positive side of Neutral
10 Error ...";
CM_ SG_ 3221225472 Jystck10GrpYAxsLvrBckNgtvPsSttus "Reports when the current joystick grip position is on the negative travel side (back, left, counterclockwise, down) relative to the neutral position for that axis of travel.
00 Not on negative side of Neutral
01 On negative side of Neutral
10 ...";
CM_ SG_ 3221225472 Jystck10GrpYAxisNeutralPosStatus "Reports when the current joystick grip position is in the neutral position for that axis of travel.  The neutral position measurement must be determined from some mechanism other than the axis position measurement device.
00 Not in Neutral Position
 ...";
CM_ SG_ 3221225472 Joystick10GripXAxisPos "The position of the joystick grip in the relative motion of travel from the neutral position.  Position value of 0 is Neutral and position value 1000 (100%) is the end of linear zone.  Value of 1022 indicates an error has occurred.";
CM_ SG_ 3221225472 Jystck10GrpXAxsLvrRghtPstvPsStts "Reports when the current joystick grip position is on the positive travel side (forward, right, clockwise, up) relative to the neutral position for that axis of travel.
00 Not on Positive side of Neutral
01 On positive side of Neutral
10 Error ...";
CM_ SG_ 3221225472 Jystck10GrpXAxsLvrLftNgtvPsSttus "Reports when the current joystick grip position is on the negative travel side (back, left, counterclockwise, down) relative to the neutral position for that axis of travel.
00 Not on negative side of Neutral
01 On negative side of Neutral
10 ...";
CM_ SG_ 3221225472 Jystck10GrpXAxisNeutralPosStatus "Reports when the current joystick grip position is in the neutral position for that axis of travel.  The neutral position measurement must be determined from some mechanism other than the axis position measurement device.
00 Not in Neutral Position
 ...";
CM_ SG_ 3221225472 FuelTankTransferPumpPress "Gage pressure of the fuel in the system as delivered by the transfer pump.";
CM_ SG_ 3221225472 FuelTankTransferPump "Operating state of the fuel tank transfer pump. The fuel tank transfer pump transfers fuel from the secondary fuel tank to the primary fuel tank.

00 = Off
01 = On
10 = Error
11 = Not available";
CM_ SG_ 3221225472 EngFuelFilterIntakeAbsPress "Absolute pressure of fuel at the intake of the fuel filter (suction side) located between the fuel tank and the fuel supply pump.  See Figures SPN16_A & SPN16_B.";
CM_ SG_ 3221225472 EngFuelDeliveryPress "Gage pressure of fuel in system as delivered from supply pump to the injection pump. See SPN 94 for alternate resolution.

See also SPN 5578 for Engine Fuel Delivery Absolute Pressure.";
CM_ SG_ 3221225472 EngOilPress "Gage pressure of oil in engine lubrication system as provided by oil pump. See SPN 100 for alternate resolution.";
CM_ SG_ 3221225472 EngExhstGsRcrcltn1OutletAbsPress "EGR outlet absolute pressure is measured after the EGR 1 valve. See SPN 5019 for 1 byte resolution.";
CM_ SG_ 3221225472 EngExhstGsRcrcltn1IntakeAbsPress "EGR intake absolute pressure measured before the EGR 1 valve.";
CM_ SG_ 3221225472 EngCoolantPress2 "Gage pressure of liquid found in the engine coolant system - second instance.

See SPN 7313 for alternate range and resolution.";
CM_ SG_ 3221225472 EngExhstGsRcrcltn2IntakeAbsPress "EGR intake absolute pressure measured before the EGR 2 valve.";
CM_ SG_ 3221225472 EngExhstGsRcrcltn2OutletAbsPress "Absolute Pressure immediately after the EGR2 valve";
CM_ SG_ 3221225472 EngExhstGsRcrclation2IntakePress "EGR2 intake gauge pressure is measured after EGR2 cooler and before EGR2 valve";
CM_ SG_ 3221225472 EngExhstGsRcirculation2DiffPress "Differential Pressure across the Exhaust Gas Recirculation 2 (EGR2) system.";
CM_ SG_ 3221225472 CmmndedEngFuelInjectionCtrlPress "Provides the commanded set point value for the engine fuel injection control pressure.";
CM_ SG_ 3221225472 CommandedEngFuelRailPress "Provides the commanded set point value for the engine fuel rail gage pressure";
CM_ SG_ 3221225472 EngExhstGsRcirculation2Valve2Pos "The position of the second exhaust gas recirculation valve of EGR 2 expressed as a percentage of full travel. 0% means the valve is closed and no exhaust gas is flowing into the air stream. 100% means the valve is fully opened.";
CM_ SG_ 3221225472 EngExhstGsRecirculation2ValvePos "Position of EGR2 valve expressed as a percentage of full travel. 0% means the valve is closed and no exhaust gas is flowing into the air stream. 100% means the valve is fully opened.";
CM_ SG_ 3221225472 EngExhstGsRcrcltn2Valve2PosError "The position error of the Exhaust Gas Recirculation 2 valve 2, determined as the actual position (SPN 5265) minus the commanded position (SPN 5263).";
CM_ SG_ 3221225472 EngExhstGsRcrcltn2Valve1PosError "The position error of the Exhaust Gas Recirculation 2 valve, determined as the actual position (SPN 5264) minus the commanded position (SPN 5262).";
CM_ SG_ 3221225472 EngExhstGsRcrculation2Valve2Ctrl "Desired percentage of maximum Exhaust Gas Recirculation 2 (EGR2) valve 2 opening. 0% means the valve is closed. 100% means maximum opening (full gas flow).";
CM_ SG_ 3221225472 EngExhstGsRcirculation2ValveCtrl "Desired percentage of maximum Exhaust Gas Recirculation 2 (EGR2) valve opening. 0% means the valve is closed. 100% means maximum opening (full gas flow).";
CM_ SG_ 3221225472 EGR2CoolerBypassActuatorPos "EGR2 Cooler Bypass Actuator position, where 0% = Fully Closed (no gas flowing through the bypass), and 100% = Fully Open..";
CM_ SG_ 3221225472 EngExhstGsRcrcltn2ClerEfficiency "Exhaust Gas Recirculation 2 cooler efficiency is an indication of the cooler's ability to reduce the temperature of the exhaust gas that is being recirculated back to the intake. 0% = no reduction in temperature, 100% = maximum cooling. The EGR 2 ...";
CM_ SG_ 3221225472 EngExhstGsRcrcltn2ClrIntkGsAbsPr "Exhaust Gas Recirculation 2 gas absolute pressure is measured at EGR2 cooler intake. See SPN 5253 for EGR2 pressure measured at the EGR2 cooler outlet before the valve.";
CM_ SG_ 3221225472 EngExhstGsRcrcltn2ClerIntakeTemp "Exhaust Gas Recirculation 2 (EGR2) Temperature measured at EGR2 cooler intake. See SPN 5255 for Engine EGR2 temperature.";
CM_ SG_ 3221225472 EngFrictionPercentTorquePoint7 "The static portion of the friction torque at speed point 7 (SPN 533) of the engine torque map in the engine configuration message.  This parameter does not include Estimated Pumping - Percent Torque (SPN 5398) and is expected to change with ...";
CM_ SG_ 3221225472 EngFrictionPercentTorquePoint6 "For engine configuration map modes 1 and 2, this is the static portion of the friction torque at speed point 6 (SPN 532) of the engine torque map.  For engine configuration map mode 3, this parameter is the static portion of the friction torque at ...";
CM_ SG_ 3221225472 EngFrictionPercentTorquePoint5 "The static portion of the friction torque at speed point 5 (SPN 531) of the engine torque map in the engine configuration message.  This parameter does not include Estimated Pumping - Percent Torque (SPN 5398) and is expected to change with ...";
CM_ SG_ 3221225472 EngFrictionPercentTorquePoint4 "The static portion of the friction torque at speed point 4 (SPN 530) of the engine torque map in the engine configuration message.  This parameter does not include Estimated Pumping - Percent Torque (SPN 5398) and is expected to change with ...";
CM_ SG_ 3221225472 EngFrictionPercentTorquePoint3 "The static portion of the friction torque at speed point 3 (SPN 529) of the engine torque map in the engine configuration message.  This parameter does not include Estimated Pumping - Percent Torque (SPN 5398) and is expected to change with ...";
CM_ SG_ 3221225472 EngFrictionPercentTorquePoint2 "The static portion of the friction torque at speed point 2 (SPN 528) of the engine torque map in the engine configuration message.  This parameter does not include Estimated Pumping - Percent Torque (SPN 5398) and is expected to change with ...";
CM_ SG_ 3221225472 EngFrctnPrcentTorqueAtIdlePoint1 "The static portion of the friction torque at speed point 1 (SPN 188) of the engine torque map in the engine configuration message.  This parameter does not include Estimated Pumping - Percent Torque (SPN 5398) and is expected to change with ...";
CM_ SG_ 3221225472 DslPrtcltFltrActvRgnrtnInhbt5629 "Indicates the state of diesel particulate filter active regeneration inhibition due to low exhaust pressure.
00 not inhibited
01 inhibited
10 reserved for SAE assignment
11 not available
This SPN indicates the reason for the diesel particulate ...";
CM_ SG_ 3221225472 AFT1DPFCondNotMetForActiveRegen "Indicates that diesel particulate filter 1 is not able to begin or continue an active regenerate event at the current engine operating conditions.
00 active DPF regeneration not inhibited
01 active DPF regeneration inhibited
10 reserved for SAE ...";
CM_ SG_ 3221225472 HydrocarbonDoserPurgingEnable "Purging enable of the Hydrocarbon Doser (HCD).

00 Purging not enabled
01 Purging enabled - less urgent
10 Purging enabled - urgent
11 Not available";
CM_ SG_ 3221225472 DslPrtcltFltrActvRgnrtnFrcdSttus "Indicates the forced execution status of diesel particulate filter regeneration.
000 Not Active
001 Active - Forced by Switch (See SPN 3696)
010 Active - Forced by Service Tool
011 Reserved for SAE Assignment
100 Reserved for SAE Assignment
 ...";
CM_ SG_ 3221225472 ExhaustSystemHighTempLampCmd "Command to control the exhaust system high temperature lamp.  This lamp indicates that the exhaust system temperature is high.
000 Off
001 On - solid
010 reserved for SAE assignment
011 reserved for SAE assignment
100 reserved for SAE ...";
CM_ SG_ 3221225472 DslPrtcltFltrAtmtcActvRgnrtnIntt "Indicates the configuration of diesel particulate filter active regeneration automatic initiation.

00 not enabled
01 enabled
10 reserved for SAE assignment
11 not available";
CM_ SG_ 3221225472 DslPrtcltFltrActvRgnrtnInhbt3717 "Indicates the state of diesel particulate filter active regeneration inhibition due to vehicle speed being less than the allowed vehicle speed.
00 not inhibited
01 inhibited
10 reserved for SAE assignment
11 not available
This SPN indicates the ...";
CM_ SG_ 3221225472 DslPrtcltFltrActvRgnrtnInhbtdDTE "Indicates the state of diesel particulate filter active regeneration inhibition due to the engine not being warmed up.
00 not inhibited
01 inhibited
10 reserved for SAE assignment
11 not available
This SPN indicates the reason for the diesel ...";
CM_ SG_ 3221225472 DslPrtcltFltrActvRgnrtnInhbt3715 "Indicates the state of diesel particulate filter active regeneration inhibition due to a permanent system lockout.
00 not inhibited
01 inhibited
10 reserved for SAE assignment
11 not available
This SPN indicates the reason for the diesel ...";
CM_ SG_ 3221225472 DslPrtcltFltrActvRgnrtnInhbtdDTT "Indicates the state of diesel particulate filter active regeneration inhibition due to a temporary system lockout.
00 not inhibited
01 inhibited
10 reserved for SAE assignment
11 not available
This SPN indicates the reason for the diesel ...";
CM_ SG_ 3221225472 DslPrtcltFltrActvRgnrtnInhbt3713 "Indicates the state of diesel particulate filter active regeneration inhibition due to a system timeout.
00 not inhibited
01 inhibited
10 reserved for SAE assignment
11 not available
This SPN indicates the reason for the diesel particulate ...";
CM_ SG_ 3221225472 DslPrtcltFltrActvRgnrtnInhbt3712 "Indicates the state of diesel particulate filter active regeneration inhibition due to a system fault being active.
00 not inhibited
01 inhibited
10 reserved for SAE assignment
11 not available
This SPN indicates the reason for the diesel ...";
CM_ SG_ 3221225472 DslPrtcltFltrActvRgnrtnInhbtdDTL "Indicates the state of diesel particulate filter active regeneration inhibition due to the exhaust temperature being too low.  This implies that the diesel particulate filter and/or oxidation catalyst are likewise too cold for active regeneration.
 ...";
CM_ SG_ 3221225472 DslPrtcltFltrActvRgnrtnInhbt3710 "Indicates the state of diesel particulate filter active regeneration inhibition due to the parking brake being not set.
00 not inhibited
01 inhibited
10 reserved for SAE assignment
11 not available
This SPN indicates the reason for the diesel ...";
CM_ SG_ 3221225472 DslPrtcltFltrActvRgnrtnInhbtdDTV "Indicates the state of diesel particulate filter active regeneration inhibition due to the vehicle speed being above an allowed limit.
00 not inhibited
01 inhibited
10 reserved for SAE assignment
11 not available
This SPN indicates the reason ...";
CM_ SG_ 3221225472 DslPrtcltFltrActvRgnrtnInhbtdDTO "Indicates the state of diesel particulate filter active regeneration inhibition due to the transmission being out of neutral.
00 not inhibited
01 inhibited
10 reserved for SAE assignment
11 not available
This SPN indicates the reason for the ...";
CM_ SG_ 3221225472 DslPrtcltFltrActvRgnrtnInhbtdDTA "Indicates the state of diesel particulate filter active regeneration inhibition due to the accelerator pedal being off idle.
00 not inhibited
01 inhibited
10 reserved for SAE assignment
11 not available
This SPN indicates the reason for the ...";
CM_ SG_ 3221225472 DslPrtcltFltrActvRgnrtnInhbtdDTP "Indicates the state of diesel particulate filter active regeneration inhibition due to the PTO being active.
00 not inhibited
01 inhibited
10 reserved for SAE assignment
11 not available
This SPN indicates the reason for the diesel particulate ...";
CM_ SG_ 3221225472 DslPrtcltFltrActvRgnrtnInhbtdDTS "Indicates the state of diesel particulate filter active regeneration inhibition due to the service brake being active.
00 not inhibited
01 inhibited
10 reserved for SAE assignment
11 not available
This SPN indicates the reason for the diesel ...";
CM_ SG_ 3221225472 DslPrtcltFltrActvRgnrtnInhbtdDTC "Indicates the state of diesel particulate filter active regeneration inhibition due to the clutch being disengaged.
00 not inhibited
01 inhibited
10 reserved for SAE assignment
11 not available
This SPN indicates the reason for the diesel ...";
CM_ SG_ 3221225472 DslPrtcltFltrActvRgnrtnInhbtdDTI "Indicates the state of diesel particulate filter active regeneration inhibition due to the Diesel Particulate Filter Regeneration Inhibit Switch.
00 not inhibited
01 inhibited
10 reserved for SAE assignment
11 not available
This SPN indicates ...";
CM_ SG_ 3221225472 DslPrtcltFltrActvRgnrtnInhbtdStt "Indicates the state of diesel particulate filter active regeneration inhibition.
00 not inhibited
01 inhibited
10 reserved for SAE assignment
11 not available
This SPN indicates the reason for the diesel particulate filter regeneration not ...";
CM_ SG_ 3221225472 AFTDPFStatus "Indicates the state of the diesel particulate filter regeneration need and urgency.  This is an aggregate of bank 1 and bank 2.  It is a system status and not individual bank status.
000 Regeneration not needed
001 Regeneration needed - lowest ...";
CM_ SG_ 3221225472 AFTDPFActiveRegenStatus "Indicates the state of diesel particulate filter active regeneration.  This is an aggregate of bank 1 and bank 2.  It is a system status and not individual bank status.
00 not active
01 active
10 regeneration needed - automatically initiated ...";
CM_ SG_ 3221225472 AFTDPFPassiveRegenStatus "Indicates the state of diesel particulate filter passive regeneration.  This is an aggregate of bank 1 and bank 2.  It is a system status and not individual bank status.


00 not active
01 active
10 reserved for SAE assignment
11 not available";
CM_ SG_ 3221225472 DieselParticulateFilterLampCmd "Command to control the diesel particulate filter lamp.
000 Off
001 On - solid
010 reserved for SAE assignment
011 reserved for SAE assignment
100 On - fast blink (1 HZ)
101 reserved for SAE assignment
110 reserved for SAE assignment
111 not ...";
CM_ SG_ 3221225472 AFT2DPFSootSignalMin "Minimum output signal level of the current soot measurement from diesel particulate filter 2 soot sensor.  This is a statistical value, not the minimum sensing capability of the sensor.";
CM_ SG_ 3221225472 AFT2DPFSootSignalMax "Maximum output signal level of the current soot measurement from diesel particulate filter 2 soot sensor.  This is a statistical value, not the maximum sensing capability of the sensor.";
CM_ SG_ 3221225472 AFT2DPFSootSignalStdDeviation "Standard deviation of the soot measurement from diesel particulate filter 2 soot sensor.";
CM_ SG_ 3221225472 DslPrtcltFltr2StSnsrECUIntrnlTmp "Internal temperature of the diesel particulate filter 2 soot sensor ECU.";
CM_ SG_ 3221225472 AFT2DPFSootSnsrPreliminaryFMI "Used to identify the applicable J1939-73 FMI detected in the soot sensor signal by the manufacturer's sensor control software in diesel particulate filter 2. When there is no failure FMI 31 is sent. In the case of multiple failures the most severe ...";
CM_ SG_ 3221225472 AFT2DPFMedianSootSignal "Median output signal level from diesel particulate filter 2 soot sensor.";
CM_ SG_ 3221225472 AFT2DPFMeanSootSignal "Mean output signal level from diesel particulate filter 2 soot sensor.";
CM_ SG_ 3221225472 AFT2DPFSootDensity "Soot density in diesel particulate filter 2.";
CM_ SG_ 3221225472 AFT2DPFSootMass "Soot mass in diesel particulate filter 2.";
CM_ SG_ 3221225472 AFT1DPFSootSignalMin "Minimum output signal level of the current soot measurement from diesel particulate filter 1 soot sensor.  This is a statistical value, not the minimum sensing capability of the sensor.";
CM_ SG_ 3221225472 AFT1DPFSootSignalMax "Maximum output signal level of the current soot measurement from diesel particulate filter 1 soot sensor.  This is a statistical value, not the maximum sensing capability of the sensor.";
CM_ SG_ 3221225472 AFT1DPFSootSignalStdDeviation "Standard deviation of the soot measurement from diesel particulate filter 1 soot sensor.";
CM_ SG_ 3221225472 DslPrtcltFltr1StSnsrECUIntrnlTmp "Internal temperature of the diesel particulate filter 1 soot sensor ECU.";
CM_ SG_ 3221225472 AFT1DPFSootSnsrPreliminaryFMI "Used to identify the applicable J1939-73 FMI detected in the soot sensor signal by the manufacturer's sensor control software in diesel particulate filter 1. When there is no failure FMI 31 is sent. In the case of multiple failures the most severe ...";
CM_ SG_ 3221225472 AFT1DPFMedianSootSignal "Median output signal level from diesel particulate filter 1 soot sensor.";
CM_ SG_ 3221225472 AFT1DPFMeanSootSignal "Mean output signal level from diesel particulate filter 1 soot sensor.";
CM_ SG_ 3221225472 AFT1DPFSootDensity "Soot density in diesel particulate filter 1.";
CM_ SG_ 3221225472 AFT1DPFSootMass "Soot mass in diesel particulate filter 1.";
CM_ SG_ 3221225472 HillHolderLampData "This message will be transmitted by the controller that is illuminating the lamps.

00 - Lamp deactivated (Off)
01 - Lamp activated (On)
10 - Error
11 - Not Available";
CM_ SG_ 3221225472 VehicleBatteryChargingLampData "This parameter provides measured data from the Vehicle Battery Charging Lamp.

00 - Lamp deactivated (Off)
01 - Lamp activated (On)
10 - Error
11 - Not available";
CM_ SG_ 3221225472 VehicleHVACRecirculationLampData "This parameter provides measured data from the Vehicle HVAC Recirculation Lamp.

00 - Lamp deactivated (Off)
01 - Lamp activated (On)
10 - Error
11 - Not available";
CM_ SG_ 3221225472 VehicleAirPressLowLampData "This parameter provides measured data from the Vehicle Air Pressure Low Lamp.

00 - Lamp deactivated (Off)
01 - Lamp activated (On)
10 - Error
11 - Not available";
CM_ SG_ 3221225472 VehicleFuelLevelLowLampData "This parameter provides measured data from the Vehicle Fuel Level Low Lamp.

00 - Lamp deactivated (Off)
01 - Lamp activated (On)
10 - Error
11 - Not available";
CM_ SG_ 3221225472 VehicleBatteryVoltageLowLampData "This parameter provides measured data from the Vehicle Battery Voltage Low Lamp.

00 - Lamp deactivated (Off)
01 - Lamp activated (On)
10 - Error
11 - Not available";
CM_ SG_ 3221225472 VhclAcclerationRateLimitLampData "This parameter provides measured data from the Vehicle Acceleration Rate Limit Lamp.

00 - Lamp deactivated (Off)
01 - Lamp activated (On)
10 - Error
11 - Not available";
CM_ SG_ 3221225472 EngSpeedVeryHighLampData "This parameter provides measured data from the Engine Speed Very High Warning Lamp.

00 - Lamp Deactivated (Off)
01 - Lamp Activated (On)
10 - Error
11 - Not available";
CM_ SG_ 3221225472 EngSpeedHighLampData "This parameter provides measured data from the Engine Speed High Warning Lamp.

00 - Lamp Deactivated (Off)
01 - Lamp Activated (On)
10 - Error
11 - Not available";
CM_ SG_ 3221225472 EngCtrlMdule3ReadyForUseLampData "This parameter provides measured data from the Engine Control Module 3 Ready for Use Lamp.

00 - Lamp deactivated (Off)
01 - Lamp activated (On)
10 - Error
11 - Not Available";
CM_ SG_ 3221225472 EngCtrlMdule2ReadyForUseLampData "This parameter provides measured data from the Engine Control Module 2 Ready for Use Lamp.

00 - Lamp deactivated (Off)
01 - Lamp activated (On)
10 - Error
11 - Not Available";
CM_ SG_ 3221225472 EngCtrlMdule1ReadyForUseLampData "This parameter provides measured data from the Engine Control Module 1 Ready for Use Lamp.

00 - Lamp deactivated (Off)
01 - Lamp activated (On)
10 - Error
11 - Not Available";
CM_ SG_ 3221225472 EngWaitToStartLampData "This parameter provides measured data from the Engine Wait To Start Lamp.  See SPN 1081 for the command.

00 - Lamp deactived (off)
01 - Lamp actived (on)
10 - Error
11 - Not available";
CM_ SG_ 3221225472 EngFuelFilterRestrictedLampData "This parameter provides measured data from the Engine Fuel Filter Restricted Lamp.

00 - Lamp deactivated (Off)
01 - Lamp activated (On)
10 - Error
11 - Not available";
CM_ SG_ 3221225472 EngAirFilterRestrictionLampData "This parameter provides measured data from the Engine Air Filter Restriction Lamp.

00 - Lamp deactivated (Off)
01 - Lamp activated (On)
10 - Error
11 - Not available";
CM_ SG_ 3221225472 EngIdleManagementActiveLampData "This parameter provides measured data from the Engine Idle Management Active Lamp.

00 - Lamp deactivated (Off)
01 - Lamp activated (On)
10 - Error
11 - Not available";
CM_ SG_ 3221225472 EngCoolantLevelLowLampData "This parameter provides measured data from the Engine Coolant Level Low Lamp.

00 - Lamp deactivated (Off)
01 - Lamp activated (On)
10 - Error
11 - Not available";
CM_ SG_ 3221225472 EngCoolantTempHighLampData "This parameter provides measured data from the Engine Coolant Temperature High Lamp.

00 - Lamp deactivated (Off)
01 - Lamp activated (On)
10 - Error
11 - Not available";
CM_ SG_ 3221225472 EngOilPressLowLampData "This parameter provides measured data from the Engine Oil Pressure Low Lamp.

00 - Lamp deactivated (Off)
01 - Lamp activated (On)
10 - Error
11 - Not available";
CM_ SG_ 3221225472 CmprssnBrkEnblSwtchIndctrLmpData "This parameter provides measured data from the Compression Brake Enable Switch Indicator Lamp.

00 - Lamp deactivated (Off)
01 - Lamp activated (On)
10 - Error
11 - Not available";
CM_ SG_ 3221225472 EngBrakeActiveLampData "This parameter provides measured data from the Engine Brake Active Lamp.

00 - Lamp deactivated (Off)
01 - Lamp activated (On)
10 - Error
11 - Not available";
CM_ SG_ 3221225472 OBDMalfunctionIndicatorLampData "This parameter provides measured data from the OBD Malfunction Indicator Lamp.

00 - Lamp deactivated (Off)
01 - Lamp activated (On)
10 - Error
11 - Not available";
CM_ SG_ 3221225472 EngRedStopLampData "This parameter provides measured data from the Engine Red Stop Lamp.

00 - Lamp deactivated (Off)
01 - Lamp activated (On)
10 - Error
11 - Not available";
CM_ SG_ 3221225472 EngAmberWarningLampData "This parameter provides measured data from the Engine Amber Warning Lamp.

00 - Lamp deactivated (Off)
01 - Lamp activated (On)
10 - Error
11 - Not available";
CM_ SG_ 3221225472 EngProtectLampData "This parameter provides measured data from the Engine Protect Lamp.

00 - Lamp deactivated (Off)
01 - Lamp activated (On)
10 - Error
11 - Not available";
CM_ SG_ 3221225472 HillHolderLampCmd "Command signal directly controlling Hill Holder Lamp.

00 - Lamp Off
01 - Lamp On
10 - Lamp Flash (1 Hz)
11 - Not available";
CM_ SG_ 3221225472 VehicleBatteryChargingLampCmd "Command signal directly controlling the Vehicle Battery Charging Lamp.

00 - Lamp Off
01 - Lamp On
10 - Reserved
11 - Not available";
CM_ SG_ 3221225472 VehicleHVACRecirculationLampCmd "Command signal directly controlling the Vehicle HVAC Recirculation Lamp.

00 - Lamp Off
01 - Lamp On
10 - Reserved
11 - Not available";
CM_ SG_ 3221225472 VehicleAirPressLowLampCmd "Command signal directly controlling the Vehicle Air Pressure Low Lamp.

00 - Lamp Off
01 - Lamp On
10 - Reserved
11 - Not available";
CM_ SG_ 3221225472 VehicleFuelLevelLowLampCmd "Command signal directly controlling the Vehicle Fuel Level Low Lamp.

00 - Lamp Off
01 - Lamp On
10 - Reserved
11 - Not available";
CM_ SG_ 3221225472 VehicleBatteryVoltageLowLampCmd "Command signal directly controlling the Vehicle Battery Voltage Low Lamp.

00 - Lamp Off
01 - Lamp On
10 - Reserved
11 - Not available";
CM_ SG_ 3221225472 TextDisplayIndex "Used for overwriting consecutive bytes of a displayed string when byte 1 'Text Display Instructions' state is set for 'overwrite substring' mode.  When used, this byte declares where in the text string that the new text will start overwriting, this ...";
CM_ SG_ 3221225472 TextDisplayInstructions "This parameter describes the status for the display how to show the information.
0000 Clear display - The displayed information should be deleted or not displayed any more.
0001 Hold display - The presently displayed information should be retained
 ...";
CM_ SG_ 3221225472 RetractStatusOfRamp5 "Retract status of ramp at doorway 5, counting from front to back on the vehicle.
 
00 ramp retracted
01 ramp extended
10 error
11 not available";
CM_ SG_ 3221225472 RetractStatusOfRamp4 "Retract status of ramp at doorway 4, counting from front to back on the vehicle.
 
00 ramp retracted
01 ramp extended
10 error
11 not available";
CM_ SG_ 3221225472 MovementStatusOfRamp5 "Movement status of ramp at doorway 5, counting from front to back on the vehicle.

00 ramp not being moved
01 ramp being moved
10 error
11 not available";
CM_ SG_ 3221225472 MovementStatusOfRamp4 "Movement status of ramp at doorway 4, counting from front to back on the vehicle.

00 ramp not being moved
01 ramp being moved
10 error
11 not available";
CM_ SG_ 3221225472 EnableStatusOfRamp5 "Enable status of ramp at doorway 5, counting from front to back on the vehicle.

00 ramp disabled
01 ramp enabled 
10 error 
11 not available";
CM_ SG_ 3221225472 EnableStatusOfRamp4 "Enable status of ramp at doorway 4, counting from front to back on the vehicle.

00 ramp disabled
01 ramp enabled 
10 error 
11 not available";
CM_ SG_ 3221225472 MovementStatusOfRamp3 "Movement status of ramp at doorway 3, counting from front to back on the vehicle.

00 ramp not being moved
01 ramp being moved
10 error
11 not available";
CM_ SG_ 3221225472 EnableStatusOfRamp3 "Enable status of ramp at doorway 3, counting from front to back on the vehicle.

00 ramp disabled
01 ramp enabled 
10 error 
11 not available";
CM_ SG_ 3221225472 RetractStatusOfRamp3 "Retract status of ramp at doorway 3, counting from front to back on the vehicle.

00 ramp retracted
01 ramp extended
10 error
11 not available";
CM_ SG_ 3221225472 MovementStatusOfRamp2 "Movement status of ramp at doorway 2, counting from front to back on the vehicle.

00 ramp not being moved
01 ramp being moved
10 error
11 not available";
CM_ SG_ 3221225472 EnableStatusOfRamp2 "Enable status of ramp at doorway 2, counting from front to back on the vehicle.

00 ramp disabled
01 ramp enabled 
10 error 
11 not available";
CM_ SG_ 3221225472 RetractStatusOfRamp2 "Retract status of ramp at doorway 2, counting from front to back on the vehicle.

00 ramp retracted
01 ramp extended
10 error
11 not available";
CM_ SG_ 3221225472 MovementStatusOfRamp1 "Movement status of ramp at doorway 1, counting from front to back on the vehicle.

00 ramp not being moved
01 ramp being moved
10 error
11 not available";
CM_ SG_ 3221225472 EnableStatusOfRamp1 "Enable status of ramp at doorway 1, counting from front to back on the vehicle.

        00 ramp disabled
        01 ramp enabled 
       10 error 
       11 not available";
CM_ SG_ 3221225472 RetractStatusOfRamp1 "Retract status of ramp at doorway 1, counting from front to back on the vehicle.
 
00 ramp retracted
01 ramp extended
10 error
11 not available";
CM_ SG_ 3221225472 EngConfigIdentification "Used to identify the hardware configuration of engine family. Each number will have a reference to set of parameters such as, but not limited to, number of cylinders, piston displacement, bore size and firing angles.";
CM_ SG_ 3221225472 NmbrOfCmbstionCyclesForAveraging "Defined number of combustion cycles used for calculating average parameters of combustion in each cylinder.";
CM_ SG_ 3221225472 MaxCrankAttemptsPerStartAttempt "The number of cranking cycles that will be performed before ending the start attempt.  This is intended to be used in conjunction with Crank Attempt Count on Present Start Attempt, in order to give a FMI 0 diagnostic on the latter.";
CM_ SG_ 3221225472 CommandedEngIntakeManifoldPress "Provides the commanded set point value for the engine intake manifold pressure.";
CM_ SG_ 3221225472 EngCrnkcsBrtherOilSeparatorSpeed "The speed of a rotating (centrifugal) crankcase oil separator.";
CM_ SG_ 3221225472 EngExhstGsRcirculation1Valve2Pos "The position of the second exhaust gas recirculation valve expressed as a percentage of full travel. Zero percent means the valve is closed and no exhaust gas is flowing into the intake air stream. One hundred percent means the valve is fully ...";
CM_ SG_ 3221225472 EngExhstGsRecirculation1ValvePos "The position of the exhaust gas recirculation valve expressed as a percentage of full travel. Zero percent means the valve is closed and no exhaust gas is flowing into the intake air stream. One hundred percent means the valve is fully opened.";
CM_ SG_ 3221225472 EngExhstGsRcrcltn1ClerEfficiency "Exhaust Gas Recirculation cooler efficiency is an indication of the cooler's ability to reduce the temperature of the exhaust gas that is being recirculated back to the intake. 0% = no reduction in temperature, 100% = maximum cooling.  The EGR ...";
CM_ SG_ 3221225472 EngExhstGsRcrcltn1ClrIntkGsAbsPr "Exhaust gas recirculation absolute pressure is measured at the EGR cooler intake. See SPN 3358 for EGR pressure measured at the EGR cooler outlet before the valve.";
CM_ SG_ 3221225472 EngExhstGsRcrcltn1ClerIntakeTemp "Exhaust Gas Recirculation (EGR) Temperature measured at the EGR cooler intake.  See SPN 412 for Engine EGR temperature which is typically measured at the EGR cooler outlet.";
CM_ SG_ 3221225472 EngExhstGsRcrculation1Valve2Ctrl "Desired percentage of maximum Exhaust Gas Recirculation (EGR) valve opening for valve 2.  0% means valve is closed. 100% means maximum valve opening (full gas flow).";
CM_ SG_ 3221225472 EngIntkVlvActtionOilPressForCyl4 "The gage pressure of the oil in the hydraulic accumulator that powers the engine intake valve for cylinder #4.";
CM_ SG_ 3221225472 EngIntkVlvActtionOilPressForCyl3 "The gage pressure of the oil in the hydraulic accumulator that powers the engine intake valve for cylinder #3.";
CM_ SG_ 3221225472 EngIntkVlvActtionOilPressForCyl2 "The gage pressure of the oil in the hydraulic accumulator that powers the engine intake valve for cylinder #2.";
CM_ SG_ 3221225472 EngIntkVlvActtionOilPressForCyl1 "The gage pressure of the oil in the hydraulic accumulator that powers the engine intake valve for cylinder #1.
This intake valve pressure is at the first cylinder in the engine, while SPN 2948 reflects the intake valve pressure of the entire engine ...";
CM_ SG_ 3221225472 EngIntkVlvActtionOilPressForCyl8 "The gage pressure of the oil in the hydraulic accumulator that powers the engine intake valve for cylinder #8.";
CM_ SG_ 3221225472 EngIntkVlvActtionOilPressForCyl7 "The gage pressure of the oil in the hydraulic accumulator that powers the engine intake valve for cylinder #7.";
CM_ SG_ 3221225472 EngIntkVlvActtionOilPressForCyl6 "The gage pressure of the oil in the hydraulic accumulator that powers the engine intake valve for cylinder #6.";
CM_ SG_ 3221225472 EngIntkVlvActtionOilPressForCyl5 "The gage pressure of the oil in the hydraulic accumulator that powers the engine intake valve for cylinder #5.";
CM_ SG_ 3221225472 EngIntkVlvActtonOilPressForCyl12 "The gage pressure of the oil in the hydraulic accumulator that powers the engine intake valve for cylinder #12.";
CM_ SG_ 3221225472 EngIntkVlvActtonOilPressForCyl11 "The gage pressure of the oil in the hydraulic accumulator that powers the engine intake valve for cylinder #11.";
CM_ SG_ 3221225472 EngIntkVlvActtonOilPressForCyl10 "The gage pressure of the oil in the hydraulic accumulator that powers the engine intake valve for cylinder #10.";
CM_ SG_ 3221225472 EngIntkVlvActtionOilPressForCyl9 "The gage pressure of the oil in the hydraulic accumulator that powers the engine intake valve for cylinder #9.";
CM_ SG_ 3221225472 EngIntkVlvActtonOilPressForCyl16 "The gage pressure of the oil in the hydraulic accumulator that powers the engine intake valve for cylinder #16.";
CM_ SG_ 3221225472 EngIntkVlvActtonOilPressForCyl15 "The gage pressure of the oil in the hydraulic accumulator that powers the engine intake valve for cylinder #15.";
CM_ SG_ 3221225472 EngIntkVlvActtonOilPressForCyl14 "The gage pressure of the oil in the hydraulic accumulator that powers the engine intake valve for cylinder #14.";
CM_ SG_ 3221225472 EngIntkVlvActtonOilPressForCyl13 "The gage pressure of the oil in the hydraulic accumulator that powers the engine intake valve for cylinder #13.";
CM_ SG_ 3221225472 EngIntkVlvActtonOilPressForCyl20 "The gage pressure of the oil in the hydraulic accumulator that powers the engine intake valve for cylinder #20.";
CM_ SG_ 3221225472 EngIntkVlvActtonOilPressForCyl19 "The gage pressure of the oil in the hydraulic accumulator that powers the engine intake valve for cylinder #19.";
CM_ SG_ 3221225472 EngIntkVlvActtonOilPressForCyl18 "The gage pressure of the oil in the hydraulic accumulator that powers the engine intake valve for cylinder #18.";
CM_ SG_ 3221225472 EngIntkVlvActtonOilPressForCyl17 "The gage pressure of the oil in the hydraulic accumulator that powers the engine intake valve for cylinder #17.";
CM_ SG_ 3221225472 EGR1CoolerBypassActuatorPostion "The parameter gives the % open of the exhaust gas recirculation cooler bypass actuator, where 0% = Fully Closed (no gas flowing through the bypass), and 100% = Fully Open.";
CM_ SG_ 3221225472 EngSparkPlug4 "The measured voltage of the spark event on Cylinder #4";
CM_ SG_ 3221225472 EngSparkPlug3 "The measured voltage of the spark event on Cylinder #3";
CM_ SG_ 3221225472 EngSparkPlug2 "The measured voltage of the spark event on Cylinder #2";
CM_ SG_ 3221225472 EngSparkPlug1 "The measured voltage of the spark event on Cylinder #1";
CM_ SG_ 3221225472 EngSparkPlug8 "The measured voltage of the spark event on Cylinder #8";
CM_ SG_ 3221225472 EngSparkPlug7 "The measured voltage of the spark event on Cylinder #7";
CM_ SG_ 3221225472 EngSparkPlug6 "The measured voltage of the spark event on Cylinder #6";
CM_ SG_ 3221225472 EngSparkPlug5 "The measured voltage of the spark event on Cylinder #5";
CM_ SG_ 3221225472 EngSparkPlug12 "The measured voltage of the spark event on Cylinder #12";
CM_ SG_ 3221225472 EngSparkPlug11 "The measured voltage of the spark event on Cylinder #11";
CM_ SG_ 3221225472 EngSparkPlug10 "The measured voltage of the spark event on Cylinder #10";
CM_ SG_ 3221225472 EngSparkPlug9 "The measured voltage of the spark event on Cylinder #9";
CM_ SG_ 3221225472 EngSparkPlug16 "The measured voltage of the spark event on Cylinder #16";
CM_ SG_ 3221225472 EngSparkPlug15 "The measured voltage of the spark event on Cylinder #15";
CM_ SG_ 3221225472 EngSparkPlug14 "The measured voltage of the spark event on Cylinder #14";
CM_ SG_ 3221225472 EngSparkPlug13 "The measured voltage of the spark event on Cylinder #13";
CM_ SG_ 3221225472 EngSparkPlug20 "The measured voltage of the spark event on Cylinder #20";
CM_ SG_ 3221225472 EngSparkPlug19 "The measured voltage of the spark event on Cylinder #19";
CM_ SG_ 3221225472 EngSparkPlug18 "The measured voltage of the spark event on Cylinder #18";
CM_ SG_ 3221225472 EngSparkPlug17 "The measured voltage of the spark event on Cylinder #17";
CM_ SG_ 3221225472 EngSparkPlug24 "The measured voltage of the spark event on Cylinder #24";
CM_ SG_ 3221225472 EngSparkPlug23 "The measured voltage of the spark event on Cylinder #23";
CM_ SG_ 3221225472 EngSparkPlug22 "The measured voltage of the spark event on Cylinder #22";
CM_ SG_ 3221225472 EngSparkPlug21 "The measured voltage of the spark event on Cylinder #21";
CM_ SG_ 3221225472 LaneDepartureWarningEnableCmd "Command to enable/disable Lane Departure Indication

00   Disable Lane Departure Warning
01   Enable Lane Departure Warning
10   Reserved
11   Don´t care";
CM_ SG_ 3221225472 J2012DTCOccurrenceCount "Number of occurrences of the respective SAE J2012 DTC being conveyed.
If more than 126 occurrences happen the value shall be set to 126.
If the occurrence count is not available to be sent then this value shall be set to 127.";
CM_ SG_ 3221225472 J2012DTCStatus "Indicates if the respective SAE J2012 DTC is active or previously active.

0 - DTC is previously active
1 - DTC is active";
CM_ SG_ 3221225472 J2012DTC "Five character ASCII SAE J2012 DTC, sent most significant byte first.";
CM_ SG_ 3221225472 NumberOfJ2012DTCs "The number J2012 DTCs being conveyed in PGN 64906.  If the value of this parameter is zero, the device broadcasting PGN 64906 has no active or previously active J2012 DTCs.";
CM_ SG_ 3221225472 SteerAngleSensorCalibrated "This signal indicates the calibration status of the steering angle sensor.

00 - SAS not calibrated
01 - SAS calibrated
10 - Reserved
11 - Not available";
CM_ SG_ 3221225472 SteerAngleSensorActiveMode "This signal indicates the operational mode of the steering angle sensor.

00 - Programming mode active
01 - Normal mode active
10 - Reserved
11 - Not available";
CM_ SG_ 3221225472 SteerWheelAngleRange "The signal indicates the range of  the steering wheel angle the sensor element is capable to measure. The steering wheel angle signal ranges between the negative and the positive value of the steering wheel angle range.
For example, a steering ...";
CM_ SG_ 3221225472 SteerWheelAngleRangeCounterType "The signal indicates whether the steering wheel angle sensor is capable of absolute measuring of the number of steering wheel angle ranges or not.  Absolute measuring means that the steering wheel angle range counter signal indicates the real ...";
CM_ SG_ 3221225472 SteerWheelAngleRangeCounter "The signal indicates the number of steering wheel angle range overflows if the operating range of steering wheel is greater than the measuring range of sensor element. Positive values indicate left turns (counterclockwise). If the steering wheel ...";
CM_ SG_ 3221225472 SteerWheelAngle "The main operator`s steering wheel angle (on the steering column, not the actual wheel angle). The vehicle being steered to the left (counterclockwise) results in a positive steering wheel angle.  This is the yaw angle of the steering wheel with the ...";
CM_ SG_ 3221225472 SysSulfationLvl "Indicates the sulfur level in the SCR system for aftertreatment 1.
.
100% level could be the regeneration trigger level (and if conditions are not favorable for regeneration, sulfation loading can continue beyond 100%). During normal operation and ...";
CM_ SG_ 3221225472 SCROpIndActiveTraveledDist "The distance traveled while SCR inducement (SPN 5246 is equal to level 1 to 5) is active.  Distance is reset once inducement is no longer active for SCR (SPN 5246 = 0).
Emission Control System Operator Inducement Severity, SPN 5826, may be active ...";
CM_ SG_ 3221225472 ConversionEfficiency "The SCR conversion efficiency percentage.  Calculated as 100 times the catalyst intake NOx minus the catalyst outlet NOx divided by the catalyst intake NOx.  The catalyst conversion efficiency number in itself does not imply emissions compliance or ...";
CM_ SG_ 3221225472 CommandedDEFConsumption "This parameter transmits the amount of diesel exhaust fluid that the emissions control system has requested to be used, averaged over the past 15 hours of engine operation.
Used to determine whether the SCR system is using an appropriate amount of ...";
CM_ SG_ 3221225472 DEFAvgConsumption "Measured use of diesel exhaust fluid by a Selective Catalytic Reduction system for exhaust emission control, averaged over the previous 15 hours of engine operation.
Used to determine whether the SCR system is using an appropriate amount of diesel ...";
CM_ SG_ 3221225472 TransferCaseStatus "This parameter describes the feedback from the  transfer case controller . Used by instrument clusters,  tachographs, PTOs , etc.
000 2 wheel high (normal or `'On Highway' Range)
001 4 wheel high (normal or  'On Highway' Range
010 neutral
011 2 ...";
CM_ SG_ 3221225472 TransOilLevel2MeasurementStatus "Measurement status for the second instance of a transmission oil level indicator. Indicates if conditions are acceptable to obtain a valid transmission oil level measurement as conveyed in SPN 5914 Transmission Oil Level 2 High / Low. If conditions ...";
CM_ SG_ 3221225472 TransOilLevel2CountdownTimer "Countdown timer for the second instance of a transmission oil level indicator. Once all vehicle conditions (such as vehicle stopped, etc) are met, some transmissions may require a ‘settling time' to allow the fluid level to normalize. This parameter ...";
CM_ SG_ 3221225472 TransOilLevel2High_Low "Second instance of a transmission oil level indicator. Conveys the current volume of transmission sump oil compared to recommended volume. Positive values indicate overfill. Zero means the transmission fluid is filled to the recommended level. If ...";
CM_ SG_ 3221225472 TransOilTemp2 "Second instance of transmission lubricant temperature. This parameter may reflect the temperature of a second sump or oil supply. If only one instance of transmission lubricant temperature measurement exists, SPN 177 Transmission Oil Temperature 1 ...";
CM_ SG_ 3221225472 TransOilLifeRemaining "Signal which indicates the actual oil life remaining in percent.  100% means the transmission oil is brand new, and 0% means the transmission oil is at the end of its life.";
CM_ SG_ 3221225472 TrnsTorqueConverterOilOutletTemp "Temperature of transmission torque converter outlet oil.";
CM_ SG_ 3221225472 TransOverheatIndicator "Signal from transmission indicating that its fluid temperature is above normal acceptable limits, and as a result, transmission operation may be altered or restricted.  The indicator is typically a lamp.  Distinctions in meaning between the ...";
CM_ SG_ 3221225472 TransOilLevelSwitch "This switch indicates whether transmission oil level is full or empty.

00 - Empty
01 - Full or not empty
10 - Error
11 - Not available";
CM_ SG_ 3221225472 TransOilFilterRestrictionSwitch "This switch indicates whether the transmission oil filter is clogged.

00 - No restriction
01 - Restriction exists on oil filter
10 - Error
11 - Not available";
CM_ SG_ 3221225472 VehicleRoll "This parameter indicates the roll in degrees from level.  Facing the direction of travel a tip to the left would be indicated by a negative number and a tip to the right would be indicated by a positive number.";
CM_ SG_ 3221225472 TotalEngCruiseTime "Total time that the engine has operated in the cruise hold state, excluding time in accelerator override, over the life of the engine.";
CM_ SG_ 3221225472 TotalDriveAverageLoadFactor "Average engine load factor while engine speed is greater than zero, vehicle speed is greater than or equal to 2 km/h, and both the PTO (moving/non-moving) and remote PTO governors are not in the hold state, over the life of the engine.  Engine ...";
CM_ SG_ 3221225472 TripDriveAverageLoadFactor "Average engine load factor while engine speed is greater than zero, vehicle speed is greater than or equal to 2 km/h, and both the PTO (moving/non-moving) and remote PTO governors are not in the hold state, since the last trip reset.  Engine ...";
CM_ SG_ 3221225472 TripAverageEngSpeed "Average speed of the engine since the last trip reset.

NOTE - Excludes ignition-on time without the engine speed above zero.  Includes idle, engine PTO governor (moving and non-moving), and drive operation.";
CM_ SG_ 3221225472 TripMaxEngSpeed "Maximum engine speed achieved since the last trip reset.";
CM_ SG_ 3221225472 ImplementRearWorkLight "This parameter provides measured data from the implement rear work lamps.

00 De-activated
01 Activated
10 Fault Detected
11 Not Available";
CM_ SG_ 3221225472 ImplLeftFacingWorkLight "This parameter provides measured data from the left facing work lights toward the left end of the implement.

00 De-activated
01 Activated
10 Fault Detected
11 Not Available";
CM_ SG_ 3221225472 ImplRightForwardWorkLight "This parameter provides measured data from the forward facing work lights toward the right end of the implement.

00 De-activated
01 Activated
10 Fault Detected
11 Not Available";
CM_ SG_ 3221225472 ImplLeftForwardWorkLight "This parameter provides measured data from the work lights mounted on an implement to illuminate the forward left end of the implement.

00 De-activate
01 Activate
10 Fault Detected
11 Not Available";
CM_ SG_ 3221225472 ImplRightFacingWorkLight "This parameter provides measured data from the work lights mounted on an implement to illuminate beyond right end of the implement.

00 De-activated
01 Activated
10 Fault Detected
11 Not Available";
CM_ SG_ 3221225472 ImplementOEMOption1Light "This parameter provides measured data from the implement OEM option 1 light.

00 De-activated
01 Activated
10 Fault Detected
11 Not Available";
CM_ SG_ 3221225472 ImplementOEMOption2Light "This parameter provides measured data from the implement OEM option 2 light.

00 De-activated
01 Activated
10 Fault Detected
11 Not Available";
CM_ SG_ 3221225472 TrctorFrontHighMdWkLights "This parameter provides measured data from the tractor front high mounted work lights. 

00 De-activated
01 Activated
10 Fault Detected
11 Not Available";
CM_ SG_ 3221225472 TractorFrontLowMdWkLights "This parameter provides measured data from the tractor front low mounted work lights. 

00 De-activated
01 Activated
10 Fault Detected
11 Not Available";
CM_ SG_ 3221225472 TractorSideHighMdWkLights "This parameter provides measured data from the tractor side high mounted work lights. 

00 De-activated
01 Activated
10 Fault Detected
11 Not Available";
CM_ SG_ 3221225472 TractorSideLowMdWkLights "This parameter provides measured data from the tractor side low mounted work lights. 

00 De-activated
01 Activated
10 Fault Detected
11 Not Available";
CM_ SG_ 3221225472 TractorRearHighMdWkLights "This parameter provides measured data from the tractor rear high mounted work lights. 

00 De-activated
01 Activated
10 Fault Detected
11 Not Available";
CM_ SG_ 3221225472 TractorRearLowMdWkLights "This parameter provides measured data from the tractor rear low mounted work lights.

00 De-activated
01 Activated
10 Fault Detected
11 Not Available";
CM_ SG_ 3221225472 TrctorUndersideMdWkLights "This parameter provides measured data from the tractor underside mounted work lights. 

00 De-activated
01 Activated
10 Fault Detected
11 Not Available";
CM_ SG_ 3221225472 RearFogLights "This parameter provides measured data from the tractor and/or implement rear fog lights.

00 De-activated
01 Activated
10 Fault Detected
11 Not Available";
CM_ SG_ 3221225472 TractorMarkerLight "This parameter provides measured data from the tractor and attached implement marker lights, including front position lights, rear tail lights, side running lights, license plate lights and instruments and switch back lights.
00 De-activated
01 ...";
CM_ SG_ 3221225472 ImplementMarkerLight "This parameter provides measured data from an attached implement marker lights, including front position lights, rear tail lights, side running lights, license plate lights and instruments and switch back lights.
00 De-activated
01 Activated
10 ...";
CM_ SG_ 3221225472 TractorClearanceLight "This parameter provides measured data from the tractor high mounted clearance and center ID lights.

00 De-activated
01 Activated
10 Fault Detected
11 Not Available";
CM_ SG_ 3221225472 ImplementClearanceLight "This parameter provides measured data from an attached implement high mounted clearance lights.

00 De-activated
01 Activated
10 Fault Detected
11 Not Available";
CM_ SG_ 3221225472 LeftStopLight "This parameter provides measured data from the tractor and attached implement left stop lights.

00 De-activated
01 Activated
10 Fault Detected
11 Not Available";
CM_ SG_ 3221225472 RightStopLight "This parameter provides measured data from the tractor and attached implement right stop lights.

00 De-activated
01 Activated
10 Fault Detected
11 Not Available";
CM_ SG_ 3221225472 CenterStopLight "This parameter provides measured data from the tractor and attached implement center stop lights.

00 De-activated
01 Activated
10 Fault Detected
11 Not Available";
CM_ SG_ 3221225472 BackUpLightAndAlarmHorn "This parameter provides measured data from the back up lights and/ or associated alarm.

00 De-activated
01 Activated
10 Fault Detected
11 Not Available";
CM_ SG_ 3221225472 LeftTurnSignalLights "This parameter provides measured data from the tractor and attached implement left turn signal lights.

00 De-activated
01 Activated
10 Fault Detected
11 Not Available";
CM_ SG_ 3221225472 RightTurnSignalLights "This parameter provides measured data from the tractor and attached implement right turn signal lights.

00 De-activated
01 Activated
10 Fault Detected
11 Not Available";
CM_ SG_ 3221225472 RotatingBeaconLight "This parameter provides measured data from the beacon light on tractor or attached implements.

00 De-activated
01 Activated
10 Fault Detected
11 Not Available";
CM_ SG_ 3221225472 TractorFrontFogLights "This parameter provides measured data from the tractor front fog lights.

00 De-activated
01 Activated
10 Fault Detected
11 Not Available";
CM_ SG_ 3221225472 HighBeamHeadLight "This parameter provides measured data from the tractor high beam head light lamps. 

00 De-activated
01 Activated
10 Fault Detected
11 Not Available";
CM_ SG_ 3221225472 LowBeamHeadLight "This parameter provides measured data from the tractor low beam head light lamps. 

00 De-activated
01 Activated
10 Fault Detected
11 Not Available";
CM_ SG_ 3221225472 AltBeamHeadLight "This parameter provides measured data from the tractor alternate beam head light lamps. 

00 De-activated
01 Activated
10 Fault Detected
11 Not Available";
CM_ SG_ 3221225472 RunningLight "This parameter provides measured data from the vehicle's running lights.

00 De-activated
01 Activated
10 Fault Detected
11 Not Available";
CM_ SG_ 3221225472 ImplementRearWorkLightCmd "Command to activate or de-activate implement rear work lights.  (This is also the same as Reversing Lights for truck applications.)  

00 De-activate
01 Activate
10 Reserved
11 Don't Care";
CM_ SG_ 3221225472 ImplLeftFacingWorkLightCmd "Command to activate or de-activate the left facing work lights toward the left end of the implement.

00 De-activate
01 Activate
10 Reserved
11 Don't Care";
CM_ SG_ 3221225472 ImplRightFwdWorkLightCmd "Command to activate or de-activate the forward facing work lights toward the right end of the implement.

00 De-activate
01 Activate
10 Reserved
11 Don't Care";
CM_ SG_ 3221225472 LightingDataRqCmd "Command to provide a response of the light state

00 De-activate
01 Activate
10 Reserved
11 Don't Care";
CM_ SG_ 3221225472 ImplLeftForwardWorkLightCmd "Command to activate or de-activate work lights mounted on an implement to illuminate beyond left end of the implement.

00 De-activate
01 Activate
10 Reserved
11 Don't Care";
CM_ SG_ 3221225472 ImplRightFacingWorkLightCmd "Command to activate or de-activate work lights mounted on an implement to illuminate beyond right end of the implement.

00 De-activate
01 Activate
10 Reserved
11 Don't Care";
CM_ SG_ 3221225472 ImplOEMOption1LightCmd "Command to activate or de-activate an implement OEM option 1 light.  This is provided to meet special needs on implements, such as tank inspection or filling lights.

00 De-activate
01 Activate
10 Reserved
11 Don't Care";
CM_ SG_ 3221225472 ImplOEMOption2LightCmd "Command to activate or de-activate an implement OEM option 2 light.  This is provided to meet special needs on implements, such as tank inspection or filling lights.

00 De-activate
01 Activate
10 Reserved
11 Don't Care";
CM_ SG_ 3221225472 TrctrFrntHghMdWkLightsCmd "Command to activate or de-activate the tractor front high mounted work lights.

00 De-activate
01 Activate
10 Reserved
11 Don't Care";
CM_ SG_ 3221225472 TrctrFrntLowMdWkLightsCmd "Command to activate or de-activate the tractor front low mounted work lights.

00 De-activate
01 Activate
10 Reserved
11 Don't Care";
CM_ SG_ 3221225472 TrctrSdeHighMdWkLightsCmd "Command to activate or de-activate the tractor side high mounted work lights.

00 De-activate
01 Activate
10 Reserved
11 Don't Care";
CM_ SG_ 3221225472 TrctrSideLowMdWkLightsCmd "Command to activate or de-activate the tractor side low mounted work lights.

00 De-activate
01 Activate
10 Reserved
11 Don't Care";
CM_ SG_ 3221225472 TrctrRarHighMdWkLightsCmd "Command to activate or de-activate the tractor rear high  mounted work lights.

00 De-activate
01 Activate
10 Reserved
11 Don't Care";
CM_ SG_ 3221225472 TrctrRearLowMdWkLightsCmd "Command to activate or de-activate the tractor rear low  mounted work lights.

00 De-activate
01 Activate
10 Reserved
11 Don't Care";
CM_ SG_ 3221225472 TrctrUndrsdeMdWkLightsCmd "Command to activate or de-activate the tractor underside mounted work lights.

00 De-activate
01 Activate
10 Reserved
11 Don't Care";
CM_ SG_ 3221225472 RearFogLightsCmd "Command to activate or de-activate tractor or implement rear fog lights.  

00 De-activate
01 Activate
10 Reserved
11 Don't Care";
CM_ SG_ 3221225472 TractorMarkerLightCmd "Command to activate or de-activate tractor and implement front position lights, rear red tail lights, side amber running lights, license plate lights and instrument and switch back lights.  

00 De-activate
01 Activate
10 Reserved
11 Don't Care";
CM_ SG_ 3221225472 ImplementMarkerLightCmd "Command to activate or de-activate implement front position lights, rear red tail lights, side amber running lights, license plate lights and instrument and switch back lights.  

00 De-activate
01 Activate
10 Reserved
11 Don't Care";
CM_ SG_ 3221225472 TractorClearanceLightCmd "Command to activate or de-activate the tractor high mounted clearance and center ID lights

00 De-activate
01 Activate
10 Reserved
11 Don't Care";
CM_ SG_ 3221225472 ImplementClearanceLightCmd "Command to activate or de-activate the implement high mounted clearance and lights.  

00 De-activate
01 Activate
10 Reserved
11 Don't Care";
CM_ SG_ 3221225472 LeftStopLightCmd "Command to activate or de-activate the tractor and implement left stop lights

00 De-activate
01 Activate
10 Reserved
11 Don't Care";
CM_ SG_ 3221225472 RightStopLightCmd "Command to activate or de-activate the tractor and implement right stop light

00 De-activate
01 Activate
10 Reserved
11 Don't Care";
CM_ SG_ 3221225472 CenterStopLightCmd "Command to activate or de-activate the tractor and implement center stop light

00 De-activate
01 Activate
10 Reserved
11 Don't Care";
CM_ SG_ 3221225472 BackUpLightAndAlarmHornCmd "Command to activate or de-activate the back up lights and/ or associated alarm if required

00 De-activate
01 Activate
10 Reserved
11 Don't Care";
CM_ SG_ 3221225472 LeftTurnSignalLightsCmd "Command to activate or de-activate left turn signal lights on the tractor and all connected implements

00 De-activate
01 Activate
10 Reserved
11 Don't Care";
CM_ SG_ 3221225472 RightTurnSignalLightsCmd "Command to activate or de-activate right turn signal lights on the tractor and all connected implements

00 De-activate
01 Activate
10 Reserved
11 Don't Care";
CM_ SG_ 3221225472 RotatingBeaconLightCmd "Command to activate or de-activate slow moving vehicle indicator lights on tractor and/or implements.  Activation of the slow moving vehicle lights implies that the controller should manipulate the lighting as appropriate to provide the slow moving ...";
CM_ SG_ 3221225472 TractorFrontFogLightsCmd "Command to activate or de-activate tractor front fog lights.

00 De-activate
01 Activate
10 Reserved
11 Don't Care";
CM_ SG_ 3221225472 HighBeamHeadLightCmd "Command to activate or de-activate the tractor high beam head light lamps. 

00 De-activate
01 Activate
10 Reserved
11 Don't Care";
CM_ SG_ 3221225472 LowBeamHeadLightCmd "Command to activate or de-activate the tractor low beam head light lamps. 

00 De-activate
01 Activate
10 Reserved
11 Don't Care";
CM_ SG_ 3221225472 AltBeamHeadLightCmd "Command to activate or de-activate the tractor alternate head lights (only low beam is available on alternate head lights).  The alternate position lights are intended for use with loader and snow plows that tend to block the primary head lights.
 ...";
CM_ SG_ 3221225472 RunningLightCmd "Command to activate or de-activate the tractor or powered vehicle running lights.  Usually only used for on road vehicles.

00 De-activate
01 Activate
10 Reserved
11 Don't Care";
CM_ SG_ 3221225472 LandLevelingSystemEnableStatus "Communicate the enable/disable status of the Land Leveling System.

00 = Disabled
01= Enabled
10 = Error
11 = Not available / Not installed";
CM_ SG_ 3221225472 BladeCtrlModeRight "Indicate if the land leveling system's automatic control is active or inactive for the elevation sensor on the right side of the blade.  The 'left' notation is applicable to grading machines such tractors and motor graders where 'right' is the ...";
CM_ SG_ 3221225472 BladeCtrlModeLeft "Indicate if the land leveling system's automatic control is active or inactive for the elevation sensor on the left side of the blade.  The 'left' notation is applicable to grading machines such tractors and motor graders where 'left' is the ...";
CM_ SG_ 3221225472 BladeCtrlMode "Allows the user to select the type of blade control for the land leveling system.  

00000000 Manual mode
00000001 Automatic mode
00000010 Inactive automatic mode
All other values Reserved";
CM_ SG_ 3221225472 BladeDurationAndDirection "Used to indicate the duration and direction that the land leveling system blade moves.";
CM_ SG_ 3221225472 EngActualIgntTiming "The actual ignition timing at the current engine conditions. This parameter may or may not be equal to one of the desired timing parameters (see SPNs 1433-1435), depending on the status of the engine. Positive values indicate an increasingly ...";
CM_ SG_ 3221225472 EngDesiredIgntTiming3 "A programmable timing value specific to the engine's application. Factors affecting this value include both fuel type and the nature of the load being driven. Positive values indicate an increasingly advanced timing from TDC.";
CM_ SG_ 3221225472 EngDesiredIgntTiming2 "A programmable timing value specific to the engine's application. Factors affecting this value include both fuel type and the nature of the load being driven. Positive values indicate an increasingly advanced timing from TDC.";
CM_ SG_ 3221225472 EngDesiredIgntTiming1 "A programmable timing value specific to the engine's application. Factors affecting this value include both fuel type and the nature of the load being driven. Positive values indicate an increasingly advanced timing from TDC.";
CM_ SG_ 3221225472 EngCyl20IgntTiming "The ignition timing (SI engines) or main fuel injection timing (CI engines) of the cylinder. Positive values indicate an increasingly advanced timing from TDC.";
CM_ SG_ 3221225472 EngCyl19IgntTiming "The ignition timing (SI engines) or main fuel injection timing (CI engines) of the cylinder. Positive values indicate an increasingly advanced timing from TDC.";
CM_ SG_ 3221225472 EngCyl18IgntTiming "The ignition timing (SI engines) or main fuel injection timing (CI engines) of the cylinder. Positive values indicate an increasingly advanced timing from TDC.";
CM_ SG_ 3221225472 EngCyl17IgntTiming "The ignition timing (SI engines) or main fuel injection timing (CI engines) of the cylinder. Positive values indicate an increasingly advanced timing from TDC.";
CM_ SG_ 3221225472 EngCyl16IgntTiming "The ignition timing (SI engines) or main fuel injection timing (CI engines) of the cylinder. Positive values indicate an increasingly advanced timing from TDC.";
CM_ SG_ 3221225472 EngCyl15IgntTiming "The ignition timing (SI engines) or main fuel injection timing (CI engines) of the cylinder. Positive values indicate an increasingly advanced timing from TDC.";
CM_ SG_ 3221225472 EngCyl14IgntTiming "The ignition timing (SI engines) or main fuel injection timing (CI engines) of the cylinder. Positive values indicate an increasingly advanced timing from TDC.";
CM_ SG_ 3221225472 EngCyl13IgntTiming "The ignition timing (SI engines) or main fuel injection timing (CI engines) of the cylinder. Positive values indicate an increasingly advanced timing from TDC.";
CM_ SG_ 3221225472 EngCyl12IgntTiming "The ignition timing (SI engines) or main fuel injection timing (CI engines) of the cylinder. Positive values indicate an increasingly advanced timing from TDC.";
CM_ SG_ 3221225472 EngCyl11IgntTiming "The ignition timing (SI engines) or main fuel injection timing (CI engines) of the cylinder. Positive values indicate an increasingly advanced timing from TDC.";
CM_ SG_ 3221225472 EngCyl10IgntTiming "The ignition timing (SI engines) or main fuel injection timing (CI engines) of the cylinder. Positive values indicate an increasingly advanced timing from TDC.";
CM_ SG_ 3221225472 EngCyl9IgntTiming "The ignition timing (SI engines) or main fuel injection timing (CI engines) of the cylinder. Positive values indicate an increasingly advanced timing from TDC.";
CM_ SG_ 3221225472 EngCyl8IgntTiming "The ignition timing (SI engines) or main fuel injection timing (CI engines) of the cylinder. Positive values indicate an increasingly advanced timing from TDC.";
CM_ SG_ 3221225472 EngCyl7IgntTiming "The ignition timing (SI engines) or main fuel injection timing (CI engines) of the cylinder. Positive values indicate an increasingly advanced timing from TDC.";
CM_ SG_ 3221225472 EngCyl6IgntTiming "The ignition timing (SI engines) or main fuel injection timing (CI engines) of the cylinder. Positive values indicate an increasingly advanced timing from TDC.";
CM_ SG_ 3221225472 EngCyl5IgntTiming "The ignition timing (SI engines) or main fuel injection timing (CI engines) of the cylinder. Positive values indicate an increasingly advanced timing from TDC.";
CM_ SG_ 3221225472 EngCyl4IgntTiming "The ignition timing (SI engines) or main fuel injection timing (CI engines) of the cylinder. Positive values indicate an increasingly advanced timing from TDC.";
CM_ SG_ 3221225472 EngCyl3IgntTiming "The ignition timing (SI engines) or main fuel injection timing (CI engines) of the cylinder. Positive values indicate an increasingly advanced timing from TDC.";
CM_ SG_ 3221225472 EngCyl2IgntTiming "The ignition timing (SI engines) or main fuel injection timing (CI engines) of the cylinder. Positive values indicate an increasingly advanced timing from TDC.";
CM_ SG_ 3221225472 EngCyl1IgntTiming "The ignition timing (SI engines) or main fuel injection timing (CI engines) of the cylinder. Positive values indicate an increasingly advanced timing from TDC.";
CM_ SG_ 3221225472 EngCyl20IgntTransSecondOutput "This parameter indicates the relative intensity of the secondary output voltage of the ignition transformer.";
CM_ SG_ 3221225472 EngCyl19IgntTransSecondOutput "This parameter indicates the relative intensity of the secondary output voltage of the ignition transformer.";
CM_ SG_ 3221225472 EngCyl18IgntTransSecondOutput "This parameter indicates the relative intensity of the secondary output voltage of the ignition transformer.";
CM_ SG_ 3221225472 EngCyl17IgntTransSecondOutput "This parameter indicates the relative intensity of the secondary output voltage of the ignition transformer.";
CM_ SG_ 3221225472 EngCyl16IgntTransSecondOutput "This parameter indicates the relative intensity of the secondary output voltage of the ignition transformer.";
CM_ SG_ 3221225472 EngCyl15IgntTransSecondOutput "This parameter indicates the relative intensity of the secondary output voltage of the ignition transformer.";
CM_ SG_ 3221225472 EngCyl14IgntTransSecondOutput "This parameter indicates the relative intensity of the secondary output voltage of the ignition transformer.";
CM_ SG_ 3221225472 EngCyl13IgntTransSecondOutput "This parameter indicates the relative intensity of the secondary output voltage of the ignition transformer.";
CM_ SG_ 3221225472 EngCyl12IgntTransSecondOutput "This parameter indicates the relative intensity of the secondary output voltage of the ignition transformer.";
CM_ SG_ 3221225472 EngCyl11IgntTransSecondOutput "This parameter indicates the relative intensity of the secondary output voltage of the ignition transformer.";
CM_ SG_ 3221225472 EngCyl10IgntTransSecondOutput "This parameter indicates the relative intensity of the secondary output voltage of the ignition transformer.";
CM_ SG_ 3221225472 EngCyl9IgntTransSecondOutput "This parameter indicates the relative intensity of the secondary output voltage of the ignition transformer.";
CM_ SG_ 3221225472 EngCyl8IgntTransSecondOutput "This parameter indicates the relative intensity of the secondary output voltage of the ignition transformer.";
CM_ SG_ 3221225472 EngCyl7IgntTransSecondOutput "This parameter indicates the relative intensity of the secondary output voltage of the ignition transformer.";
CM_ SG_ 3221225472 EngCyl6IgntTransSecondOutput "This parameter indicates the relative intensity of the secondary output voltage of the ignition transformer.";
CM_ SG_ 3221225472 EngCyl5IgntTransSecondOutput "This parameter indicates the relative intensity of the secondary output voltage of the ignition transformer.";
CM_ SG_ 3221225472 EngCyl4IgntTransSecondOutput "This parameter indicates the relative intensity of the secondary output voltage of the ignition transformer.";
CM_ SG_ 3221225472 EngCyl3IgntTransSecondOutput "This parameter indicates the relative intensity of the secondary output voltage of the ignition transformer.";
CM_ SG_ 3221225472 EngCyl2IgntTransSecondOutput "This parameter indicates the relative intensity of the secondary output voltage of the ignition transformer.";
CM_ SG_ 3221225472 EngCyl1IgntTransSecondOutput "This parameter indicates the relative intensity of the secondary output voltage of the ignition transformer.";
CM_ SG_ 3221225472 EngOprtrPrmryIntrmdtSpdSlctState "13 preprogrammed intermediate speed control settings are available for the controlling ECM to select.  If no speed setting is requested, the engine operates normally. The Intermediate Speed Control is widely used in the Industrial application to ...";
CM_ SG_ 3221225472 EngOprtrPrmryIntrmdteSpeedSelect "Allows the operator to select one of 13 preprogrammed Intermediate Speed Control settings. If no speed setting is requested, the engine operates normally. The Intermediate Speed Control is widely used in the Industrial application to control the ...";
CM_ SG_ 3221225472 EngTotalIdleHours "Accumulated time of operation of the engine while under idle conditions.";
CM_ SG_ 3221225472 EngTotalIdleFuelUsed "Accumulated amount of fuel used during vehicle operation while under idle conditions.";
CM_ SG_ 3221225472 EngIntakeManifold6Temp "Temperature of pre-combustion air found in intake manifold  number 6 of engine air supply system.";
CM_ SG_ 3221225472 EngIntakeManifold5Temp "Temperature of pre-combustion air found in intake manifold number 5 of engine air supply system.";
CM_ SG_ 3221225472 EngIntakeManifold4Temp "Temperature of pre-combustion air found in intake manifold of engine air supply system.";
CM_ SG_ 3221225472 EngIntakeManifold3Temp "Temperature of pre-combustion air found in intake manifold of engine air supply system.";
CM_ SG_ 3221225472 EngIntakeManifold2Temp "Temperature of pre-combustion air found in intake manifold of engine air supply system.";
CM_ SG_ 3221225472 EngTurbo4BoostPress "Gage pressure of air measured downstream of the compressor discharge side of the turbocharger.  See also SPN 102 for alternate range and resolution. If there is only one boost pressure to report and the range and resolution in SPN 102 is adequate, ...";
CM_ SG_ 3221225472 EngTurbo3BoostPress "Gage pressure of air measured downstream of the compressor discharge side of the turbocharger.  See also SPN 102 for alternate range and resolution. If there is only one boost pressure to report and the range and resolution in SPN 102 is adequate, ...";
CM_ SG_ 3221225472 EngTurbo2BoostPress "Gage pressure of air measured downstream of the compressor discharge side of the turbocharger.  See also SPN 102 for alternate range and resolution. If there is only one boost pressure to report and the range and resolution in SPN 102  is adequate, ...";
CM_ SG_ 3221225472 SteerWheelAngle "The main operator`s steering wheel angle (on the steering column, not the actual wheel angle).  The vehicle being steered to the left (counterclockwise) results in a positive steering wheel angle.  This is the yaw angle of the steering wheel with ...";
CM_ SG_ 3221225472 EngOilPress "Gage pressure of oil in engine lubrication system as provided by oil pump.  See SPN 7468 for alternate resolution.";
CM_ SG_ 3221225472 EngFuelDeliveryPress "Gage pressure of fuel in system as delivered from supply pump to the injection pump.  See SPN 7469 for alternate resolution.

See also SPN 5578 for Fuel Delivery Absolute Pressure.";
CM_ SG_ 3221225472 EngCoolantPress2 "Gage pressure of liquid found in engine coolant system - second instance.

See also SPN 5708 for alternate range and resolution.";
CM_ SG_ 3221225472 ConversionEfficiency "The SCR conversion efficiency percentage.  Calculated as 100 times the catalyst intake NOx minus the catalyst outlet NOx divided by the catalyst intake NOx.  The catalyst conversion efficiency number in itself does not imply emissions compliance or ...";
CM_ SG_ 3221225472 CommandedDEFConsumption "This parameter transmits the amount of diesel exhaust fluid that the emissions control system has requested to be used, averaged over the past 15 hours of engine operation.
Used to determine whether the SCR system is using an appropriate amount of ...";
CM_ SG_ 3221225472 DEFAvgConsumption "Measured use of diesel exhaust fluid by a Selective Catalytic Reduction system for exhaust emission control, averaged over the previous 15 hours of engine operation.
Used to determine whether the SCR system is using an appropriate amount of diesel ...";
BA_DEF_ SG_  "SigType" ENUM  "Default","Range","RangeSigned","ASCII","Discrete","Control","ReferencePGN","DTC","StringDelimiter","StringLength","StringLengthControl","MessageCounter","MessageChecksum";
BA_DEF_ SG_  "GenSigStartValue" INT 0 2147483647;
BA_DEF_ SG_  "GenSigSendType" ENUM  "Cyclic","OnWrite","OnWriteWithRepetition","OnChange","OnChangeWithRepetition","IfActive","IfActiveWithRepetition","NoSigSendType";
BA_DEF_ SG_  "GenSigILSupport" ENUM  "No","Yes";
BA_DEF_ SG_  "GenSigEVName" STRING ;
BA_DEF_ SG_  "SPN" INT 0 524287;
BA_DEF_ BO_  "TpJ1939VarDlc" ENUM  "No","Yes";
BA_DEF_ BO_  "GenMsgILSupport" ENUM  "No","Yes";
BA_DEF_ BO_  "GenMsgRequestable" INT 0 1;
BA_DEF_ BO_  "GenMsgSendType" ENUM  "cyclic","NotUsed","NotUsed","NotUsed","NotUsed","NotUsed","NotUsed","IfActive","noMsgSendType";
BA_DEF_ BO_  "VFrameFormat" ENUM  "StandardCAN","ExtendedCAN","reserved","J1939PG";
BA_DEF_ SG_  "SystemSignalLongSymbol" STRING ;
BA_DEF_DEF_  "SigType" "Default";
BA_DEF_DEF_  "GenSigStartValue" 0;
BA_DEF_DEF_  "GenSigSendType" "NoSigSendType";
BA_DEF_DEF_  "GenSigILSupport" "Yes";
BA_DEF_DEF_  "GenSigEVName" "Env@Nodename_@Signame";
BA_DEF_DEF_  "SPN" 0;
BA_DEF_DEF_  "TpJ1939VarDlc" "No";
BA_DEF_DEF_  "GenMsgILSupport" "Yes";
BA_DEF_DEF_  "GenMsgRequestable" 1;
BA_DEF_DEF_  "GenMsgSendType" "noMsgSendType";
BA_DEF_DEF_  "VFrameFormat" "J1939PG";
BA_DEF_DEF_  "SystemSignalLongSymbol" "";
BA_ "SPN" SG_ 3221225472 Jystck6GrpXAxsLvrLftNgtvPsStatus 4588;
BA_ "SigType" SG_ 3221225472 Jystck6GrpXAxsLvrLftNgtvPsStatus 4;
BA_ "SPN" SG_ 3221225472 Jystck6GripXAxisNeutralPosStatus 4587;
BA_ "SigType" SG_ 3221225472 Jystck6GripXAxisNeutralPosStatus 4;
BA_ "SPN" SG_ 3221225472 Joystick5Button13PressedStatus 6747;
BA_ "SigType" SG_ 3221225472 Joystick5Button13PressedStatus 4;
BA_ "SPN" SG_ 3221225472 Joystick5Button14PressedStatus 6748;
BA_ "SigType" SG_ 3221225472 Joystick5Button14PressedStatus 4;
BA_ "SPN" SG_ 3221225472 Joystick5Button15PressedStatus 6749;
BA_ "SigType" SG_ 3221225472 Joystick5Button15PressedStatus 4;
BA_ "SPN" SG_ 3221225472 Joystick5Button16PressedStatus 6750;
BA_ "SigType" SG_ 3221225472 Joystick5Button16PressedStatus 4;
BA_ "SPN" SG_ 3221225472 Jystick5GripXAxisDetentPosStatus 4564;
BA_ "SigType" SG_ 3221225472 Jystick5GripXAxisDetentPosStatus 4;
BA_ "SPN" SG_ 3221225472 Jystick5GripYAxisDetentPosStatus 4563;
BA_ "SigType" SG_ 3221225472 Jystick5GripYAxisDetentPosStatus 4;
BA_ "SPN" SG_ 3221225472 Jystick5ThetaAxisDetentPosStatus 4562;
BA_ "SigType" SG_ 3221225472 Jystick5ThetaAxisDetentPosStatus 4;
BA_ "SPN" SG_ 3221225472 Joystick5ThetaAxisPos 4561;
BA_ "SPN" SG_ 3221225472 Jystck5ThtAxsClckwsPstvPosStatus 4560;
BA_ "SigType" SG_ 3221225472 Jystck5ThtAxsClckwsPstvPosStatus 4;
BA_ "SPN" SG_ 3221225472 Jystck5ThtAxsCntrClckwsNgtvPsStt 4559;
BA_ "SigType" SG_ 3221225472 Jystck5ThtAxsCntrClckwsNgtvPsStt 4;
BA_ "SPN" SG_ 3221225472 Jystck5ThetaAxisNeutralPosStatus 4558;
BA_ "SigType" SG_ 3221225472 Jystck5ThetaAxisNeutralPosStatus 4;
BA_ "SPN" SG_ 3221225472 Joystick5GripYAxisPos 4557;
BA_ "SPN" SG_ 3221225472 Jystck5GrpYAxsLvrFrwrdPstvPsStts 4556;
BA_ "SigType" SG_ 3221225472 Jystck5GrpYAxsLvrFrwrdPstvPsStts 4;
BA_ "SPN" SG_ 3221225472 Jystck5GrpYAxsLvrBckNgtvPsStatus 4555;
BA_ "SigType" SG_ 3221225472 Jystck5GrpYAxsLvrBckNgtvPsStatus 4;
BA_ "SPN" SG_ 3221225472 Jystck5GripYAxisNeutralPosStatus 4554;
BA_ "SigType" SG_ 3221225472 Jystck5GripYAxisNeutralPosStatus 4;
BA_ "SPN" SG_ 3221225472 Joystick5GripXAxisPos 4553;
BA_ "SPN" SG_ 3221225472 Jystck5GrpXAxsLvrRghtPstvPsSttus 4552;
BA_ "SigType" SG_ 3221225472 Jystck5GrpXAxsLvrRghtPstvPsSttus 4;
BA_ "SPN" SG_ 3221225472 Jystck5GrpXAxsLvrLftNgtvPsStatus 4551;
BA_ "SigType" SG_ 3221225472 Jystck5GrpXAxsLvrLftNgtvPsStatus 4;
BA_ "SPN" SG_ 3221225472 Jystck5GripXAxisNeutralPosStatus 4550;
BA_ "SigType" SG_ 3221225472 Jystck5GripXAxisNeutralPosStatus 4;
BA_ "SPN" SG_ 3221225472 Joystick4Button13PressedStatus 6743;
BA_ "SigType" SG_ 3221225472 Joystick4Button13PressedStatus 4;
BA_ "SPN" SG_ 3221225472 Joystick4Button14PressedStatus 6744;
BA_ "SigType" SG_ 3221225472 Joystick4Button14PressedStatus 4;
BA_ "SPN" SG_ 3221225472 Joystick4Button15PressedStatus 6745;
BA_ "SigType" SG_ 3221225472 Joystick4Button15PressedStatus 4;
BA_ "SPN" SG_ 3221225472 Joystick4Button16PressedStatus 6746;
BA_ "SigType" SG_ 3221225472 Joystick4Button16PressedStatus 4;
BA_ "SPN" SG_ 3221225472 Jystick4GripXAxisDetentPosStatus 4527;
BA_ "SigType" SG_ 3221225472 Jystick4GripXAxisDetentPosStatus 4;
BA_ "SPN" SG_ 3221225472 Jystick4GripYAxisDetentPosStatus 4526;
BA_ "SigType" SG_ 3221225472 Jystick4GripYAxisDetentPosStatus 4;
BA_ "SPN" SG_ 3221225472 Jystick4ThetaAxisDetentPosStatus 4525;
BA_ "SigType" SG_ 3221225472 Jystick4ThetaAxisDetentPosStatus 4;
BA_ "SPN" SG_ 3221225472 Joystick4ThetaAxisPos 4524;
BA_ "SPN" SG_ 3221225472 Jystck4ThtAxsClckwsPstvPosStatus 4523;
BA_ "SigType" SG_ 3221225472 Jystck4ThtAxsClckwsPstvPosStatus 4;
BA_ "SPN" SG_ 3221225472 Jystck4ThtAxsCntrClckwsNgtvPsStt 4522;
BA_ "SigType" SG_ 3221225472 Jystck4ThtAxsCntrClckwsNgtvPsStt 4;
BA_ "SPN" SG_ 3221225472 Jystck4ThetaAxisNeutralPosStatus 4521;
BA_ "SigType" SG_ 3221225472 Jystck4ThetaAxisNeutralPosStatus 4;
BA_ "SPN" SG_ 3221225472 Joystick4GripYAxisPos 4520;
BA_ "SPN" SG_ 3221225472 Jystck4GrpYAxsLvrFrwrdPstvPsStts 4519;
BA_ "SigType" SG_ 3221225472 Jystck4GrpYAxsLvrFrwrdPstvPsStts 4;
BA_ "SPN" SG_ 3221225472 Jystck4GrpYAxsLvrBckNgtvPsStatus 4518;
BA_ "SigType" SG_ 3221225472 Jystck4GrpYAxsLvrBckNgtvPsStatus 4;
BA_ "SPN" SG_ 3221225472 Jystck4GripYAxisNeutralPosStatus 4517;
BA_ "SigType" SG_ 3221225472 Jystck4GripYAxisNeutralPosStatus 4;
BA_ "SPN" SG_ 3221225472 Joystick4GripXAxisPos 4516;
BA_ "SPN" SG_ 3221225472 Jystck4GrpXAxsLvrRghtPstvPsSttus 4515;
BA_ "SigType" SG_ 3221225472 Jystck4GrpXAxsLvrRghtPstvPsSttus 4;
BA_ "SPN" SG_ 3221225472 Jystck4GrpXAxsLvrLftNgtvPsStatus 4514;
BA_ "SigType" SG_ 3221225472 Jystck4GrpXAxsLvrLftNgtvPsStatus 4;
BA_ "SPN" SG_ 3221225472 Jystck4GripXAxisNeutralPosStatus 4513;
BA_ "SigType" SG_ 3221225472 Jystck4GripXAxisNeutralPosStatus 4;
BA_ "SPN" SG_ 3221225472 Joystick10Button13PressedStatus 6767;
BA_ "SigType" SG_ 3221225472 Joystick10Button13PressedStatus 4;
BA_ "SPN" SG_ 3221225472 Joystick10Button14PressedStatus 6768;
BA_ "SigType" SG_ 3221225472 Joystick10Button14PressedStatus 4;
BA_ "SPN" SG_ 3221225472 Joystick10Button15PressedStatus 6769;
BA_ "SigType" SG_ 3221225472 Joystick10Button15PressedStatus 4;
BA_ "SPN" SG_ 3221225472 Joystick10Button16PressedStatus 6770;
BA_ "SigType" SG_ 3221225472 Joystick10Button16PressedStatus 4;
BA_ "SPN" SG_ 3221225472 Jystck10GripXAxisDetentPosStatus 4749;
BA_ "SigType" SG_ 3221225472 Jystck10GripXAxisDetentPosStatus 4;
BA_ "SPN" SG_ 3221225472 Jystck10GripYAxisDetentPosStatus 4748;
BA_ "SigType" SG_ 3221225472 Jystck10GripYAxisDetentPosStatus 4;
BA_ "SPN" SG_ 3221225472 Jystck10ThetaAxisDetentPosStatus 4747;
BA_ "SigType" SG_ 3221225472 Jystck10ThetaAxisDetentPosStatus 4;
BA_ "SPN" SG_ 3221225472 Joystick10ThetaAxisPos 4746;
BA_ "SPN" SG_ 3221225472 Jystck10ThtAxsClckwsPstvPsStatus 4745;
BA_ "SigType" SG_ 3221225472 Jystck10ThtAxsClckwsPstvPsStatus 4;
BA_ "SPN" SG_ 3221225472 Jystck10ThtAxsCntrClckwsNgtvPsSt 4744;
BA_ "SigType" SG_ 3221225472 Jystck10ThtAxsCntrClckwsNgtvPsSt 4;
BA_ "SPN" SG_ 3221225472 Jystck10ThtaAxisNeutralPosStatus 4743;
BA_ "SigType" SG_ 3221225472 Jystck10ThtaAxisNeutralPosStatus 4;
BA_ "SPN" SG_ 3221225472 Joystick10GripYAxisPos 4742;
BA_ "SPN" SG_ 3221225472 Jystck10GrpYAxsLvrFrwrdPstvPsStt 4741;
BA_ "SigType" SG_ 3221225472 Jystck10GrpYAxsLvrFrwrdPstvPsStt 4;
BA_ "SPN" SG_ 3221225472 Jystck10GrpYAxsLvrBckNgtvPsSttus 4740;
BA_ "SigType" SG_ 3221225472 Jystck10GrpYAxsLvrBckNgtvPsSttus 4;
BA_ "SPN" SG_ 3221225472 Jystck10GrpYAxisNeutralPosStatus 4739;
BA_ "SigType" SG_ 3221225472 Jystck10GrpYAxisNeutralPosStatus 4;
BA_ "SPN" SG_ 3221225472 Joystick10GripXAxisPos 4738;
BA_ "SPN" SG_ 3221225472 Jystck10GrpXAxsLvrRghtPstvPsStts 4737;
BA_ "SigType" SG_ 3221225472 Jystck10GrpXAxsLvrRghtPstvPsStts 4;
BA_ "SPN" SG_ 3221225472 Jystck10GrpXAxsLvrLftNgtvPsSttus 4736;
BA_ "SigType" SG_ 3221225472 Jystck10GrpXAxsLvrLftNgtvPsSttus 4;
BA_ "SPN" SG_ 3221225472 Jystck10GrpXAxisNeutralPosStatus 4735;
BA_ "SigType" SG_ 3221225472 Jystck10GrpXAxisNeutralPosStatus 4;
BA_ "SPN" SG_ 3221225472 FuelTankTransferPumpPress 7395;
BA_ "SigType" SG_ 3221225472 FuelTankTransferPumpPress 1;
BA_ "SPN" SG_ 3221225472 FuelTankTransferPump 4010;
BA_ "SigType" SG_ 3221225472 FuelTankTransferPump 4;
BA_ "SPN" SG_ 3221225472 EngFuelFilterIntakeAbsPress 5417;
BA_ "SigType" SG_ 3221225472 EngFuelFilterIntakeAbsPress 1;
BA_ "SPN" SG_ 3221225472 EngFuelDeliveryPress 7469;
BA_ "SigType" SG_ 3221225472 EngFuelDeliveryPress 1;
BA_ "SPN" SG_ 3221225472 EngOilPress 7468;
BA_ "SigType" SG_ 3221225472 EngOilPress 1;
BA_ "SPN" SG_ 3221225472 EngExhstGsRcrcltn1OutletAbsPress 5431;
BA_ "SigType" SG_ 3221225472 EngExhstGsRcrcltn1OutletAbsPress 1;
BA_ "SPN" SG_ 3221225472 EngExhstGsRcrcltn1IntakeAbsPress 5430;
BA_ "SigType" SG_ 3221225472 EngExhstGsRcrcltn1IntakeAbsPress 1;
BA_ "SPN" SG_ 3221225472 EngCoolantPress2 5708;
BA_ "SigType" SG_ 3221225472 EngCoolantPress2 1;
BA_ "SPN" SG_ 3221225472 EngExhstGsRcrcltn2IntakeAbsPress 5429;
BA_ "SigType" SG_ 3221225472 EngExhstGsRcrcltn2IntakeAbsPress 1;
BA_ "SPN" SG_ 3221225472 EngExhstGsRcrcltn2OutletAbsPress 5254;
BA_ "SigType" SG_ 3221225472 EngExhstGsRcrcltn2OutletAbsPress 1;
BA_ "SPN" SG_ 3221225472 EngExhstGsRcrclation2IntakePress 5253;
BA_ "SigType" SG_ 3221225472 EngExhstGsRcrclation2IntakePress 1;
BA_ "SPN" SG_ 3221225472 EngExhstGsRcirculation2DiffPress 5252;
BA_ "SigType" SG_ 3221225472 EngExhstGsRcirculation2DiffPress 1;
BA_ "SPN" SG_ 3221225472 CmmndedEngFuelInjectionCtrlPress 5314;
BA_ "SigType" SG_ 3221225472 CmmndedEngFuelInjectionCtrlPress 1;
BA_ "SPN" SG_ 3221225472 CommandedEngFuelRailPress 5313;
BA_ "SigType" SG_ 3221225472 CommandedEngFuelRailPress 1;
BA_ "SPN" SG_ 3221225472 EngExhstGsRcirculation2Valve2Pos 5263;
BA_ "SigType" SG_ 3221225472 EngExhstGsRcirculation2Valve2Pos 1;
BA_ "SPN" SG_ 3221225472 EngExhstGsRecirculation2ValvePos 5262;
BA_ "SigType" SG_ 3221225472 EngExhstGsRecirculation2ValvePos 1;
BA_ "SPN" SG_ 3221225472 EngExhstGsRcrcltn2Valve2PosError 5832;
BA_ "SigType" SG_ 3221225472 EngExhstGsRcrcltn2Valve2PosError 1;
BA_ "SPN" SG_ 3221225472 EngExhstGsRcrcltn2Valve1PosError 5831;
BA_ "SigType" SG_ 3221225472 EngExhstGsRcrcltn2Valve1PosError 1;
BA_ "SPN" SG_ 3221225472 EngExhstGsRcrculation2Valve2Ctrl 5265;
BA_ "SigType" SG_ 3221225472 EngExhstGsRcrculation2Valve2Ctrl 1;
BA_ "SPN" SG_ 3221225472 EngExhstGsRcirculation2ValveCtrl 5264;
BA_ "SigType" SG_ 3221225472 EngExhstGsRcirculation2ValveCtrl 1;
BA_ "SPN" SG_ 3221225472 EGR2CoolerBypassActuatorPos 5261;
BA_ "SigType" SG_ 3221225472 EGR2CoolerBypassActuatorPos 1;
BA_ "SPN" SG_ 3221225472 EngExhstGsRcrcltn2ClerEfficiency 5260;
BA_ "SigType" SG_ 3221225472 EngExhstGsRcrcltn2ClerEfficiency 1;
BA_ "SPN" SG_ 3221225472 EngExhstGsRcrcltn2ClrIntkGsAbsPr 5259;
BA_ "SigType" SG_ 3221225472 EngExhstGsRcrcltn2ClrIntkGsAbsPr 1;
BA_ "SPN" SG_ 3221225472 EngExhstGsRcrcltn2ClerIntakeTemp 5258;
BA_ "SigType" SG_ 3221225472 EngExhstGsRcrcltn2ClerIntakeTemp 1;
BA_ "SPN" SG_ 3221225472 EngFrictionPercentTorquePoint7 5477;
BA_ "GenSigStartValue" SG_ 3221225472 EngFrictionPercentTorquePoint7 125;
BA_ "SigType" SG_ 3221225472 EngFrictionPercentTorquePoint7 1;
BA_ "SPN" SG_ 3221225472 EngFrictionPercentTorquePoint6 5476;
BA_ "GenSigStartValue" SG_ 3221225472 EngFrictionPercentTorquePoint6 125;
BA_ "SigType" SG_ 3221225472 EngFrictionPercentTorquePoint6 1;
BA_ "SPN" SG_ 3221225472 EngFrictionPercentTorquePoint5 5475;
BA_ "GenSigStartValue" SG_ 3221225472 EngFrictionPercentTorquePoint5 125;
BA_ "SigType" SG_ 3221225472 EngFrictionPercentTorquePoint5 1;
BA_ "SPN" SG_ 3221225472 EngFrictionPercentTorquePoint4 5474;
BA_ "GenSigStartValue" SG_ 3221225472 EngFrictionPercentTorquePoint4 125;
BA_ "SigType" SG_ 3221225472 EngFrictionPercentTorquePoint4 1;
BA_ "SPN" SG_ 3221225472 EngFrictionPercentTorquePoint3 5473;
BA_ "GenSigStartValue" SG_ 3221225472 EngFrictionPercentTorquePoint3 125;
BA_ "SigType" SG_ 3221225472 EngFrictionPercentTorquePoint3 1;
BA_ "SPN" SG_ 3221225472 EngFrictionPercentTorquePoint2 5472;
BA_ "GenSigStartValue" SG_ 3221225472 EngFrictionPercentTorquePoint2 125;
BA_ "SigType" SG_ 3221225472 EngFrictionPercentTorquePoint2 1;
BA_ "SPN" SG_ 3221225472 EngFrctnPrcentTorqueAtIdlePoint1 5471;
BA_ "GenSigStartValue" SG_ 3221225472 EngFrctnPrcentTorqueAtIdlePoint1 125;
BA_ "SigType" SG_ 3221225472 EngFrctnPrcentTorqueAtIdlePoint1 1;
BA_ "SPN" SG_ 3221225472 DslPrtcltFltrActvRgnrtnInhbt5629 5629;
BA_ "SigType" SG_ 3221225472 DslPrtcltFltrActvRgnrtnInhbt5629 5;
BA_ "SPN" SG_ 3221225472 AFT1DPFCondNotMetForActiveRegen 3750;
BA_ "SigType" SG_ 3221225472 AFT1DPFCondNotMetForActiveRegen 5;
BA_ "SPN" SG_ 3221225472 HydrocarbonDoserPurgingEnable 5504;
BA_ "SigType" SG_ 3221225472 HydrocarbonDoserPurgingEnable 5;
BA_ "SPN" SG_ 3221225472 DslPrtcltFltrActvRgnrtnFrcdSttus 4175;
BA_ "SPN" SG_ 3221225472 ExhaustSystemHighTempLampCmd 3698;
BA_ "SPN" SG_ 3221225472 DslPrtcltFltrAtmtcActvRgnrtnIntt 3718;
BA_ "SigType" SG_ 3221225472 DslPrtcltFltrAtmtcActvRgnrtnIntt 5;
BA_ "SPN" SG_ 3221225472 DslPrtcltFltrActvRgnrtnInhbt3717 3717;
BA_ "SigType" SG_ 3221225472 DslPrtcltFltrActvRgnrtnInhbt3717 5;
BA_ "SPN" SG_ 3221225472 DslPrtcltFltrActvRgnrtnInhbtdDTE 3716;
BA_ "SigType" SG_ 3221225472 DslPrtcltFltrActvRgnrtnInhbtdDTE 5;
BA_ "SPN" SG_ 3221225472 DslPrtcltFltrActvRgnrtnInhbt3715 3715;
BA_ "SigType" SG_ 3221225472 DslPrtcltFltrActvRgnrtnInhbt3715 4;
BA_ "SPN" SG_ 3221225472 DslPrtcltFltrActvRgnrtnInhbtdDTT 3714;
BA_ "SigType" SG_ 3221225472 DslPrtcltFltrActvRgnrtnInhbtdDTT 5;
BA_ "SPN" SG_ 3221225472 DslPrtcltFltrActvRgnrtnInhbt3713 3713;
BA_ "SigType" SG_ 3221225472 DslPrtcltFltrActvRgnrtnInhbt3713 5;
BA_ "SPN" SG_ 3221225472 DslPrtcltFltrActvRgnrtnInhbt3712 3712;
BA_ "SigType" SG_ 3221225472 DslPrtcltFltrActvRgnrtnInhbt3712 5;
BA_ "SPN" SG_ 3221225472 DslPrtcltFltrActvRgnrtnInhbtdDTL 3711;
BA_ "SigType" SG_ 3221225472 DslPrtcltFltrActvRgnrtnInhbtdDTL 4;
BA_ "SPN" SG_ 3221225472 DslPrtcltFltrActvRgnrtnInhbt3710 3710;
BA_ "SigType" SG_ 3221225472 DslPrtcltFltrActvRgnrtnInhbt3710 5;
BA_ "SPN" SG_ 3221225472 DslPrtcltFltrActvRgnrtnInhbtdDTV 3709;
BA_ "SigType" SG_ 3221225472 DslPrtcltFltrActvRgnrtnInhbtdDTV 5;
BA_ "SPN" SG_ 3221225472 DslPrtcltFltrActvRgnrtnInhbtdDTO 3708;
BA_ "SigType" SG_ 3221225472 DslPrtcltFltrActvRgnrtnInhbtdDTO 5;
BA_ "SPN" SG_ 3221225472 DslPrtcltFltrActvRgnrtnInhbtdDTA 3707;
BA_ "SigType" SG_ 3221225472 DslPrtcltFltrActvRgnrtnInhbtdDTA 5;
BA_ "SPN" SG_ 3221225472 DslPrtcltFltrActvRgnrtnInhbtdDTP 3706;
BA_ "SigType" SG_ 3221225472 DslPrtcltFltrActvRgnrtnInhbtdDTP 5;
BA_ "SPN" SG_ 3221225472 DslPrtcltFltrActvRgnrtnInhbtdDTS 3705;
BA_ "SigType" SG_ 3221225472 DslPrtcltFltrActvRgnrtnInhbtdDTS 5;
BA_ "SPN" SG_ 3221225472 DslPrtcltFltrActvRgnrtnInhbtdDTC 3704;
BA_ "SigType" SG_ 3221225472 DslPrtcltFltrActvRgnrtnInhbtdDTC 5;
BA_ "SPN" SG_ 3221225472 DslPrtcltFltrActvRgnrtnInhbtdDTI 3703;
BA_ "SigType" SG_ 3221225472 DslPrtcltFltrActvRgnrtnInhbtdDTI 5;
BA_ "SPN" SG_ 3221225472 DslPrtcltFltrActvRgnrtnInhbtdStt 3702;
BA_ "SigType" SG_ 3221225472 DslPrtcltFltrActvRgnrtnInhbtdStt 5;
BA_ "SPN" SG_ 3221225472 AFTDPFStatus 3701;
BA_ "SPN" SG_ 3221225472 AFTDPFActiveRegenStatus 3700;
BA_ "SigType" SG_ 3221225472 AFTDPFActiveRegenStatus 5;
BA_ "SPN" SG_ 3221225472 AFTDPFPassiveRegenStatus 3699;
BA_ "SigType" SG_ 3221225472 AFTDPFPassiveRegenStatus 5;
BA_ "SPN" SG_ 3221225472 DieselParticulateFilterLampCmd 3697;
BA_ "SPN" SG_ 3221225472 AFT2DPFSootSignalMin 5271;
BA_ "SigType" SG_ 3221225472 AFT2DPFSootSignalMin 1;
BA_ "SPN" SG_ 3221225472 AFT2DPFSootSignalMax 5270;
BA_ "SigType" SG_ 3221225472 AFT2DPFSootSignalMax 1;
BA_ "SPN" SG_ 3221225472 AFT2DPFSootSignalStdDeviation 5269;
BA_ "SigType" SG_ 3221225472 AFT2DPFSootSignalStdDeviation 1;
BA_ "SPN" SG_ 3221225472 DslPrtcltFltr2StSnsrECUIntrnlTmp 5570;
BA_ "SigType" SG_ 3221225472 DslPrtcltFltr2StSnsrECUIntrnlTmp 1;
BA_ "SPN" SG_ 3221225472 AFT2DPFSootSnsrPreliminaryFMI 4790;
BA_ "SPN" SG_ 3221225472 AFT2DPFMedianSootSignal 4789;
BA_ "SigType" SG_ 3221225472 AFT2DPFMedianSootSignal 1;
BA_ "SPN" SG_ 3221225472 AFT2DPFMeanSootSignal 4788;
BA_ "SigType" SG_ 3221225472 AFT2DPFMeanSootSignal 1;
BA_ "SPN" SG_ 3221225472 AFT2DPFSootDensity 4787;
BA_ "SigType" SG_ 3221225472 AFT2DPFSootDensity 1;
BA_ "SPN" SG_ 3221225472 AFT2DPFSootMass 4786;
BA_ "SigType" SG_ 3221225472 AFT2DPFSootMass 1;
BA_ "SPN" SG_ 3221225472 AFT1DPFSootSignalMin 5268;
BA_ "SigType" SG_ 3221225472 AFT1DPFSootSignalMin 1;
BA_ "SPN" SG_ 3221225472 AFT1DPFSootSignalMax 5267;
BA_ "SigType" SG_ 3221225472 AFT1DPFSootSignalMax 1;
BA_ "SPN" SG_ 3221225472 AFT1DPFSootSignalStdDeviation 5266;
BA_ "SigType" SG_ 3221225472 AFT1DPFSootSignalStdDeviation 1;
BA_ "SPN" SG_ 3221225472 DslPrtcltFltr1StSnsrECUIntrnlTmp 5569;
BA_ "SigType" SG_ 3221225472 DslPrtcltFltr1StSnsrECUIntrnlTmp 1;
BA_ "SPN" SG_ 3221225472 AFT1DPFSootSnsrPreliminaryFMI 4785;
BA_ "SPN" SG_ 3221225472 AFT1DPFMedianSootSignal 4784;
BA_ "SigType" SG_ 3221225472 AFT1DPFMedianSootSignal 1;
BA_ "SPN" SG_ 3221225472 AFT1DPFMeanSootSignal 4783;
BA_ "SigType" SG_ 3221225472 AFT1DPFMeanSootSignal 1;
BA_ "SPN" SG_ 3221225472 AFT1DPFSootDensity 4782;
BA_ "SigType" SG_ 3221225472 AFT1DPFSootDensity 1;
BA_ "SPN" SG_ 3221225472 AFT1DPFSootMass 4781;
BA_ "SigType" SG_ 3221225472 AFT1DPFSootMass 1;
BA_ "SPN" SG_ 3221225472 HillHolderLampData 1848;
BA_ "SigType" SG_ 3221225472 HillHolderLampData 5;
BA_ "SPN" SG_ 3221225472 VehicleBatteryChargingLampData 5108;
BA_ "SigType" SG_ 3221225472 VehicleBatteryChargingLampData 4;
BA_ "SPN" SG_ 3221225472 VehicleHVACRecirculationLampData 5107;
BA_ "SigType" SG_ 3221225472 VehicleHVACRecirculationLampData 4;
BA_ "SPN" SG_ 3221225472 VehicleAirPressLowLampData 5106;
BA_ "SigType" SG_ 3221225472 VehicleAirPressLowLampData 4;
BA_ "SPN" SG_ 3221225472 VehicleFuelLevelLowLampData 5105;
BA_ "SigType" SG_ 3221225472 VehicleFuelLevelLowLampData 4;
BA_ "SPN" SG_ 3221225472 VehicleBatteryVoltageLowLampData 5104;
BA_ "SigType" SG_ 3221225472 VehicleBatteryVoltageLowLampData 4;
BA_ "SPN" SG_ 3221225472 VhclAcclerationRateLimitLampData 6900;
BA_ "SigType" SG_ 3221225472 VhclAcclerationRateLimitLampData 4;
BA_ "SPN" SG_ 3221225472 EngSpeedVeryHighLampData 6712;
BA_ "SigType" SG_ 3221225472 EngSpeedVeryHighLampData 5;
BA_ "SPN" SG_ 3221225472 EngSpeedHighLampData 6711;
BA_ "SigType" SG_ 3221225472 EngSpeedHighLampData 5;
BA_ "SPN" SG_ 3221225472 EngCtrlMdule3ReadyForUseLampData 6204;
BA_ "SigType" SG_ 3221225472 EngCtrlMdule3ReadyForUseLampData 4;
BA_ "SPN" SG_ 3221225472 EngCtrlMdule2ReadyForUseLampData 6203;
BA_ "SigType" SG_ 3221225472 EngCtrlMdule2ReadyForUseLampData 4;
BA_ "SPN" SG_ 3221225472 EngCtrlMdule1ReadyForUseLampData 6202;
BA_ "SigType" SG_ 3221225472 EngCtrlMdule1ReadyForUseLampData 4;
BA_ "SPN" SG_ 3221225472 EngWaitToStartLampData 5416;
BA_ "SigType" SG_ 3221225472 EngWaitToStartLampData 4;
BA_ "SPN" SG_ 3221225472 EngFuelFilterRestrictedLampData 5470;
BA_ "SigType" SG_ 3221225472 EngFuelFilterRestrictedLampData 5;
BA_ "SPN" SG_ 3221225472 EngAirFilterRestrictionLampData 5103;
BA_ "SigType" SG_ 3221225472 EngAirFilterRestrictionLampData 4;
BA_ "SPN" SG_ 3221225472 EngIdleManagementActiveLampData 5102;
BA_ "SigType" SG_ 3221225472 EngIdleManagementActiveLampData 4;
BA_ "SPN" SG_ 3221225472 EngCoolantLevelLowLampData 5101;
BA_ "SigType" SG_ 3221225472 EngCoolantLevelLowLampData 4;
BA_ "SPN" SG_ 3221225472 EngCoolantTempHighLampData 5100;
BA_ "SigType" SG_ 3221225472 EngCoolantTempHighLampData 4;
BA_ "SPN" SG_ 3221225472 EngOilPressLowLampData 5099;
BA_ "SigType" SG_ 3221225472 EngOilPressLowLampData 4;
BA_ "SPN" SG_ 3221225472 CmprssnBrkEnblSwtchIndctrLmpData 5098;
BA_ "SigType" SG_ 3221225472 CmprssnBrkEnblSwtchIndctrLmpData 4;
BA_ "SPN" SG_ 3221225472 EngBrakeActiveLampData 5097;
BA_ "SigType" SG_ 3221225472 EngBrakeActiveLampData 4;
BA_ "SPN" SG_ 3221225472 OBDMalfunctionIndicatorLampData 5096;
BA_ "SigType" SG_ 3221225472 OBDMalfunctionIndicatorLampData 4;
BA_ "SPN" SG_ 3221225472 EngRedStopLampData 5095;
BA_ "SigType" SG_ 3221225472 EngRedStopLampData 4;
BA_ "SPN" SG_ 3221225472 EngAmberWarningLampData 5094;
BA_ "SigType" SG_ 3221225472 EngAmberWarningLampData 4;
BA_ "SPN" SG_ 3221225472 EngProtectLampData 5093;
BA_ "SigType" SG_ 3221225472 EngProtectLampData 4;
BA_ "SPN" SG_ 3221225472 HillHolderLampCmd 1847;
BA_ "SigType" SG_ 3221225472 HillHolderLampCmd 5;
BA_ "SPN" SG_ 3221225472 VehicleBatteryChargingLampCmd 5091;
BA_ "SigType" SG_ 3221225472 VehicleBatteryChargingLampCmd 5;
BA_ "SPN" SG_ 3221225472 VehicleHVACRecirculationLampCmd 5090;
BA_ "SigType" SG_ 3221225472 VehicleHVACRecirculationLampCmd 5;
BA_ "SPN" SG_ 3221225472 VehicleAirPressLowLampCmd 5089;
BA_ "SigType" SG_ 3221225472 VehicleAirPressLowLampCmd 5;
BA_ "SPN" SG_ 3221225472 VehicleFuelLevelLowLampCmd 5088;
BA_ "SigType" SG_ 3221225472 VehicleFuelLevelLowLampCmd 5;
BA_ "SPN" SG_ 3221225472 VehicleBatteryVoltageLowLampCmd 5087;
BA_ "SigType" SG_ 3221225472 VehicleBatteryVoltageLowLampCmd 5;
BA_ "SPN" SG_ 3221225472 TextDisplayIndex 3614;
BA_ "SigType" SG_ 3221225472 TextDisplayIndex 1;
BA_ "SPN" SG_ 3221225472 TextDisplayInstructions 3613;
BA_ "SPN" SG_ 3221225472 RetractStatusOfRamp5 4457;
BA_ "SigType" SG_ 3221225472 RetractStatusOfRamp5 5;
BA_ "SPN" SG_ 3221225472 RetractStatusOfRamp4 4454;
BA_ "SigType" SG_ 3221225472 RetractStatusOfRamp4 5;
BA_ "SPN" SG_ 3221225472 MovementStatusOfRamp5 4459;
BA_ "SigType" SG_ 3221225472 MovementStatusOfRamp5 5;
BA_ "SPN" SG_ 3221225472 MovementStatusOfRamp4 4456;
BA_ "SigType" SG_ 3221225472 MovementStatusOfRamp4 5;
BA_ "SPN" SG_ 3221225472 EnableStatusOfRamp5 4458;
BA_ "SigType" SG_ 3221225472 EnableStatusOfRamp5 5;
BA_ "SPN" SG_ 3221225472 EnableStatusOfRamp4 4455;
BA_ "SigType" SG_ 3221225472 EnableStatusOfRamp4 5;
BA_ "SPN" SG_ 3221225472 MovementStatusOfRamp3 3818;
BA_ "SigType" SG_ 3221225472 MovementStatusOfRamp3 5;
BA_ "SPN" SG_ 3221225472 EnableStatusOfRamp3 3817;
BA_ "SigType" SG_ 3221225472 EnableStatusOfRamp3 5;
BA_ "SPN" SG_ 3221225472 RetractStatusOfRamp3 3816;
BA_ "SigType" SG_ 3221225472 RetractStatusOfRamp3 5;
BA_ "SPN" SG_ 3221225472 MovementStatusOfRamp2 3815;
BA_ "SigType" SG_ 3221225472 MovementStatusOfRamp2 5;
BA_ "SPN" SG_ 3221225472 EnableStatusOfRamp2 3814;
BA_ "SigType" SG_ 3221225472 EnableStatusOfRamp2 5;
BA_ "SPN" SG_ 3221225472 RetractStatusOfRamp2 3813;
BA_ "SigType" SG_ 3221225472 RetractStatusOfRamp2 5;
BA_ "SPN" SG_ 3221225472 MovementStatusOfRamp1 3812;
BA_ "SigType" SG_ 3221225472 MovementStatusOfRamp1 5;
BA_ "SPN" SG_ 3221225472 EnableStatusOfRamp1 3811;
BA_ "SigType" SG_ 3221225472 EnableStatusOfRamp1 5;
BA_ "SPN" SG_ 3221225472 RetractStatusOfRamp1 3810;
BA_ "SigType" SG_ 3221225472 RetractStatusOfRamp1 5;
BA_ "SPN" SG_ 3221225472 EngConfigIdentification 6395;
BA_ "SigType" SG_ 3221225472 EngConfigIdentification 1;
BA_ "SPN" SG_ 3221225472 NmbrOfCmbstionCyclesForAveraging 6394;
BA_ "GenSigStartValue" SG_ 3221225472 NmbrOfCmbstionCyclesForAveraging 1;
BA_ "SigType" SG_ 3221225472 NmbrOfCmbstionCyclesForAveraging 1;
BA_ "SPN" SG_ 3221225472 MaxCrankAttemptsPerStartAttempt 3670;
BA_ "SigType" SG_ 3221225472 MaxCrankAttemptsPerStartAttempt 1;
BA_ "SPN" SG_ 3221225472 CommandedEngIntakeManifoldPress 5312;
BA_ "SigType" SG_ 3221225472 CommandedEngIntakeManifoldPress 1;
BA_ "SPN" SG_ 3221225472 EngCrnkcsBrtherOilSeparatorSpeed 5444;
BA_ "SigType" SG_ 3221225472 EngCrnkcsBrtherOilSeparatorSpeed 1;
BA_ "SPN" SG_ 3221225472 EngExhstGsRcirculation1Valve2Pos 3822;
BA_ "SigType" SG_ 3221225472 EngExhstGsRcirculation1Valve2Pos 1;
BA_ "SPN" SG_ 3221225472 EngExhstGsRecirculation1ValvePos 27;
BA_ "SigType" SG_ 3221225472 EngExhstGsRecirculation1ValvePos 1;
BA_ "SPN" SG_ 3221225472 EngExhstGsRcrcltn1ClerEfficiency 4752;
BA_ "SigType" SG_ 3221225472 EngExhstGsRcrcltn1ClerEfficiency 1;
BA_ "SPN" SG_ 3221225472 EngExhstGsRcrcltn1ClrIntkGsAbsPr 4751;
BA_ "SigType" SG_ 3221225472 EngExhstGsRcrcltn1ClrIntkGsAbsPr 1;
BA_ "SPN" SG_ 3221225472 EngExhstGsRcrcltn1ClerIntakeTemp 4750;
BA_ "SigType" SG_ 3221225472 EngExhstGsRcrcltn1ClerIntakeTemp 1;
BA_ "SPN" SG_ 3221225472 EngExhstGsRcrculation1Valve2Ctrl 3821;
BA_ "SigType" SG_ 3221225472 EngExhstGsRcrculation1Valve2Ctrl 1;
BA_ "SPN" SG_ 3221225472 EngIntkVlvActtionOilPressForCyl4 3627;
BA_ "SigType" SG_ 3221225472 EngIntkVlvActtionOilPressForCyl4 1;
BA_ "SPN" SG_ 3221225472 EngIntkVlvActtionOilPressForCyl3 3626;
BA_ "SigType" SG_ 3221225472 EngIntkVlvActtionOilPressForCyl3 1;
BA_ "SPN" SG_ 3221225472 EngIntkVlvActtionOilPressForCyl2 3625;
BA_ "SigType" SG_ 3221225472 EngIntkVlvActtionOilPressForCyl2 1;
BA_ "SPN" SG_ 3221225472 EngIntkVlvActtionOilPressForCyl1 3624;
BA_ "SigType" SG_ 3221225472 EngIntkVlvActtionOilPressForCyl1 1;
BA_ "SPN" SG_ 3221225472 EngIntkVlvActtionOilPressForCyl8 3631;
BA_ "SigType" SG_ 3221225472 EngIntkVlvActtionOilPressForCyl8 1;
BA_ "SPN" SG_ 3221225472 EngIntkVlvActtionOilPressForCyl7 3630;
BA_ "SigType" SG_ 3221225472 EngIntkVlvActtionOilPressForCyl7 1;
BA_ "SPN" SG_ 3221225472 EngIntkVlvActtionOilPressForCyl6 3629;
BA_ "SigType" SG_ 3221225472 EngIntkVlvActtionOilPressForCyl6 1;
BA_ "SPN" SG_ 3221225472 EngIntkVlvActtionOilPressForCyl5 3628;
BA_ "SigType" SG_ 3221225472 EngIntkVlvActtionOilPressForCyl5 1;
BA_ "SPN" SG_ 3221225472 EngIntkVlvActtonOilPressForCyl12 3635;
BA_ "SigType" SG_ 3221225472 EngIntkVlvActtonOilPressForCyl12 1;
BA_ "SPN" SG_ 3221225472 EngIntkVlvActtonOilPressForCyl11 3634;
BA_ "SigType" SG_ 3221225472 EngIntkVlvActtonOilPressForCyl11 1;
BA_ "SPN" SG_ 3221225472 EngIntkVlvActtonOilPressForCyl10 3633;
BA_ "SigType" SG_ 3221225472 EngIntkVlvActtonOilPressForCyl10 1;
BA_ "SPN" SG_ 3221225472 EngIntkVlvActtionOilPressForCyl9 3632;
BA_ "SigType" SG_ 3221225472 EngIntkVlvActtionOilPressForCyl9 1;
BA_ "SPN" SG_ 3221225472 EngIntkVlvActtonOilPressForCyl16 3639;
BA_ "SigType" SG_ 3221225472 EngIntkVlvActtonOilPressForCyl16 1;
BA_ "SPN" SG_ 3221225472 EngIntkVlvActtonOilPressForCyl15 3638;
BA_ "SigType" SG_ 3221225472 EngIntkVlvActtonOilPressForCyl15 1;
BA_ "SPN" SG_ 3221225472 EngIntkVlvActtonOilPressForCyl14 3637;
BA_ "SigType" SG_ 3221225472 EngIntkVlvActtonOilPressForCyl14 1;
BA_ "SPN" SG_ 3221225472 EngIntkVlvActtonOilPressForCyl13 3636;
BA_ "SigType" SG_ 3221225472 EngIntkVlvActtonOilPressForCyl13 1;
BA_ "SPN" SG_ 3221225472 EngIntkVlvActtonOilPressForCyl20 3643;
BA_ "SigType" SG_ 3221225472 EngIntkVlvActtonOilPressForCyl20 1;
BA_ "SPN" SG_ 3221225472 EngIntkVlvActtonOilPressForCyl19 3642;
BA_ "SigType" SG_ 3221225472 EngIntkVlvActtonOilPressForCyl19 1;
BA_ "SPN" SG_ 3221225472 EngIntkVlvActtonOilPressForCyl18 3641;
BA_ "SigType" SG_ 3221225472 EngIntkVlvActtonOilPressForCyl18 1;
BA_ "SPN" SG_ 3221225472 EngIntkVlvActtonOilPressForCyl17 3640;
BA_ "SigType" SG_ 3221225472 EngIntkVlvActtonOilPressForCyl17 1;
BA_ "SPN" SG_ 3221225472 EGR1CoolerBypassActuatorPostion 3672;
BA_ "SigType" SG_ 3221225472 EGR1CoolerBypassActuatorPostion 1;
BA_ "SPN" SG_ 3221225472 EngSparkPlug4 1297;
BA_ "SigType" SG_ 3221225472 EngSparkPlug4 1;
BA_ "SPN" SG_ 3221225472 EngSparkPlug3 1296;
BA_ "SigType" SG_ 3221225472 EngSparkPlug3 1;
BA_ "SPN" SG_ 3221225472 EngSparkPlug2 1295;
BA_ "SigType" SG_ 3221225472 EngSparkPlug2 1;
BA_ "SPN" SG_ 3221225472 EngSparkPlug1 1294;
BA_ "SigType" SG_ 3221225472 EngSparkPlug1 1;
BA_ "SPN" SG_ 3221225472 EngSparkPlug8 1301;
BA_ "SigType" SG_ 3221225472 EngSparkPlug8 1;
BA_ "SPN" SG_ 3221225472 EngSparkPlug7 1300;
BA_ "SigType" SG_ 3221225472 EngSparkPlug7 1;
BA_ "SPN" SG_ 3221225472 EngSparkPlug6 1299;
BA_ "SigType" SG_ 3221225472 EngSparkPlug6 1;
BA_ "SPN" SG_ 3221225472 EngSparkPlug5 1298;
BA_ "SigType" SG_ 3221225472 EngSparkPlug5 1;
BA_ "SPN" SG_ 3221225472 EngSparkPlug12 1305;
BA_ "SigType" SG_ 3221225472 EngSparkPlug12 1;
BA_ "SPN" SG_ 3221225472 EngSparkPlug11 1304;
BA_ "SigType" SG_ 3221225472 EngSparkPlug11 1;
BA_ "SPN" SG_ 3221225472 EngSparkPlug10 1303;
BA_ "SigType" SG_ 3221225472 EngSparkPlug10 1;
BA_ "SPN" SG_ 3221225472 EngSparkPlug9 1302;
BA_ "SigType" SG_ 3221225472 EngSparkPlug9 1;
BA_ "SPN" SG_ 3221225472 EngSparkPlug16 1309;
BA_ "SigType" SG_ 3221225472 EngSparkPlug16 1;
BA_ "SPN" SG_ 3221225472 EngSparkPlug15 1308;
BA_ "SigType" SG_ 3221225472 EngSparkPlug15 1;
BA_ "SPN" SG_ 3221225472 EngSparkPlug14 1307;
BA_ "SigType" SG_ 3221225472 EngSparkPlug14 1;
BA_ "SPN" SG_ 3221225472 EngSparkPlug13 1306;
BA_ "SigType" SG_ 3221225472 EngSparkPlug13 1;
BA_ "SPN" SG_ 3221225472 EngSparkPlug20 1313;
BA_ "SigType" SG_ 3221225472 EngSparkPlug20 1;
BA_ "SPN" SG_ 3221225472 EngSparkPlug19 1312;
BA_ "SigType" SG_ 3221225472 EngSparkPlug19 1;
BA_ "SPN" SG_ 3221225472 EngSparkPlug18 1311;
BA_ "SigType" SG_ 3221225472 EngSparkPlug18 1;
BA_ "SPN" SG_ 3221225472 EngSparkPlug17 1310;
BA_ "SigType" SG_ 3221225472 EngSparkPlug17 1;
BA_ "SPN" SG_ 3221225472 EngSparkPlug24 1317;
BA_ "SigType" SG_ 3221225472 EngSparkPlug24 1;
BA_ "SPN" SG_ 3221225472 EngSparkPlug23 1316;
BA_ "SigType" SG_ 3221225472 EngSparkPlug23 1;
BA_ "SPN" SG_ 3221225472 EngSparkPlug22 1315;
BA_ "SigType" SG_ 3221225472 EngSparkPlug22 1;
BA_ "SPN" SG_ 3221225472 EngSparkPlug21 1314;
BA_ "SigType" SG_ 3221225472 EngSparkPlug21 1;
BA_ "SPN" SG_ 3221225472 LaneDepartureWarningEnableCmd 3564;
BA_ "SigType" SG_ 3221225472 LaneDepartureWarningEnableCmd 5;
BA_ "SPN" SG_ 3221225472 J2012DTCOccurrenceCount 3622;
BA_ "SPN" SG_ 3221225472 J2012DTCStatus 3621;
BA_ "SPN" SG_ 3221225472 J2012DTC 3620;
BA_ "SPN" SG_ 3221225472 NumberOfJ2012DTCs 3619;
BA_ "SigType" SG_ 3221225472 NumberOfJ2012DTCs 1;
BA_ "SPN" SG_ 3221225472 SteerAngleSensorCalibrated 3688;
BA_ "SigType" SG_ 3221225472 SteerAngleSensorCalibrated 5;
BA_ "SPN" SG_ 3221225472 SteerAngleSensorActiveMode 3687;
BA_ "SigType" SG_ 3221225472 SteerAngleSensorActiveMode 5;
BA_ "SPN" SG_ 3221225472 SteerWheelAngleRange 3686;
BA_ "GenSigStartValue" SG_ 3221225472 SteerWheelAngleRange 32127;
BA_ "SigType" SG_ 3221225472 SteerWheelAngleRange 1;
BA_ "SPN" SG_ 3221225472 SteerWheelAngleRangeCounterType 3685;
BA_ "SigType" SG_ 3221225472 SteerWheelAngleRangeCounterType 5;
BA_ "SPN" SG_ 3221225472 SteerWheelAngleRangeCounter 3684;
BA_ "SPN" SG_ 3221225472 SteerWheelAngle 3683;
BA_ "SigType" SG_ 3221225472 SteerWheelAngle 1;
BA_ "SPN" SG_ 3221225472 SysSulfationLvl 7504;
BA_ "SigType" SG_ 3221225472 SysSulfationLvl 1;
BA_ "SPN" SG_ 3221225472 SCROpIndActiveTraveledDist 5463;
BA_ "SigType" SG_ 3221225472 SCROpIndActiveTraveledDist 1;
BA_ "SPN" SG_ 3221225472 ConversionEfficiency 4364;
BA_ "SigType" SG_ 3221225472 ConversionEfficiency 1;
BA_ "SPN" SG_ 3221225472 CommandedDEFConsumption 3828;
BA_ "SigType" SG_ 3221225472 CommandedDEFConsumption 1;
BA_ "SPN" SG_ 3221225472 DEFAvgConsumption 3826;
BA_ "SigType" SG_ 3221225472 DEFAvgConsumption 1;
BA_ "SPN" SG_ 3221225472 TransferCaseStatus 3645;
BA_ "SPN" SG_ 3221225472 TransOilLevel2MeasurementStatus 5916;
BA_ "SPN" SG_ 3221225472 TransOilLevel2CountdownTimer 5915;
BA_ "SPN" SG_ 3221225472 TransOilLevel2High_Low 5914;
BA_ "SigType" SG_ 3221225472 TransOilLevel2High_Low 1;
BA_ "SPN" SG_ 3221225472 TransOilTemp2 5913;
BA_ "SigType" SG_ 3221225472 TransOilTemp2 1;
BA_ "SPN" SG_ 3221225472 TransOilLifeRemaining 4177;
BA_ "SigType" SG_ 3221225472 TransOilLifeRemaining 1;
BA_ "SPN" SG_ 3221225472 TrnsTorqueConverterOilOutletTemp 3823;
BA_ "SigType" SG_ 3221225472 TrnsTorqueConverterOilOutletTemp 1;
BA_ "SPN" SG_ 3221225472 TransOverheatIndicator 5345;
BA_ "SigType" SG_ 3221225472 TransOverheatIndicator 5;
BA_ "SPN" SG_ 3221225472 TransOilLevelSwitch 3533;
BA_ "SigType" SG_ 3221225472 TransOilLevelSwitch 5;
BA_ "SPN" SG_ 3221225472 TransOilFilterRestrictionSwitch 3359;
BA_ "SigType" SG_ 3221225472 TransOilFilterRestrictionSwitch 5;
BA_ "SPN" SG_ 3221225472 VehicleRoll 3623;
BA_ "GenSigStartValue" SG_ 3221225472 VehicleRoll 14080;
BA_ "SigType" SG_ 3221225472 VehicleRoll 1;
BA_ "SPN" SG_ 3221225472 TotalEngCruiseTime 1017;
BA_ "SigType" SG_ 3221225472 TotalEngCruiseTime 1;
BA_ "SPN" SG_ 3221225472 TotalDriveAverageLoadFactor 1016;
BA_ "SigType" SG_ 3221225472 TotalDriveAverageLoadFactor 1;
BA_ "SPN" SG_ 3221225472 TripDriveAverageLoadFactor 1015;
BA_ "SigType" SG_ 3221225472 TripDriveAverageLoadFactor 1;
BA_ "SPN" SG_ 3221225472 TripAverageEngSpeed 1014;
BA_ "SigType" SG_ 3221225472 TripAverageEngSpeed 1;
BA_ "SPN" SG_ 3221225472 TripMaxEngSpeed 1013;
BA_ "SigType" SG_ 3221225472 TripMaxEngSpeed 1;
BA_ "SPN" SG_ 3221225472 ImplementRearWorkLight 2394;
BA_ "SigType" SG_ 3221225472 ImplementRearWorkLight 4;
BA_ "SPN" SG_ 3221225472 ImplLeftFacingWorkLight 2400;
BA_ "SigType" SG_ 3221225472 ImplLeftFacingWorkLight 4;
BA_ "SPN" SG_ 3221225472 ImplRightForwardWorkLight 2402;
BA_ "SigType" SG_ 3221225472 ImplRightForwardWorkLight 4;
BA_ "SPN" SG_ 3221225472 ImplLeftForwardWorkLight 2598;
BA_ "SigType" SG_ 3221225472 ImplLeftForwardWorkLight 4;
BA_ "SPN" SG_ 3221225472 ImplRightFacingWorkLight 2407;
BA_ "SigType" SG_ 3221225472 ImplRightFacingWorkLight 4;
BA_ "SPN" SG_ 3221225472 ImplementOEMOption1Light 2396;
BA_ "SigType" SG_ 3221225472 ImplementOEMOption1Light 4;
BA_ "SPN" SG_ 3221225472 ImplementOEMOption2Light 2398;
BA_ "SigType" SG_ 3221225472 ImplementOEMOption2Light 4;
BA_ "SPN" SG_ 3221225472 TrctorFrontHighMdWkLights 2356;
BA_ "SigType" SG_ 3221225472 TrctorFrontHighMdWkLights 4;
BA_ "SPN" SG_ 3221225472 TractorFrontLowMdWkLights 2354;
BA_ "SigType" SG_ 3221225472 TractorFrontLowMdWkLights 4;
BA_ "SPN" SG_ 3221225472 TractorSideHighMdWkLights 2366;
BA_ "SigType" SG_ 3221225472 TractorSideHighMdWkLights 4;
BA_ "SPN" SG_ 3221225472 TractorSideLowMdWkLights 2364;
BA_ "SigType" SG_ 3221225472 TractorSideLowMdWkLights 4;
BA_ "SPN" SG_ 3221225472 TractorRearHighMdWkLights 2362;
BA_ "SigType" SG_ 3221225472 TractorRearHighMdWkLights 4;
BA_ "SPN" SG_ 3221225472 TractorRearLowMdWkLights 2360;
BA_ "SigType" SG_ 3221225472 TractorRearLowMdWkLights 4;
BA_ "SPN" SG_ 3221225472 TrctorUndersideMdWkLights 2358;
BA_ "SigType" SG_ 3221225472 TrctorUndersideMdWkLights 4;
BA_ "SPN" SG_ 3221225472 RearFogLights 2390;
BA_ "SigType" SG_ 3221225472 RearFogLights 4;
BA_ "SPN" SG_ 3221225472 TractorMarkerLight 2378;
BA_ "SigType" SG_ 3221225472 TractorMarkerLight 4;
BA_ "SPN" SG_ 3221225472 ImplementMarkerLight 2380;
BA_ "SigType" SG_ 3221225472 ImplementMarkerLight 4;
BA_ "SPN" SG_ 3221225472 TractorClearanceLight 2382;
BA_ "SigType" SG_ 3221225472 TractorClearanceLight 4;
BA_ "SPN" SG_ 3221225472 ImplementClearanceLight 2384;
BA_ "SigType" SG_ 3221225472 ImplementClearanceLight 4;
BA_ "SPN" SG_ 3221225472 LeftStopLight 2372;
BA_ "SigType" SG_ 3221225472 LeftStopLight 4;
BA_ "SPN" SG_ 3221225472 RightStopLight 2374;
BA_ "SigType" SG_ 3221225472 RightStopLight 4;
BA_ "SPN" SG_ 3221225472 CenterStopLight 2376;
BA_ "SigType" SG_ 3221225472 CenterStopLight 4;
BA_ "SPN" SG_ 3221225472 BackUpLightAndAlarmHorn 2392;
BA_ "SigType" SG_ 3221225472 BackUpLightAndAlarmHorn 4;
BA_ "SPN" SG_ 3221225472 LeftTurnSignalLights 2368;
BA_ "SigType" SG_ 3221225472 LeftTurnSignalLights 4;
BA_ "SPN" SG_ 3221225472 RightTurnSignalLights 2370;
BA_ "SigType" SG_ 3221225472 RightTurnSignalLights 4;
BA_ "SPN" SG_ 3221225472 RotatingBeaconLight 2386;
BA_ "SigType" SG_ 3221225472 RotatingBeaconLight 4;
BA_ "SPN" SG_ 3221225472 TractorFrontFogLights 2388;
BA_ "SigType" SG_ 3221225472 TractorFrontFogLights 4;
BA_ "SPN" SG_ 3221225472 HighBeamHeadLight 2348;
BA_ "SigType" SG_ 3221225472 HighBeamHeadLight 4;
BA_ "SPN" SG_ 3221225472 LowBeamHeadLight 2350;
BA_ "SigType" SG_ 3221225472 LowBeamHeadLight 4;
BA_ "SPN" SG_ 3221225472 AltBeamHeadLight 2352;
BA_ "SigType" SG_ 3221225472 AltBeamHeadLight 4;
BA_ "SPN" SG_ 3221225472 RunningLight 2404;
BA_ "SigType" SG_ 3221225472 RunningLight 4;
BA_ "SPN" SG_ 3221225472 ImplementRearWorkLightCmd 2405;
BA_ "SigType" SG_ 3221225472 ImplementRearWorkLightCmd 5;
BA_ "SPN" SG_ 3221225472 ImplLeftFacingWorkLightCmd 2399;
BA_ "SigType" SG_ 3221225472 ImplLeftFacingWorkLightCmd 5;
BA_ "SPN" SG_ 3221225472 ImplRightFwdWorkLightCmd 2401;
BA_ "SigType" SG_ 3221225472 ImplRightFwdWorkLightCmd 5;
BA_ "SPN" SG_ 3221225472 LightingDataRqCmd 2393;
BA_ "SigType" SG_ 3221225472 LightingDataRqCmd 5;
BA_ "SPN" SG_ 3221225472 ImplLeftForwardWorkLightCmd 2597;
BA_ "SigType" SG_ 3221225472 ImplLeftForwardWorkLightCmd 5;
BA_ "SPN" SG_ 3221225472 ImplRightFacingWorkLightCmd 2406;
BA_ "SigType" SG_ 3221225472 ImplRightFacingWorkLightCmd 5;
BA_ "SPN" SG_ 3221225472 ImplOEMOption1LightCmd 2395;
BA_ "SigType" SG_ 3221225472 ImplOEMOption1LightCmd 5;
BA_ "SPN" SG_ 3221225472 ImplOEMOption2LightCmd 2397;
BA_ "SigType" SG_ 3221225472 ImplOEMOption2LightCmd 5;
BA_ "SPN" SG_ 3221225472 TrctrFrntHghMdWkLightsCmd 2355;
BA_ "SigType" SG_ 3221225472 TrctrFrntHghMdWkLightsCmd 5;
BA_ "SPN" SG_ 3221225472 TrctrFrntLowMdWkLightsCmd 2353;
BA_ "SigType" SG_ 3221225472 TrctrFrntLowMdWkLightsCmd 5;
BA_ "SPN" SG_ 3221225472 TrctrSdeHighMdWkLightsCmd 2365;
BA_ "SigType" SG_ 3221225472 TrctrSdeHighMdWkLightsCmd 5;
BA_ "SPN" SG_ 3221225472 TrctrSideLowMdWkLightsCmd 2363;
BA_ "SigType" SG_ 3221225472 TrctrSideLowMdWkLightsCmd 5;
BA_ "SPN" SG_ 3221225472 TrctrRarHighMdWkLightsCmd 2361;
BA_ "SigType" SG_ 3221225472 TrctrRarHighMdWkLightsCmd 5;
BA_ "SPN" SG_ 3221225472 TrctrRearLowMdWkLightsCmd 2359;
BA_ "SigType" SG_ 3221225472 TrctrRearLowMdWkLightsCmd 5;
BA_ "SPN" SG_ 3221225472 TrctrUndrsdeMdWkLightsCmd 2357;
BA_ "SigType" SG_ 3221225472 TrctrUndrsdeMdWkLightsCmd 5;
BA_ "SPN" SG_ 3221225472 RearFogLightsCmd 2389;
BA_ "SigType" SG_ 3221225472 RearFogLightsCmd 5;
BA_ "SPN" SG_ 3221225472 TractorMarkerLightCmd 2377;
BA_ "SigType" SG_ 3221225472 TractorMarkerLightCmd 5;
BA_ "SPN" SG_ 3221225472 ImplementMarkerLightCmd 2379;
BA_ "SigType" SG_ 3221225472 ImplementMarkerLightCmd 5;
BA_ "SPN" SG_ 3221225472 TractorClearanceLightCmd 2381;
BA_ "SigType" SG_ 3221225472 TractorClearanceLightCmd 5;
BA_ "SPN" SG_ 3221225472 ImplementClearanceLightCmd 2383;
BA_ "SigType" SG_ 3221225472 ImplementClearanceLightCmd 5;
BA_ "SPN" SG_ 3221225472 LeftStopLightCmd 2371;
BA_ "SigType" SG_ 3221225472 LeftStopLightCmd 5;
BA_ "SPN" SG_ 3221225472 RightStopLightCmd 2373;
BA_ "SigType" SG_ 3221225472 RightStopLightCmd 5;
BA_ "SPN" SG_ 3221225472 CenterStopLightCmd 2375;
BA_ "SigType" SG_ 3221225472 CenterStopLightCmd 5;
BA_ "SPN" SG_ 3221225472 BackUpLightAndAlarmHornCmd 2391;
BA_ "SigType" SG_ 3221225472 BackUpLightAndAlarmHornCmd 5;
BA_ "SPN" SG_ 3221225472 LeftTurnSignalLightsCmd 2367;
BA_ "SigType" SG_ 3221225472 LeftTurnSignalLightsCmd 5;
BA_ "SPN" SG_ 3221225472 RightTurnSignalLightsCmd 2369;
BA_ "SigType" SG_ 3221225472 RightTurnSignalLightsCmd 5;
BA_ "SPN" SG_ 3221225472 RotatingBeaconLightCmd 2385;
BA_ "SigType" SG_ 3221225472 RotatingBeaconLightCmd 5;
BA_ "SPN" SG_ 3221225472 TractorFrontFogLightsCmd 2387;
BA_ "SigType" SG_ 3221225472 TractorFrontFogLightsCmd 5;
BA_ "SPN" SG_ 3221225472 HighBeamHeadLightCmd 2347;
BA_ "SigType" SG_ 3221225472 HighBeamHeadLightCmd 5;
BA_ "SPN" SG_ 3221225472 LowBeamHeadLightCmd 2349;
BA_ "SigType" SG_ 3221225472 LowBeamHeadLightCmd 5;
BA_ "SPN" SG_ 3221225472 AltBeamHeadLightCmd 2351;
BA_ "SigType" SG_ 3221225472 AltBeamHeadLightCmd 5;
BA_ "SPN" SG_ 3221225472 RunningLightCmd 2403;
BA_ "SigType" SG_ 3221225472 RunningLightCmd 5;
BA_ "SPN" SG_ 3221225472 LandLevelingSystemEnableStatus 5409;
BA_ "SigType" SG_ 3221225472 LandLevelingSystemEnableStatus 5;
BA_ "SPN" SG_ 3221225472 BladeCtrlModeRight 5408;
BA_ "SPN" SG_ 3221225472 BladeCtrlModeLeft 5407;
BA_ "SPN" SG_ 3221225472 BladeCtrlMode 1578;
BA_ "SPN" SG_ 3221225472 BladeDurationAndDirection 1577;
BA_ "SigType" SG_ 3221225472 BladeDurationAndDirection 1;
BA_ "SPN" SG_ 3221225472 EngActualIgntTiming 1436;
BA_ "SigType" SG_ 3221225472 EngActualIgntTiming 1;
BA_ "SPN" SG_ 3221225472 EngDesiredIgntTiming3 1435;
BA_ "SigType" SG_ 3221225472 EngDesiredIgntTiming3 1;
BA_ "SPN" SG_ 3221225472 EngDesiredIgntTiming2 1434;
BA_ "SigType" SG_ 3221225472 EngDesiredIgntTiming2 1;
BA_ "SPN" SG_ 3221225472 EngDesiredIgntTiming1 1433;
BA_ "SigType" SG_ 3221225472 EngDesiredIgntTiming1 1;
BA_ "SPN" SG_ 3221225472 EngCyl20IgntTiming 1432;
BA_ "SigType" SG_ 3221225472 EngCyl20IgntTiming 1;
BA_ "SPN" SG_ 3221225472 EngCyl19IgntTiming 1431;
BA_ "SigType" SG_ 3221225472 EngCyl19IgntTiming 1;
BA_ "SPN" SG_ 3221225472 EngCyl18IgntTiming 1430;
BA_ "SigType" SG_ 3221225472 EngCyl18IgntTiming 1;
BA_ "SPN" SG_ 3221225472 EngCyl17IgntTiming 1429;
BA_ "SigType" SG_ 3221225472 EngCyl17IgntTiming 1;
BA_ "SPN" SG_ 3221225472 EngCyl16IgntTiming 1428;
BA_ "SigType" SG_ 3221225472 EngCyl16IgntTiming 1;
BA_ "SPN" SG_ 3221225472 EngCyl15IgntTiming 1427;
BA_ "SigType" SG_ 3221225472 EngCyl15IgntTiming 1;
BA_ "SPN" SG_ 3221225472 EngCyl14IgntTiming 1426;
BA_ "SigType" SG_ 3221225472 EngCyl14IgntTiming 1;
BA_ "SPN" SG_ 3221225472 EngCyl13IgntTiming 1425;
BA_ "SigType" SG_ 3221225472 EngCyl13IgntTiming 1;
BA_ "SPN" SG_ 3221225472 EngCyl12IgntTiming 1424;
BA_ "SigType" SG_ 3221225472 EngCyl12IgntTiming 1;
BA_ "SPN" SG_ 3221225472 EngCyl11IgntTiming 1423;
BA_ "SigType" SG_ 3221225472 EngCyl11IgntTiming 1;
BA_ "SPN" SG_ 3221225472 EngCyl10IgntTiming 1422;
BA_ "SigType" SG_ 3221225472 EngCyl10IgntTiming 1;
BA_ "SPN" SG_ 3221225472 EngCyl9IgntTiming 1421;
BA_ "SigType" SG_ 3221225472 EngCyl9IgntTiming 1;
BA_ "SPN" SG_ 3221225472 EngCyl8IgntTiming 1420;
BA_ "SigType" SG_ 3221225472 EngCyl8IgntTiming 1;
BA_ "SPN" SG_ 3221225472 EngCyl7IgntTiming 1419;
BA_ "SigType" SG_ 3221225472 EngCyl7IgntTiming 1;
BA_ "SPN" SG_ 3221225472 EngCyl6IgntTiming 1418;
BA_ "SigType" SG_ 3221225472 EngCyl6IgntTiming 1;
BA_ "SPN" SG_ 3221225472 EngCyl5IgntTiming 1417;
BA_ "SigType" SG_ 3221225472 EngCyl5IgntTiming 1;
BA_ "SPN" SG_ 3221225472 EngCyl4IgntTiming 1416;
BA_ "SigType" SG_ 3221225472 EngCyl4IgntTiming 1;
BA_ "SPN" SG_ 3221225472 EngCyl3IgntTiming 1415;
BA_ "SigType" SG_ 3221225472 EngCyl3IgntTiming 1;
BA_ "SPN" SG_ 3221225472 EngCyl2IgntTiming 1414;
BA_ "SigType" SG_ 3221225472 EngCyl2IgntTiming 1;
BA_ "SPN" SG_ 3221225472 EngCyl1IgntTiming 1413;
BA_ "SigType" SG_ 3221225472 EngCyl1IgntTiming 1;
BA_ "SPN" SG_ 3221225472 EngCyl20IgntTransSecondOutput 1412;
BA_ "SigType" SG_ 3221225472 EngCyl20IgntTransSecondOutput 1;
BA_ "SPN" SG_ 3221225472 EngCyl19IgntTransSecondOutput 1411;
BA_ "SigType" SG_ 3221225472 EngCyl19IgntTransSecondOutput 1;
BA_ "SPN" SG_ 3221225472 EngCyl18IgntTransSecondOutput 1410;
BA_ "SigType" SG_ 3221225472 EngCyl18IgntTransSecondOutput 1;
BA_ "SPN" SG_ 3221225472 EngCyl17IgntTransSecondOutput 1409;
BA_ "SigType" SG_ 3221225472 EngCyl17IgntTransSecondOutput 1;
BA_ "SPN" SG_ 3221225472 EngCyl16IgntTransSecondOutput 1408;
BA_ "SigType" SG_ 3221225472 EngCyl16IgntTransSecondOutput 1;
BA_ "SPN" SG_ 3221225472 EngCyl15IgntTransSecondOutput 1407;
BA_ "SigType" SG_ 3221225472 EngCyl15IgntTransSecondOutput 1;
BA_ "SPN" SG_ 3221225472 EngCyl14IgntTransSecondOutput 1406;
BA_ "SigType" SG_ 3221225472 EngCyl14IgntTransSecondOutput 1;
BA_ "SPN" SG_ 3221225472 EngCyl13IgntTransSecondOutput 1405;
BA_ "SigType" SG_ 3221225472 EngCyl13IgntTransSecondOutput 1;
BA_ "SPN" SG_ 3221225472 EngCyl12IgntTransSecondOutput 1404;
BA_ "SigType" SG_ 3221225472 EngCyl12IgntTransSecondOutput 1;
BA_ "SPN" SG_ 3221225472 EngCyl11IgntTransSecondOutput 1403;
BA_ "SigType" SG_ 3221225472 EngCyl11IgntTransSecondOutput 1;
BA_ "SPN" SG_ 3221225472 EngCyl10IgntTransSecondOutput 1402;
BA_ "SigType" SG_ 3221225472 EngCyl10IgntTransSecondOutput 1;
BA_ "SPN" SG_ 3221225472 EngCyl9IgntTransSecondOutput 1401;
BA_ "SigType" SG_ 3221225472 EngCyl9IgntTransSecondOutput 1;
BA_ "SPN" SG_ 3221225472 EngCyl8IgntTransSecondOutput 1400;
BA_ "SigType" SG_ 3221225472 EngCyl8IgntTransSecondOutput 1;
BA_ "SPN" SG_ 3221225472 EngCyl7IgntTransSecondOutput 1399;
BA_ "SigType" SG_ 3221225472 EngCyl7IgntTransSecondOutput 1;
BA_ "SPN" SG_ 3221225472 EngCyl6IgntTransSecondOutput 1398;
BA_ "SigType" SG_ 3221225472 EngCyl6IgntTransSecondOutput 1;
BA_ "SPN" SG_ 3221225472 EngCyl5IgntTransSecondOutput 1397;
BA_ "SigType" SG_ 3221225472 EngCyl5IgntTransSecondOutput 1;
BA_ "SPN" SG_ 3221225472 EngCyl4IgntTransSecondOutput 1396;
BA_ "SigType" SG_ 3221225472 EngCyl4IgntTransSecondOutput 1;
BA_ "SPN" SG_ 3221225472 EngCyl3IgntTransSecondOutput 1395;
BA_ "SigType" SG_ 3221225472 EngCyl3IgntTransSecondOutput 1;
BA_ "SPN" SG_ 3221225472 EngCyl2IgntTransSecondOutput 1394;
BA_ "SigType" SG_ 3221225472 EngCyl2IgntTransSecondOutput 1;
BA_ "SPN" SG_ 3221225472 EngCyl1IgntTransSecondOutput 1393;
BA_ "SigType" SG_ 3221225472 EngCyl1IgntTransSecondOutput 1;
BA_ "SPN" SG_ 3221225472 EngOprtrPrmryIntrmdtSpdSlctState 2892;
BA_ "SPN" SG_ 3221225472 EngOprtrPrmryIntrmdteSpeedSelect 2880;
BA_ "SPN" SG_ 3221225472 EngTotalIdleHours 235;
BA_ "SigType" SG_ 3221225472 EngTotalIdleHours 1;
BA_ "SPN" SG_ 3221225472 EngTotalIdleFuelUsed 236;
BA_ "SigType" SG_ 3221225472 EngTotalIdleFuelUsed 1;
BA_ "SPN" SG_ 3221225472 EngIntakeManifold6Temp 1803;
BA_ "SigType" SG_ 3221225472 EngIntakeManifold6Temp 1;
BA_ "SPN" SG_ 3221225472 EngIntakeManifold5Temp 1802;
BA_ "SigType" SG_ 3221225472 EngIntakeManifold5Temp 1;
BA_ "SPN" SG_ 3221225472 EngIntakeManifold4Temp 1133;
BA_ "SigType" SG_ 3221225472 EngIntakeManifold4Temp 1;
BA_ "SPN" SG_ 3221225472 EngIntakeManifold3Temp 1132;
BA_ "SigType" SG_ 3221225472 EngIntakeManifold3Temp 1;
BA_ "SPN" SG_ 3221225472 EngIntakeManifold2Temp 1131;
BA_ "SigType" SG_ 3221225472 EngIntakeManifold2Temp 1;
BA_ "SPN" SG_ 3221225472 EngTurbo4BoostPress 1130;
BA_ "SigType" SG_ 3221225472 EngTurbo4BoostPress 1;
BA_ "SPN" SG_ 3221225472 EngTurbo3BoostPress 1129;
BA_ "SigType" SG_ 3221225472 EngTurbo3BoostPress 1;
BA_ "SPN" SG_ 3221225472 EngTurbo2BoostPress 1128;
BA_ "SigType" SG_ 3221225472 EngTurbo2BoostPress 1;
BA_ "SPN" SG_ 3221225472 SteerWheelAngle 1807;
BA_ "SigType" SG_ 3221225472 SteerWheelAngle 1;
BA_ "SPN" SG_ 3221225472 EngOilPress 100;
BA_ "SigType" SG_ 3221225472 EngOilPress 1;
BA_ "SPN" SG_ 3221225472 EngFuelDeliveryPress 94;
BA_ "SigType" SG_ 3221225472 EngFuelDeliveryPress 1;
BA_ "SPN" SG_ 3221225472 EngCoolantPress2 7313;
BA_ "SigType" SG_ 3221225472 EngCoolantPress2 1;
BA_ "SPN" SG_ 3221225472 ConversionEfficiency 4419;
BA_ "SigType" SG_ 3221225472 ConversionEfficiency 1;
BA_ "SPN" SG_ 3221225472 CommandedDEFConsumption 4418;
BA_ "SigType" SG_ 3221225472 CommandedDEFConsumption 1;
BA_ "SPN" SG_ 3221225472 DEFAvgConsumption 4417;
BA_ "SigType" SG_ 3221225472 DEFAvgConsumption 1;
VAL_ 3221225472 Jystck6GrpXAxsLvrLftNgtvPsStatus 3 "Not Available" 2 "Error Indicator" 1 "On negative side of Neutral" 0 "Not on negative side of Neutral" ;
VAL_ 3221225472 Jystck6GripXAxisNeutralPosStatus 3 "Not Available" 2 "Error Indicator" 1 "In Neutral Position" 0 "Not in Neutral Position" ;
VAL_ 3221225472 Joystick5Button13PressedStatus 3 "Not Available" 2 "Error Indicator" 1 "Button pressed" 0 "Button not pressed" ;
VAL_ 3221225472 Joystick5Button14PressedStatus 3 "Not Available" 2 "Error Indicator" 1 "Button pressed" 0 "Button not pressed" ;
VAL_ 3221225472 Joystick5Button15PressedStatus 3 "Not Available" 2 "Error Indicator" 1 "Button pressed" 0 "Button not pressed" ;
VAL_ 3221225472 Joystick5Button16PressedStatus 3 "Not Available" 2 "Error Indicator" 1 "Button pressed" 0 "Button not pressed" ;
VAL_ 3221225472 Jystick5GripXAxisDetentPosStatus 3 "Not Available" 2 "Error Indicator" 1 "In the Detent Position" 0 "Not in the Detent Position" ;
VAL_ 3221225472 Jystick5GripYAxisDetentPosStatus 3 "Not Available" 2 "Error Indicator" 1 "In the Detent Position" 0 "Not in the Detent Position" ;
VAL_ 3221225472 Jystick5ThetaAxisDetentPosStatus 3 "Not Available" 2 "Error Indicator" 1 "In the Detent Position" 0 "Not in the Detent Position" ;
VAL_ 3221225472 Jystck5ThtAxsClckwsPstvPosStatus 3 "Not Available" 2 "Error Indicator" 1 "On positive side of Neutral" 0 "Not on Positive side of Neutral" ;
VAL_ 3221225472 Jystck5ThtAxsCntrClckwsNgtvPsStt 3 "Not Available" 2 "Error Indicator" 1 "On negative side of Neutral" 0 "Not on negative side of Neutral" ;
VAL_ 3221225472 Jystck5ThetaAxisNeutralPosStatus 3 "Not Available" 2 "Error Indicator" 1 "In Neutral Position" 0 "Not in Neutral Position" ;
VAL_ 3221225472 Jystck5GrpYAxsLvrFrwrdPstvPsStts 3 "Not Available" 2 "Error Indicator" 1 "On positive side of Neutral" 0 "Not on Positive side of Neutral" ;
VAL_ 3221225472 Jystck5GrpYAxsLvrBckNgtvPsStatus 3 "Not Available" 2 "Error Indicator" 1 "On negative side of Neutral" 0 "Not on negative side of Neutral" ;
VAL_ 3221225472 Jystck5GripYAxisNeutralPosStatus 3 "Not Available" 2 "Error Indicator" 1 "In Neutral Position" 0 "Not in Neutral Position" ;
VAL_ 3221225472 Jystck5GrpXAxsLvrRghtPstvPsSttus 3 "Not Available" 2 "Error Indicator" 1 "On positive side of Neutral" 0 "Not on Positive side of Neutral" ;
VAL_ 3221225472 Jystck5GrpXAxsLvrLftNgtvPsStatus 3 "Not Available" 2 "Error Indicator" 1 "On negative side of Neutral" 0 "Not on negative side of Neutral" ;
VAL_ 3221225472 Jystck5GripXAxisNeutralPosStatus 3 "Not Available" 2 "Error Indicator" 1 "In Neutral Position" 0 "Not in Neutral Position" ;
VAL_ 3221225472 Joystick4Button13PressedStatus 3 "Not Available" 2 "Error Indicator" 1 "Button pressed" 0 "Button not pressed" ;
VAL_ 3221225472 Joystick4Button14PressedStatus 3 "Not Available" 2 "Error Indicator" 1 "Button pressed" 0 "Button not pressed" ;
VAL_ 3221225472 Joystick4Button15PressedStatus 3 "Not Available" 2 "Error Indicator" 1 "Button pressed" 0 "Button not pressed" ;
VAL_ 3221225472 Joystick4Button16PressedStatus 3 "Not Available" 2 "Error Indicator" 1 "Button pressed" 0 "Button not pressed" ;
VAL_ 3221225472 Jystick4GripXAxisDetentPosStatus 3 "Not Available" 2 "Error Indicator" 1 "In the Detent Position" 0 "Not in the Detent Position" ;
VAL_ 3221225472 Jystick4GripYAxisDetentPosStatus 3 "Not Available" 2 "Error Indicator" 1 "In the Detent Position" 0 "Not in the Detent Position" ;
VAL_ 3221225472 Jystick4ThetaAxisDetentPosStatus 3 "Not Available" 2 "Error Indicator" 1 "In the Detent Position" 0 "Not in the Detent Position" ;
VAL_ 3221225472 Jystck4ThtAxsClckwsPstvPosStatus 3 "Not Available" 2 "Error Indicator" 1 "On positive side of Neutral" 0 "Not on Positive side of Neutral" ;
VAL_ 3221225472 Jystck4ThtAxsCntrClckwsNgtvPsStt 3 "Not Available" 2 "Error Indicator" 1 "On negative side of Neutral" 0 "Not on negative side of Neutral" ;
VAL_ 3221225472 Jystck4ThetaAxisNeutralPosStatus 3 "Not Available" 2 "Error Indicator" 1 "In Neutral Position" 0 "Not in Neutral Position" ;
VAL_ 3221225472 Jystck4GrpYAxsLvrFrwrdPstvPsStts 3 "Not Available" 2 "Error Indicator" 1 "On positive side of Neutral" 0 "Not on Positive side of Neutral" ;
VAL_ 3221225472 Jystck4GrpYAxsLvrBckNgtvPsStatus 3 "Not Available" 2 "Error Indicator" 1 "On negative side of Neutral" 0 "Not on negative side of Neutral" ;
VAL_ 3221225472 Jystck4GripYAxisNeutralPosStatus 3 "Not Available" 2 "Error Indicator" 1 "In Neutral Position" 0 "Not in Neutral Position" ;
VAL_ 3221225472 Jystck4GrpXAxsLvrRghtPstvPsSttus 3 "Not Available" 2 "Error Indicator" 1 "On positive side of Neutral" 0 "Not on Positive side of Neutral" ;
VAL_ 3221225472 Jystck4GrpXAxsLvrLftNgtvPsStatus 3 "Not Available" 2 "Error Indicator" 1 "On negative side of Neutral" 0 "Not on negative side of Neutral" ;
VAL_ 3221225472 Jystck4GripXAxisNeutralPosStatus 3 "Not Available" 2 "Error Indicator" 1 "In Neutral Position" 0 "Not in Neutral Position" ;
VAL_ 3221225472 Joystick10Button13PressedStatus 3 "Not Available" 2 "Error Indicator" 1 "Button pressed" 0 "Button not pressed" ;
VAL_ 3221225472 Joystick10Button14PressedStatus 3 "Not Available" 2 "Error Indicator" 1 "Button pressed" 0 "Button not pressed" ;
VAL_ 3221225472 Joystick10Button15PressedStatus 3 "Not Available" 2 "Error Indicator" 1 "Button pressed" 0 "Button not pressed" ;
VAL_ 3221225472 Joystick10Button16PressedStatus 3 "Not Available" 2 "Error Indicator" 1 "Button pressed" 0 "Button not pressed" ;
VAL_ 3221225472 Jystck10GripXAxisDetentPosStatus 3 "Not Available" 2 "Error Indicator" 1 "In the Detent Position" 0 "Not in the Detent Position" ;
VAL_ 3221225472 Jystck10GripYAxisDetentPosStatus 3 "Not Available" 2 "Error Indicator" 1 "In the Detent Position" 0 "Not in the Detent Position" ;
VAL_ 3221225472 Jystck10ThetaAxisDetentPosStatus 3 "Not Available" 2 "Error Indicator" 1 "In the Detent Position" 0 "Not in the Detent Position" ;
VAL_ 3221225472 Jystck10ThtAxsClckwsPstvPsStatus 3 "Not Available" 2 "Error Indicator" 1 "On positive side of Neutral" 0 "Not on Positive side of Neutral" ;
VAL_ 3221225472 Jystck10ThtAxsCntrClckwsNgtvPsSt 3 "Not Available" 2 "Error Indicator" 1 "On negative side of Neutral" 0 "Not on negative side of Neutral" ;
VAL_ 3221225472 Jystck10ThtaAxisNeutralPosStatus 3 "Not Available" 2 "Error Indicator" 1 "In Neutral Position" 0 "Not in Neutral Position" ;
VAL_ 3221225472 Jystck10GrpYAxsLvrFrwrdPstvPsStt 3 "Not Available" 2 "Error Indicator" 1 "On positive side of Neutral" 0 "Not on Positive side of Neutral" ;
VAL_ 3221225472 Jystck10GrpYAxsLvrBckNgtvPsSttus 3 "Not Available" 2 "Error Indicator" 1 "On negative side of Neutral" 0 "Not on negative side of Neutral" ;
VAL_ 3221225472 Jystck10GrpYAxisNeutralPosStatus 3 "Not Available" 2 "Error Indicator" 1 "In Neutral Position" 0 "Not in Neutral Position" ;
VAL_ 3221225472 Jystck10GrpXAxsLvrRghtPstvPsStts 3 "Not Available" 2 "Error Indicator" 1 "On positive side of Neutral" 0 "Not on Positive side of Neutral" ;
VAL_ 3221225472 Jystck10GrpXAxsLvrLftNgtvPsSttus 3 "Not Available" 2 "Error Indicator" 1 "On negative side of Neutral" 0 "Not on negative side of Neutral" ;
VAL_ 3221225472 Jystck10GrpXAxisNeutralPosStatus 3 "Not Available" 2 "Error Indicator" 1 "In Neutral Position" 0 "Not in Neutral Position" ;
VAL_ 3221225472 FuelTankTransferPump 3 "Not Available" 2 "Error" 1 "On" 0 "Off" ;
VAL_ 3221225472 DslPrtcltFltrActvRgnrtnInhbt5629 3 "not available" 2 "reserved for SAE assignment" 1 "inhibited" 0 "not inhibited" ;
VAL_ 3221225472 AFT1DPFCondNotMetForActiveRegen 3 "not available" 2 "reserved for SAE assignment" 1 "active DPF regeneration inhibited" 0 "active DPF regeneration not inhibited" ;
VAL_ 3221225472 HydrocarbonDoserPurgingEnable 3 "Not available" 2 "Purging enabled, urgent" 1 "Purging enabled, less urgent" 0 "Purging not enabled" ;
VAL_ 3221225472 DslPrtcltFltrActvRgnrtnFrcdSttus 3 "Reserved for SAE Assignment" 2 "Active, Forced by Service Tool " 1 "Active, Forced by Switch" 0 "Not Active" 7 "not available" 6 "Reserved for SAE Assignment" 5 "Reserved for SAE Assignment" 4 "Reserved for SAE Assignment" ;
VAL_ 3221225472 ExhaustSystemHighTempLampCmd 7 "not available" 6 "reserved for SAE assignment" 5 "reserved for SAE assignment" 4 "reserved for SAE assignment" 3 "reserved for SAE assignment" 2 "reserved for SAE assignment " 1 "On" 0 "Off" ;
VAL_ 3221225472 DslPrtcltFltrAtmtcActvRgnrtnIntt 3 "not available" 2 "reserved for SAE assignment" 1 "enabled" 0 "not enabled" ;
VAL_ 3221225472 DslPrtcltFltrActvRgnrtnInhbt3717 3 "not available" 2 "reserved for SAE assignment" 1 "inhibited" 0 "not inhibited" ;
VAL_ 3221225472 DslPrtcltFltrActvRgnrtnInhbtdDTE 3 "not available" 2 "reserved for SAE assignment" 1 "inhibited" 0 "not inhibited" ;
VAL_ 3221225472 DslPrtcltFltrActvRgnrtnInhbt3715 3 "not available" 2 "reserved for SAE assignment" 1 "inhibited" 0 "not inhibited" ;
VAL_ 3221225472 DslPrtcltFltrActvRgnrtnInhbtdDTT 3 "not available" 2 "reserved for SAE assignment" 1 "inhibited" 0 "not inhibited" ;
VAL_ 3221225472 DslPrtcltFltrActvRgnrtnInhbt3713 3 "not available" 2 "reserved for SAE assignment" 1 "inhibited" 0 "not inhibited" ;
VAL_ 3221225472 DslPrtcltFltrActvRgnrtnInhbt3712 3 "not available" 2 "reserved for SAE assignment" 1 "inhibited" 0 "not inhibited" ;
VAL_ 3221225472 DslPrtcltFltrActvRgnrtnInhbtdDTL 3 "not available" 2 "reserved for SAE assignment" 1 "inhibited" 0 "not inhibited" ;
VAL_ 3221225472 DslPrtcltFltrActvRgnrtnInhbt3710 3 "not available" 2 "reserved for SAE assignment" 1 "inhibited" 0 "not inhibited" ;
VAL_ 3221225472 DslPrtcltFltrActvRgnrtnInhbtdDTV 3 "not available" 2 "reserved for SAE assignment" 1 "inhibited" 0 "not inhibited" ;
VAL_ 3221225472 DslPrtcltFltrActvRgnrtnInhbtdDTO 3 "not available" 2 "reserved for SAE assignment" 1 "inhibited" 0 "not inhibited" ;
VAL_ 3221225472 DslPrtcltFltrActvRgnrtnInhbtdDTA 3 "not available" 2 "reserved for SAE assignment" 1 "inhibited" 0 "not inhibited" ;
VAL_ 3221225472 DslPrtcltFltrActvRgnrtnInhbtdDTP 3 "not available" 2 "reserved for SAE assignment" 1 "inhibited" 0 "not inhibited" ;
VAL_ 3221225472 DslPrtcltFltrActvRgnrtnInhbtdDTS 3 "not available" 2 "reserved for SAE assignment" 1 "inhibited" 0 "not inhibited" ;
VAL_ 3221225472 DslPrtcltFltrActvRgnrtnInhbtdDTC 3 "not available" 2 "reserved for SAE assignment" 1 "inhibited" 0 "not inhibited" ;
VAL_ 3221225472 DslPrtcltFltrActvRgnrtnInhbtdDTI 3 "not available" 2 "reserved for SAE assignment" 1 "inhibited" 0 "not inhibited" ;
VAL_ 3221225472 DslPrtcltFltrActvRgnrtnInhbtdStt 3 "not available" 2 "reserved for SAE assignment" 1 "inhibited" 0 "not inhibited" ;
VAL_ 3221225472 AFTDPFStatus 7 "not available" 6 "reserved for SAE assignment" 5 "reserved for SAE assignment" 4 "reserved for SAE assignment" 3 "Regeneration needed, highest level" 2 "Regeneration needed, moderate level" 1 "Regeneration needed, lowest level" 0 "Regeneration not needed" ;
VAL_ 3221225472 AFTDPFActiveRegenStatus 3 "not available" 2 "regeneration needed" 1 "active" 0 "not active" ;
VAL_ 3221225472 AFTDPFPassiveRegenStatus 3 "not available" 2 "reserved for SAE assignment" 1 "active" 0 "not active" ;
VAL_ 3221225472 DieselParticulateFilterLampCmd 7 "not available" 6 "reserved for SAE assignment" 5 "reserved for SAE assignment" 4 "On, fast blink" 3 "reserved for SAE assignment" 2 "reserved for SAE assignment " 1 "On, solid" 0 "Off" ;
VAL_ 3221225472 HillHolderLampData 3 "Not Available" 2 "Error" 1 "Lamp activated" 0 "Lamp deactivated" ;
VAL_ 3221225472 VehicleBatteryChargingLampData 3 "Not available" 2 "Error" 1 "Lamp activated" 0 "Lamp deactivated" ;
VAL_ 3221225472 VehicleHVACRecirculationLampData 3 "Not available" 2 "Error" 1 "Lamp activated" 0 "Lamp deactivated" ;
VAL_ 3221225472 VehicleAirPressLowLampData 3 "Not available" 2 "Error" 1 "Lamp activated" 0 "Lamp deactivated" ;
VAL_ 3221225472 VehicleFuelLevelLowLampData 3 "Not available" 2 "Error" 1 "Lamp activated" 0 "Lamp deactivated" ;
VAL_ 3221225472 VehicleBatteryVoltageLowLampData 3 "Not available" 2 "Error" 1 "Lamp activated" 0 "Lamp deactivated" ;
VAL_ 3221225472 VhclAcclerationRateLimitLampData 3 "Not available" 2 "Error" 1 "Lamp activated" 0 "Lamp deactivated" ;
VAL_ 3221225472 EngSpeedVeryHighLampData 3 "Not available" 2 "Error" 1 "Lamp Activated" 0 "Lamp Deactivated" ;
VAL_ 3221225472 EngSpeedHighLampData 0 "Lamp Deactivated" 3 "Not available" 2 "Error" 1 "Lamp Activated" ;
VAL_ 3221225472 EngCtrlMdule3ReadyForUseLampData 3 "Not Available" 2 "Error" 1 "Lamp activated" 0 "Lamp deactivated" ;
VAL_ 3221225472 EngCtrlMdule2ReadyForUseLampData 3 "Not Available" 2 "Error" 1 "Lamp activated" 0 "Lamp deactivated" ;
VAL_ 3221225472 EngCtrlMdule1ReadyForUseLampData 3 "Not Available" 2 "Error" 1 "Lamp activated" 0 "Lamp deactivated" ;
VAL_ 3221225472 EngWaitToStartLampData 3 "Not available" 2 "Error" 1 "Lamp actived" 0 "Lamp deactived" ;
VAL_ 3221225472 EngFuelFilterRestrictedLampData 3 "Not available" 2 "Error" 1 "Lamp activated" 0 "Lamp deactivated" ;
VAL_ 3221225472 EngAirFilterRestrictionLampData 3 "Not available" 2 "Error" 1 "Lamp activated" 0 "Lamp deactivated" ;
VAL_ 3221225472 EngIdleManagementActiveLampData 3 "Not available" 2 "Error" 1 "Lamp activated" 0 "Lamp deactivated" ;
VAL_ 3221225472 EngCoolantLevelLowLampData 3 "Not available" 2 "Error" 1 "Lamp activated" 0 "Lamp deactivated" ;
VAL_ 3221225472 EngCoolantTempHighLampData 3 "Not available" 2 "Error" 1 "Lamp activated" 0 "Lamp deactivated" ;
VAL_ 3221225472 EngOilPressLowLampData 3 "Not available" 2 "Error" 1 "Lamp activated" 0 "Lamp deactivated" ;
VAL_ 3221225472 CmprssnBrkEnblSwtchIndctrLmpData 3 "Not available" 2 "Error" 1 "Lamp activated" 0 "Lamp deactivated" ;
VAL_ 3221225472 EngBrakeActiveLampData 3 "Not available" 2 "Error" 1 "Lamp activated" 0 "Lamp deactivated" ;
VAL_ 3221225472 OBDMalfunctionIndicatorLampData 3 "Not available" 2 "Error" 1 "Lamp activated" 0 "Lamp deactivated" ;
VAL_ 3221225472 EngRedStopLampData 3 "Not available" 2 "Error" 1 "Lamp activated" 0 "Lamp deactivated" ;
VAL_ 3221225472 EngAmberWarningLampData 3 "Not available" 2 "Error" 1 "Lamp activated" 0 "Lamp deactivated" ;
VAL_ 3221225472 EngProtectLampData 3 "Not available" 2 "Error" 1 "Lamp activated" 0 "Lamp deactivated" ;
VAL_ 3221225472 HillHolderLampCmd 3 "Not available" 2 "Lamp Flash" 1 "Lamp On" 0 "Lamp Off" ;
VAL_ 3221225472 VehicleBatteryChargingLampCmd 3 "Not available" 2 "Reserved" 1 "Lamp On" 0 "Lamp Off" ;
VAL_ 3221225472 VehicleHVACRecirculationLampCmd 3 "Not available" 2 "Reserved" 1 "Lamp On" 0 "Lamp Off" ;
VAL_ 3221225472 VehicleAirPressLowLampCmd 3 "Not available" 2 "Reserved" 1 "Lamp On" 0 "Lamp Off" ;
VAL_ 3221225472 VehicleFuelLevelLowLampCmd 3 "Not available" 2 "Reserved" 1 "Lamp On" 0 "Lamp Off" ;
VAL_ 3221225472 VehicleBatteryVoltageLowLampCmd 3 "Not available" 2 "Reserved" 1 "Lamp On" 0 "Lamp Off" ;
VAL_ 3221225472 TextDisplayInstructions 15 "- Not applicable" 6 "Blink substring" 5 "Highlight substring" 4 "Overwrite substring" 3 "Overwrite display" 2 "Append at end of display" 1 "Hold display" 0 "Clear display" ;
VAL_ 3221225472 RetractStatusOfRamp5 3 "not available" 2 "error" 1 "ramp extended" 0 "ramp retracted" ;
VAL_ 3221225472 RetractStatusOfRamp4 3 "not available" 2 "error" 1 "ramp extended" 0 "ramp retracted" ;
VAL_ 3221225472 MovementStatusOfRamp5 3 "not available" 2 "error" 1 "ramp being moved" 0 "ramp not being moved" ;
VAL_ 3221225472 MovementStatusOfRamp4 3 "not available" 2 "error" 1 "ramp being moved" 0 "ramp not being moved" ;
VAL_ 3221225472 EnableStatusOfRamp5 3 "not available" 2 "error " 1 "ramp enabled " 0 "ramp disabled" ;
VAL_ 3221225472 EnableStatusOfRamp4 3 "not available" 2 "error " 1 "ramp enabled " 0 "ramp disabled" ;
VAL_ 3221225472 MovementStatusOfRamp3 3 "not available" 2 "error" 1 "ramp being moved" 0 "ramp not being moved" ;
VAL_ 3221225472 EnableStatusOfRamp3 3 "not available" 2 "error " 1 "ramp enabled " 0 "ramp disabled" ;
VAL_ 3221225472 RetractStatusOfRamp3 3 "not available" 2 "error" 1 "ramp extended" 0 "ramp retracted" ;
VAL_ 3221225472 MovementStatusOfRamp2 3 "not available" 2 "error" 1 "ramp being moved" 0 "ramp not being moved" ;
VAL_ 3221225472 EnableStatusOfRamp2 3 "not available" 2 "error " 1 "ramp enabled " 0 "ramp disabled" ;
VAL_ 3221225472 RetractStatusOfRamp2 3 "not available" 2 "error" 1 "ramp extended" 0 "ramp retracted" ;
VAL_ 3221225472 MovementStatusOfRamp1 3 "not available" 2 "error" 1 "ramp being moved" 0 "ramp not being moved" ;
VAL_ 3221225472 EnableStatusOfRamp1 3 "not available" 2 "error " 1 "ramp enabled " 0 "ramp disabled" ;
VAL_ 3221225472 RetractStatusOfRamp1 3 "not available" 2 "error" 1 "ramp extended" 0 "ramp retracted" ;
VAL_ 3221225472 LaneDepartureWarningEnableCmd 3 "Don´t care" 2 "Reserved" 1 "Enable Lane Departure Warning" 0 "Disable Lane Departure Warning" ;
VAL_ 3221225472 J2012DTCStatus 1 "DTC is active" 0 "DTC is previously active" ;
VAL_ 3221225472 SteerAngleSensorCalibrated 3 "Not available" 2 "Reserved" 1 "SAS calibrated" 0 "SAS not calibrated" ;
VAL_ 3221225472 SteerAngleSensorActiveMode 3 "Not available" 2 "Reserved" 1 "Normal mode active" 0 "Programming mode active" ;
VAL_ 3221225472 SteerWheelAngleRangeCounterType 3 "signal not available" 2 "not defined" 1 "absolute number of counts" 0 "relative number of counts" ;
VAL_ 3221225472 TransferCaseStatus 7 "not available" 6 "error" 5 "Transfer Case Shift in Progress or gear not confirmed" 4 "4 wheel low" 3 "2 wheel low" 2 "neutral" 1 "4 wheel high" 0 "2 wheel high" ;
VAL_ 3221225472 TransOilLevel2MeasurementStatus 15 "Not available" 14 "Error" 13 "Conditions not valid, Other" 12 "Not defined" 11 "Not defined" 10 "Not defined" 9 "Conditions not valid, No request for reading" 8 "Conditions not valid, Engine speed too high" 7 "Conditions not valid, Engine speed too low" 6 "Conditions not valid, Vehicle not level" 5 "Conditions not valid, Vehicle moving" 4 "Conditions not valid, Transmission fluid temperature too high" 3 "Conditions not valid, Transmission fluid temperature too low" 2 "Conditions not valid, Transmission in gear" 1 "Conditions not valid, Settling timer still counting down" 0 "Conditions valid for transmission oil level measurement" ;
VAL_ 3221225472 TransOilLevel2CountdownTimer 15 "Not Available" 14 "Error" 13 "Thirteen minutes" 12 "Twelve minutes" 11 "Eleven minutes" 10 "Ten minutes" 9 "Nine minutes" 8 "Eight minutes" 7 "Seven minutes" 6 "Six minutes" 5 "Five minutes" 4 "Four minutes" 3 "Three minutes" 2 "Two minutes" 1 "One minute" 0 "less than 1 minute" ;
VAL_ 3221225472 TransOverheatIndicator 3 "Not available" 2 "Transmission Overheat Indicator is flashing" 1 "Transmission Overheat Indicator is on continuously" 0 "Transmission Overheat Indicator is off" ;
VAL_ 3221225472 TransOilLevelSwitch 3 "Not available" 2 "Error" 1 "Full or not empty" 0 "Empty" ;
VAL_ 3221225472 TransOilFilterRestrictionSwitch 3 "Not available" 2 "Error" 1 "Restriction exists on oil filter" 0 "No restriction" ;
VAL_ 3221225472 ImplementRearWorkLight 3 "Not Available" 2 "Fault Detected" 1 "Activated" 0 "De-activated" ;
VAL_ 3221225472 ImplLeftFacingWorkLight 3 "Not Available" 2 "Fault Detected" 1 "Activated" 0 "De-activated" ;
VAL_ 3221225472 ImplRightForwardWorkLight 3 "Not Available" 2 "Fault Detected" 1 "Activated" 0 "De-activated" ;
VAL_ 3221225472 ImplLeftForwardWorkLight 3 "Not Available" 2 "Fault Detected" 1 "Activated" 0 "De-activated" ;
VAL_ 3221225472 ImplRightFacingWorkLight 3 "Not Available" 2 "Fault Detected" 1 "Activated" 0 "De-activated" ;
VAL_ 3221225472 ImplementOEMOption1Light 3 "Not Available" 2 "Fault Detected" 1 "Activated" 0 "De-activated" ;
VAL_ 3221225472 ImplementOEMOption2Light 3 "Not Available" 2 "Fault Detected" 1 "Activated" 0 "De-activated" ;
VAL_ 3221225472 TrctorFrontHighMdWkLights 3 "Not Available" 2 "Fault Detected" 1 "Activated" 0 "De-activated" ;
VAL_ 3221225472 TractorFrontLowMdWkLights 3 "Not Available" 2 "Fault Detected" 1 "Activated" 0 "De-activated" ;
VAL_ 3221225472 TractorSideHighMdWkLights 3 "Not Available" 2 "Fault Detected" 1 "Activated" 0 "De-activated" ;
VAL_ 3221225472 TractorSideLowMdWkLights 3 "Not Available" 2 "Fault Detected" 1 "Activated" 0 "De-activated" ;
VAL_ 3221225472 TractorRearHighMdWkLights 3 "Not Available" 2 "Fault Detected" 1 "Activated" 0 "De-activated" ;
VAL_ 3221225472 TractorRearLowMdWkLights 3 "Not Available" 2 "Fault Detected" 1 "Activated" 0 "De-activated" ;
VAL_ 3221225472 TrctorUndersideMdWkLights 3 "Not Available" 2 "Fault Detected" 1 "Activated" 0 "De-activated" ;
VAL_ 3221225472 RearFogLights 3 "Not Available" 2 "Fault Detected" 1 "Activated" 0 "De-activated" ;
VAL_ 3221225472 TractorMarkerLight 3 "Not Available" 2 "Fault Detected" 1 "Activated" 0 "De-activated" ;
VAL_ 3221225472 ImplementMarkerLight 3 "Not Available" 2 "Fault Detected" 1 "Activated" 0 "De-activated" ;
VAL_ 3221225472 TractorClearanceLight 3 "Not Available" 2 "Fault Detected" 1 "Activated" 0 "De-activated" ;
VAL_ 3221225472 ImplementClearanceLight 3 "Not Available" 2 "Fault Detected" 1 "Activated" 0 "De-activated" ;
VAL_ 3221225472 LeftStopLight 3 "Not Available" 2 "Fault Detected" 1 "Activated" 0 "De-activated" ;
VAL_ 3221225472 RightStopLight 3 "Not Available" 2 "Fault Detected" 1 "Activated" 0 "De-activated" ;
VAL_ 3221225472 CenterStopLight 3 "Not Available" 2 "Fault Detected" 1 "Activated" 0 "De-activated" ;
VAL_ 3221225472 BackUpLightAndAlarmHorn 3 "Not Available" 2 "Fault Detected" 1 "Activated" 0 "De-activated" ;
VAL_ 3221225472 LeftTurnSignalLights 3 "Not Available" 2 "Fault Detected" 1 "Activated" 0 "De-activated" ;
VAL_ 3221225472 RightTurnSignalLights 3 "Not Available" 2 "Fault Detected" 1 "Activated" 0 "De-activated" ;
VAL_ 3221225472 RotatingBeaconLight 3 "Not Available" 2 "Fault Detected" 1 "Activated" 0 "De-activated" ;
VAL_ 3221225472 TractorFrontFogLights 3 "Not Available" 2 "Fault Detected" 1 "Activated" 0 "De-activated" ;
VAL_ 3221225472 HighBeamHeadLight 3 "Not Available" 2 "Fault Detected" 1 "Activated" 0 "De-activated" ;
VAL_ 3221225472 LowBeamHeadLight 3 "Not Available" 2 "Fault Detected" 1 "Activated" 0 "De-activated" ;
VAL_ 3221225472 AltBeamHeadLight 3 "Not Available" 2 "Fault Detected" 1 "Activated" 0 "De-activated" ;
VAL_ 3221225472 RunningLight 3 "Not Available" 2 "Fault Detected" 1 "Activated" 0 "De-activated" ;
VAL_ 3221225472 ImplementRearWorkLightCmd 3 "Don't Care" 2 "Reserved" 1 "Activate" 0 "De-activate" ;
VAL_ 3221225472 ImplLeftFacingWorkLightCmd 3 "Don't Care" 2 "Reserved" 1 "Activate" 0 "De-activate" ;
VAL_ 3221225472 ImplRightFwdWorkLightCmd 3 "Don't Care" 2 "Reserved" 1 "Activate" 0 "De-activate" ;
VAL_ 3221225472 LightingDataRqCmd 3 "Don't Care" 2 "Reserved" 1 "Activate" 0 "De-activate" ;
VAL_ 3221225472 ImplLeftForwardWorkLightCmd 3 "Don't Care" 2 "Reserved" 1 "Activate" 0 "De-activate" ;
VAL_ 3221225472 ImplRightFacingWorkLightCmd 3 "Don't Care" 2 "Reserved" 1 "Activate" 0 "De-activate" ;
VAL_ 3221225472 ImplOEMOption1LightCmd 3 "Don't Care" 2 "Reserved" 1 "Activate" 0 "De-activate" ;
VAL_ 3221225472 ImplOEMOption2LightCmd 3 "Don't Care" 2 "Reserved" 1 "Activate" 0 "De-activate" ;
VAL_ 3221225472 TrctrFrntHghMdWkLightsCmd 3 "Don't Care" 2 "Reserved" 1 "Activate" 0 "De-activate" ;
VAL_ 3221225472 TrctrFrntLowMdWkLightsCmd 3 "Don't Care" 2 "Reserved" 1 "Activate" 0 "De-activate" ;
VAL_ 3221225472 TrctrSdeHighMdWkLightsCmd 3 "Don't Care" 2 "Reserved" 1 "Activate" 0 "De-activate" ;
VAL_ 3221225472 TrctrSideLowMdWkLightsCmd 3 "Don't Care" 2 "Reserved" 1 "Activate" 0 "De-activate" ;
VAL_ 3221225472 TrctrRarHighMdWkLightsCmd 3 "Don't Care" 2 "Reserved" 1 "Activate" 0 "De-activate" ;
VAL_ 3221225472 TrctrRearLowMdWkLightsCmd 3 "Don't Care" 2 "Reserved" 1 "Activate" 0 "De-activate" ;
VAL_ 3221225472 TrctrUndrsdeMdWkLightsCmd 3 "Don't Care" 2 "Reserved" 1 "Activate" 0 "De-activate" ;
VAL_ 3221225472 RearFogLightsCmd 3 "Don't Care" 2 "Reserved" 1 "Activate" 0 "De-activate" ;
VAL_ 3221225472 TractorMarkerLightCmd 3 "Don't Care" 2 "Reserved" 1 "Activate" 0 "De-activate" ;
VAL_ 3221225472 ImplementMarkerLightCmd 2 "Reserved" 3 "Don't Care" 1 "Activate" 0 "De-activate" ;
VAL_ 3221225472 TractorClearanceLightCmd 3 "Don't Care" 2 "Reserved" 1 "Activate" 0 "De-activate" ;
VAL_ 3221225472 ImplementClearanceLightCmd 3 "Don't Care" 2 "Reserved" 1 "Activate" 0 "De-activate" ;
VAL_ 3221225472 LeftStopLightCmd 3 "Don't Care" 2 "Reserved" 1 "Activate" 0 "De-activate" ;
VAL_ 3221225472 RightStopLightCmd 3 "Don't Care" 2 "Reserved" 1 "Activate" 0 "De-activate" ;
VAL_ 3221225472 CenterStopLightCmd 3 "Don't Care" 2 "Reserved" 1 "Activate" 0 "De-activate" ;
VAL_ 3221225472 BackUpLightAndAlarmHornCmd 3 "Don't Care" 2 "Reserved" 1 "Activate" 0 "De-activate" ;
VAL_ 3221225472 LeftTurnSignalLightsCmd 3 "Don't Care" 2 "Reserved" 1 "Activate" 0 "De-activate" ;
VAL_ 3221225472 RightTurnSignalLightsCmd 3 "Don't Care" 2 "Reserved" 1 "Activate" 0 "De-activate" ;
VAL_ 3221225472 RotatingBeaconLightCmd 3 "Don't Care" 2 "Reserved" 1 "Activate" 0 "De-activate" ;
VAL_ 3221225472 TractorFrontFogLightsCmd 3 "Don't Care" 2 "Reserved" 1 "Activate" 0 "De-activate" ;
VAL_ 3221225472 HighBeamHeadLightCmd 3 "Don't Care" 2 "Reserved" 1 "Activate" 0 "De-activate" ;
VAL_ 3221225472 LowBeamHeadLightCmd 3 "Don't Care" 2 "Reserved" 1 "Activate" 0 "De-activate" ;
VAL_ 3221225472 AltBeamHeadLightCmd 3 "Don't Care" 2 "Reserved" 1 "Activate" 0 "De-activate" ;
VAL_ 3221225472 RunningLightCmd 3 "Don't Care" 2 "Reserved" 1 "Activate" 0 "De-activate" ;
VAL_ 3221225472 LandLevelingSystemEnableStatus 3 "Not available / Not installed" 2 "Error" 0 "Disabled" ;
VAL_ 3221225472 BladeCtrlModeRight 15 "Not Available" 14 "Error" 2 "Inactive Auto" 1 "Auto " 0 "Manual" ;
VAL_ 3221225472 BladeCtrlModeLeft 15 "Not Available" 14 "Error" 2 "Inactive Auto" 1 "Auto " 0 "Manual" ;
VAL_ 3221225472 BladeCtrlMode 2 "Inactive automatic mode" 1 "Automatic mode" 0 "Manual mode" ;
VAL_ 3221225472 EngOprtrPrmryIntrmdtSpdSlctState 15 "- not available" 14 "- SAE reserved" 1 "thru 1101" 0 "- Control state is ISC functionality is not requested" ;
VAL_ 3221225472 EngOprtrPrmryIntrmdteSpeedSelect 15 "- not available" 14 "- error condition" 1 "thru 1101" 0 "- indicates that the ISC functionality is not requested" ;
