VERSION ""

NS_ :

BS_:

BU_: PowertrainControlModule AtmosphericSensor SafetyRestraintSystem2 Aftertreatment_2_GasOutlet Aftertreatment_2_GasIntake DieselPartFilterControl Turbocharger SafetyRestraintSystem1 CabDisplay2 Aftertreatment_1_GasOutlet Aftertreatment_1_GasIntake OnBoardDataLogger OffBoardDiagnosticTool2 OffBoardDiagnosticTool1 FileServer ParkingBrakeController SeatController2 FanDriveController SteeringColumnUnit CommunicationUnitRadio CommunicationUnitSatellite CommunicationUnitCellular PropulsionBatteryCharger ChassisController2 ChassisController1 EngineValveControl AuxiliaryHeater2 AuxiliaryHeater1 ClutchUnit RampControl InformationSystem1 SuspensionSystemController2 OilSensor VehicleDynamicStability ExhaustEmissionController TransmissionDisplay2 TransmissionDisplay1 ClimateControl2 WaterPumpController RearAxleSteeringController LightingOperatorControl SeatController1 IgnitionController2 IgnitionController1 TirePressureController CabController2 CabController1 PneumaticSystemController SuspensionSystemController1 HydraulicPumpController EnduranceBrakingSystem RetarderExhaustEngine2 OnBoardDiagnosticUnit HeadwayController RetarderExhaustEngine1 CabDisplay1 ManagementComputer VirtualTerminal OffVehicleGateway PowerTakeOffFront HitchControl AuxiliaryValveControl BodyController TractorTrailerBridge1 StarterSystem ElectricalSystem VehicleSecurity VehicleNavigation AerodynamicControl ElectricalChargingSystem ClimateControl1 TripRecorder InstrumentCluster SuspensionDriveAxle2 SuspensionDriveAxle1 SuspensionSteerAxle SteeringController FuelSystem CruiseControl RetarderDriveline RetarderEngine BrakesDriveAxle2 BrakesDriveAxle1 BrakesSystemController BrakesSteerAxle AxleDrive2 AxleDrive1 AxleSteering PowerTakeOff ShiftConsoleSecondary ShiftConsolePrimary Transmission2 Transmission1 Engine2 Engine1

BO_ 3221225472 VECTOR__INDEPENDENT_SIG_MSG: 0 Vector__XXX
 SG_ HghRsolutionTotalVehicleDistance : 0|32@1+ (5,0) [0|21055406075] "m" Vector__XXX
 SG_ LongitudinalAcceleration : 0|8@1+ (0.1,-12.5) [-12.5|12.5] "m/s²" Vector__XXX
 SG_ LateralAcceleration : 0|16@1+ (0.00048828125,-15.687) [-15.687|15.687] "m/s²" Vector__XXX
 SG_ YawRate : 0|16@1+ (0.0001220703125,-3.92) [-3.92|3.92] "rad/s" Vector__XXX
 SG_ SteerWheelAngleSensorType : 0|2@1+ (1,0) [0|3] "" Vector__XXX
 SG_ SteerWheelTurnCounter : 0|6@1+ (1,-32) [-10|10] "turns" Vector__XXX
 SG_ TrailerVDCActive : 0|2@1+ (1,0) [0|3] "" Vector__XXX
 SG_ YCBrakeCtrlActive : 0|2@1+ (1,0) [0|3] "" Vector__XXX
 SG_ YCEngCtrlActive : 0|2@1+ (1,0) [0|3] "" Vector__XXX
 SG_ ROPBrakeCtrlActive : 0|2@1+ (1,0) [0|3] "" Vector__XXX
 SG_ ROPEngCtrlActive : 0|2@1+ (1,0) [0|3] "" Vector__XXX
 SG_ VDCBrakeLightRq : 0|2@1+ (1,0) [0|3] "" Vector__XXX
 SG_ VDCFullyOperational : 0|2@1+ (1,0) [0|3] "" Vector__XXX
 SG_ VDCInformationSignal : 0|2@1+ (1,0) [0|3] "" Vector__XXX
 SG_ TotalVehicleDistance : 0|32@1+ (0.125,0) [0|526385151.875] "km" Vector__XXX
 SG_ TripDistance : 0|32@1+ (0.125,0) [0|526385151.875] "km" Vector__XXX
 SG_ TripCruiseDistance : 0|32@1+ (0.125,0) [0|526385151.875] "km" Vector__XXX
 SG_ TripMaxVehicleSpeed : 0|16@1+ (0.00390625,0) [0|250.996] "km/h" Vector__XXX
 SG_ TripAirCompressorOnTime : 0|32@1+ (0.05,0) [0|210554060.75] "h" Vector__XXX
 SG_ TripIdleTime : 0|32@1+ (0.05,0) [0|210554060.75] "h" Vector__XXX
 SG_ TripEngRunningTime : 0|32@1+ (0.05,0) [0|210554060.75] "h" Vector__XXX
 SG_ TripCruiseTime : 0|32@1+ (0.05,0) [0|210554060.75] "h" Vector__XXX
 SG_ TripPTOGovernorTime : 0|32@1+ (0.05,0) [0|210554060.75] "h" Vector__XXX
 SG_ TripTimeInDerateByEng : 0|32@1+ (0.05,0) [0|210554060.75] "h" Vector__XXX
 SG_ TripTimeInGearDown : 0|32@1+ (0.05,0) [0|210554060.75] "h" Vector__XXX
 SG_ TripTimeInTopGear : 0|32@1+ (0.05,0) [0|210554060.75] "h" Vector__XXX
 SG_ TripTimeInVSL : 0|32@1+ (0.05,0) [0|210554060.75] "h" Vector__XXX
 SG_ TripSuddenDecelerations : 0|16@1+ (1,0) [0|64255] "" Vector__XXX
 SG_ TrpNumberOfIdleShutdownOverrides : 0|16@1+ (1,0) [0|64255] "" Vector__XXX
 SG_ TripNumberOfIdleShutdowns : 0|16@1+ (1,0) [0|64255] "" Vector__XXX
 SG_ TripNumberOfHotShutdowns : 0|16@1+ (1,0) [0|64255] "" Vector__XXX
 SG_ EngRequestedTorqueHighResolution : 0|4@1+ (0.125,0) [0|0.875] "%" Vector__XXX
 SG_ TSC1CtrlPurpose : 0|5@1+ (1,0) [0|31] "" Vector__XXX
 SG_ TSC1TransRate : 0|3@1+ (1,0) [0|7] "" Vector__XXX
 SG_ EngRequestedTorque_TorqueLimit : 0|8@1+ (1,-125) [-125|125] "%" Vector__XXX
 SG_ EngRequestedSpeed_SpeedLimit : 0|16@1+ (0.125,0) [0|8031.875] "rpm" Vector__XXX
 SG_ OverrideCtrlModePriority : 0|2@1+ (1,0) [0|3] "" Vector__XXX
 SG_ EngRequestedSpeedCtrlConditions : 0|2@1+ (1,0) [0|3] "" Vector__XXX
 SG_ EngOverrideCtrlMode : 0|2@1+ (1,0) [0|3] "" Vector__XXX
 SG_ TransitRunStatus : 0|2@1+ (1,0) [0|3] "" Vector__XXX
 SG_ VehicleUseStatus : 0|2@1+ (1,0) [0|3] "" Vector__XXX
 SG_ SilentAlarmStatus : 0|2@1+ (1,0) [0|3] "" Vector__XXX
 SG_ PatronCount : 0|8@1+ (1,0) [0|250] "" Vector__XXX
 SG_ TypeOfPassengerCount : 0|8@1+ (1,0) [0|255] "" Vector__XXX
 SG_ FareboxAlarmIdentifier : 0|7@1+ (1,0) [0|127] "" Vector__XXX
 SG_ FareboxEmergencyStatus : 0|2@1+ (1,0) [0|3] "" Vector__XXX
 SG_ TransferSold : 0|8@1+ (1,0) [0|255] "" Vector__XXX
 SG_ TransferType : 0|5@1+ (1,0) [0|31] "" Vector__XXX
 SG_ TypeOfService : 0|3@1+ (1,0) [0|7] "" Vector__XXX
 SG_ InitialFareAgency : 0|5@1+ (1,0) [1|31] "" Vector__XXX
 SG_ PassCategory : 0|4@1+ (1,0) [0|15] "" Vector__XXX
 SG_ FareValidity : 0|4@1+ (1,0) [0|15] "" Vector__XXX
 SG_ PaymentDetails : 0|4@1+ (1,0) [0|15] "" Vector__XXX
 SG_ TypeOfFare : 0|4@1+ (1,0) [0|15] "" Vector__XXX
 SG_ PassengerType : 0|4@1+ (1,0) [0|15] "" Vector__XXX
 SG_ TransactionType : 0|4@1+ (1,0) [0|15] "" Vector__XXX
 SG_ RouteNumber : 0|12@1+ (1,0) [0|4095] "" Vector__XXX
 SG_ DriversFareboxSecurityCode : 0|16@1+ (1,0) [0|65535] "" Vector__XXX
 SG_ AssignedBlock : 0|16@1+ (1,0) [0|65535] "" Vector__XXX
 SG_ AssignedRun : 0|16@1+ (1,0) [0|65535] "" Vector__XXX
 SG_ AssignedRoute : 0|16@1+ (1,0) [0|65535] "" Vector__XXX
 SG_ PatternNumber : 0|16@1+ (1,0) [0|65535] "" Vector__XXX
 SG_ TripNumber : 0|16@1+ (1,0) [0|65535] "" Vector__XXX
 SG_ FarePresets : 0|8@1+ (1,0) [0|255] "" Vector__XXX
 SG_ TripDirection : 0|4@1+ (1,0) [0|15] "" Vector__XXX
 SG_ TripStatus : 0|3@1+ (1,0) [0|7] "" Vector__XXX
 SG_ FareboxServiceStatus : 0|2@1+ (1,0) [0|3] "" Vector__XXX
 SG_ VehicleID : 0|16@1+ (1,0) [0|65534] "" Vector__XXX
 SG_ StrobeActivationCtrlStatus : 0|2@1+ (1,0) [0|3] "" Vector__XXX
 SG_ TransitDoorEnable : 0|2@1+ (1,0) [0|3] "" Vector__XXX
 SG_ PriorityOfRespSentByEmitter : 0|4@1+ (1,0) [0|15] "" Vector__XXX
 SG_ IntrsctnPrmptionRequest_Response : 0|2@1+ (1,0) [0|3] "" Vector__XXX
 SG_ TransitRouteIDUsage : 0|2@1+ (1,0) [0|3] "" Vector__XXX
 SG_ RangeCodeEnable : 0|2@1+ (1,0) [0|3] "" Vector__XXX
 SG_ NmbrOfBytsInThMlpstIdntification : 0|8@1+ (1,0) [0|100] "bytes" Vector__XXX
 SG_ NmbrOfBytsInThTrnstAssgndBlckIdn : 0|8@1+ (1,0) [1|100] "bytes" Vector__XXX
 SG_ NmbrOfBytsInThTrnstAssgndRnIdntt : 0|8@1+ (1,0) [1|100] "bytes" Vector__XXX
 SG_ NmbrOfBytsInThTrnstAssgndRtIdntt : 0|8@1+ (1,0) [1|100] "bytes" Vector__XXX
 SG_ Agency : 0|8@1+ (1,0) [0|255] "" Vector__XXX
 SG_ ReferenceTirePressSetting_33 : 0|8@1+ (8,0) [0|2000] "kPa" Vector__XXX
 SG_ ReferenceTirePressSetting_32 : 0|8@1+ (8,0) [0|2000] "kPa" Vector__XXX
 SG_ ReferenceTirePressSetting_31 : 0|8@1+ (8,0) [0|2000] "kPa" Vector__XXX
 SG_ ReferenceTirePressSetting_30 : 0|8@1+ (8,0) [0|2000] "kPa" Vector__XXX
 SG_ ReferenceTirePressSetting_23 : 0|8@1+ (8,0) [0|2000] "kPa" Vector__XXX
 SG_ ReferenceTirePressSetting_22 : 0|8@1+ (8,0) [0|2000] "kPa" Vector__XXX
 SG_ ReferenceTirePressSetting_21 : 0|8@1+ (8,0) [0|2000] "kPa" Vector__XXX
 SG_ ReferenceTirePressSetting_20 : 0|8@1+ (8,0) [0|2000] "kPa" Vector__XXX
 SG_ ReferenceTirePressSetting_13 : 0|8@1+ (8,0) [0|2000] "kPa" Vector__XXX
 SG_ ReferenceTirePressSetting_12 : 0|8@1+ (8,0) [0|2000] "kPa" Vector__XXX
 SG_ ReferenceTirePressSetting_11 : 0|8@1+ (8,0) [0|2000] "kPa" Vector__XXX
 SG_ ReferenceTirePressSetting_10 : 0|8@1+ (8,0) [0|2000] "kPa" Vector__XXX
 SG_ ReferenceTirePressSetting_01 : 0|8@1+ (8,0) [0|2000] "kPa" Vector__XXX
 SG_ ReferenceTirePressSetting_00 : 0|8@1+ (8,0) [0|2000] "kPa" Vector__XXX
 SG_ ReferenceTirePress_33 : 0|8@1+ (8,0) [0|2000] "kPa" Vector__XXX
 SG_ ReferenceTirePress_32 : 0|8@1+ (8,0) [0|2000] "kPa" Vector__XXX
 SG_ ReferenceTirePress_31 : 0|8@1+ (8,0) [0|2000] "kPa" Vector__XXX
 SG_ ReferenceTirePress_30 : 0|8@1+ (8,0) [0|2000] "kPa" Vector__XXX
 SG_ ReferenceTirePress_23 : 0|8@1+ (8,0) [0|2000] "kPa" Vector__XXX
 SG_ ReferenceTirePress_22 : 0|8@1+ (8,0) [0|2000] "kPa" Vector__XXX
 SG_ ReferenceTirePress_21 : 0|8@1+ (8,0) [0|2000] "kPa" Vector__XXX
 SG_ ReferenceTirePress_20 : 0|8@1+ (8,0) [0|2000] "kPa" Vector__XXX
 SG_ ReferenceTirePress_13 : 0|8@1+ (8,0) [0|2000] "kPa" Vector__XXX
 SG_ ReferenceTirePress_12 : 0|8@1+ (8,0) [0|2000] "kPa" Vector__XXX
 SG_ ReferenceTirePress_11 : 0|8@1+ (8,0) [0|2000] "kPa" Vector__XXX
 SG_ ReferenceTirePress_10 : 0|8@1+ (8,0) [0|2000] "kPa" Vector__XXX
 SG_ ReferenceTirePress_01 : 0|8@1+ (8,0) [0|2000] "kPa" Vector__XXX
 SG_ ReferenceTirePress_00 : 0|8@1+ (8,0) [0|2000] "kPa" Vector__XXX
 SG_ SteerChannelTirePress : 0|16@1+ (0.5,0) [0|32127.5] "kPa" Vector__XXX
 SG_ DriveChannelTirePress : 0|16@1+ (0.5,0) [0|32127.5] "kPa" Vector__XXX
 SG_ TrailerTagOrPushChannelTirePress : 0|16@1+ (0.5,0) [0|32127.5] "kPa" Vector__XXX
 SG_ SteerChannelTirePressTarget : 0|16@1+ (0.5,0) [0|32127.5] "kPa" Vector__XXX
 SG_ DriveChannelTirePressTarget : 0|16@1+ (0.5,0) [0|32127.5] "kPa" Vector__XXX
 SG_ TrlrTgOrPshChnnelTirePressTarget : 0|16@1+ (0.5,0) [0|32127.5] "kPa" Vector__XXX
 SG_ PCUTrilerTagOrPushSolenoidStatus : 0|2@1+ (1,0) [0|3] "" Vector__XXX
 SG_ PCUSupplySolenoidStatus : 0|2@1+ (1,0) [0|3] "" Vector__XXX
 SG_ PCUCtrlSolenoidStatus : 0|2@1+ (1,0) [0|3] "" Vector__XXX
 SG_ PCUDeflateSolenoidStatus : 0|2@1+ (1,0) [0|3] "" Vector__XXX
 SG_ TirePressSupplySwitchStatus : 0|2@1+ (1,0) [0|3] "" Vector__XXX
 SG_ PCUSteerSolenoidStatus : 0|2@1+ (1,0) [0|3] "" Vector__XXX
 SG_ PCUDriveSolenoidStatus : 0|2@1+ (1,0) [0|3] "" Vector__XXX
 SG_ DriveChannelMode : 0|4@1+ (1,0) [0|15] "" Vector__XXX
 SG_ Trailer_tagChannelMode : 0|4@1+ (1,0) [0|15] "" Vector__XXX
 SG_ SteerChannelMode : 0|4@1+ (1,0) [0|15] "" Vector__XXX
 SG_ TirePressCheckInterval : 0|8@1+ (1,0) [0|250] "min" Vector__XXX
 SG_ ExTirePressSupport : 0|2@1+ (1,0) [0|3] "" Vector__XXX
 SG_ TirePressThresholdDetection_13 : 0|3@1+ (1,0) [0|7] "" Vector__XXX
 SG_ TirePressThresholdDetection_12 : 0|3@1+ (1,0) [0|7] "" Vector__XXX
 SG_ TirePressThresholdDetection_11 : 0|3@1+ (1,0) [0|7] "" Vector__XXX
 SG_ TirePressThresholdDetection_10 : 0|3@1+ (1,0) [0|7] "" Vector__XXX
 SG_ TirePressThresholdDetection_01 : 0|3@1+ (1,0) [0|7] "" Vector__XXX
 SG_ TirePress_33 : 0|8@1+ (4,0) [0|1000] "kPa" Vector__XXX
 SG_ TirePress_32 : 0|8@1+ (4,0) [0|1000] "kPa" Vector__XXX
 SG_ TirePress_31 : 0|8@1+ (4,0) [0|1000] "kPa" Vector__XXX
 SG_ TirePress_30 : 0|8@1+ (4,0) [0|1000] "kPa" Vector__XXX
 SG_ TirePress_23 : 0|8@1+ (4,0) [0|1000] "kPa" Vector__XXX
 SG_ TirePress_22 : 0|8@1+ (4,0) [0|1000] "kPa" Vector__XXX
 SG_ TirePress_21 : 0|8@1+ (4,0) [0|1000] "kPa" Vector__XXX
 SG_ TirePress_20 : 0|8@1+ (4,0) [0|1000] "kPa" Vector__XXX
 SG_ TirePress_13 : 0|8@1+ (4,0) [0|1000] "kPa" Vector__XXX
 SG_ TirePress_12 : 0|8@1+ (4,0) [0|1000] "kPa" Vector__XXX
 SG_ TirePress_11 : 0|8@1+ (4,0) [0|1000] "kPa" Vector__XXX
 SG_ TirePress_10 : 0|8@1+ (4,0) [0|1000] "kPa" Vector__XXX
 SG_ TireAirLeakageRate_33 : 0|16@1+ (0.1,0) [0|6425.5] "Pa/s" Vector__XXX
 SG_ TireAirLeakageRate_32 : 0|16@1+ (0.1,0) [0|6425.5] "Pa/s" Vector__XXX
 SG_ TireAirLeakageRate_31 : 0|16@1+ (0.1,0) [0|6425.5] "Pa/s" Vector__XXX
 SG_ TireAirLeakageRate_30 : 0|16@1+ (0.1,0) [0|6425.5] "Pa/s" Vector__XXX
 SG_ TireAirLeakageRate_23 : 0|16@1+ (0.1,0) [0|6425.5] "Pa/s" Vector__XXX
 SG_ TireAirLeakageRate_22 : 0|16@1+ (0.1,0) [0|6425.5] "Pa/s" Vector__XXX
 SG_ TireAirLeakageRate_21 : 0|16@1+ (0.1,0) [0|6425.5] "Pa/s" Vector__XXX
 SG_ TireAirLeakageRate_20 : 0|16@1+ (0.1,0) [0|6425.5] "Pa/s" Vector__XXX
 SG_ TireAirLeakageRate_13 : 0|16@1+ (0.1,0) [0|6425.5] "Pa/s" Vector__XXX
 SG_ TireAirLeakageRate_12 : 0|16@1+ (0.1,0) [0|6425.5] "Pa/s" Vector__XXX
 SG_ TireAirLeakageRate_11 : 0|16@1+ (0.1,0) [0|6425.5] "Pa/s" Vector__XXX
 SG_ TireAirLeakageRate_10 : 0|16@1+ (0.1,0) [0|6425.5] "Pa/s" Vector__XXX
 SG_ TireAirLeakageRate_01 : 0|16@1+ (0.1,0) [0|6425.5] "Pa/s" Vector__XXX
 SG_ TireAirLeakageRate_00 : 0|16@1+ (0.1,0) [0|6425.5] "Pa/s" Vector__XXX
 SG_ CTIWheelSensorStatus_33 : 0|2@1+ (1,0) [0|3] "" Vector__XXX
 SG_ CTIWheelSensorStatus_32 : 0|2@1+ (1,0) [0|3] "" Vector__XXX
 SG_ CTIWheelSensorStatus_31 : 0|2@1+ (1,0) [0|3] "" Vector__XXX
 SG_ CTIWheelSensorStatus_30 : 0|2@1+ (1,0) [0|3] "" Vector__XXX
 SG_ CTIWheelSensorStatus_23 : 0|2@1+ (1,0) [0|3] "" Vector__XXX
 SG_ CTIWheelSensorStatus_22 : 0|2@1+ (1,0) [0|3] "" Vector__XXX
 SG_ CTIWheelSensorStatus_21 : 0|2@1+ (1,0) [0|3] "" Vector__XXX
 SG_ CTIWheelSensorStatus_20 : 0|2@1+ (1,0) [0|3] "" Vector__XXX
 SG_ CTIWheelSensorStatus_13 : 0|2@1+ (1,0) [0|3] "" Vector__XXX
 SG_ CTIWheelSensorStatus_12 : 0|2@1+ (1,0) [0|3] "" Vector__XXX
 SG_ CTIWheelSensorStatus_11 : 0|2@1+ (1,0) [0|3] "" Vector__XXX
 SG_ CTIWheelSensorStatus_10 : 0|2@1+ (1,0) [0|3] "" Vector__XXX
 SG_ CTIWheelSensorStatus_01 : 0|2@1+ (1,0) [0|3] "" Vector__XXX
 SG_ CTIWheelEndElectricalFault_33 : 0|2@1+ (1,0) [0|3] "" Vector__XXX
 SG_ CTIWheelEndElectricalFault_32 : 0|2@1+ (1,0) [0|3] "" Vector__XXX
 SG_ CTIWheelEndElectricalFault_31 : 0|2@1+ (1,0) [0|3] "" Vector__XXX
 SG_ CTIWheelEndElectricalFault_30 : 0|2@1+ (1,0) [0|3] "" Vector__XXX
 SG_ CTIWheelEndElectricalFault_23 : 0|2@1+ (1,0) [0|3] "" Vector__XXX
 SG_ CTIWheelEndElectricalFault_22 : 0|2@1+ (1,0) [0|3] "" Vector__XXX
 SG_ CTIWheelEndElectricalFault_21 : 0|2@1+ (1,0) [0|3] "" Vector__XXX
 SG_ CTIWheelEndElectricalFault_20 : 0|2@1+ (1,0) [0|3] "" Vector__XXX
 SG_ CTIWheelEndElectricalFault_13 : 0|2@1+ (1,0) [0|3] "" Vector__XXX
 SG_ CTIWheelEndElectricalFault_12 : 0|2@1+ (1,0) [0|3] "" Vector__XXX
 SG_ CTIWheelEndElectricalFault_11 : 0|2@1+ (1,0) [0|3] "" Vector__XXX
 SG_ CTIWheelEndElectricalFault_10 : 0|2@1+ (1,0) [0|3] "" Vector__XXX
 SG_ CTIWheelEndElectricalFault_01 : 0|2@1+ (1,0) [0|3] "" Vector__XXX
 SG_ CTITireStatus_33 : 0|2@1+ (1,0) [0|3] "" Vector__XXX
 SG_ CTITireStatus_32 : 0|2@1+ (1,0) [0|3] "" Vector__XXX
 SG_ CTITireStatus_31 : 0|2@1+ (1,0) [0|3] "" Vector__XXX
 SG_ CTITireStatus_30 : 0|2@1+ (1,0) [0|3] "" Vector__XXX
 SG_ CTITireStatus_23 : 0|2@1+ (1,0) [0|3] "" Vector__XXX
 SG_ CTITireStatus_22 : 0|2@1+ (1,0) [0|3] "" Vector__XXX
 SG_ CTITireStatus_21 : 0|2@1+ (1,0) [0|3] "" Vector__XXX
 SG_ CTITireStatus_20 : 0|2@1+ (1,0) [0|3] "" Vector__XXX
 SG_ CTITireStatus_13 : 0|2@1+ (1,0) [0|3] "" Vector__XXX
 SG_ CTITireStatus_12 : 0|2@1+ (1,0) [0|3] "" Vector__XXX
 SG_ CTITireStatus_11 : 0|2@1+ (1,0) [0|3] "" Vector__XXX
 SG_ CTITireStatus_10 : 0|2@1+ (1,0) [0|3] "" Vector__XXX
 SG_ CTITireStatus_01 : 0|2@1+ (1,0) [0|3] "" Vector__XXX
 SG_ TireTemp_11 : 0|16@1+ (0.03125,-273) [-273|1735] "°C" Vector__XXX
 SG_ TireTemp_33 : 0|16@1+ (0.03125,-273) [-273|1735] "°C" Vector__XXX
 SG_ TireTemp_32 : 0|16@1+ (0.03125,-273) [-273|1735] "°C" Vector__XXX
 SG_ TireTemp_31 : 0|16@1+ (0.03125,-273) [-273|1735] "°C" Vector__XXX
 SG_ TireTemp_30 : 0|16@1+ (0.03125,-273) [-273|1735] "°C" Vector__XXX
 SG_ TireTemp_23 : 0|16@1+ (0.03125,-273) [-273|1735] "°C" Vector__XXX
 SG_ TireTemp_22 : 0|16@1+ (0.03125,-273) [-273|1735] "°C" Vector__XXX
 SG_ TireTemp_21 : 0|16@1+ (0.03125,-273) [-273|1735] "°C" Vector__XXX
 SG_ TireTemp_20 : 0|16@1+ (0.03125,-273) [-273|1735] "°C" Vector__XXX
 SG_ TireTemp_13 : 0|16@1+ (0.03125,-273) [-273|1735] "°C" Vector__XXX
 SG_ TireTemp_12 : 0|16@1+ (0.03125,-273) [-273|1735] "°C" Vector__XXX
 SG_ TireTemp_10 : 0|16@1+ (0.03125,-273) [-273|1735] "°C" Vector__XXX
 SG_ TireTemp_01 : 0|16@1+ (0.03125,-273) [-273|1735] "°C" Vector__XXX
 SG_ TireTemp_00 : 0|16@1+ (0.03125,-273) [-273|1735] "°C" Vector__XXX
 SG_ TirePressThresholdDetection_33 : 0|3@1+ (1,0) [0|7] "" Vector__XXX
 SG_ TirePressThresholdDetection_32 : 0|3@1+ (1,0) [0|7] "" Vector__XXX
 SG_ TirePressThresholdDetection_31 : 0|3@1+ (1,0) [0|7] "" Vector__XXX
 SG_ TirePressThresholdDetection_30 : 0|3@1+ (1,0) [0|7] "" Vector__XXX
 SG_ TirePressThresholdDetection_23 : 0|3@1+ (1,0) [0|7] "" Vector__XXX
 SG_ TirePressThresholdDetection_22 : 0|3@1+ (1,0) [0|7] "" Vector__XXX
 SG_ TirePressThresholdDetection_21 : 0|3@1+ (1,0) [0|7] "" Vector__XXX
 SG_ TirePressThresholdDetection_20 : 0|3@1+ (1,0) [0|7] "" Vector__XXX
 SG_ TirePressThresholdDetection_00 : 0|3@1+ (1,0) [0|7] "" Vector__XXX
 SG_ TirePress_01 : 0|8@1+ (4,0) [0|1000] "kPa" Vector__XXX
 SG_ TirePress_00 : 0|8@1+ (4,0) [0|1000] "kPa" Vector__XXX
 SG_ CTIWheelSensorStatus_00 : 0|2@1+ (1,0) [0|3] "" Vector__XXX
 SG_ CTIWheelEndElectricalFault_00 : 0|2@1+ (1,0) [0|3] "" Vector__XXX
 SG_ CTITireStatus_00 : 0|2@1+ (1,0) [0|3] "" Vector__XXX
 SG_ TripFanOnTimeDueToTheA_CSystem : 0|32@1+ (0.05,0) [0|210554060.75] "h" Vector__XXX
 SG_ TripFanOnTimeDueToAManualSwitch : 0|32@1+ (0.05,0) [0|210554060.75] "h" Vector__XXX
 SG_ TripFanOnTimeDueToTheEngSystem : 0|32@1+ (0.05,0) [0|210554060.75] "h" Vector__XXX
 SG_ TripFanOnTime : 0|32@1+ (0.05,0) [0|210554060.75] "h" Vector__XXX
 SG_ TripDistanceInTopGear : 0|32@1+ (0.125,0) [0|526385151.875] "km" Vector__XXX
 SG_ TripGearDownDistance : 0|32@1+ (0.125,0) [0|526385151.875] "km" Vector__XXX
 SG_ TripDistanceOnVSL : 0|32@1+ (0.125,0) [0|526385151.875] "km" Vector__XXX
 SG_ AdjustLocalHourOffset : 0|8@1+ (1,-125) [-24|23] "h" Vector__XXX
 SG_ AdjustLocalMinuteOffset : 0|8@1+ (1,-125) [-59|59] "min" Vector__XXX
 SG_ AdjustYear : 0|8@1+ (1,1985) [1985|2235] "years" Vector__XXX
 SG_ AdjustDay : 0|8@1+ (0.25,0) [0.25|31.75] "days" Vector__XXX
 SG_ AdjustMonth : 0|8@1+ (1,0) [1|12] "months" Vector__XXX
 SG_ AdjustHours : 0|8@1+ (1,0) [0|23] "h" Vector__XXX
 SG_ AdjustMinutes : 0|8@1+ (1,0) [0|59] "min" Vector__XXX
 SG_ AdjustSeconds : 0|8@1+ (0.25,0) [0|59.75] "s" Vector__XXX
 SG_ LocalHourOffset : 0|8@1+ (1,-125) [-23|23] "h" Vector__XXX
 SG_ LocalMinuteOffset : 0|8@1+ (1,-125) [-59|59] "min" Vector__XXX
 SG_ Year : 0|8@1+ (1,1985) [1985|2235] "years" Vector__XXX
 SG_ Day : 0|8@1+ (0.25,0) [0.25|31.75] "days" Vector__XXX
 SG_ Month : 0|8@1+ (1,0) [1|12] "months" Vector__XXX
 SG_ Hours : 0|8@1+ (1,0) [0|23] "h" Vector__XXX
 SG_ Minutes : 0|8@1+ (1,0) [0|59] "min" Vector__XXX
 SG_ Seconds : 0|8@1+ (0.25,0) [0|59.75] "s" Vector__XXX
 SG_ EngDsrdTrboWastegateActuator2Pos : 0|8@1+ (0.4,0) [0|100] "%" Vector__XXX
 SG_ EngTrbWstgateActuator1TempStatus : 0|3@1+ (1,0) [0|7] "" Vector__XXX
 SG_ EngTrbWstgtActtor1PreliminaryFMI : 0|5@1+ (1,0) [0|31] "" Vector__XXX
 SG_ EngDsrdTrboWastegateActuator1Pos : 0|8@1+ (0.4,0) [0|100] "%" Vector__XXX
 SG_ EngTrbWstgteActuatorCtrlAirPress : 0|8@1+ (4,0) [0|1000] "kPa" Vector__XXX
 SG_ EngTurboWastegateActuator4Pos : 0|8@1+ (0.4,0) [0|100] "%" Vector__XXX
 SG_ EngTurboWastegateActuator3Pos : 0|8@1+ (0.4,0) [0|100] "%" Vector__XXX
 SG_ EngTurboWastegateActuator2Pos : 0|8@1+ (0.4,0) [0|100] "%" Vector__XXX
 SG_ EngTurboWastegateActuator1Pos : 0|8@1+ (0.4,0) [0|100] "%" Vector__XXX
 SG_ TachographVehicleSpeed : 0|16@1+ (0.00390625,0) [0|250.996] "km/h" Vector__XXX
 SG_ TachographOutputShaftSpeed : 0|16@1+ (0.125,0) [0|8031.875] "rpm" Vector__XXX
 SG_ DirectionIndicator : 0|2@1+ (1,0) [0|3] "" Vector__XXX
 SG_ TachographPerformance : 0|2@1+ (1,0) [0|3] "" Vector__XXX
 SG_ HandlingInformation : 0|2@1+ (1,0) [0|3] "" Vector__XXX
 SG_ SystemEvent : 0|2@1+ (1,0) [0|3] "" Vector__XXX
 SG_ DriverCardDriver2 : 0|2@1+ (1,0) [0|3] "" Vector__XXX
 SG_ Driver2TimeRelatedStates : 0|4@1+ (1,0) [0|15] "" Vector__XXX
 SG_ VehicleOverspeed : 0|2@1+ (1,0) [0|3] "" Vector__XXX
 SG_ DriverCardDriver1 : 0|2@1+ (1,0) [0|3] "" Vector__XXX
 SG_ Driver1TimeRelatedStates : 0|4@1+ (1,0) [0|15] "" Vector__XXX
 SG_ VehicleMotion : 0|2@1+ (1,0) [0|3] "" Vector__XXX
 SG_ Driver2WorkingState : 0|3@1+ (1,0) [0|7] "" Vector__XXX
 SG_ Driver1WorkingState : 0|3@1+ (1,0) [0|7] "" Vector__XXX
 SG_ EngTurbo4CompressorOutletTemp : 0|16@1+ (0.03125,-273) [-273|1734.96875] "°C" Vector__XXX
 SG_ EngTurbo3CompressorOutletTemp : 0|16@1+ (0.03125,-273) [-273|1734.96875] "°C" Vector__XXX
 SG_ EngTurbo2CompressorOutletTemp : 0|16@1+ (0.03125,-273) [-273|1734.96875] "°C" Vector__XXX
 SG_ EngTurbo1CompressorOutletTemp : 0|16@1+ (0.03125,-273) [-273|1734.96875] "°C" Vector__XXX
 SG_ EngTurbo4TurbineOutletTemp : 0|16@1+ (0.03125,-273) [-273|1734.96875] "°C" Vector__XXX
 SG_ EngTurbo3TurbineOutletTemp : 0|16@1+ (0.03125,-273) [-273|1734.96875] "°C" Vector__XXX
 SG_ EngTurbo2TurbineOutletTemp : 0|16@1+ (0.03125,-273) [-273|1734.96875] "°C" Vector__XXX
 SG_ EngTurbo1TurbineOutletTemp : 0|16@1+ (0.03125,-273) [-273|1734.96875] "°C" Vector__XXX
 SG_ EngTurbo4TurbineIntakeTemp : 0|16@1+ (0.03125,-273) [-273|1734.96875] "°C" Vector__XXX
 SG_ EngTurbo3TurbineIntakeTemp : 0|16@1+ (0.03125,-273) [-273|1734.96875] "°C" Vector__XXX
 SG_ EngTurbo2TurbineIntakeTemp : 0|16@1+ (0.03125,-273) [-273|1734.96875] "°C" Vector__XXX
 SG_ EngTurbo1TurbineIntakeTemp : 0|16@1+ (0.03125,-273) [-273|1734.96875] "°C" Vector__XXX
 SG_ EngTurbo4CompressorIntakePress : 0|16@1+ (0.0078125,-250) [-250|251.99] "kPa" Vector__XXX
 SG_ EngTurbo3CompressorIntakePress : 0|16@1+ (0.0078125,-250) [-250|251.99] "kPa" Vector__XXX
 SG_ EngTurbo2CompressorIntakePress : 0|16@1+ (0.0078125,-250) [-250|251.99] "kPa" Vector__XXX
 SG_ EngTurbo1CompressorIntakePress : 0|16@1+ (0.0078125,-250) [-250|251.99] "kPa" Vector__XXX
 SG_ EngTurbo4CompressorIntakeTemp : 0|16@1+ (0.03125,-273) [-273|1734.96875] "°C" Vector__XXX
 SG_ EngTurbo3CompressorIntakeTemp : 0|16@1+ (0.03125,-273) [-273|1734.96875] "°C" Vector__XXX
 SG_ EngTurbo2CompressorIntakeTemp : 0|16@1+ (0.03125,-273) [-273|1734.96875] "°C" Vector__XXX
 SG_ EngTurbo1CompressorIntakeTemp : 0|16@1+ (0.03125,-273) [-273|1734.96875] "°C" Vector__XXX
 SG_ EngTurbo4Speed : 0|16@1+ (4,0) [0|257020] "rpm" Vector__XXX
 SG_ EngTurbo3Speed : 0|16@1+ (4,0) [0|257020] "rpm" Vector__XXX
 SG_ EngTurbo2Speed : 0|16@1+ (4,0) [0|257020] "rpm" Vector__XXX
 SG_ EngTurboLubeOilPress2 : 0|8@1+ (4,0) [0|1000] "kPa" Vector__XXX
 SG_ TransTorqueLimit : 0|16@1+ (1,0) [0|64255] "Nm" Vector__XXX
 SG_ TransGearRatio : 0|16@1+ (0.001,0) [0|64.255] "" Vector__XXX
 SG_ NumberOfForwardGearRatios : 0|8@1+ (1,0) [0|125] "" Vector__XXX
 SG_ NumberOfReverseGearRatios : 0|8@1+ (1,0) [0|125] "" Vector__XXX
 SG_ AutoNeutralReq : 0|2@1+ (1,0) [0|3] "" Vector__XXX
 SG_ TransMode8 : 0|2@1+ (1,0) [0|3] "" Vector__XXX
 SG_ TransMode7 : 0|2@1+ (1,0) [0|3] "" Vector__XXX
 SG_ TransMode6 : 0|2@1+ (1,0) [0|3] "" Vector__XXX
 SG_ TransMode5 : 0|2@1+ (1,0) [0|3] "" Vector__XXX
 SG_ TrnsShftSlectorDisplayModeSwitch : 0|2@1+ (1,0) [0|3] "" Vector__XXX
 SG_ TransRequestedLaunchGear : 0|4@1+ (1,0) [0|15] "" Vector__XXX
 SG_ TransMode4 : 0|2@1+ (1,0) [0|3] "" Vector__XXX
 SG_ TransMode3 : 0|2@1+ (1,0) [0|3] "" Vector__XXX
 SG_ TransMode2 : 0|2@1+ (1,0) [0|3] "" Vector__XXX
 SG_ TransMode1 : 0|2@1+ (1,0) [0|3] "" Vector__XXX
 SG_ TransLoadReductionInhibitRq : 0|2@1+ (1,0) [0|3] "" Vector__XXX
 SG_ DisengageDiffLockRqCentralRear : 0|2@1+ (1,0) [0|3] "" Vector__XXX
 SG_ DisengageDiffLockRqCentralFront : 0|2@1+ (1,0) [0|3] "" Vector__XXX
 SG_ DisengageDiffLockRqCentral : 0|2@1+ (1,0) [0|3] "" Vector__XXX
 SG_ DisengageDiffLockRqRearAxle2 : 0|2@1+ (1,0) [0|3] "" Vector__XXX
 SG_ DisengageDiffLockRqRearAxle1 : 0|2@1+ (1,0) [0|3] "" Vector__XXX
 SG_ DisengageDiffLockRqFrontAxle2 : 0|2@1+ (1,0) [0|3] "" Vector__XXX
 SG_ DisengageDiffLockRqFrontAxle1 : 0|2@1+ (1,0) [0|3] "" Vector__XXX
 SG_ TransRequestedGear : 0|8@1+ (1,-125) [-64|64] "" Vector__XXX
 SG_ RequestedPercentClutchSlip : 0|8@1+ (0.4,0) [0|100] "%" Vector__XXX
 SG_ TransReverseGearShiftInhibitRq : 0|2@1+ (1,0) [0|3] "" Vector__XXX
 SG_ DisengageDrivelineRq : 0|2@1+ (1,0) [0|3] "" Vector__XXX
 SG_ TrnsTrqeConverterLockupDisableRq : 0|2@1+ (1,0) [0|3] "" Vector__XXX
 SG_ TransGearShiftInhibitRq : 0|2@1+ (1,0) [0|3] "" Vector__XXX
 SG_ EngTurboOilLevelSwitch : 0|2@1+ (1,0) [0|3] "" Vector__XXX
 SG_ EngTurbo1Speed : 0|16@1+ (4,0) [0|257020] "rpm" Vector__XXX
 SG_ EngTurboLubeOilPress1 : 0|8@1+ (4,0) [0|1000] "kPa" Vector__XXX
 SG_ EngTurboDiffSpeed : 0|16@1+ (4,0) [0|257020] "rpm" Vector__XXX
 SG_ EngTotalAverageFuelEconomy : 0|16@1+ (0.001953125,0) [0|125.498046875] "km/L" Vector__XXX
 SG_ EngTotalAverageFuelRate : 0|16@1+ (0.05,0) [0|3212.75] "L/h" Vector__XXX
 SG_ PwertrainCircuitAirSupplyPressRq : 0|8@1+ (8,0) [0|2000] "kPa" Vector__XXX
 SG_ AirSuspensionSupplyPressRq : 0|8@1+ (8,0) [0|2000] "kPa" Vector__XXX
 SG_ AuxEquipmentSupplyPressRq : 0|8@1+ (8,0) [0|2000] "kPa" Vector__XXX
 SG_ ServiceBrakeAirPressRqCircuit2 : 0|8@1+ (8,0) [0|2000] "kPa" Vector__XXX
 SG_ ServiceBrakeAirPressRqCircuit1 : 0|8@1+ (8,0) [0|2000] "kPa" Vector__XXX
 SG_ ParkingAnd_orTrailerAirPressRq : 0|8@1+ (8,0) [0|2000] "kPa" Vector__XXX
 SG_ PneumaticSupplyPressRq : 0|8@1+ (8,0) [0|2000] "kPa" Vector__XXX
 SG_ EngExtlShutdownAirSupplyPress : 0|16@1+ (0.5,0) [0|32127.5] "kPa" Vector__XXX
 SG_ NmbrOfSftwreIdentificationFields : 0|8@1+ (1,0) [0|125] "steps" Vector__XXX
 SG_ SoftwareIdentification : 0|8@1+ (1,0) [0|255] "" Vector__XXX
 SG_ ClntLvlEngPrtctionShutdownStatus : 0|2@1+ (1,0) [0|3] "" Vector__XXX
 SG_ PTOShutdownHasShutdownEng : 0|2@1+ (1,0) [0|3] "" Vector__XXX
 SG_ EngAirShutoffStatus : 0|2@1+ (1,0) [0|3] "" Vector__XXX
 SG_ EngOverspeedTest : 0|2@1+ (1,0) [0|3] "" Vector__XXX
 SG_ EngAirShutoffCmdStatus : 0|2@1+ (1,0) [0|3] "" Vector__XXX
 SG_ EngAlarmOutputCmdStatus : 0|2@1+ (1,0) [0|3] "" Vector__XXX
 SG_ EngAlarmAcknowledge : 0|2@1+ (1,0) [0|3] "" Vector__XXX
 SG_ EngProtectionSystemConfig : 0|2@1+ (1,0) [0|3] "" Vector__XXX
 SG_ EngProtectionSystemTimerState : 0|2@1+ (1,0) [0|3] "" Vector__XXX
 SG_ EngProtectionSystemTimerOverride : 0|2@1+ (1,0) [0|3] "" Vector__XXX
 SG_ EngPrtctnSystmApprachingShutdown : 0|2@1+ (1,0) [0|3] "" Vector__XXX
 SG_ EngPrtectionSystemHasShutdownEng : 0|2@1+ (1,0) [0|3] "" Vector__XXX
 SG_ EngWaitToStartLamp : 0|2@1+ (1,0) [0|3] "" Vector__XXX
 SG_ RefrigerantHighPressSwitch : 0|2@1+ (1,0) [0|3] "" Vector__XXX
 SG_ RefrigerantLowPressSwitch : 0|2@1+ (1,0) [0|3] "" Vector__XXX
 SG_ A_CHighPressFanSwitch : 0|2@1+ (1,0) [0|3] "" Vector__XXX
 SG_ EngIdleShutdownTimerFunction : 0|2@1+ (1,0) [0|3] "" Vector__XXX
 SG_ EngIdleShutdownTimerState : 0|2@1+ (1,0) [0|3] "" Vector__XXX
 SG_ EngIdleShutdownTimerOverride : 0|2@1+ (1,0) [0|3] "" Vector__XXX
 SG_ EngIdleShutdownDriverAlertMode : 0|2@1+ (1,0) [0|3] "" Vector__XXX
 SG_ EngIdleShutdownHasShutdownEng : 0|2@1+ (1,0) [0|3] "" Vector__XXX
 SG_ VehicleSystem5 : 0|7@1+ (1,0) [0|127] "" Vector__XXX
 SG_ VehicleSystem4 : 0|7@1+ (1,0) [0|127] "" Vector__XXX
 SG_ VehicleSystem3 : 0|7@1+ (1,0) [0|127] "" Vector__XXX
 SG_ VehicleSystem2 : 0|7@1+ (1,0) [0|127] "" Vector__XXX
 SG_ VehicleSystem1 : 0|7@1+ (1,0) [0|127] "" Vector__XXX
 SG_ ArbitraryAddressCapable : 0|1@1+ (1,0) [0|1] "" Vector__XXX
 SG_ IndustryGroup : 0|3@1+ (1,0) [0|7] "" Vector__XXX
 SG_ VehicleSystemInstance : 0|4@1+ (1,0) [0|15] "" Vector__XXX
 SG_ VehicleSystem : 0|7@1+ (1,0) [0|127] "" Vector__XXX
 SG_ ECUInstance : 0|3@1+ (1,0) [0|7] "" Vector__XXX
 SG_ FunctionInstance : 0|5@1+ (1,0) [0|31] "" Vector__XXX
 SG_ Function : 0|8@1+ (1,0) [0|255] "" Vector__XXX
 SG_ ManufacturerCode : 0|11@1+ (1,0) [0|2047] "" Vector__XXX
 SG_ IdentityNumber : 0|21@1+ (1,0) [0|2097151] "" Vector__XXX
 SG_ SrviceDelay_OperationalTimeBased : 0|16@1+ (1,-32127) [-32127|32128] "h" Vector__XXX
 SG_ ServiceComponentIdentificatio913 : 0|8@1+ (1,0) [0|250] "ID" Vector__XXX
 SG_ ServiceDelay_CalendarTimeBased : 0|8@1+ (1,-125) [-125|125] "weeks" Vector__XXX
 SG_ ServiceComponentIdentificatio912 : 0|8@1+ (1,0) [0|250] "ID" Vector__XXX
 SG_ ServiceDistance : 0|16@1+ (5,-160635) [-160635|160640] "km" Vector__XXX
 SG_ ServiceComponentIdentification : 0|8@1+ (1,0) [0|250] "ID" Vector__XXX
 SG_ TimeSinceLastService : 0|16@1+ (1,-32127) [-32127|32128] "h" Vector__XXX
 SG_ ServiceComponentIdentification : 0|8@1+ (1,0) [0|250] "ID" Vector__XXX
 SG_ MinContinuousRetarderTorque : 0|8@1+ (1,-125) [-125|125] "%" Vector__XXX
 SG_ MaxContinuousRetarderTorque : 0|8@1+ (1,-125) [-125|125] "%" Vector__XXX
 SG_ MinContinuousRetarderSpeed : 0|8@1+ (32,0) [0|8000] "rpm" Vector__XXX
 SG_ MaxContinuousRetarderSpeed : 0|8@1+ (32,0) [0|8000] "rpm" Vector__XXX
 SG_ HghLmtThrshldFrMnCntnsTrqFrmRtrd : 0|8@1+ (1,-125) [-125|125] "%" Vector__XXX
 SG_ LwLmtThrshldFrMxTrqeFromRetarder : 0|8@1+ (1,-125) [-125|125] "%" Vector__XXX
 SG_ HghLmtThrshldFrMnCntnsRPMFrmRtrd : 0|8@1+ (32,0) [0|8000] "rpm" Vector__XXX
 SG_ LwLmtThrshldFrMaxRPMFromRetarder : 0|8@1+ (32,0) [0|8000] "rpm" Vector__XXX
 SG_ DrvlineRetarderOverheatIndicator : 0|2@1+ (1,0) [0|3] "" Vector__XXX
 SG_ RetarderCoolantOutletTemp : 0|8@1+ (1,-40) [-40|210] "°C" Vector__XXX
 SG_ HydRetarderOilTemp : 0|8@1+ (1,-40) [-40|210] "°C" Vector__XXX
 SG_ HydRetarderPress : 0|8@1+ (16,0) [0|4000] "kPa" Vector__XXX
 SG_ SteerStraightAheadPosReset : 0|2@1+ (1,0) [0|3] "" Vector__XXX
 SG_ EngBuildHoursReset : 0|2@1+ (1,0) [0|3] "" Vector__XXX
 SG_ EngIgntCtrlMaintenanceHoursReset : 0|2@1+ (1,0) [0|3] "" Vector__XXX
 SG_ EngSprkPlgScndVltgeTrackingReset : 0|2@1+ (1,0) [0|3] "" Vector__XXX
 SG_ ServiceComponentIdentification : 0|8@1+ (1,0) [0|250] "ID" Vector__XXX
 SG_ TripGroup2Proprietary : 0|2@1+ (1,0) [0|3] "" Vector__XXX
 SG_ TireSensorInformation : 0|2@1+ (1,0) [0|3] "" Vector__XXX
 SG_ TireConfigInformation : 0|2@1+ (1,0) [0|3] "" Vector__XXX
 SG_ BinLiftCountReset : 0|2@1+ (1,0) [0|3] "" Vector__XXX
 SG_ TripGroup1 : 0|2@1+ (1,0) [0|3] "" Vector__XXX
 SG_ PercentTorqueAtPeakTorquePoint5 : 0|8@1+ (1,-125) [-125|0] "%" Vector__XXX
 SG_ RetarderSpeedAtPeakTorquePoint5 : 0|16@1+ (0.125,0) [0|8031.875] "rpm" Vector__XXX
 SG_ PercentTorqueAtPoint4 : 0|8@1+ (1,-125) [-125|0] "%" Vector__XXX
 SG_ RetarderSpeedAtPoint4 : 0|16@1+ (0.125,0) [0|8031.875] "rpm" Vector__XXX
 SG_ PercentTorqueAtPoint3 : 0|8@1+ (1,-125) [-125|0] "%" Vector__XXX
 SG_ RetarderSpeedAtPoint3 : 0|16@1+ (0.125,0) [0|8031.875] "rpm" Vector__XXX
 SG_ PercentTorqueAtMaxSpeedPoint2 : 0|8@1+ (1,-125) [-125|0] "%" Vector__XXX
 SG_ MaxRetarderSpeedPoint2 : 0|16@1+ (0.125,0) [0|8031.875] "rpm" Vector__XXX
 SG_ PercentTorqueAtIdlePoint1 : 0|8@1+ (1,-125) [-125|0] "%" Vector__XXX
 SG_ RetarderSpeedAtIdlePoint1 : 0|16@1+ (0.125,0) [0|8031.875] "rpm" Vector__XXX
 SG_ RetarderCtrlMethod : 0|8@1+ (1,0) [0|250] "steps" Vector__XXX
 SG_ RetarderLocation : 0|4@1+ (1,0) [0|15] "" Vector__XXX
 SG_ RetarderType : 0|4@1+ (1,0) [0|15] "" Vector__XXX
 SG_ EngOperationTimeSinceRebuild : 0|32@1+ (1,0) [0|4211081215] "s" Vector__XXX
 SG_ PowerTakeoffSetSpeed : 0|16@1+ (0.125,0) [0|8031.875] "rpm" Vector__XXX
 SG_ PowerTakeoffSpeed : 0|16@1+ (0.125,0) [0|8031.875] "rpm" Vector__XXX
 SG_ PowerTakeoffOilTemp : 0|8@1+ (1,-40) [-40|210] "°C" Vector__XXX
 SG_ OprtrEngPTOGvrnrMmrySelectSwitch : 0|2@1+ (1,0) [0|3] "" Vector__XXX
 SG_ EngRmtPTOGvrnrVrblSpedCtrlSwitch : 0|2@1+ (1,0) [0|3] "" Vector__XXX
 SG_ EngRmtPTOGvrnrPrprgrmmdSpdCtrlSw : 0|2@1+ (1,0) [0|3] "" Vector__XXX
 SG_ EngPTOGvrnrCast_DecelerateSwitch : 0|2@1+ (1,0) [0|3] "" Vector__XXX
 SG_ ArbitraryAddressCapable : 0|1@1+ (1,0) [0|1] "" Vector__XXX
 SG_ IndustryGroup : 0|3@1+ (1,0) [0|7] "" Vector__XXX
 SG_ VehicleSystemInstance : 0|4@1+ (1,0) [0|15] "" Vector__XXX
 SG_ Function : 0|8@1+ (1,0) [0|255] "" Vector__XXX
 SG_ VehicleSystem : 0|7@1+ (1,0) [0|127] "" Vector__XXX
 SG_ FunctionInstance : 0|5@1+ (1,0) [0|31] "" Vector__XXX
 SG_ ECUInstance : 0|3@1+ (1,0) [0|7] "" Vector__XXX
 SG_ ManufacturerCode : 0|11@1+ (1,0) [0|2047] "" Vector__XXX
 SG_ IdentityNumber : 0|21@1+ (1,0) [0|2097151] "" Vector__XXX
 SG_ VehicleSystem5 : 0|7@1+ (1,0) [0|127] "" Vector__XXX
 SG_ VehicleSystem4 : 0|7@1+ (1,0) [0|127] "" Vector__XXX
 SG_ VehicleSystem3 : 0|7@1+ (1,0) [0|127] "" Vector__XXX
 SG_ VehicleSystem2 : 0|7@1+ (1,0) [0|127] "" Vector__XXX
 SG_ VehicleSystem1 : 0|7@1+ (1,0) [0|127] "" Vector__XXX
 SG_ ArbitraryAddressCapable : 0|1@1+ (1,0) [0|1] "" Vector__XXX
 SG_ IndustryGroup : 0|3@1+ (1,0) [0|7] "" Vector__XXX
 SG_ VehicleSystemInstance : 0|4@1+ (1,0) [0|15] "" Vector__XXX
 SG_ Function : 0|8@1+ (1,0) [0|255] "" Vector__XXX
 SG_ FunctionInstance : 0|5@1+ (1,0) [0|31] "" Vector__XXX
 SG_ ECUInstance : 0|3@1+ (1,0) [0|7] "" Vector__XXX
 SG_ ManufacturerCode : 0|11@1+ (1,0) [0|2047] "" Vector__XXX
 SG_ IdentityNumber : 0|21@1+ (1,0) [0|2097151] "" Vector__XXX
 SG_ VehicleSystem : 0|7@1+ (1,0) [0|127] "" Vector__XXX
 SG_ VehicleSystem5 : 0|7@1+ (1,0) [0|127] "" Vector__XXX
 SG_ VehicleSystem4 : 0|7@1+ (1,0) [0|127] "" Vector__XXX
 SG_ VehicleSystem3 : 0|7@1+ (1,0) [0|127] "" Vector__XXX
 SG_ VehicleSystem2 : 0|7@1+ (1,0) [0|127] "" Vector__XXX
 SG_ VehicleSystem1 : 0|7@1+ (1,0) [0|127] "" Vector__XXX

CM_ SG_ 3221225472 HghRsolutionTotalVehicleDistance "Accumulated distance traveled by the vehicle during its operation.

NOTE - See SPN 245 for alternate resolution.";
CM_ SG_ 3221225472 LongitudinalAcceleration "Indicates the longitudinal acceleration of the vehicle. A positive longitudinal acceleration signal results when the vehicle speed increases, regardless of driving the vehicle forward or backward.  This parameter is applicable to vehicle speed ...";
CM_ SG_ 3221225472 LateralAcceleration "Indicates a lateral acceleration of the vehicle (the component of vehicle acceleration vector along the Y-axis). A positive lateral acceleration signal results when the vehicle is accelerated to the left.  This parameter is defined according to a ...";
CM_ SG_ 3221225472 YawRate "Indicates the rate of rotation about the vertical axis (i.e. the z-axis).  A positive yaw rate signal results when the vehicle turns counter-clockwise.   This parameter is defined according to a Z-Up axis system and the sign of the value is in ...";
CM_ SG_ 3221225472 SteerWheelAngleSensorType "Indicates whether the steering wheel angle sensor is capable of absolute measuring of the number of steering wheel turns or not (relative measuring to position at ignition on).
00 Relative measuring principle
01 Absolute measuring principle
10 ...";
CM_ SG_ 3221225472 SteerWheelTurnCounter "Indicates number of steering wheel turns, absolute position or relative position at ignition on. Positive values indicate left turns.";
CM_ SG_ 3221225472 TrailerVDCActive "The trailer-VDC (Vehicle Dynamic Control) is an electronic vehicle stability function within the (semi) trailer braking system. It acts to stabilize the (semi) trailer during dynamic maneuvers. VDC includes Roll Over Prevention (ROP) and/or Yaw ...";
CM_ SG_ 3221225472 YCBrakeCtrlActive "State signal which indicates that Yaw Control (YC) has activated brake control. Active means that YC actually controls wheel brake pressure at one or more wheels of the vehicle or vehicle combination. Within the physical limits, YC attempts to ...";
CM_ SG_ 3221225472 YCEngCtrlActive "State Signal which indicates that the Yaw Control (YC) has commanded engine control to be active. Within the physical limits, YC attempts to prevent yawing of the vehicle. Active means that YC actually tries to control the engine. This state signal ...";
CM_ SG_ 3221225472 ROPBrakeCtrlActive "State signal which indicates that Roll over Prevention (ROP) has activated brake control. Active means that ROP actually controls wheel brake pressure at one or more wheels of the vehicle or vehicle combination. Within the physical limits, ROP ...";
CM_ SG_ 3221225472 ROPEngCtrlActive "State Signal which indicates that the Roll Over Prevention (ROP) has commanded engine control to be active. Within the physical limits, ROP attempts to prevent rolling over of the vehicle. Active means that ROP actually tries to control the engine ...";
CM_ SG_ 3221225472 VDCBrakeLightRq "Indicates whether VDC requests to turn the vehicle brake lights on

00 Turn brake light not on
01 Turn brake light on
10 Reserved
11 Don't care/Take no action";
CM_ SG_ 3221225472 VDCFullyOperational "Signal that indicates whether VDC is fully operational or whether its functionality is reduced by a permanent or temporary (e.g. low voltage) defect, by intended action (e.g. disabled by a switch or during special diagnostic procedures), not ...";
CM_ SG_ 3221225472 VDCInformationSignal "This parameter commands the VDC information signal, for example a dash lamp.

00 Off
01 On
10 Reserved
11 Don't care/Take no action";
CM_ SG_ 3221225472 TotalVehicleDistance "Accumulated distance traveled by vehicle during its operation.

NOTE See SPN 917 for alternate resolution.";
CM_ SG_ 3221225472 TripDistance "Distance traveled during all or part of a journey.

NOTE See SPN 918 for alternate resolution.";
CM_ SG_ 3221225472 TripCruiseDistance "Total distance that the engine has operated in the cruise hold state, excluding time in accelerator override, since the last trip reset.";
CM_ SG_ 3221225472 TripMaxVehicleSpeed "Maximum vehicle speed achieved while the engine speed is greater than zero and the accelerator pedal position (APS) is at a value greater than 0%, since the last trip reset.";
CM_ SG_ 3221225472 TripAirCompressorOnTime "Total time that the air compressor is on and compressing air since the last trip reset.";
CM_ SG_ 3221225472 TripIdleTime "Total time accumulated while the engine speed is greater than zero, both the PTO and remote PTO governors are inactive, and the vehicle speed is less than 2 km/h, since the last trip reset.
In marine applications, this parameter is defined as the ...";
CM_ SG_ 3221225472 TripEngRunningTime "Total time accumulated while the engine speed is greater than zero since the last trip reset.  Note that time with the ignition switch on but engine speed at zero is not included.";
CM_ SG_ 3221225472 TripCruiseTime "Total time accumulated while the engine is in the cruise hold state, excluding time in accelerator override, since the last trip reset.";
CM_ SG_ 3221225472 TripPTOGovernorTime "Total time accumulated while the engine is in the PTO or remote PTO governor hold state since the last trip reset.";
CM_ SG_ 3221225472 TripTimeInDerateByEng "Total time accumulated when the engine final fueling has been derated due to an engine protection algorithm, since the last reset.";
CM_ SG_ 3221225472 TripTimeInGearDown "Total time accumulated when the vehicle has operated in one gear down from the top gear for a calibrated minimum time, since the last trip reset.";
CM_ SG_ 3221225472 TripTimeInTopGear "Total time accumulated when the vehicle has operated in top gear for a calibrated minimum time, since the last trip reset.";
CM_ SG_ 3221225472 TripTimeInVSL "Total time accumulated when the engine has operated on the vehicle speed limiter (VSL) while not in the cruise hold state, since the last trip reset.  The engine torque mode is equal to road speed governor during this operation.";
CM_ SG_ 3221225472 TripSuddenDecelerations "Total number of decelerations whenever the vehicle deceleration is more than XYZ km/h/sec (where XYZ is a calibratible threshold), since the last trip reset.  A lengthy deceleration shall be counted as one sudden deceleration.";
CM_ SG_ 3221225472 TrpNumberOfIdleShutdownOverrides "Total number of times an operator disables idle shutdown to prevent an engine shutdown, since the last trip reset.";
CM_ SG_ 3221225472 TripNumberOfIdleShutdowns "Total number of times the engine has been shutdown due to idling too long (at normal idle or fast idle) since the last trip reset.";
CM_ SG_ 3221225472 TripNumberOfHotShutdowns "Total number of hot shutdowns since the last trip reset.  A hot shutdown is based on operation at high load or high engine speed or for long operating periods without allowing the engine to cool sufficiently.";
CM_ SG_ 3221225472 EngRequestedTorqueHighResolution "This parameter displays an additional torque in percent of the reference engine torque.
When the MSB is set to 1, this parameter is not available.  When the MSB is set to 0, bits 1 to 3 indicate the desired torque with resolution of 0.125%/bit  ...";
CM_ SG_ 3221225472 TSC1CtrlPurpose "State signal which indicates which control mode the sending device is using to generate the TSC1 command.  Note that the modes are not in prioritized order. Not all modes may be relevant for a given device. Some devices may not implement all ...";
CM_ SG_ 3221225472 TSC1TransRate "This parameter indicates the transmission rate at which the sending device will transmit the TSC1 message.  The engine shall adjust its timeout for TSC1 messages accordingly. Variable TSC1 transmission rates shall only apply to messages sent to the ...";
CM_ SG_ 3221225472 EngRequestedTorque_TorqueLimit "Parameter provided to the engine or retarder in the torque/speed control message for controlling or limiting the output torque.
Requested torque to the engine is measured in indicated torque as a percentage of reference engine torque (see the ...";
CM_ SG_ 3221225472 EngRequestedSpeed_SpeedLimit "Parameter provided to the engine from external sources in the torque/speed control message.  This is the engine speed which the engine is expected to operate at if the speed control mode is active or the engine speed which the engine is not expected ...";
CM_ SG_ 3221225472 OverrideCtrlModePriority "This field is used as an input to the engine or retarder to determine the priority of the Override Control Mode received in the Torque/Speed Control message (see PGN 0).  The default is 11 (Low priority).  It is not required to use the same priority ...";
CM_ SG_ 3221225472 EngRequestedSpeedCtrlConditions "This mode tells the engine control system the governor characteristics that are desired during speed control.  The four characteristics defined are:
00 Transient Optimized for driveline disengaged and non-lockup conditions
01 Stability Optimized ...";
CM_ SG_ 3221225472 EngOverrideCtrlMode "The override control mode defines which sort of command is used:
00 Override disabled - Disable any existing control commanded by the source of this command.
01 Speed control - Govern speed to the included 'desired speed' value.
10 Torque control ...";
CM_ SG_ 3221225472 TransitRunStatus "Status of the run switch for the vehicle.

00 - Off
01- On
10 - Error condition
11 - Not available";
CM_ SG_ 3221225472 VehicleUseStatus "Used to indicate the proper or unauthorized use of the vehicle. The administrative control device or any device issuing the vehicle use status PID should be sensitive to the run switch status (SPN 3046) and any other locally defined criteria for ...";
CM_ SG_ 3221225472 SilentAlarmStatus "Used to report silent alarm push button status.

00 - Off
01 - On
10 - Error condition
11 - Not available";
CM_ SG_ 3221225472 PatronCount "Count of the number of passengers on a transit vehicle.  If the type of passenger count (SPN 3043) is 0, the patron count indicates the number of patrons currently on vehicle after the door has closed.  If the type of passenger count is 1 to 4,
the ...";
CM_ SG_ 3221225472 TypeOfPassengerCount "Used to notify transit link devices of the type of passenger counting system used in the vehicle.  Some passenger counting systems indicate real-time boarding and exiting data for other devices to accumulate. Other types of passenger counters report ...";
CM_ SG_ 3221225472 FareboxAlarmIdentifier "Indicates the nature of the farebox alarm condition.
0000000 = Voltage dropout
0000001 = Voltage restored
0000010 = Probe started
0000011 = Probe completed
0000100 = Cashbox removed
0000101 = Cashbox restored
0000110 = Cashbox door timeout
 ...";
CM_ SG_ 3221225472 FareboxEmergencyStatus "Indicates if a farebox emergency condition exists.

00 = Non-emergency condition
01 = Emergency condition
10 = Error Condition
11 = Not available";
CM_ SG_ 3221225472 TransferSold "Indicates that a transfer was sold or issued on this transaction including its type and/or restrictions. The final definitions of the transfer issued information shall be agreed by the operating agency and the farebox manufacturer.
Note:  A ...";
CM_ SG_ 3221225472 TransferType "The kind of transfer used

00000 = North
00001 = South
00010 = East
00011 = West
00100 = In
00101 = Out
00110-11111 = Agency defined";
CM_ SG_ 3221225472 TypeOfService "The type of service provided

000 = Local service
001 = Express service
010-111 = Agency defined";
CM_ SG_ 3221225472 InitialFareAgency "Identifies where the initial fare is paid

Note:  The definition of the agency numbering plan shall be agreed by the operating agency and the farebox manufacturer.  The value of 0 is reserved, the usable range is 1 to 31.";
CM_ SG_ 3221225472 PassCategory "Agency defined value indicating the category of the passenger associated with this fare";
CM_ SG_ 3221225472 FareValidity "Agency defined value indicating validity of this fare";
CM_ SG_ 3221225472 PaymentDetails "Payment details.

0000 = Not an upgrade
0001 = Cash
0010 = Token
0011 = Ticket
0100 = Pass
0101 = Card
0110-1010 = Reserved for assignment
1011-1111 = Agency defined";
CM_ SG_ 3221225472 TypeOfFare "Type of Fare

0000 = Cash/No detail
0001 = Token A
0010 = Token B
0011 = Ticket A
0100 = Ticket B
0101 = Pass A
0110 = Pass B
0111-1010 = Reserved for assignment
1011-1111 = Agency defined";
CM_ SG_ 3221225472 PassengerType "Enumerated value representing the type/class of passenger, as defined by the agency.";
CM_ SG_ 3221225472 TransactionType "Enumerated value representing the type of transaction completed

0000 = Cash
0001 = Token
0010 = Ticket
0011 = Pass
0100 = Card
0101 = Permit
0110 = Transfer
0111 = Free
1000-1011 = Reserved for assignment
1100-1111 = Agency defined";
CM_ SG_ 3221225472 RouteNumber "The route number issuing the transfer.";
CM_ SG_ 3221225472 DriversFareboxSecurityCode "Security code for the farebox, numerical only.

Note:  0 = Farebox is in reporting status
           1 - 65535 = security code";
CM_ SG_ 3221225472 AssignedBlock "The agency defined block number for this trip";
CM_ SG_ 3221225472 AssignedRun "The agency defined run number for this trip";
CM_ SG_ 3221225472 AssignedRoute "The identity number assigned to this route.

Note:  This is the numerical value for the route as opposed to the 'Transit Assigned Route Identity' (SPN 3074) which is variable length ASCII or the 'Route number' (SPN 3169) which is 12 bit numeric.";
CM_ SG_ 3221225472 PatternNumber "The agency defined pattern number for this trip";
CM_ SG_ 3221225472 TripNumber "The identity number assigned to this trip.";
CM_ SG_ 3221225472 FarePresets "Fare Presets

00000000 to 00001111 = Agency defined
00010000 to 11111111 = Reserved for assignment";
CM_ SG_ 3221225472 TripDirection "The general direction of travel for this trip.

0000 = North
0001 = South
0010 = East
0011 = West
0100 = In
0101 = Out
0110-1111 = Agency defined";
CM_ SG_ 3221225472 TripStatus "Trip Status

000 = Undefined
001 = Trip start
010 = Trip end
011 = Undefined
100 = Undefined
101 = Layover start
110 = Layover end
111 = Undefined";
CM_ SG_ 3221225472 FareboxServiceStatus "Indicates if the farebox is in or out of service.

00 = Farebox out of service
01 = Farebox in service
10 = Error Condition
11 = Not available";
CM_ SG_ 3221225472 VehicleID "Numerical designation of the vehicle.   65535 is used to represent the vehicle ID is not available.";
CM_ SG_ 3221225472 StrobeActivationCtrlStatus "Strobe activation control status

00 - Deactivate strobe
01 - Activate strobe
10 - Error condition
11 - Not available

Note: Strobe will flash if not overridden by transit door status, strobe is working, and emitter is in the normal mode.";
CM_ SG_ 3221225472 TransitDoorEnable "Transit door enable

00 - Ignore transit door status
01 - Transit door status will override strobe activation
10 - Error condition
11 - Not available";
CM_ SG_ 3221225472 PriorityOfRespSentByEmitter "Priority of response sent by emitter
0000               - Reserved
0001               - Low priority
0010               - Probe priority
0011               - High priority
0100 to 1000 - Reserved
1001               - Priority set by hardware ...";
CM_ SG_ 3221225472 IntrsctnPrmptionRequest_Response "Status of the intersection signal preemption

00 - Message is a request directed to the emitter
01 - Message is a response from the emitter
10 - Error condition
11 - Not available";
CM_ SG_ 3221225472 TransitRouteIDUsage "Transit route ID usage

00 - Transit route ID not used for interleaved data
01 - Transit route ID used for interleaved data (if range code not enabled)
10 - Error condition
11 - Not available";
CM_ SG_ 3221225472 RangeCodeEnable "Range code enable

00 - Range code not used for interleaved data
01 - Range code used for interleaved data
10 - Error condition
11 - Not available";
CM_ SG_ 3221225472 NmbrOfBytsInThMlpstIdntification "Number of bytes in the Milepost Identification.  This parameter identifies the length, in bytes, of the data in SPN 590 (Milepost Identification).";
CM_ SG_ 3221225472 NmbrOfBytsInThTrnstAssgndBlckIdn "Number of bytes in the Transit Assigned Block Identity.  This parameter identifies the length, in bytes, of the data in SPN 3076 (Transit Assigned Block Identity).";
CM_ SG_ 3221225472 NmbrOfBytsInThTrnstAssgndRnIdntt "Number of bytes in the Transit Assigned Run Identity.  This parameter identifies the length, in bytes, of the data in SPN 3075 (Transit Assigned Run Identity).";
CM_ SG_ 3221225472 NmbrOfBytsInThTrnstAssgndRtIdntt "Number of bytes in the Transit Assigned Route Identity.  This parameter identifies the length, in bytes, of the data in SPN 3074 (Transit Assigned Route Identity).";
CM_ SG_ 3221225472 Agency "The identity of the agency involved in this transaction";
CM_ SG_ 3221225472 SteerChannelTirePress "The latest gage pressure reading of the steer group of tires, as opposed to the pressure in each tire.";
CM_ SG_ 3221225472 DriveChannelTirePress "The latest gage pressure reading of the drive group of tires, as opposed to the pressure in each tire.";
CM_ SG_ 3221225472 TrailerTagOrPushChannelTirePress "The latest gage pressure reading of the trailer, tag, or push group of tires, as opposed to the pressure in each tire.";
CM_ SG_ 3221225472 SteerChannelTirePressTarget "The tire pressure control system's target gage pressure for the steer group of tires.";
CM_ SG_ 3221225472 DriveChannelTirePressTarget "The tire pressure control system's target gage pressure for the drive group of tires.";
CM_ SG_ 3221225472 TrlrTgOrPshChnnelTirePressTarget "The tire pressure control system's target gage pressure for the trailer, tag, or push group of tires.";
CM_ SG_ 3221225472 PCUTrilerTagOrPushSolenoidStatus "Current state of the trailer, tag, or push solenoid used to implement a tire pressure control system in its pneumatic control unit (PCU).

00 - Off
01 - On
10 - Error
11 - Not available";
CM_ SG_ 3221225472 PCUSupplySolenoidStatus "Current state of the supply solenoid used to implement a tire pressure control system in its pneumatic control unit (PCU).

00 - Off
01 - On
10 - Error
11 - Not available";
CM_ SG_ 3221225472 PCUCtrlSolenoidStatus "Current state of the control solenoid used to implement a tire pressure control system in its pneumatic control unit (PCU).

00 - Off
01 - On
10 - Error
11 - Not available";
CM_ SG_ 3221225472 PCUDeflateSolenoidStatus "Current state of the deflate solenoid used to implement a tire pressure control system in its pneumatic control unit (PCU).

00 - Off
01 - On
10 - Error
11 - Not available";
CM_ SG_ 3221225472 TirePressSupplySwitchStatus "Current state of an open/closed type switch used to determine if adequate pressure exists for system implementation.

00 - Off
01 - On
10 - Error
11 - Not available";
CM_ SG_ 3221225472 PCUSteerSolenoidStatus "Current state of the steer solenoid used to implement a tire pressure control system in its pneumatic control unit (PCU).

00 - Off
01 - On
10 - Error
11 - Not available";
CM_ SG_ 3221225472 PCUDriveSolenoidStatus "Current state of the drive solenoid used to implement a tire pressure control system in its pneumatic control unit (PCU).

00 - Off
01 - On
10 - Error
11 - Not available";
CM_ SG_ 3221225472 DriveChannelMode "Indicates the functional mode of trailer/tag channel of the tire pressure control system.
0000 Maintain
0001 Inflate
0010 Deflate
0011 Confirm
0100 Inflate Wait - System will inflate when conditions allow
0101 Deflate Wait - System will ...";
CM_ SG_ 3221225472 Trailer_tagChannelMode "Indicates the functional mode of trailer/tag channel of the tire pressure control system.
0000 Maintain
0001 Inflate
0010 Deflate
0011 Confirm
0100 Inflate Wait - System will inflate when conditions allow
0101 Deflate Wait - System will ...";
CM_ SG_ 3221225472 SteerChannelMode "Indicates the functional mode of steer channel of the tire pressure control system.
0000 Maintain
0001 Inflate
0010 Deflate
0011 Confirm
0100 Inflate Wait - System will inflate when conditions allow
0101 Deflate Wait - System will deflate when ...";
CM_ SG_ 3221225472 TirePressCheckInterval "The interval at which the system will check the tire pressures (e.g., 5, 10, 15 min.).

NOTE - A value of 0 indicates continuous (real time) pressure readings.";
CM_ SG_ 3221225472 ExTirePressSupport "Defines the choice of using the tire pressure (PGN 65268) or Extended Tire Pressure (PGN 64578). The state value '01' indicates the extended tire pressure SPN is used for the pressure data. Any other value indicates the extended tire pressure SPN is ...";
CM_ SG_ 3221225472 TirePressThresholdDetection_13 "Signal indicating the pressure level of the tire.";
CM_ SG_ 3221225472 TirePressThresholdDetection_12 "Signal indicating the pressure level of the tire.";
CM_ SG_ 3221225472 TirePressThresholdDetection_11 "Signal indicating the pressure level of the tire.";
CM_ SG_ 3221225472 TirePressThresholdDetection_10 "Signal indicating the pressure level of the tire.";
CM_ SG_ 3221225472 TirePressThresholdDetection_01 "Signal indicating the pressure level of the tire.";
CM_ SG_ 3221225472 TirePress_33 "Pressure at which air is contained in cavity formed by tire and rim.";
CM_ SG_ 3221225472 TirePress_32 "Pressure at which air is contained in cavity formed by tire and rim.";
CM_ SG_ 3221225472 TirePress_31 "Pressure at which air is contained in cavity formed by tire and rim.";
CM_ SG_ 3221225472 TirePress_30 "Pressure at which air is contained in cavity formed by tire and rim.";
CM_ SG_ 3221225472 TirePress_23 "Pressure at which air is contained in cavity formed by tire and rim.";
CM_ SG_ 3221225472 TirePress_22 "Pressure at which air is contained in cavity formed by tire and rim.";
CM_ SG_ 3221225472 TirePress_21 "Pressure at which air is contained in cavity formed by tire and rim.";
CM_ SG_ 3221225472 TirePress_20 "Pressure at which air is contained in cavity formed by tire and rim.";
CM_ SG_ 3221225472 TirePress_13 "Pressure at which air is contained in cavity formed by tire and rim.";
CM_ SG_ 3221225472 TirePress_12 "Pressure at which air is contained in cavity formed by tire and rim.";
CM_ SG_ 3221225472 TirePress_11 "Pressure at which air is contained in cavity formed by tire and rim.";
CM_ SG_ 3221225472 TirePress_10 "Pressure at which air is contained in cavity formed by tire and rim.";
CM_ SG_ 3221225472 TireAirLeakageRate_33 "The pressure loss rate of a tire.";
CM_ SG_ 3221225472 TireAirLeakageRate_32 "The pressure loss rate of a tire.";
CM_ SG_ 3221225472 TireAirLeakageRate_31 "The pressure loss rate of a tire.";
CM_ SG_ 3221225472 TireAirLeakageRate_30 "The pressure loss rate of a tire.";
CM_ SG_ 3221225472 TireAirLeakageRate_23 "The pressure loss rate of a tire.";
CM_ SG_ 3221225472 TireAirLeakageRate_22 "The pressure loss rate of a tire.";
CM_ SG_ 3221225472 TireAirLeakageRate_21 "The pressure loss rate of a tire.";
CM_ SG_ 3221225472 TireAirLeakageRate_20 "The pressure loss rate of a tire.";
CM_ SG_ 3221225472 TireAirLeakageRate_13 "The pressure loss rate of a tire.";
CM_ SG_ 3221225472 TireAirLeakageRate_12 "The pressure loss rate of a tire.";
CM_ SG_ 3221225472 TireAirLeakageRate_11 "The pressure loss rate of a tire.";
CM_ SG_ 3221225472 TireAirLeakageRate_10 "The pressure loss rate of a tire.";
CM_ SG_ 3221225472 TireAirLeakageRate_01 "The pressure loss rate of a tire.";
CM_ SG_ 3221225472 TireAirLeakageRate_00 "The pressure loss rate of a tire.";
CM_ SG_ 3221225472 CTIWheelSensorStatus_33 "Indicates whether the wheel is being monitored by the CTI controller.";
CM_ SG_ 3221225472 CTIWheelSensorStatus_32 "Indicates whether the wheel is being monitored by the CTI controller.";
CM_ SG_ 3221225472 CTIWheelSensorStatus_31 "Indicates whether the wheel is being monitored by the CTI controller.";
CM_ SG_ 3221225472 CTIWheelSensorStatus_30 "Indicates whether the wheel is being monitored by the CTI controller.";
CM_ SG_ 3221225472 CTIWheelSensorStatus_23 "Indicates whether the wheel is being monitored by the CTI controller.";
CM_ SG_ 3221225472 CTIWheelSensorStatus_22 "Indicates whether the wheel is being monitored by the CTI controller.";
CM_ SG_ 3221225472 CTIWheelSensorStatus_21 "Indicates whether the wheel is being monitored by the CTI controller.";
CM_ SG_ 3221225472 CTIWheelSensorStatus_20 "Indicates whether the wheel is being monitored by the CTI controller.";
CM_ SG_ 3221225472 CTIWheelSensorStatus_13 "Indicates whether the wheel is being monitored by the CTI controller.";
CM_ SG_ 3221225472 CTIWheelSensorStatus_12 "Indicates whether the wheel is being monitored by the CTI controller.";
CM_ SG_ 3221225472 CTIWheelSensorStatus_11 "Indicates whether the wheel is being monitored by the CTI controller.";
CM_ SG_ 3221225472 CTIWheelSensorStatus_10 "Indicates whether the wheel is being monitored by the CTI controller.";
CM_ SG_ 3221225472 CTIWheelSensorStatus_01 "Indicates whether the wheel is being monitored by the CTI controller.";
CM_ SG_ 3221225472 CTIWheelEndElectricalFault_33 "Indicates the status of electrical fault on CTI wheel interface.";
CM_ SG_ 3221225472 CTIWheelEndElectricalFault_32 "Indicates the status of electrical fault on CTI wheel interface.";
CM_ SG_ 3221225472 CTIWheelEndElectricalFault_31 "Indicates the status of electrical fault on CTI wheel interface.";
CM_ SG_ 3221225472 CTIWheelEndElectricalFault_30 "Indicates the status of electrical fault on CTI wheel interface.";
CM_ SG_ 3221225472 CTIWheelEndElectricalFault_23 "Indicates the status of electrical fault on CTI wheel interface.";
CM_ SG_ 3221225472 CTIWheelEndElectricalFault_22 "Indicates the status of electrical fault on CTI wheel interface.";
CM_ SG_ 3221225472 CTIWheelEndElectricalFault_21 "Indicates the status of electrical fault on CTI wheel interface.";
CM_ SG_ 3221225472 CTIWheelEndElectricalFault_20 "Indicates the status of electrical fault on CTI wheel interface.";
CM_ SG_ 3221225472 CTIWheelEndElectricalFault_13 "Indicates the status of electrical fault on CTI wheel interface.";
CM_ SG_ 3221225472 CTIWheelEndElectricalFault_12 "Indicates the status of electrical fault on CTI wheel interface.";
CM_ SG_ 3221225472 CTIWheelEndElectricalFault_11 "Indicates the status of electrical fault on CTI wheel interface.";
CM_ SG_ 3221225472 CTIWheelEndElectricalFault_10 "Indicates the status of electrical fault on CTI wheel interface.";
CM_ SG_ 3221225472 CTIWheelEndElectricalFault_01 "Indicates the status of electrical fault on CTI wheel interface.";
CM_ SG_ 3221225472 CTITireStatus_33 "Indicates the status of the tire.";
CM_ SG_ 3221225472 CTITireStatus_32 "Indicates the status of the tire.";
CM_ SG_ 3221225472 CTITireStatus_31 "Indicates the status of the tire.";
CM_ SG_ 3221225472 CTITireStatus_30 "Indicates the status of the tire.";
CM_ SG_ 3221225472 CTITireStatus_23 "Indicates the status of the tire.";
CM_ SG_ 3221225472 CTITireStatus_22 "Indicates the status of the tire.";
CM_ SG_ 3221225472 CTITireStatus_21 "Indicates the status of the tire.";
CM_ SG_ 3221225472 CTITireStatus_20 "Indicates the status of the tire.";
CM_ SG_ 3221225472 CTITireStatus_13 "Indicates the status of the tire.";
CM_ SG_ 3221225472 CTITireStatus_12 "Indicates the status of the tire.";
CM_ SG_ 3221225472 CTITireStatus_11 "Indicates the status of the tire.";
CM_ SG_ 3221225472 CTITireStatus_10 "Indicates the status of the tire.";
CM_ SG_ 3221225472 CTITireStatus_01 "Indicates the status of the tire.";
CM_ SG_ 3221225472 TireTemp_11 "Temperature at the surface of the tire sidewall.";
CM_ SG_ 3221225472 TireTemp_33 "Temperature at the surface of the tire sidewall.";
CM_ SG_ 3221225472 TireTemp_32 "Temperature at the surface of the tire sidewall.";
CM_ SG_ 3221225472 TireTemp_31 "Temperature at the surface of the tire sidewall.";
CM_ SG_ 3221225472 TireTemp_30 "Temperature at the surface of the tire sidewall.";
CM_ SG_ 3221225472 TireTemp_23 "Temperature at the surface of the tire sidewall.";
CM_ SG_ 3221225472 TireTemp_22 "Temperature at the surface of the tire sidewall.";
CM_ SG_ 3221225472 TireTemp_21 "Temperature at the surface of the tire sidewall.";
CM_ SG_ 3221225472 TireTemp_20 "Temperature at the surface of the tire sidewall.";
CM_ SG_ 3221225472 TireTemp_13 "Temperature at the surface of the tire sidewall.";
CM_ SG_ 3221225472 TireTemp_12 "Temperature at the surface of the tire sidewall.";
CM_ SG_ 3221225472 TireTemp_10 "Temperature at the surface of the tire sidewall.";
CM_ SG_ 3221225472 TireTemp_01 "Temperature at the surface of the tire sidewall.";
CM_ SG_ 3221225472 TireTemp_00 "Temperature at the surface of the tire sidewall.";
CM_ SG_ 3221225472 TirePressThresholdDetection_33 "Signal indicating the pressure level of the tire.";
CM_ SG_ 3221225472 TirePressThresholdDetection_32 "Signal indicating the pressure level of the tire.";
CM_ SG_ 3221225472 TirePressThresholdDetection_31 "Signal indicating the pressure level of the tire.";
CM_ SG_ 3221225472 TirePressThresholdDetection_30 "Signal indicating the pressure level of the tire.";
CM_ SG_ 3221225472 TirePressThresholdDetection_23 "Signal indicating the pressure level of the tire.";
CM_ SG_ 3221225472 TirePressThresholdDetection_22 "Signal indicating the pressure level of the tire.";
CM_ SG_ 3221225472 TirePressThresholdDetection_21 "Signal indicating the pressure level of the tire.";
CM_ SG_ 3221225472 TirePressThresholdDetection_20 "Signal indicating the pressure level of the tire.";
CM_ SG_ 3221225472 TirePressThresholdDetection_00 "Signal indicating the pressure level of the tire.";
CM_ SG_ 3221225472 TirePress_01 "Pressure at which air is contained in cavity formed by tire and rim.";
CM_ SG_ 3221225472 TirePress_00 "Pressure at which air is contained in cavity formed by tire and rim.";
CM_ SG_ 3221225472 CTIWheelSensorStatus_00 "Indicates whether the wheel is being monitored by the CTI controller.";
CM_ SG_ 3221225472 CTIWheelEndElectricalFault_00 "Indicates the status of electrical fault on CTI wheel interface.";
CM_ SG_ 3221225472 CTITireStatus_00 "Indicates the status of the tire.";
CM_ SG_ 3221225472 TripFanOnTimeDueToTheA_CSystem "Total time the fan has been on due to the A/C system since the last trip reset.  For the time to be accumulated against the A/C system, it is necessary that it be the first to request the fan activation or it be the only system requesting fan ...";
CM_ SG_ 3221225472 TripFanOnTimeDueToAManualSwitch "Total time the fan has been on due to manual activation by the operator (i.e., excluding time on due to automatic triggers) since the last trip reset.  For the time to be accumulated against the manual switch, it is necessary that it be the first to ...";
CM_ SG_ 3221225472 TripFanOnTimeDueToTheEngSystem "Total time the fan has been on due to engine triggers (i.e., excluding time on due to an operator manual switch or A/C system) since the last trip reset.  For the time to be accumulated against the engine system, it is necessary that it be the first ...";
CM_ SG_ 3221225472 TripFanOnTime "Total time the fan has been on (due to an automatic trigger or manual trigger) since the last trip reset.  The fan could be requested to be on by the engine system, a manual switch, and/or the A/C system.  Whichever system requests the fan ...";
CM_ SG_ 3221225472 TripDistanceInTopGear "Total distance accumulated while the vehicle has operated in top gear for a calibrated minimum time since the last trip reset.";
CM_ SG_ 3221225472 TripGearDownDistance "Total distance accumulated while the vehicle has operated in the gear which is one gear down from top gear and exceeds a calibrated minimum time (typically the time to shift the transmission) since the last trip reset.";
CM_ SG_ 3221225472 TripDistanceOnVSL "Total distance accumulated while the engine torque mode is road speed governing since the last trip reset.";
CM_ SG_ 3221225472 AdjustLocalHourOffset "The hour component for setting the offset between the UTC (Universal Time Coordinate) time and date and a the local time zone time and date.  This is the number of minutes to add to UTC, a.k.a. GMT, time and date to convert to the time and date in ...";
CM_ SG_ 3221225472 AdjustLocalMinuteOffset "The minute component for setting the offset between the UTC (Universal Time Coordinate) time and date and a the local time zone time and date.  This is the number of minutes to add to UTC, a.k.a. GMT, time and date to convert to the time and date in ...";
CM_ SG_ 3221225472 AdjustYear "The year component for setting the current calendar date.  This should be reported as the year component of the current date according to the calendar date standard indicated with the Local Hour Offset parameter (SPN 1602).  The calendar date should ...";
CM_ SG_ 3221225472 AdjustDay "The day component for setting the current calendar date.  This should be reported as the day component of the current date according to the calendar date standard indicated with the Local Hour Offset parameter (SPN 1602).  The calendar date should ...";
CM_ SG_ 3221225472 AdjustMonth "The month component for setting the current calendar date.  This should be reported as the month component of the current date according to the calendar date standard indicated with the Local Hour Offset parameter (SPN 1602).  The calendar date ...";
CM_ SG_ 3221225472 AdjustHours "The hours component for setting the current time of day.  This should be reported as the hours component of the current time according to the time of day standard indicated with the Local Hour Offset parameter (SPN 1602).  The time of day should be ...";
CM_ SG_ 3221225472 AdjustMinutes "The minutes component for setting the current time of day.  This should be reported as the minutes component of the current time according to the time of day standard indicated with the Local Hour Offset parameter (SPN 1602).  The time of day should ...";
CM_ SG_ 3221225472 AdjustSeconds "The seconds component for setting the current time of day.  This should be reported as the seconds component of the current time according to the time of day standard indicated with the Local Hour Offset parameter (SPN 1602).  The time of day should ...";
CM_ SG_ 3221225472 LocalHourOffset "The hour component of the offset between the UTC (Universal Time Coordinate) time and date and a local time zone time and date.  This is the number of hours to add to UTC, a.k.a. GMT, time and date to convert to the time and date in the local time ...";
CM_ SG_ 3221225472 LocalMinuteOffset "The minute component of the offset between the UTC time and date and a local time zone time and date.  This is the number of minutes to add to UTC (Universal Time Coordinate) time and date to convert to the time and date in the local time zone  ...";
CM_ SG_ 3221225472 Year "The year component of the current calendar date.  This should be reported as the year component of the current date at UTC (Universal Time Coordinate), a.k.a. GMT; however, it may be reported as the year component of the current date at a local time ...";
CM_ SG_ 3221225472 Day "The day component of the current calendar date.  This should be reported as the day component of the current date at UTC (Universal Time Coordinate), a.k.a. GMT; however, it may be reported as the day component of the current date at a local time ...";
CM_ SG_ 3221225472 Month "The month component of the current calendar date.  This should be reported as the month component of the current date at UTC (Universal Time Coordinate), a.k.a. GMT; however, it may be reported as the month component of the current date at a local ...";
CM_ SG_ 3221225472 Hours "The hour component of the current time of day.  This should be reported as the hour component of the current time at UTC (Universal Time Coordinate), a.k.a. GMT; however, it may be reported as the hour component of the current time at a local time ...";
CM_ SG_ 3221225472 Minutes "The minutes component of the current time of day.  This should be reported as the minutes component of the current time at UTC (Universal Time Coordinate), a.k.a. GMT; however, it may be reported as the minutes component of the current time at a ...";
CM_ SG_ 3221225472 Seconds "The seconds component of the current time of day.  This should be reported as the seconds component of the current time at UTC (Universal Time Coordinate), a.k.a. GMT; however, it may be reported as the seconds component of the current time at a ...";
CM_ SG_ 3221225472 EngDsrdTrboWastegateActuator2Pos "The Requested Valve position of the Turbocharger Wastegate Valve 2, commanded by the engine ECU. A value of 0% represents fully closed and a value of 100% represents fully open.

This is the position that the device is attempting to achieve.";
CM_ SG_ 3221225472 EngTrbWstgateActuator1TempStatus "Used to identify the status of the Engine Turbocharger Wastegate Actuator 1 drive circuitry temperature.  Temperature excursions may affect the torque output.
000 - High Most severe
001 - High Least severe
010 - In Range
011 - Low Least severe
 ...";
CM_ SG_ 3221225472 EngTrbWstgtActtor1PreliminaryFMI "Used to identify the applicable J1939-73 FMI detected in the Engine Turbocharger Wastegate Actuator 1 by the manufacturers software. When there is no failure FMI 31 is transmitted. When there is multiple failures, the most severe is transmitted";
CM_ SG_ 3221225472 EngDsrdTrboWastegateActuator1Pos "The Requested Valve position of the Turbocharger Wastegate Valve 1, commanded by the engine ECU. A value of 0% represents fully closed and a value of 100% represents fully open.

This is the position that the device is attempting to achieve.";
CM_ SG_ 3221225472 EngTrbWstgteActuatorCtrlAirPress "Gage pressure of the air used to control the actuator which opens and closes the wastegate valve.";
CM_ SG_ 3221225472 EngTurboWastegateActuator4Pos "Position of the wastegate drive.  A value of 0% represents fully closed and a value of 100% represents fully open.";
CM_ SG_ 3221225472 EngTurboWastegateActuator3Pos "Position of the wastegate drive.  A value of 0% represents fully closed and a value of 100% represents fully open.";
CM_ SG_ 3221225472 EngTurboWastegateActuator2Pos "Position of the wastegate drive.  A value of 0% represents fully closed and a value of 100% represents fully open.";
CM_ SG_ 3221225472 EngTurboWastegateActuator1Pos "Position of the wastegate drive.  A value of 0% represents fully closed and a value of 100% represents fully open.";
CM_ SG_ 3221225472 TachographVehicleSpeed "Speed of the vehicle registered by the tachograph.";
CM_ SG_ 3221225472 TachographOutputShaftSpeed "Calculated speed of the transmission output shaft.";
CM_ SG_ 3221225472 DirectionIndicator "Indicates the direction of the vehicle.

00 - Forward
01 - Reverse
10 - Error
11 - Not available";
CM_ SG_ 3221225472 TachographPerformance "Indicates the tachograph performance; including electronic or mechanical analysis, instrument analysis, speed sensor analysis, mass storage analysis, and printer analysis.
00 - Normal performance
01 - Performance analysis
10 - Error
11 - Not ...";
CM_ SG_ 3221225472 HandlingInformation "Indicates that handling information is present.  Information could include 'no printer paper', 'no driver card', etc.

00 - No handling information
01 - Handling information
10 - Error
11 - Not available";
CM_ SG_ 3221225472 SystemEvent "Indicates that a tachograph event has occurred.  This may include power supply interruption, interruption of the speed sensor, incorrect data on the driver card, driving without a driver card, illegal removal of a driver card, insertion of a driver ...";
CM_ SG_ 3221225472 DriverCardDriver2 "Indicates the presence of a driver card

00 - Driver card not present
01 - Driver card present
10 - Error
11 - Not available";
CM_ SG_ 3221225472 Driver2TimeRelatedStates "Indicates if the driver approaches or exceeds working time limits (or other limits).
0000 Normal/No limits reached
0001 Limit #1 - 15 min before 4 ½ h
0010 Limit #2 - 4 ½ h reached
0011 Limit #3 - 15 min before 9 h
0100 Limit #4 - 9 h reached
 ...";
CM_ SG_ 3221225472 VehicleOverspeed "Indicates whether the vehicle is exceeding the legal speed limit set in the tachograph.

00 No overspeed
01 Overspeed
10 Error
11 Not available";
CM_ SG_ 3221225472 DriverCardDriver1 "Indicates the presence of a driver card

00 - Driver card not present
01 - Driver card present
10 - Error
11 - Not available";
CM_ SG_ 3221225472 Driver1TimeRelatedStates "Indicates if the driver approaches or exceeds working time limits (or other limits).
0000 Normal/No limits reached
0001 Limit #1 - 15 min before 4 ½ h
0010 Limit #2 - 4 ½ h reached
0011 Limit #3 - 15 min before 9 h
0100 Limit #4 - 9 h reached
 ...";
CM_ SG_ 3221225472 VehicleMotion "Indicates whether motion of the vehicle is detected or not.

00 Vehicle motion not detected
01 Vehicle motion detected
10 - Error
11 - Not available";
CM_ SG_ 3221225472 Driver2WorkingState "State of work of the driver.  

000 Rest - sleeping
001 Driver available - short break
010 Work - loading, unloading, working in an office
011 Drive - behind wheel 
100-101 Reserved
110 Error
111 Not available";
CM_ SG_ 3221225472 Driver1WorkingState "State of work of the driver.  

000 Rest - sleeping
001 Driver available - short break
010 Work - loading, unloading, working in an office
011 Drive - behind wheel 
100-101 Reserved
110 Error
111 Not available";
CM_ SG_ 3221225472 EngTurbo4CompressorOutletTemp "Temperature of the air exiting the turbocharger 4 compressor outlet";
CM_ SG_ 3221225472 EngTurbo3CompressorOutletTemp "Temperature of the air exiting the turbocharger 3 compressor outlet";
CM_ SG_ 3221225472 EngTurbo2CompressorOutletTemp "Temperature of the air exiting the turbocharger 2 compressor outlet";
CM_ SG_ 3221225472 EngTurbo1CompressorOutletTemp "Temperature of the air exiting the turbocharger 1 compressor outlet";
CM_ SG_ 3221225472 EngTurbo4TurbineOutletTemp "Temperature of the combustion by-products exiting the turbine side of the turbocharger.";
CM_ SG_ 3221225472 EngTurbo3TurbineOutletTemp "Temperature of the combustion by-products exiting the turbine side of the turbocharger.";
CM_ SG_ 3221225472 EngTurbo2TurbineOutletTemp "Temperature of the combustion by-products exiting the turbine side of the turbocharger.";
CM_ SG_ 3221225472 EngTurbo1TurbineOutletTemp "Temperature of the combustion by-products exiting the turbine side of the turbocharger.";
CM_ SG_ 3221225472 EngTurbo4TurbineIntakeTemp "Temperature of the combustion by-products entering the turbine side of the turbocharger.";
CM_ SG_ 3221225472 EngTurbo3TurbineIntakeTemp "Temperature of the combustion by-products entering the turbine side of the turbocharger.";
CM_ SG_ 3221225472 EngTurbo2TurbineIntakeTemp "Temperature of the combustion by-products entering the turbine side of the turbocharger.";
CM_ SG_ 3221225472 EngTurbo1TurbineIntakeTemp "Temperature of the combustion by-products entering the turbine side of the turbocharger.";
CM_ SG_ 3221225472 EngTurbo4CompressorIntakePress "Gage pressure of the air entering the compressor side of the turbocharger.";
CM_ SG_ 3221225472 EngTurbo3CompressorIntakePress "Gage pressure of the air entering the compressor side of the turbocharger.";
CM_ SG_ 3221225472 EngTurbo2CompressorIntakePress "Gage pressure of the air entering the compressor side of the turbocharger.";
CM_ SG_ 3221225472 EngTurbo1CompressorIntakePress "Gage pressure of the air entering the compressor side of the turbocharger.";
CM_ SG_ 3221225472 EngTurbo4CompressorIntakeTemp "Temperature of the air entering the compressor side of the turbocharger.";
CM_ SG_ 3221225472 EngTurbo3CompressorIntakeTemp "Temperature of the air entering the compressor side of the turbocharger.";
CM_ SG_ 3221225472 EngTurbo2CompressorIntakeTemp "Temperature of the air entering the compressor side of the turbocharger.";
CM_ SG_ 3221225472 EngTurbo1CompressorIntakeTemp "Temperature of the air entering the compressor side of the turbocharger.";
CM_ SG_ 3221225472 EngTurbo4Speed "Rotational velocity of rotor in the turbocharger.";
CM_ SG_ 3221225472 EngTurbo3Speed "Rotational velocity of rotor in the turbocharger.";
CM_ SG_ 3221225472 EngTurbo2Speed "Rotational velocity of rotor in the turbocharger.";
CM_ SG_ 3221225472 EngTurboLubeOilPress2 "Gage pressure of oil in turbocharger lubrication system.";
CM_ SG_ 3221225472 TransTorqueLimit "Parameter provided to the engine from the transmission as a torque limit to be invoked by the engine in the event that J1939 communication with the transmission is lost.
The intention is to protect transmissions that use a continuous torque limit ...";
CM_ SG_ 3221225472 TransGearRatio "The transmission configuration describes the number of forward gears, the number of reverse gears, and the ratio of each gear with the following resolution.";
CM_ SG_ 3221225472 NumberOfForwardGearRatios "Number of forward gear ratios in the transmission, provided as part of the configuration.";
CM_ SG_ 3221225472 NumberOfReverseGearRatios "Number of reverse gear ratios in the transmission, provided as part of the transmission configuration.";
CM_ SG_ 3221225472 AutoNeutralReq "This parameter conveys a vehicle system desire to override the operator's current shift selector request (e.g. Drive, Reverse) and shift the transmission into Neutral. 'Manual Return' indicates this parameter has the ability to initiate a ...";
CM_ SG_ 3221225472 TransMode8 "Indicates whether transmission mode 8 is enabled. Modes are manufacturer specific and are not necessarily mutually exclusive. See also SPN 4253.

00  Disable
01  Enable
10  Reserved
11  Take no action";
CM_ SG_ 3221225472 TransMode7 "Indicates whether transmission mode 7 is enabled. Modes are manufacturer specific and are not necessarily mutually exclusive. See also SPN 4252.

00  Disable
01  Enable
10  Reserved
11  Take no action";
CM_ SG_ 3221225472 TransMode6 "Indicates whether transmission mode 6 is enabled. Modes are manufacturer specific and are not necessarily mutually exclusive. See also SPN 4251.

00  Disable
01  Enable
10  Reserved
11  Take no action";
CM_ SG_ 3221225472 TransMode5 "Indicates whether transmission mode 5 is enabled. Modes are manufacturer specific and are not necessarily mutually exclusive. See also SPN 4250.

00  Disable
01  Enable
10  Reserved
11  Take no action";
CM_ SG_ 3221225472 TrnsShftSlectorDisplayModeSwitch "Status of the operator's switch used to ‘toggle' through multiple display modes of a shift selector display.
When a shift selector display is capable of displaying more than just range information, this switch is toggled by the operator to move ...";
CM_ SG_ 3221225472 TransRequestedLaunchGear "Initial gear for the transmission to start out in when the vehicle is launched from a standing stop, as specified by the vehicle operator or vehicle system.  Automatic transmissions typically default to starting out in 1st gear.  However, in ...";
CM_ SG_ 3221225472 TransMode4 "Indicates whether transmission mode 4 is enabled.  Modes are manufacturer specific and are not necessarily mutually exclusive.  See also SPN 2539.

00 Disable
01 Enable
10 Reserved
11 Take no action";
CM_ SG_ 3221225472 TransMode3 "Indicates whether transmission mode 3 is enabled.  Modes are manufacturer specific and are not necessarily mutually exclusive.  See also SPN 2538.

00 Disable
01 Enable
10 Reserved
11 Take no action";
CM_ SG_ 3221225472 TransMode2 "Indicates whether transmission mode 2 is enabled.  Modes are manufacturer specific and are not necessarily mutually exclusive.  See also SPN 2537.

00 Disable
01 Enable
10 Reserved
11 Take no action";
CM_ SG_ 3221225472 TransMode1 "Indicates whether transmission mode 1 is enabled.  Modes are manufacturer specific and are not necessarily mutually exclusive.  See also SPN 2536.

00 Disable
01 Enable
10 Reserved
11 Take no action";
CM_ SG_ 3221225472 TransLoadReductionInhibitRq "Request signal to the transmission to inhibit activation of load reduction functions.
Automatic transmissions may incorporate functions designed to reduce engine load during certain operating conditions (vehicle standstill at bus stop, traffic ...";
CM_ SG_ 3221225472 DisengageDiffLockRqCentralRear "Command signal used to disengage the various differential locks, e.g., to allow an undistributed individual wheel control by ABS.  The differential locks are located as defined in Figure SPN564_A.
00 Engage differential lock
01 Disengage ...";
CM_ SG_ 3221225472 DisengageDiffLockRqCentralFront "Command signal used to disengage the various differential locks, e.g., to allow an undistributed individual wheel control by ABS.  The differential locks are located as defined in Figure SPN564_A.
00 Engage differential lock
01 Disengage ...";
CM_ SG_ 3221225472 DisengageDiffLockRqCentral "Command signal used to disengage the various differential locks, e.g., to allow an undistributed individual wheel control by ABS.  The differential locks are located as defined in Figure SPN564_A.
00 Engage differential lock
01 Disengage ...";
CM_ SG_ 3221225472 DisengageDiffLockRqRearAxle2 "Command signal used to disengage the various differential locks, e.g., to allow an undistributed individual wheel control by ABS.  The differential locks are located as defined in Figure SPN564_A.
00 Engage differential lock
01 Disengage ...";
CM_ SG_ 3221225472 DisengageDiffLockRqRearAxle1 "Command signal used to disengage the various differential locks, e.g., to allow an undistributed individual wheel control by ABS.  The differential locks are located as defined in Figure SPN564_A.
00 Engage differential lock
01 Disengage ...";
CM_ SG_ 3221225472 DisengageDiffLockRqFrontAxle2 "Command signal used to disengage the various differential locks, e.g., to allow an undistributed individual wheel control by ABS.  The differential locks are located as defined in Figure SPN564_A.
00 Engage differential lock
01 Disengage ...";
CM_ SG_ 3221225472 DisengageDiffLockRqFrontAxle1 "Command signal used to disengage the various differential locks, e.g., to allow an undistributed individual wheel control by ABS.  The differential locks are located as defined in Figure SPN564_A.
00 Engage differential lock
01 Disengage ...";
CM_ SG_ 3221225472 TransRequestedGear "Gear requested by the operator, ABS, or engine.
Negative values are reverse gears, positive values are forward gears, zero is neutral, parameter specific indicators are listed below.
Parameter specific values for this parameter are as follows:
 ...";
CM_ SG_ 3221225472 RequestedPercentClutchSlip "Parameter which represents the percent clutch slip requested by a device.";
CM_ SG_ 3221225472 TransReverseGearShiftInhibitRq "Allows devices external to the normal transmission shift selector system to request the transmission to inhibit shifts into any Reverse gear and force the transmission into Neutral if it is currently in Reverse or attempting to shift to Reverse ...";
CM_ SG_ 3221225472 DisengageDrivelineRq "Command signal used to simply disengage the driveline, e.g., to prevent engine drag torque from causing high wheel slip on slippery surfaces.
00 Allow driveline engagement
01 Disengage driveline
10 Reserved
11 Take no action
Note:  If this ...";
CM_ SG_ 3221225472 TrnsTrqeConverterLockupDisableRq "Command signal to prevent torque converter lockup, which may cause problems in certain circumstances for ASR.

00 Allow torque converter lockup
01 Disable torque converter lockup
10 Reserved
11 Take no action";
CM_ SG_ 3221225472 TransGearShiftInhibitRq "Command signal to inhibit gear shifts.

00 Gear shifts are allowed  (disable function)
01 Gear shifts are inhibited  (enable function)
10 Reserved
11 Take no action  (leave function as is)";
CM_ SG_ 3221225472 EngTurboOilLevelSwitch "Switch signal which indicates the presence of oil at the turbocharger

     00 = No oil present at turbocharger
     01 = Oil present at turbocharger
     10 = Error
     11 = Not available";
CM_ SG_ 3221225472 EngTurbo1Speed "Rotational velocity of rotor in the turbocharger.";
CM_ SG_ 3221225472 EngTurboLubeOilPress1 "Gage pressure of oil in turbocharger lubrication system.";
CM_ SG_ 3221225472 EngTurboDiffSpeed "The difference between turbocharger speeds on engine systems with 2 or more turbochargers. If there are are more than 2 turbochargers, it will be the difference between the fastest and the slowest turbocharger speed.";
CM_ SG_ 3221225472 EngTotalAverageFuelEconomy "Average fuel economy, equal to total vehicle distance divided by total fuel used, over the life of the engine";
CM_ SG_ 3221225472 EngTotalAverageFuelRate "Average fuel rate, equal to total fuel used divided by total engine hours, over the life of the engine";
CM_ SG_ 3221225472 PwertrainCircuitAirSupplyPressRq "Command signal to influence the air pressure in the powertrain circuit.  This parameter is the setpoint for the parameter SPN 6305.";
CM_ SG_ 3221225472 AirSuspensionSupplyPressRq "Command signal to influence the pneumatic pressure in the circuit for the electronically controlled air suspension system.   This parameter is the setpoint for the parameter SPN 1090.";
CM_ SG_ 3221225472 AuxEquipmentSupplyPressRq "Command signal to influence the pneumatic pressure in the auxiliary circuit.   This parameter is the setpoint for the parameter SPN 1089.";
CM_ SG_ 3221225472 ServiceBrakeAirPressRqCircuit2 "Command signal to influence the pneumatic pressure in the service brake circuit or reservoir #2.  This parameter is the setpoint for the parameter SPN 1088.";
CM_ SG_ 3221225472 ServiceBrakeAirPressRqCircuit1 "Command signal to influence the pneumatic pressure in the service brake circuit or reservoir #1.  This parameter is the setpoint for the parameter SPN 1087.";
CM_ SG_ 3221225472 ParkingAnd_orTrailerAirPressRq "Command signal to influence the pneumatic pressure in the circuit or reservoir for the parking brake and/or the trailer supply.  This parameter is the setpoint for the parameter SPN 1086.";
CM_ SG_ 3221225472 PneumaticSupplyPressRq "Command signal to influence the pneumatic pressure in the main reservoir.  This parameter is the setpoint for the parameter SPN 46.";
CM_ SG_ 3221225472 EngExtlShutdownAirSupplyPress "Pressure of the air used to shut off the fuel supply to the engine.";
CM_ SG_ 3221225472 NmbrOfSftwreIdentificationFields "Number of software identification designators represented in the software identification parameter group.";
CM_ SG_ 3221225472 SoftwareIdentification "Software identification of an electronic module.  As an example, this parameter may be represented with ASCII characters MMDDYYaa where MM is the month, DD is the day, YY is the year, and aa is the revision number.
NOTE The ASCII character '*' is ...";
CM_ SG_ 3221225472 ClntLvlEngPrtctionShutdownStatus "Parameter which indicates the configuration of the coolant level engine protection shutdown.
00 - Disabled - calibration does not allow engine protection due to low coolant level or the override is currently active
01 - Enabled - calibration ...";
CM_ SG_ 3221225472 PTOShutdownHasShutdownEng "Status signal which identifies whether or not the engine has been shutdown by the PTO shutdown system.

00 - No
01 - Yes
10 - Error
11 - Not available";
CM_ SG_ 3221225472 EngAirShutoffStatus "State signal which indicates the actual measured position of the Air Shutoff.
00 - Air flow allowed to engine
01 - Air flow restricted
10 - Error
11 - Not Available
Note:   This parameter, in conjunction with SPN 2813 - 'Engine Air Shutoff ...";
CM_ SG_ 3221225472 EngOverspeedTest "The engine overspeed test signal as measured by the reporting ECM.  Engine Overspeed Test is a mechanism to simulate engine overspeed situations, while operating the engine within the engine's safe operating range.
State signal which indicates when ...";
CM_ SG_ 3221225472 EngAirShutoffCmdStatus "State signal which indicates when the Air Shutoff  driver output is being driven. Disabled means controller wants air flowing to the engine. Status of the airflow  shutoff as being commanded by the ECU.
00 Air Shutoff Disabled, not attempting to ...";
CM_ SG_ 3221225472 EngAlarmOutputCmdStatus "State signal which indicates when the Alarm driver output is being driven. Not active means the Controller has no alarm level conditions.
00 Engine Alarm Output Command Not Active
01 Engine Alarm Output Command Active
10 Reserved
11 Not ...";
CM_ SG_ 3221225472 EngAlarmAcknowledge "The Engine Alarm Acknowledge Input signal as measured by the reporting ECU.  The Engine Alarm Acknowledge is a mechanism for external acknowledgement of the SPN 2814,  Engine Alarm Output Command.
00 Engine Alarm Acknowledge  Not Active
01 Engine ...";
CM_ SG_ 3221225472 EngProtectionSystemConfig "Parameter which indicates the configuration of the engine shutdown system.

00 - Disabled in calibration
01 - Enabled in calibration
10 - Error
11 - Not available";
CM_ SG_ 3221225472 EngProtectionSystemTimerState "Status signal which indicates the current mode of the engine protection system timer system.  See Figure SPN1107_A.

00 - Inactive
01 - Active
10 - Error
11 - Not available";
CM_ SG_ 3221225472 EngProtectionSystemTimerOverride "Status signal which indicates the status of the override feature of the engine protection system timer. See Figure SPN1107_A.

00 - Inactive
01 - Active
10 - Error
11 - Not available";
CM_ SG_ 3221225472 EngPrtctnSystmApprachingShutdown "Status signal which indicates that engine shutdown is imminent.  This engine protection signal can be a result of different systems failing, i.e., engine overheating. See Figure SPN1107_A.
00 - Not approaching
01 - Approaching
10 - Error
11 - ...";
CM_ SG_ 3221225472 EngPrtectionSystemHasShutdownEng "Status signal which indicates whether or not the engine protection system has shutdown the engine.  See Figure SPN1107_A.

00 - No
01 - Yes
10 - Error
11 - Not available";
CM_ SG_ 3221225472 EngWaitToStartLamp "Lamp signal which indicates that the engine is too cold to start and the operator should wait until the signal becomes inactive (turns off).  See SPN 5416 for the lamp operating condition.

00 - Off
01 - On
10 - Error
11 - Not available";
CM_ SG_ 3221225472 RefrigerantHighPressSwitch "Switch signal which indicates the position of the high pressure switch in the coolant circuit of an air conditioning system.  When the switch is enabled, the pressure inside the circuit is too high and the compressor clutch may be disengaged.
00 - ...";
CM_ SG_ 3221225472 RefrigerantLowPressSwitch "Switch signal which indicates the position of the low pressure switch in the coolant circuit of an air conditioning system.  When the switch is enabled, the pressure inside the circuit is too low and the compressor clutch may be disengaged.
00 - ...";
CM_ SG_ 3221225472 A_CHighPressFanSwitch "Switch signal which indicates that the pressure in the coolant circuit of an air conditioning system is high and the fan may be engaged.

00 - Pressure normal
01 - Pressure high, fan may be engaged
10 - Error
11 - Not available";
CM_ SG_ 3221225472 EngIdleShutdownTimerFunction "Parameter which indicates the configuration of the idle shutdown timer system.

00 - Disabled in calibration
01 - Enabled in calibration
10 - Error
11 - Not available";
CM_ SG_ 3221225472 EngIdleShutdownTimerState "Status signal which indicates the current mode of operation of the idle shutdown timer system.  See Figure SPN590_A.

00 - Inactive
01 - Active
10 - Error
11 - Not available";
CM_ SG_ 3221225472 EngIdleShutdownTimerOverride "Status signal which indicates the status of the override feature of the idle shutdown timer system.  See Figure SPN590_A.

00 - Inactive
01 - Active
10 - Error
11 - Not available";
CM_ SG_ 3221225472 EngIdleShutdownDriverAlertMode "Status signal which indicates the status of the driver alert mode of the idle shutdown timer system.  While the driver alert mode is active, the idle shutdown timer may be overridden.  See Figure SPN590_A.
00 - Inactive
01 - Active
10 - Error
11 ...";
CM_ SG_ 3221225472 EngIdleShutdownHasShutdownEng "Status signal which identifies whether or not the engine has been shutdown by the idle shutdown timer system.  See Figure SPN590_A.

00 - No
01 - Yes
10 - Error
11 - Not available";
CM_ SG_ 3221225472 IndustryGroup "0 = Global
   1  = On-Highway
   2  = Agricultural and Forestry
   3  = Construction
   4  = Marine
   5  = Industrial - Process
          Control - Stationary (Gen-Sets)
   6  = Reserve for SAE
   7  = Reserve for SAE";
CM_ SG_ 3221225472 ManufacturerCode "Assigned by NMEA 2000 Committee";
CM_ SG_ 3221225472 SrviceDelay_OperationalTimeBased "The time in vehicle operational time until the next vehicle service inspection is required.  A negative value is transmitted if the service inspection has been passed.  The component that requires service is identified by the service component ...";
CM_ SG_ 3221225472 ServiceComponentIdentificatio913 "Identification of component needing service.  See Table SPN911_A.";
CM_ SG_ 3221225472 ServiceDelay_CalendarTimeBased "The time in weeks until the next vehicle service inspection is required.  A negative value is transmitted if the service inspection has been passed.  The component that requires service is identified by the service component identification (see SPN ...";
CM_ SG_ 3221225472 ServiceComponentIdentificatio912 "Identification of component needing service.  See Table SPN911_A.";
CM_ SG_ 3221225472 ServiceDistance "The distance which can be traveled by the vehicle before the next service inspection is required.  A negative distance is transmitted if the service inspection has been passed.  The component that requires service is identified by the service ...";
CM_ SG_ 3221225472 ServiceComponentIdentification "Identification of component needing service.  See Table SPN911_A.";
CM_ SG_ 3221225472 TimeSinceLastService "The vehicle operation time since the last service was performed.  The type of service information is identified by the service component identification number.";
CM_ SG_ 3221225472 ServiceComponentIdentification "Identification of component needing service.  See Table SPN911_A.";
CM_ SG_ 3221225472 MinContinuousRetarderTorque "Applied limit for minimum continuous retarder torque";
CM_ SG_ 3221225472 MaxContinuousRetarderTorque "Applied limit for maximum continuous retarder torque.";
CM_ SG_ 3221225472 MinContinuousRetarderSpeed "Applied limit for minimum continuous retarder RPM";
CM_ SG_ 3221225472 MaxContinuousRetarderSpeed "Applied limit for maximum continuous retarder RPM";
CM_ SG_ 3221225472 HghLmtThrshldFrMnCntnsTrqFrmRtrd "Maximum allowable value for minimum continuous retarder torque.";
CM_ SG_ 3221225472 LwLmtThrshldFrMxTrqeFromRetarder "Minimum allowable value for maximum continuous retarder torque.";
CM_ SG_ 3221225472 HghLmtThrshldFrMnCntnsRPMFrmRtrd "Maximum allowable value for minimum continuous retarder speed";
CM_ SG_ 3221225472 LwLmtThrshldFrMaxRPMFromRetarder "Minimum allowable value for maximum continuous retarder speed";
CM_ SG_ 3221225472 DrvlineRetarderOverheatIndicator "Signal from the driveline retarder indicating that its fluid temperature is above normal acceptable limits, and as a result, retarder operation may be altered or restricted.  The indicator is typically a lamp.  Distinctions in meaning between the ...";
CM_ SG_ 3221225472 RetarderCoolantOutletTemp "Temperature of liquid found in retarder cooling system.";
CM_ SG_ 3221225472 HydRetarderOilTemp "Temperature of oil found in a hydraulic retarder.";
CM_ SG_ 3221225472 HydRetarderPress "Gage pressure of oil in hydraulic retarder system.";
CM_ SG_ 3221225472 SteerStraightAheadPosReset "Used to reset the straight ahead position for a steering sensor in the steering column or a steering controller's straight ahead position on any steerable axle.
00 Take no action - Do not Reset
01 Reset
10 Reserved, take no action
11 Not ...";
CM_ SG_ 3221225472 EngBuildHoursReset "Command signal used to reset the engine rebuild hours.

00 Do not reset
01 Reset
10 Reserved
11 Take no action";
CM_ SG_ 3221225472 EngIgntCtrlMaintenanceHoursReset "Used to reset the maintenance hour counter for an engine ignition control module.  The hours remaining until required maintenance is performed are reported in PGN 64688.

00 Do not reset
01 Reset
10 Reserved
11 Take no action";
CM_ SG_ 3221225472 EngSprkPlgScndVltgeTrackingReset "Command signal used to reset the ignition controller average, maximum, and minimum level tracking of the spark plug secondary voltages and to reset the learned misfire rate.  Average secondary voltage tracking is reported in PGNs 64882 - 64887 ...";
CM_ SG_ 3221225472 ServiceComponentIdentification "Identification of component needing service.  See Table SPN911_A.";
CM_ SG_ 3221225472 TripGroup2Proprietary "Command signal used to reset proprietary parameters associated with a trip but not defined within this document.

00 Take no action
01 Reset
10 Reserved
11 Not applicable";
CM_ SG_ 3221225472 TireSensorInformation "Command signal used to initiate change in the tire sensor identification information.

00 Take no action
01 Reset
10 Reserved
11 Not applicable";
CM_ SG_ 3221225472 TireConfigInformation "Command signal used to initiate change in the tire configuration of the vehicle system. On receipt of this reset, necessary changes will be made in the tire configuration command information.
00 - Take No Action
01 - Reset
10 - Reserved
11 - Not ...";
CM_ SG_ 3221225472 BinLiftCountReset "Used to reset the bin lift count as reported in PGN 64594.

00 Do not reset
01 Reset
10 Reserved
11 Take no action";
CM_ SG_ 3221225472 TripGroup1 "Command signal used to reset the PGNs and parameters as defined in Table SPN988_A.

00 Take no action
01 Reset
10 Reserved
11 Not applicable";
CM_ SG_ 3221225472 PercentTorqueAtPeakTorquePoint5 "The torque limit that indicates the available retarder torque which can be provided by the retarder at point 5 of the retarder torque map.  Please reference PGN 65249.  The data is transmitted in indicated torque as a percent of the reference ...";
CM_ SG_ 3221225472 RetarderSpeedAtPeakTorquePoint5 "Please reference PGN 65249";
CM_ SG_ 3221225472 PercentTorqueAtPoint4 "The torque limit that indicates the available retarder torque which can be provided by the retarder at points 3 and 4 of the retarder torque map.  Please reference PGN 65249.  The data is transmitted in indicated torque as a percent of the reference ...";
CM_ SG_ 3221225472 RetarderSpeedAtPoint4 "Retarder speed of point 4 of the engine retarder torque map.  Please reference PGN 65249.";
CM_ SG_ 3221225472 PercentTorqueAtPoint3 "The torque limit that indicates the available retarder torque which can be provided by the retarder at points 3 and 4 of the retarder torque map.  Please reference PGN 65249.  The data is transmitted in indicated torque as a percent of the reference ...";
CM_ SG_ 3221225472 RetarderSpeedAtPoint3 "Retarder speed of point 3 of the engine retarder torque map.  Please reference PGN 65249.";
CM_ SG_ 3221225472 PercentTorqueAtMaxSpeedPoint2 "The torque limit that indicates the available retarder torque which can be provided by the retarder at its maximum speed.  Please reference PGN 65249.  The data is transmitted in indicated torque as a percent of the reference retarder torque.";
CM_ SG_ 3221225472 MaxRetarderSpeedPoint2 "Maximum speed of retarder (Please reference PGN 65249).";
CM_ SG_ 3221225472 PercentTorqueAtIdlePoint1 "The torque limit that indicates the available retarder torque which can be provided by the retarder at idle speed.  The data is transmitted in indicated torque as a percent of the reference retarder torque.";
CM_ SG_ 3221225472 RetarderSpeedAtIdlePoint1 "Please reference PGN 65249";
CM_ SG_ 3221225472 RetarderCtrlMethod "This parameter identifies the number of steps used by the retarder.";
CM_ SG_ 3221225472 RetarderLocation "This parameter defines whether the 'torque/speed curve' defined by the retarder configuration message (PGN 65249) is dependent on engine rpm, output shaft rpm, or other parameter.  The data type of this parameter is measured.
0000  (Primary) ...";
CM_ SG_ 3221225472 RetarderType "A vehicle retarder is a supplementary device to the wheel brakes for the driver to better control the vehicle.  The wheel brakes used in the vehicle are not designed for continuous retarding operation.  In a prolonged period of braking, the brakes ...";
CM_ SG_ 3221225472 EngOperationTimeSinceRebuild "The time in engine operation since the last engine rebuild.";
CM_ SG_ 3221225472 PowerTakeoffSetSpeed "Rotational velocity selected by operator for device used to transmit engine power to auxiliary equipment.";
CM_ SG_ 3221225472 PowerTakeoffSpeed "Rotational velocity of device used to transmit engine power to auxiliary equipment.";
CM_ SG_ 3221225472 PowerTakeoffOilTemp "Temperature of lubricant in device used to transmit engine power to auxiliary equipment.";
CM_ SG_ 3221225472 OprtrEngPTOGvrnrMmrySelectSwitch "Measured state of the operator's engine PTO governor memory select switch. This switch selects which of the two available memory locations is to be used to store the dynamically assigned value. This speed will be set using the PTO governor set ...";
CM_ SG_ 3221225472 EngRmtPTOGvrnrVrblSpedCtrlSwitch "Switch signal which indicates that the remote PTO governor toggle switch is in the enabled (ON) position.  If the toggle switch is enabled and other conditions are satisfied then the remote PTO governor feature is activated and the PTO governor will ...";
CM_ SG_ 3221225472 EngRmtPTOGvrnrPrprgrmmdSpdCtrlSw "Switch signal which indicates that the remote PTO governor  toggle switch is in the enabled (ON) position.  If the toggle switch is enabled and other conditions are satisfied then the remote PTO governor feature is activated and the PTO governor ...";
CM_ SG_ 3221225472 EngPTOGvrnrCast_DecelerateSwitch "Switch signal of the PTO control activator which indicates that the activator is in the position to 'coast/decelerate' the PTO governor set speed.

00 - Off
01 - On
10 - Error
11 - Not available";
CM_ SG_ 3221225472 IndustryGroup "0 = Global
   1  = On-Highway
   2  = Agricultural and Forestry
   3  = Construction
   4  = Marine
   5  = Industrial - Process
          Control - Stationary (Gen-Sets)
   6  = Reserve for SAE
   7  = Reserve for SAE";
CM_ SG_ 3221225472 ManufacturerCode "Assigned by NMEA 2000 Committee";
CM_ SG_ 3221225472 IndustryGroup "0 = Global
   1  = On-Highway
   2  = Agricultural and Forestry
   3  = Construction
   4  = Marine
   5  = Industrial - Process
          Control - Stationary (Gen-Sets)
   6  = Reserve for SAE
   7  = Reserve for SAE";
CM_ SG_ 3221225472 ManufacturerCode "Assigned by NMEA 2000 Committee";
BA_DEF_ SG_  "SigType" ENUM  "Default","Range","RangeSigned","ASCII","Discrete","Control","ReferencePGN","DTC","StringDelimiter","StringLength","StringLengthControl","MessageCounter","MessageChecksum";
BA_DEF_ SG_  "GenSigStartValue" INT 0 2147483647;
BA_DEF_ SG_  "GenSigSendType" ENUM  "Cyclic","OnWrite","OnWriteWithRepetition","OnChange","OnChangeWithRepetition","IfActive","IfActiveWithRepetition","NoSigSendType";
BA_DEF_ SG_  "GenSigILSupport" ENUM  "No","Yes";
BA_DEF_ SG_  "GenSigEVName" STRING ;
BA_DEF_ SG_  "SPN" INT 0 524287;
BA_DEF_ BO_  "TpJ1939VarDlc" ENUM  "No","Yes";
BA_DEF_ BO_  "GenMsgILSupport" ENUM  "No","Yes";
BA_DEF_ BO_  "GenMsgRequestable" INT 0 1;
BA_DEF_ BO_  "GenMsgSendType" ENUM  "cyclic","NotUsed","NotUsed","NotUsed","NotUsed","NotUsed","NotUsed","IfActive","noMsgSendType";
BA_DEF_ BO_  "VFrameFormat" ENUM  "StandardCAN","ExtendedCAN","reserved","J1939PG";
BA_DEF_ SG_  "SystemSignalLongSymbol" STRING ;
BA_DEF_DEF_  "SigType" "Default";
BA_DEF_DEF_  "GenSigStartValue" 0;
BA_DEF_DEF_  "GenSigSendType" "NoSigSendType";
BA_DEF_DEF_  "GenSigILSupport" "Yes";
BA_DEF_DEF_  "GenSigEVName" "Env@Nodename_@Signame";
BA_DEF_DEF_  "SPN" 0;
BA_DEF_DEF_  "TpJ1939VarDlc" "No";
BA_DEF_DEF_  "GenMsgILSupport" "Yes";
BA_DEF_DEF_  "GenMsgRequestable" 1;
BA_DEF_DEF_  "GenMsgSendType" "noMsgSendType";
BA_DEF_DEF_  "VFrameFormat" "J1939PG";
BA_DEF_DEF_  "SystemSignalLongSymbol" "";
BA_ "SPN" SG_ 3221225472 HghRsolutionTotalVehicleDistance 917;
BA_ "SigType" SG_ 3221225472 HghRsolutionTotalVehicleDistance 1;
BA_ "SPN" SG_ 3221225472 LongitudinalAcceleration 1810;
BA_ "SigType" SG_ 3221225472 LongitudinalAcceleration 1;
BA_ "SPN" SG_ 3221225472 LateralAcceleration 1809;
BA_ "SigType" SG_ 3221225472 LateralAcceleration 1;
BA_ "SPN" SG_ 3221225472 YawRate 1808;
BA_ "SigType" SG_ 3221225472 YawRate 1;
BA_ "SPN" SG_ 3221225472 SteerWheelAngleSensorType 1812;
BA_ "SigType" SG_ 3221225472 SteerWheelAngleSensorType 5;
BA_ "SPN" SG_ 3221225472 SteerWheelTurnCounter 1811;
BA_ "GenSigStartValue" SG_ 3221225472 SteerWheelTurnCounter 22;
BA_ "SPN" SG_ 3221225472 TrailerVDCActive 5624;
BA_ "SigType" SG_ 3221225472 TrailerVDCActive 5;
BA_ "SPN" SG_ 3221225472 YCBrakeCtrlActive 1819;
BA_ "SigType" SG_ 3221225472 YCBrakeCtrlActive 5;
BA_ "SPN" SG_ 3221225472 YCEngCtrlActive 1817;
BA_ "SigType" SG_ 3221225472 YCEngCtrlActive 5;
BA_ "SPN" SG_ 3221225472 ROPBrakeCtrlActive 1818;
BA_ "SigType" SG_ 3221225472 ROPBrakeCtrlActive 5;
BA_ "SPN" SG_ 3221225472 ROPEngCtrlActive 1816;
BA_ "SigType" SG_ 3221225472 ROPEngCtrlActive 5;
BA_ "SPN" SG_ 3221225472 VDCBrakeLightRq 1815;
BA_ "SigType" SG_ 3221225472 VDCBrakeLightRq 5;
BA_ "SPN" SG_ 3221225472 VDCFullyOperational 1814;
BA_ "SigType" SG_ 3221225472 VDCFullyOperational 5;
BA_ "SPN" SG_ 3221225472 VDCInformationSignal 1813;
BA_ "SigType" SG_ 3221225472 VDCInformationSignal 5;
BA_ "SPN" SG_ 3221225472 TotalVehicleDistance 245;
BA_ "SigType" SG_ 3221225472 TotalVehicleDistance 1;
BA_ "SPN" SG_ 3221225472 TripDistance 244;
BA_ "SigType" SG_ 3221225472 TripDistance 1;
BA_ "SPN" SG_ 3221225472 TripCruiseDistance 1019;
BA_ "SigType" SG_ 3221225472 TripCruiseDistance 1;
BA_ "SPN" SG_ 3221225472 TripMaxVehicleSpeed 1018;
BA_ "SigType" SG_ 3221225472 TripMaxVehicleSpeed 1;
BA_ "SPN" SG_ 3221225472 TripAirCompressorOnTime 1038;
BA_ "SigType" SG_ 3221225472 TripAirCompressorOnTime 1;
BA_ "SPN" SG_ 3221225472 TripIdleTime 1037;
BA_ "SigType" SG_ 3221225472 TripIdleTime 1;
BA_ "SPN" SG_ 3221225472 TripEngRunningTime 1036;
BA_ "SigType" SG_ 3221225472 TripEngRunningTime 1;
BA_ "SPN" SG_ 3221225472 TripCruiseTime 1034;
BA_ "SigType" SG_ 3221225472 TripCruiseTime 1;
BA_ "SPN" SG_ 3221225472 TripPTOGovernorTime 1035;
BA_ "SigType" SG_ 3221225472 TripPTOGovernorTime 1;
BA_ "SPN" SG_ 3221225472 TripTimeInDerateByEng 1027;
BA_ "SigType" SG_ 3221225472 TripTimeInDerateByEng 1;
BA_ "SPN" SG_ 3221225472 TripTimeInGearDown 1026;
BA_ "SigType" SG_ 3221225472 TripTimeInGearDown 1;
BA_ "SPN" SG_ 3221225472 TripTimeInTopGear 1025;
BA_ "SigType" SG_ 3221225472 TripTimeInTopGear 1;
BA_ "SPN" SG_ 3221225472 TripTimeInVSL 1024;
BA_ "SigType" SG_ 3221225472 TripTimeInVSL 1;
BA_ "SPN" SG_ 3221225472 TripSuddenDecelerations 1023;
BA_ "SigType" SG_ 3221225472 TripSuddenDecelerations 1;
BA_ "SPN" SG_ 3221225472 TrpNumberOfIdleShutdownOverrides 1022;
BA_ "SigType" SG_ 3221225472 TrpNumberOfIdleShutdownOverrides 1;
BA_ "SPN" SG_ 3221225472 TripNumberOfIdleShutdowns 1021;
BA_ "SigType" SG_ 3221225472 TripNumberOfIdleShutdowns 1;
BA_ "SPN" SG_ 3221225472 TripNumberOfHotShutdowns 1020;
BA_ "SigType" SG_ 3221225472 TripNumberOfHotShutdowns 1;
BA_ "SPN" SG_ 3221225472 EngRequestedTorqueHighResolution 4191;
BA_ "SPN" SG_ 3221225472 TSC1CtrlPurpose 3350;
BA_ "SPN" SG_ 3221225472 TSC1TransRate 3349;
BA_ "SPN" SG_ 3221225472 EngRequestedTorque_TorqueLimit 518;
BA_ "SigType" SG_ 3221225472 EngRequestedTorque_TorqueLimit 1;
BA_ "SPN" SG_ 3221225472 EngRequestedSpeed_SpeedLimit 898;
BA_ "SigType" SG_ 3221225472 EngRequestedSpeed_SpeedLimit 1;
BA_ "SPN" SG_ 3221225472 OverrideCtrlModePriority 897;
BA_ "SigType" SG_ 3221225472 OverrideCtrlModePriority 5;
BA_ "SPN" SG_ 3221225472 EngRequestedSpeedCtrlConditions 696;
BA_ "SigType" SG_ 3221225472 EngRequestedSpeedCtrlConditions 5;
BA_ "SPN" SG_ 3221225472 EngOverrideCtrlMode 695;
BA_ "SigType" SG_ 3221225472 EngOverrideCtrlMode 5;
BA_ "SPN" SG_ 3221225472 TransitRunStatus 3046;
BA_ "SigType" SG_ 3221225472 TransitRunStatus 5;
BA_ "SPN" SG_ 3221225472 VehicleUseStatus 3045;
BA_ "SigType" SG_ 3221225472 VehicleUseStatus 5;
BA_ "SPN" SG_ 3221225472 SilentAlarmStatus 3044;
BA_ "SigType" SG_ 3221225472 SilentAlarmStatus 5;
BA_ "SPN" SG_ 3221225472 PatronCount 3047;
BA_ "SigType" SG_ 3221225472 PatronCount 1;
BA_ "SPN" SG_ 3221225472 TypeOfPassengerCount 3043;
BA_ "SPN" SG_ 3221225472 FareboxAlarmIdentifier 3181;
BA_ "SPN" SG_ 3221225472 FareboxEmergencyStatus 3179;
BA_ "SigType" SG_ 3221225472 FareboxEmergencyStatus 4;
BA_ "SPN" SG_ 3221225472 TransferSold 3168;
BA_ "SPN" SG_ 3221225472 TransferType 3173;
BA_ "SPN" SG_ 3221225472 TypeOfService 3172;
BA_ "SPN" SG_ 3221225472 InitialFareAgency 3167;
BA_ "GenSigStartValue" SG_ 3221225472 InitialFareAgency 1;
BA_ "SPN" SG_ 3221225472 PassCategory 3166;
BA_ "SPN" SG_ 3221225472 FareValidity 3165;
BA_ "SPN" SG_ 3221225472 PaymentDetails 3177;
BA_ "SPN" SG_ 3221225472 TypeOfFare 3176;
BA_ "SPN" SG_ 3221225472 PassengerType 3171;
BA_ "SPN" SG_ 3221225472 TransactionType 3170;
BA_ "SPN" SG_ 3221225472 RouteNumber 3169;
BA_ "SPN" SG_ 3221225472 DriversFareboxSecurityCode 3164;
BA_ "SPN" SG_ 3221225472 AssignedBlock 3163;
BA_ "SPN" SG_ 3221225472 AssignedRun 3162;
BA_ "SPN" SG_ 3221225472 AssignedRoute 3160;
BA_ "SPN" SG_ 3221225472 PatternNumber 3161;
BA_ "SPN" SG_ 3221225472 TripNumber 3159;
BA_ "SPN" SG_ 3221225472 FarePresets 3175;
BA_ "SPN" SG_ 3221225472 TripDirection 3174;
BA_ "SPN" SG_ 3221225472 TripStatus 3180;
BA_ "SPN" SG_ 3221225472 FareboxServiceStatus 3178;
BA_ "SigType" SG_ 3221225472 FareboxServiceStatus 4;
BA_ "SPN" SG_ 3221225472 VehicleID 3085;
BA_ "SigType" SG_ 3221225472 VehicleID 1;
BA_ "SPN" SG_ 3221225472 StrobeActivationCtrlStatus 3082;
BA_ "SigType" SG_ 3221225472 StrobeActivationCtrlStatus 4;
BA_ "SPN" SG_ 3221225472 TransitDoorEnable 3083;
BA_ "SigType" SG_ 3221225472 TransitDoorEnable 4;
BA_ "SPN" SG_ 3221225472 PriorityOfRespSentByEmitter 3084;
BA_ "SPN" SG_ 3221225472 IntrsctnPrmptionRequest_Response 3079;
BA_ "SigType" SG_ 3221225472 IntrsctnPrmptionRequest_Response 4;
BA_ "SPN" SG_ 3221225472 TransitRouteIDUsage 3080;
BA_ "SigType" SG_ 3221225472 TransitRouteIDUsage 4;
BA_ "SPN" SG_ 3221225472 RangeCodeEnable 3081;
BA_ "SigType" SG_ 3221225472 RangeCodeEnable 4;
BA_ "SPN" SG_ 3221225472 NmbrOfBytsInThMlpstIdntification 3070;
BA_ "SigType" SG_ 3221225472 NmbrOfBytsInThMlpstIdntification 1;
BA_ "SPN" SG_ 3221225472 NmbrOfBytsInThTrnstAssgndBlckIdn 3073;
BA_ "GenSigStartValue" SG_ 3221225472 NmbrOfBytsInThTrnstAssgndBlckIdn 1;
BA_ "SigType" SG_ 3221225472 NmbrOfBytsInThTrnstAssgndBlckIdn 1;
BA_ "SPN" SG_ 3221225472 NmbrOfBytsInThTrnstAssgndRnIdntt 3072;
BA_ "GenSigStartValue" SG_ 3221225472 NmbrOfBytsInThTrnstAssgndRnIdntt 1;
BA_ "SigType" SG_ 3221225472 NmbrOfBytsInThTrnstAssgndRnIdntt 1;
BA_ "SPN" SG_ 3221225472 NmbrOfBytsInThTrnstAssgndRtIdntt 3071;
BA_ "GenSigStartValue" SG_ 3221225472 NmbrOfBytsInThTrnstAssgndRtIdntt 1;
BA_ "SigType" SG_ 3221225472 NmbrOfBytsInThTrnstAssgndRtIdntt 1;
BA_ "SPN" SG_ 3221225472 Agency 3078;
BA_ "SPN" SG_ 3221225472 ReferenceTirePressSetting_33 521833;
BA_ "SigType" SG_ 3221225472 ReferenceTirePressSetting_33 1;
BA_ "SPN" SG_ 3221225472 ReferenceTirePressSetting_32 521832;
BA_ "SigType" SG_ 3221225472 ReferenceTirePressSetting_32 1;
BA_ "SPN" SG_ 3221225472 ReferenceTirePressSetting_31 521831;
BA_ "SigType" SG_ 3221225472 ReferenceTirePressSetting_31 1;
BA_ "SPN" SG_ 3221225472 ReferenceTirePressSetting_30 521830;
BA_ "SigType" SG_ 3221225472 ReferenceTirePressSetting_30 1;
BA_ "SPN" SG_ 3221225472 ReferenceTirePressSetting_23 521823;
BA_ "SigType" SG_ 3221225472 ReferenceTirePressSetting_23 1;
BA_ "SPN" SG_ 3221225472 ReferenceTirePressSetting_22 521822;
BA_ "SigType" SG_ 3221225472 ReferenceTirePressSetting_22 1;
BA_ "SPN" SG_ 3221225472 ReferenceTirePressSetting_21 521821;
BA_ "SigType" SG_ 3221225472 ReferenceTirePressSetting_21 1;
BA_ "SPN" SG_ 3221225472 ReferenceTirePressSetting_20 521820;
BA_ "SigType" SG_ 3221225472 ReferenceTirePressSetting_20 1;
BA_ "SPN" SG_ 3221225472 ReferenceTirePressSetting_13 521813;
BA_ "SigType" SG_ 3221225472 ReferenceTirePressSetting_13 1;
BA_ "SPN" SG_ 3221225472 ReferenceTirePressSetting_12 521812;
BA_ "SigType" SG_ 3221225472 ReferenceTirePressSetting_12 1;
BA_ "SPN" SG_ 3221225472 ReferenceTirePressSetting_11 521811;
BA_ "SigType" SG_ 3221225472 ReferenceTirePressSetting_11 1;
BA_ "SPN" SG_ 3221225472 ReferenceTirePressSetting_10 521810;
BA_ "SigType" SG_ 3221225472 ReferenceTirePressSetting_10 1;
BA_ "SPN" SG_ 3221225472 ReferenceTirePressSetting_01 521801;
BA_ "SigType" SG_ 3221225472 ReferenceTirePressSetting_01 1;
BA_ "SPN" SG_ 3221225472 ReferenceTirePressSetting_00 521800;
BA_ "SigType" SG_ 3221225472 ReferenceTirePressSetting_00 1;
BA_ "SPN" SG_ 3221225472 ReferenceTirePress_33 521933;
BA_ "SigType" SG_ 3221225472 ReferenceTirePress_33 1;
BA_ "SPN" SG_ 3221225472 ReferenceTirePress_32 521932;
BA_ "SigType" SG_ 3221225472 ReferenceTirePress_32 1;
BA_ "SPN" SG_ 3221225472 ReferenceTirePress_31 521931;
BA_ "SigType" SG_ 3221225472 ReferenceTirePress_31 1;
BA_ "SPN" SG_ 3221225472 ReferenceTirePress_30 521930;
BA_ "SigType" SG_ 3221225472 ReferenceTirePress_30 1;
BA_ "SPN" SG_ 3221225472 ReferenceTirePress_23 521923;
BA_ "SigType" SG_ 3221225472 ReferenceTirePress_23 1;
BA_ "SPN" SG_ 3221225472 ReferenceTirePress_22 521922;
BA_ "SigType" SG_ 3221225472 ReferenceTirePress_22 1;
BA_ "SPN" SG_ 3221225472 ReferenceTirePress_21 521921;
BA_ "SigType" SG_ 3221225472 ReferenceTirePress_21 1;
BA_ "SPN" SG_ 3221225472 ReferenceTirePress_20 521920;
BA_ "SigType" SG_ 3221225472 ReferenceTirePress_20 1;
BA_ "SPN" SG_ 3221225472 ReferenceTirePress_13 521913;
BA_ "SigType" SG_ 3221225472 ReferenceTirePress_13 1;
BA_ "SPN" SG_ 3221225472 ReferenceTirePress_12 521912;
BA_ "SigType" SG_ 3221225472 ReferenceTirePress_12 1;
BA_ "SPN" SG_ 3221225472 ReferenceTirePress_11 521911;
BA_ "SigType" SG_ 3221225472 ReferenceTirePress_11 1;
BA_ "SPN" SG_ 3221225472 ReferenceTirePress_10 521910;
BA_ "SigType" SG_ 3221225472 ReferenceTirePress_10 1;
BA_ "SPN" SG_ 3221225472 ReferenceTirePress_01 521901;
BA_ "SigType" SG_ 3221225472 ReferenceTirePress_01 1;
BA_ "SPN" SG_ 3221225472 ReferenceTirePress_00 521900;
BA_ "SigType" SG_ 3221225472 ReferenceTirePress_00 1;
BA_ "SPN" SG_ 3221225472 SteerChannelTirePress 146;
BA_ "SigType" SG_ 3221225472 SteerChannelTirePress 1;
BA_ "SPN" SG_ 3221225472 DriveChannelTirePress 145;
BA_ "SigType" SG_ 3221225472 DriveChannelTirePress 1;
BA_ "SPN" SG_ 3221225472 TrailerTagOrPushChannelTirePress 144;
BA_ "SigType" SG_ 3221225472 TrailerTagOrPushChannelTirePress 1;
BA_ "SPN" SG_ 3221225472 SteerChannelTirePressTarget 143;
BA_ "SigType" SG_ 3221225472 SteerChannelTirePressTarget 1;
BA_ "SPN" SG_ 3221225472 DriveChannelTirePressTarget 142;
BA_ "SigType" SG_ 3221225472 DriveChannelTirePressTarget 1;
BA_ "SPN" SG_ 3221225472 TrlrTgOrPshChnnelTirePressTarget 141;
BA_ "SigType" SG_ 3221225472 TrlrTgOrPshChnnelTirePressTarget 1;
BA_ "SPN" SG_ 3221225472 PCUTrilerTagOrPushSolenoidStatus 1475;
BA_ "SigType" SG_ 3221225472 PCUTrilerTagOrPushSolenoidStatus 5;
BA_ "SPN" SG_ 3221225472 PCUSupplySolenoidStatus 1474;
BA_ "SigType" SG_ 3221225472 PCUSupplySolenoidStatus 5;
BA_ "SPN" SG_ 3221225472 PCUCtrlSolenoidStatus 1473;
BA_ "SigType" SG_ 3221225472 PCUCtrlSolenoidStatus 5;
BA_ "SPN" SG_ 3221225472 PCUDeflateSolenoidStatus 1472;
BA_ "SigType" SG_ 3221225472 PCUDeflateSolenoidStatus 5;
BA_ "SPN" SG_ 3221225472 TirePressSupplySwitchStatus 1471;
BA_ "SigType" SG_ 3221225472 TirePressSupplySwitchStatus 5;
BA_ "SPN" SG_ 3221225472 PCUSteerSolenoidStatus 1470;
BA_ "SigType" SG_ 3221225472 PCUSteerSolenoidStatus 5;
BA_ "SPN" SG_ 3221225472 PCUDriveSolenoidStatus 1469;
BA_ "SigType" SG_ 3221225472 PCUDriveSolenoidStatus 5;
BA_ "SPN" SG_ 3221225472 DriveChannelMode 1468;
BA_ "SPN" SG_ 3221225472 Trailer_tagChannelMode 1467;
BA_ "SPN" SG_ 3221225472 SteerChannelMode 1466;
BA_ "SPN" SG_ 3221225472 TirePressCheckInterval 39;
BA_ "SigType" SG_ 3221225472 TirePressCheckInterval 1;
BA_ "SPN" SG_ 3221225472 ExTirePressSupport 6990;
BA_ "SigType" SG_ 3221225472 ExTirePressSupport 4;
BA_ "SPN" SG_ 3221225472 TirePressThresholdDetection_13 521613;
BA_ "SPN" SG_ 3221225472 TirePressThresholdDetection_12 521612;
BA_ "SPN" SG_ 3221225472 TirePressThresholdDetection_11 521611;
BA_ "SPN" SG_ 3221225472 TirePressThresholdDetection_10 521610;
BA_ "SPN" SG_ 3221225472 TirePressThresholdDetection_01 521601;
BA_ "SPN" SG_ 3221225472 TirePress_33 521033;
BA_ "SigType" SG_ 3221225472 TirePress_33 1;
BA_ "SPN" SG_ 3221225472 TirePress_32 521032;
BA_ "SigType" SG_ 3221225472 TirePress_32 1;
BA_ "SPN" SG_ 3221225472 TirePress_31 521031;
BA_ "SigType" SG_ 3221225472 TirePress_31 1;
BA_ "SPN" SG_ 3221225472 TirePress_30 521030;
BA_ "SigType" SG_ 3221225472 TirePress_30 1;
BA_ "SPN" SG_ 3221225472 TirePress_23 521023;
BA_ "SigType" SG_ 3221225472 TirePress_23 1;
BA_ "SPN" SG_ 3221225472 TirePress_22 521022;
BA_ "SigType" SG_ 3221225472 TirePress_22 1;
BA_ "SPN" SG_ 3221225472 TirePress_21 521021;
BA_ "SigType" SG_ 3221225472 TirePress_21 1;
BA_ "SPN" SG_ 3221225472 TirePress_20 521020;
BA_ "SigType" SG_ 3221225472 TirePress_20 1;
BA_ "SPN" SG_ 3221225472 TirePress_13 521013;
BA_ "SigType" SG_ 3221225472 TirePress_13 1;
BA_ "SPN" SG_ 3221225472 TirePress_12 521012;
BA_ "SigType" SG_ 3221225472 TirePress_12 1;
BA_ "SPN" SG_ 3221225472 TirePress_11 521011;
BA_ "SigType" SG_ 3221225472 TirePress_11 1;
BA_ "SPN" SG_ 3221225472 TirePress_10 521010;
BA_ "SigType" SG_ 3221225472 TirePress_10 1;
BA_ "SPN" SG_ 3221225472 TireAirLeakageRate_33 521533;
BA_ "SigType" SG_ 3221225472 TireAirLeakageRate_33 1;
BA_ "SPN" SG_ 3221225472 TireAirLeakageRate_32 521532;
BA_ "SigType" SG_ 3221225472 TireAirLeakageRate_32 1;
BA_ "SPN" SG_ 3221225472 TireAirLeakageRate_31 521531;
BA_ "SigType" SG_ 3221225472 TireAirLeakageRate_31 1;
BA_ "SPN" SG_ 3221225472 TireAirLeakageRate_30 521530;
BA_ "SigType" SG_ 3221225472 TireAirLeakageRate_30 1;
BA_ "SPN" SG_ 3221225472 TireAirLeakageRate_23 521523;
BA_ "SigType" SG_ 3221225472 TireAirLeakageRate_23 1;
BA_ "SPN" SG_ 3221225472 TireAirLeakageRate_22 521522;
BA_ "SigType" SG_ 3221225472 TireAirLeakageRate_22 1;
BA_ "SPN" SG_ 3221225472 TireAirLeakageRate_21 521521;
BA_ "SigType" SG_ 3221225472 TireAirLeakageRate_21 1;
BA_ "SPN" SG_ 3221225472 TireAirLeakageRate_20 521520;
BA_ "SigType" SG_ 3221225472 TireAirLeakageRate_20 1;
BA_ "SPN" SG_ 3221225472 TireAirLeakageRate_13 521513;
BA_ "SigType" SG_ 3221225472 TireAirLeakageRate_13 1;
BA_ "SPN" SG_ 3221225472 TireAirLeakageRate_12 521512;
BA_ "SigType" SG_ 3221225472 TireAirLeakageRate_12 1;
BA_ "SPN" SG_ 3221225472 TireAirLeakageRate_11 521511;
BA_ "SigType" SG_ 3221225472 TireAirLeakageRate_11 1;
BA_ "SPN" SG_ 3221225472 TireAirLeakageRate_10 521510;
BA_ "SigType" SG_ 3221225472 TireAirLeakageRate_10 1;
BA_ "SPN" SG_ 3221225472 TireAirLeakageRate_01 521501;
BA_ "SigType" SG_ 3221225472 TireAirLeakageRate_01 1;
BA_ "SPN" SG_ 3221225472 TireAirLeakageRate_00 521500;
BA_ "SigType" SG_ 3221225472 TireAirLeakageRate_00 1;
BA_ "SPN" SG_ 3221225472 CTIWheelSensorStatus_33 521433;
BA_ "SigType" SG_ 3221225472 CTIWheelSensorStatus_33 4;
BA_ "SPN" SG_ 3221225472 CTIWheelSensorStatus_32 521432;
BA_ "SigType" SG_ 3221225472 CTIWheelSensorStatus_32 4;
BA_ "SPN" SG_ 3221225472 CTIWheelSensorStatus_31 521431;
BA_ "SigType" SG_ 3221225472 CTIWheelSensorStatus_31 4;
BA_ "SPN" SG_ 3221225472 CTIWheelSensorStatus_30 521430;
BA_ "SigType" SG_ 3221225472 CTIWheelSensorStatus_30 4;
BA_ "SPN" SG_ 3221225472 CTIWheelSensorStatus_23 521423;
BA_ "SigType" SG_ 3221225472 CTIWheelSensorStatus_23 4;
BA_ "SPN" SG_ 3221225472 CTIWheelSensorStatus_22 521422;
BA_ "SigType" SG_ 3221225472 CTIWheelSensorStatus_22 4;
BA_ "SPN" SG_ 3221225472 CTIWheelSensorStatus_21 521421;
BA_ "SigType" SG_ 3221225472 CTIWheelSensorStatus_21 4;
BA_ "SPN" SG_ 3221225472 CTIWheelSensorStatus_20 521420;
BA_ "SigType" SG_ 3221225472 CTIWheelSensorStatus_20 4;
BA_ "SPN" SG_ 3221225472 CTIWheelSensorStatus_13 521413;
BA_ "SigType" SG_ 3221225472 CTIWheelSensorStatus_13 4;
BA_ "SPN" SG_ 3221225472 CTIWheelSensorStatus_12 521412;
BA_ "SigType" SG_ 3221225472 CTIWheelSensorStatus_12 4;
BA_ "SPN" SG_ 3221225472 CTIWheelSensorStatus_11 521411;
BA_ "SigType" SG_ 3221225472 CTIWheelSensorStatus_11 4;
BA_ "SPN" SG_ 3221225472 CTIWheelSensorStatus_10 521410;
BA_ "SigType" SG_ 3221225472 CTIWheelSensorStatus_10 4;
BA_ "SPN" SG_ 3221225472 CTIWheelSensorStatus_01 521401;
BA_ "SigType" SG_ 3221225472 CTIWheelSensorStatus_01 4;
BA_ "SPN" SG_ 3221225472 CTIWheelEndElectricalFault_33 521233;
BA_ "SigType" SG_ 3221225472 CTIWheelEndElectricalFault_33 4;
BA_ "SPN" SG_ 3221225472 CTIWheelEndElectricalFault_32 521232;
BA_ "SigType" SG_ 3221225472 CTIWheelEndElectricalFault_32 4;
BA_ "SPN" SG_ 3221225472 CTIWheelEndElectricalFault_31 521231;
BA_ "SigType" SG_ 3221225472 CTIWheelEndElectricalFault_31 4;
BA_ "SPN" SG_ 3221225472 CTIWheelEndElectricalFault_30 521230;
BA_ "SigType" SG_ 3221225472 CTIWheelEndElectricalFault_30 4;
BA_ "SPN" SG_ 3221225472 CTIWheelEndElectricalFault_23 521223;
BA_ "SigType" SG_ 3221225472 CTIWheelEndElectricalFault_23 4;
BA_ "SPN" SG_ 3221225472 CTIWheelEndElectricalFault_22 521222;
BA_ "SigType" SG_ 3221225472 CTIWheelEndElectricalFault_22 4;
BA_ "SPN" SG_ 3221225472 CTIWheelEndElectricalFault_21 521221;
BA_ "SigType" SG_ 3221225472 CTIWheelEndElectricalFault_21 4;
BA_ "SPN" SG_ 3221225472 CTIWheelEndElectricalFault_20 521220;
BA_ "SigType" SG_ 3221225472 CTIWheelEndElectricalFault_20 4;
BA_ "SPN" SG_ 3221225472 CTIWheelEndElectricalFault_13 521213;
BA_ "SigType" SG_ 3221225472 CTIWheelEndElectricalFault_13 4;
BA_ "SPN" SG_ 3221225472 CTIWheelEndElectricalFault_12 521212;
BA_ "SigType" SG_ 3221225472 CTIWheelEndElectricalFault_12 4;
BA_ "SPN" SG_ 3221225472 CTIWheelEndElectricalFault_11 521211;
BA_ "SigType" SG_ 3221225472 CTIWheelEndElectricalFault_11 4;
BA_ "SPN" SG_ 3221225472 CTIWheelEndElectricalFault_10 521210;
BA_ "SigType" SG_ 3221225472 CTIWheelEndElectricalFault_10 4;
BA_ "SPN" SG_ 3221225472 CTIWheelEndElectricalFault_01 521201;
BA_ "SigType" SG_ 3221225472 CTIWheelEndElectricalFault_01 4;
BA_ "SPN" SG_ 3221225472 CTITireStatus_33 521333;
BA_ "SigType" SG_ 3221225472 CTITireStatus_33 4;
BA_ "SPN" SG_ 3221225472 CTITireStatus_32 521332;
BA_ "SigType" SG_ 3221225472 CTITireStatus_32 4;
BA_ "SPN" SG_ 3221225472 CTITireStatus_31 521331;
BA_ "SigType" SG_ 3221225472 CTITireStatus_31 4;
BA_ "SPN" SG_ 3221225472 CTITireStatus_30 521330;
BA_ "SigType" SG_ 3221225472 CTITireStatus_30 4;
BA_ "SPN" SG_ 3221225472 CTITireStatus_23 521323;
BA_ "SigType" SG_ 3221225472 CTITireStatus_23 4;
BA_ "SPN" SG_ 3221225472 CTITireStatus_22 521322;
BA_ "SigType" SG_ 3221225472 CTITireStatus_22 4;
BA_ "SPN" SG_ 3221225472 CTITireStatus_21 521321;
BA_ "SigType" SG_ 3221225472 CTITireStatus_21 4;
BA_ "SPN" SG_ 3221225472 CTITireStatus_20 521320;
BA_ "SigType" SG_ 3221225472 CTITireStatus_20 4;
BA_ "SPN" SG_ 3221225472 CTITireStatus_13 521313;
BA_ "SigType" SG_ 3221225472 CTITireStatus_13 4;
BA_ "SPN" SG_ 3221225472 CTITireStatus_12 521312;
BA_ "SigType" SG_ 3221225472 CTITireStatus_12 4;
BA_ "SPN" SG_ 3221225472 CTITireStatus_11 521311;
BA_ "SigType" SG_ 3221225472 CTITireStatus_11 4;
BA_ "SPN" SG_ 3221225472 CTITireStatus_10 521310;
BA_ "SigType" SG_ 3221225472 CTITireStatus_10 4;
BA_ "SPN" SG_ 3221225472 CTITireStatus_01 521301;
BA_ "SigType" SG_ 3221225472 CTITireStatus_01 4;
BA_ "SPN" SG_ 3221225472 TireTemp_11 521111;
BA_ "SigType" SG_ 3221225472 TireTemp_11 1;
BA_ "SPN" SG_ 3221225472 TireTemp_33 521133;
BA_ "SigType" SG_ 3221225472 TireTemp_33 1;
BA_ "SPN" SG_ 3221225472 TireTemp_32 521132;
BA_ "SigType" SG_ 3221225472 TireTemp_32 1;
BA_ "SPN" SG_ 3221225472 TireTemp_31 521131;
BA_ "SigType" SG_ 3221225472 TireTemp_31 1;
BA_ "SPN" SG_ 3221225472 TireTemp_30 521130;
BA_ "SigType" SG_ 3221225472 TireTemp_30 1;
BA_ "SPN" SG_ 3221225472 TireTemp_23 521123;
BA_ "SigType" SG_ 3221225472 TireTemp_23 1;
BA_ "SPN" SG_ 3221225472 TireTemp_22 521122;
BA_ "SigType" SG_ 3221225472 TireTemp_22 1;
BA_ "SPN" SG_ 3221225472 TireTemp_21 521121;
BA_ "SigType" SG_ 3221225472 TireTemp_21 1;
BA_ "SPN" SG_ 3221225472 TireTemp_20 521120;
BA_ "SigType" SG_ 3221225472 TireTemp_20 1;
BA_ "SPN" SG_ 3221225472 TireTemp_13 521113;
BA_ "SigType" SG_ 3221225472 TireTemp_13 1;
BA_ "SPN" SG_ 3221225472 TireTemp_12 521112;
BA_ "SigType" SG_ 3221225472 TireTemp_12 1;
BA_ "SPN" SG_ 3221225472 TireTemp_10 521110;
BA_ "SigType" SG_ 3221225472 TireTemp_10 1;
BA_ "SPN" SG_ 3221225472 TireTemp_01 521101;
BA_ "SigType" SG_ 3221225472 TireTemp_01 1;
BA_ "SPN" SG_ 3221225472 TireTemp_00 521100;
BA_ "SigType" SG_ 3221225472 TireTemp_00 1;
BA_ "SPN" SG_ 3221225472 TirePressThresholdDetection_33 521633;
BA_ "SPN" SG_ 3221225472 TirePressThresholdDetection_32 521632;
BA_ "SPN" SG_ 3221225472 TirePressThresholdDetection_31 521631;
BA_ "SPN" SG_ 3221225472 TirePressThresholdDetection_30 521630;
BA_ "SPN" SG_ 3221225472 TirePressThresholdDetection_23 521623;
BA_ "SPN" SG_ 3221225472 TirePressThresholdDetection_22 521622;
BA_ "SPN" SG_ 3221225472 TirePressThresholdDetection_21 521621;
BA_ "SPN" SG_ 3221225472 TirePressThresholdDetection_20 521620;
BA_ "SPN" SG_ 3221225472 TirePressThresholdDetection_00 521600;
BA_ "SPN" SG_ 3221225472 TirePress_01 521001;
BA_ "SigType" SG_ 3221225472 TirePress_01 1;
BA_ "SPN" SG_ 3221225472 TirePress_00 521000;
BA_ "SigType" SG_ 3221225472 TirePress_00 1;
BA_ "SPN" SG_ 3221225472 CTIWheelSensorStatus_00 521400;
BA_ "SigType" SG_ 3221225472 CTIWheelSensorStatus_00 4;
BA_ "SPN" SG_ 3221225472 CTIWheelEndElectricalFault_00 521200;
BA_ "SigType" SG_ 3221225472 CTIWheelEndElectricalFault_00 4;
BA_ "SPN" SG_ 3221225472 CTITireStatus_00 521300;
BA_ "SigType" SG_ 3221225472 CTITireStatus_00 4;
BA_ "SPN" SG_ 3221225472 TripFanOnTimeDueToTheA_CSystem 997;
BA_ "SigType" SG_ 3221225472 TripFanOnTimeDueToTheA_CSystem 1;
BA_ "SPN" SG_ 3221225472 TripFanOnTimeDueToAManualSwitch 996;
BA_ "SigType" SG_ 3221225472 TripFanOnTimeDueToAManualSwitch 1;
BA_ "SPN" SG_ 3221225472 TripFanOnTimeDueToTheEngSystem 995;
BA_ "SigType" SG_ 3221225472 TripFanOnTimeDueToTheEngSystem 1;
BA_ "SPN" SG_ 3221225472 TripFanOnTime 994;
BA_ "SigType" SG_ 3221225472 TripFanOnTime 1;
BA_ "SPN" SG_ 3221225472 TripDistanceInTopGear 1000;
BA_ "SigType" SG_ 3221225472 TripDistanceInTopGear 1;
BA_ "SPN" SG_ 3221225472 TripGearDownDistance 999;
BA_ "SigType" SG_ 3221225472 TripGearDownDistance 1;
BA_ "SPN" SG_ 3221225472 TripDistanceOnVSL 998;
BA_ "SigType" SG_ 3221225472 TripDistanceOnVSL 1;
BA_ "SPN" SG_ 3221225472 AdjustLocalHourOffset 1610;
BA_ "GenSigStartValue" SG_ 3221225472 AdjustLocalHourOffset 101;
BA_ "SigType" SG_ 3221225472 AdjustLocalHourOffset 1;
BA_ "SPN" SG_ 3221225472 AdjustLocalMinuteOffset 1609;
BA_ "GenSigStartValue" SG_ 3221225472 AdjustLocalMinuteOffset 66;
BA_ "SigType" SG_ 3221225472 AdjustLocalMinuteOffset 1;
BA_ "SPN" SG_ 3221225472 AdjustYear 1608;
BA_ "SigType" SG_ 3221225472 AdjustYear 1;
BA_ "SPN" SG_ 3221225472 AdjustDay 1607;
BA_ "GenSigStartValue" SG_ 3221225472 AdjustDay 1;
BA_ "SigType" SG_ 3221225472 AdjustDay 1;
BA_ "SPN" SG_ 3221225472 AdjustMonth 1606;
BA_ "GenSigStartValue" SG_ 3221225472 AdjustMonth 1;
BA_ "SigType" SG_ 3221225472 AdjustMonth 1;
BA_ "SPN" SG_ 3221225472 AdjustHours 1605;
BA_ "SigType" SG_ 3221225472 AdjustHours 1;
BA_ "SPN" SG_ 3221225472 AdjustMinutes 1604;
BA_ "SigType" SG_ 3221225472 AdjustMinutes 1;
BA_ "SPN" SG_ 3221225472 AdjustSeconds 1603;
BA_ "SigType" SG_ 3221225472 AdjustSeconds 1;
BA_ "SPN" SG_ 3221225472 LocalHourOffset 1602;
BA_ "GenSigStartValue" SG_ 3221225472 LocalHourOffset 102;
BA_ "SigType" SG_ 3221225472 LocalHourOffset 1;
BA_ "SPN" SG_ 3221225472 LocalMinuteOffset 1601;
BA_ "GenSigStartValue" SG_ 3221225472 LocalMinuteOffset 66;
BA_ "SigType" SG_ 3221225472 LocalMinuteOffset 1;
BA_ "SPN" SG_ 3221225472 Year 964;
BA_ "SigType" SG_ 3221225472 Year 1;
BA_ "SPN" SG_ 3221225472 Day 962;
BA_ "GenSigStartValue" SG_ 3221225472 Day 1;
BA_ "SigType" SG_ 3221225472 Day 1;
BA_ "SPN" SG_ 3221225472 Month 963;
BA_ "GenSigStartValue" SG_ 3221225472 Month 1;
BA_ "SigType" SG_ 3221225472 Month 1;
BA_ "SPN" SG_ 3221225472 Hours 961;
BA_ "SigType" SG_ 3221225472 Hours 1;
BA_ "SPN" SG_ 3221225472 Minutes 960;
BA_ "SigType" SG_ 3221225472 Minutes 1;
BA_ "SPN" SG_ 3221225472 Seconds 959;
BA_ "SigType" SG_ 3221225472 Seconds 1;
BA_ "SPN" SG_ 3221225472 EngDsrdTrboWastegateActuator2Pos 5373;
BA_ "SigType" SG_ 3221225472 EngDsrdTrboWastegateActuator2Pos 1;
BA_ "SPN" SG_ 3221225472 EngTrbWstgateActuator1TempStatus 5372;
BA_ "SPN" SG_ 3221225472 EngTrbWstgtActtor1PreliminaryFMI 5371;
BA_ "SPN" SG_ 3221225472 EngDsrdTrboWastegateActuator1Pos 5370;
BA_ "SigType" SG_ 3221225472 EngDsrdTrboWastegateActuator1Pos 1;
BA_ "SPN" SG_ 3221225472 EngTrbWstgteActuatorCtrlAirPress 1192;
BA_ "SigType" SG_ 3221225472 EngTrbWstgteActuatorCtrlAirPress 1;
BA_ "SPN" SG_ 3221225472 EngTurboWastegateActuator4Pos 1191;
BA_ "SigType" SG_ 3221225472 EngTurboWastegateActuator4Pos 1;
BA_ "SPN" SG_ 3221225472 EngTurboWastegateActuator3Pos 1190;
BA_ "SigType" SG_ 3221225472 EngTurboWastegateActuator3Pos 1;
BA_ "SPN" SG_ 3221225472 EngTurboWastegateActuator2Pos 1189;
BA_ "SigType" SG_ 3221225472 EngTurboWastegateActuator2Pos 1;
BA_ "SPN" SG_ 3221225472 EngTurboWastegateActuator1Pos 1188;
BA_ "SigType" SG_ 3221225472 EngTurboWastegateActuator1Pos 1;
BA_ "SPN" SG_ 3221225472 TachographVehicleSpeed 1624;
BA_ "SigType" SG_ 3221225472 TachographVehicleSpeed 1;
BA_ "SPN" SG_ 3221225472 TachographOutputShaftSpeed 1623;
BA_ "SigType" SG_ 3221225472 TachographOutputShaftSpeed 1;
BA_ "SPN" SG_ 3221225472 DirectionIndicator 1619;
BA_ "SigType" SG_ 3221225472 DirectionIndicator 4;
BA_ "SPN" SG_ 3221225472 TachographPerformance 1620;
BA_ "SigType" SG_ 3221225472 TachographPerformance 5;
BA_ "SPN" SG_ 3221225472 HandlingInformation 1621;
BA_ "SigType" SG_ 3221225472 HandlingInformation 5;
BA_ "SPN" SG_ 3221225472 SystemEvent 1622;
BA_ "SigType" SG_ 3221225472 SystemEvent 5;
BA_ "SPN" SG_ 3221225472 DriverCardDriver2 1616;
BA_ "SigType" SG_ 3221225472 DriverCardDriver2 4;
BA_ "SPN" SG_ 3221225472 Driver2TimeRelatedStates 1618;
BA_ "SPN" SG_ 3221225472 VehicleOverspeed 1614;
BA_ "SigType" SG_ 3221225472 VehicleOverspeed 4;
BA_ "SPN" SG_ 3221225472 DriverCardDriver1 1615;
BA_ "SigType" SG_ 3221225472 DriverCardDriver1 4;
BA_ "SPN" SG_ 3221225472 Driver1TimeRelatedStates 1617;
BA_ "SPN" SG_ 3221225472 VehicleMotion 1611;
BA_ "SigType" SG_ 3221225472 VehicleMotion 4;
BA_ "SPN" SG_ 3221225472 Driver2WorkingState 1613;
BA_ "SPN" SG_ 3221225472 Driver1WorkingState 1612;
BA_ "SPN" SG_ 3221225472 EngTurbo4CompressorOutletTemp 2801;
BA_ "SigType" SG_ 3221225472 EngTurbo4CompressorOutletTemp 1;
BA_ "SPN" SG_ 3221225472 EngTurbo3CompressorOutletTemp 2800;
BA_ "SigType" SG_ 3221225472 EngTurbo3CompressorOutletTemp 1;
BA_ "SPN" SG_ 3221225472 EngTurbo2CompressorOutletTemp 2799;
BA_ "SigType" SG_ 3221225472 EngTurbo2CompressorOutletTemp 1;
BA_ "SPN" SG_ 3221225472 EngTurbo1CompressorOutletTemp 2629;
BA_ "SigType" SG_ 3221225472 EngTurbo1CompressorOutletTemp 1;
BA_ "SPN" SG_ 3221225472 EngTurbo4TurbineOutletTemp 1187;
BA_ "SigType" SG_ 3221225472 EngTurbo4TurbineOutletTemp 1;
BA_ "SPN" SG_ 3221225472 EngTurbo3TurbineOutletTemp 1186;
BA_ "SigType" SG_ 3221225472 EngTurbo3TurbineOutletTemp 1;
BA_ "SPN" SG_ 3221225472 EngTurbo2TurbineOutletTemp 1185;
BA_ "SigType" SG_ 3221225472 EngTurbo2TurbineOutletTemp 1;
BA_ "SPN" SG_ 3221225472 EngTurbo1TurbineOutletTemp 1184;
BA_ "SigType" SG_ 3221225472 EngTurbo1TurbineOutletTemp 1;
BA_ "SPN" SG_ 3221225472 EngTurbo4TurbineIntakeTemp 1183;
BA_ "SigType" SG_ 3221225472 EngTurbo4TurbineIntakeTemp 1;
BA_ "SPN" SG_ 3221225472 EngTurbo3TurbineIntakeTemp 1182;
BA_ "SigType" SG_ 3221225472 EngTurbo3TurbineIntakeTemp 1;
BA_ "SPN" SG_ 3221225472 EngTurbo2TurbineIntakeTemp 1181;
BA_ "SigType" SG_ 3221225472 EngTurbo2TurbineIntakeTemp 1;
BA_ "SPN" SG_ 3221225472 EngTurbo1TurbineIntakeTemp 1180;
BA_ "SigType" SG_ 3221225472 EngTurbo1TurbineIntakeTemp 1;
BA_ "SPN" SG_ 3221225472 EngTurbo4CompressorIntakePress 1179;
BA_ "SigType" SG_ 3221225472 EngTurbo4CompressorIntakePress 1;
BA_ "SPN" SG_ 3221225472 EngTurbo3CompressorIntakePress 1178;
BA_ "SigType" SG_ 3221225472 EngTurbo3CompressorIntakePress 1;
BA_ "SPN" SG_ 3221225472 EngTurbo2CompressorIntakePress 1177;
BA_ "SigType" SG_ 3221225472 EngTurbo2CompressorIntakePress 1;
BA_ "SPN" SG_ 3221225472 EngTurbo1CompressorIntakePress 1176;
BA_ "SigType" SG_ 3221225472 EngTurbo1CompressorIntakePress 1;
BA_ "SPN" SG_ 3221225472 EngTurbo4CompressorIntakeTemp 1175;
BA_ "SigType" SG_ 3221225472 EngTurbo4CompressorIntakeTemp 1;
BA_ "SPN" SG_ 3221225472 EngTurbo3CompressorIntakeTemp 1174;
BA_ "SigType" SG_ 3221225472 EngTurbo3CompressorIntakeTemp 1;
BA_ "SPN" SG_ 3221225472 EngTurbo2CompressorIntakeTemp 1173;
BA_ "SigType" SG_ 3221225472 EngTurbo2CompressorIntakeTemp 1;
BA_ "SPN" SG_ 3221225472 EngTurbo1CompressorIntakeTemp 1172;
BA_ "SigType" SG_ 3221225472 EngTurbo1CompressorIntakeTemp 1;
BA_ "SPN" SG_ 3221225472 EngTurbo4Speed 1171;
BA_ "SigType" SG_ 3221225472 EngTurbo4Speed 1;
BA_ "SPN" SG_ 3221225472 EngTurbo3Speed 1170;
BA_ "SigType" SG_ 3221225472 EngTurbo3Speed 1;
BA_ "SPN" SG_ 3221225472 EngTurbo2Speed 1169;
BA_ "SigType" SG_ 3221225472 EngTurbo2Speed 1;
BA_ "SPN" SG_ 3221225472 EngTurboLubeOilPress2 1168;
BA_ "SigType" SG_ 3221225472 EngTurboLubeOilPress2 1;
BA_ "SPN" SG_ 3221225472 TransTorqueLimit 1845;
BA_ "SigType" SG_ 3221225472 TransTorqueLimit 1;
BA_ "SPN" SG_ 3221225472 TransGearRatio 581;
BA_ "SigType" SG_ 3221225472 TransGearRatio 1;
BA_ "SPN" SG_ 3221225472 NumberOfForwardGearRatios 957;
BA_ "SigType" SG_ 3221225472 NumberOfForwardGearRatios 1;
BA_ "SPN" SG_ 3221225472 NumberOfReverseGearRatios 958;
BA_ "SigType" SG_ 3221225472 NumberOfReverseGearRatios 1;
BA_ "SPN" SG_ 3221225472 AutoNeutralReq 7695;
BA_ "SigType" SG_ 3221225472 AutoNeutralReq 5;
BA_ "SPN" SG_ 3221225472 TransMode8 4249;
BA_ "SigType" SG_ 3221225472 TransMode8 5;
BA_ "SPN" SG_ 3221225472 TransMode7 4248;
BA_ "SigType" SG_ 3221225472 TransMode7 5;
BA_ "SPN" SG_ 3221225472 TransMode6 4247;
BA_ "SigType" SG_ 3221225472 TransMode6 5;
BA_ "SPN" SG_ 3221225472 TransMode5 4246;
BA_ "SigType" SG_ 3221225472 TransMode5 5;
BA_ "SPN" SG_ 3221225472 TrnsShftSlectorDisplayModeSwitch 2985;
BA_ "SigType" SG_ 3221225472 TrnsShftSlectorDisplayModeSwitch 4;
BA_ "SPN" SG_ 3221225472 TransRequestedLaunchGear 4255;
BA_ "SPN" SG_ 3221225472 TransMode4 1855;
BA_ "SigType" SG_ 3221225472 TransMode4 5;
BA_ "SPN" SG_ 3221225472 TransMode3 1854;
BA_ "SigType" SG_ 3221225472 TransMode3 5;
BA_ "SPN" SG_ 3221225472 TransMode2 1853;
BA_ "SigType" SG_ 3221225472 TransMode2 5;
BA_ "SPN" SG_ 3221225472 TransMode1 1852;
BA_ "SigType" SG_ 3221225472 TransMode1 5;
BA_ "SPN" SG_ 3221225472 TransLoadReductionInhibitRq 5762;
BA_ "SigType" SG_ 3221225472 TransLoadReductionInhibitRq 5;
BA_ "SPN" SG_ 3221225472 DisengageDiffLockRqCentralRear 691;
BA_ "SigType" SG_ 3221225472 DisengageDiffLockRqCentralRear 5;
BA_ "SPN" SG_ 3221225472 DisengageDiffLockRqCentralFront 690;
BA_ "SigType" SG_ 3221225472 DisengageDiffLockRqCentralFront 5;
BA_ "SPN" SG_ 3221225472 DisengageDiffLockRqCentral 689;
BA_ "SigType" SG_ 3221225472 DisengageDiffLockRqCentral 5;
BA_ "SPN" SG_ 3221225472 DisengageDiffLockRqRearAxle2 688;
BA_ "SigType" SG_ 3221225472 DisengageDiffLockRqRearAxle2 5;
BA_ "SPN" SG_ 3221225472 DisengageDiffLockRqRearAxle1 687;
BA_ "SigType" SG_ 3221225472 DisengageDiffLockRqRearAxle1 5;
BA_ "SPN" SG_ 3221225472 DisengageDiffLockRqFrontAxle2 686;
BA_ "SigType" SG_ 3221225472 DisengageDiffLockRqFrontAxle2 5;
BA_ "SPN" SG_ 3221225472 DisengageDiffLockRqFrontAxle1 685;
BA_ "SigType" SG_ 3221225472 DisengageDiffLockRqFrontAxle1 5;
BA_ "SPN" SG_ 3221225472 TransRequestedGear 525;
BA_ "GenSigStartValue" SG_ 3221225472 TransRequestedGear 61;
BA_ "SigType" SG_ 3221225472 TransRequestedGear 1;
BA_ "SPN" SG_ 3221225472 RequestedPercentClutchSlip 684;
BA_ "SigType" SG_ 3221225472 RequestedPercentClutchSlip 1;
BA_ "SPN" SG_ 3221225472 TransReverseGearShiftInhibitRq 4242;
BA_ "SigType" SG_ 3221225472 TransReverseGearShiftInhibitRq 5;
BA_ "SPN" SG_ 3221225472 DisengageDrivelineRq 683;
BA_ "SigType" SG_ 3221225472 DisengageDrivelineRq 5;
BA_ "SPN" SG_ 3221225472 TrnsTrqeConverterLockupDisableRq 682;
BA_ "SigType" SG_ 3221225472 TrnsTrqeConverterLockupDisableRq 5;
BA_ "SPN" SG_ 3221225472 TransGearShiftInhibitRq 681;
BA_ "SigType" SG_ 3221225472 TransGearShiftInhibitRq 5;
BA_ "SPN" SG_ 3221225472 EngTurboOilLevelSwitch 1665;
BA_ "SigType" SG_ 3221225472 EngTurboOilLevelSwitch 4;
BA_ "SPN" SG_ 3221225472 EngTurbo1Speed 103;
BA_ "SigType" SG_ 3221225472 EngTurbo1Speed 1;
BA_ "SPN" SG_ 3221225472 EngTurboLubeOilPress1 104;
BA_ "SigType" SG_ 3221225472 EngTurboLubeOilPress1 1;
BA_ "SPN" SG_ 3221225472 EngTurboDiffSpeed 5980;
BA_ "SigType" SG_ 3221225472 EngTurboDiffSpeed 1;
BA_ "SPN" SG_ 3221225472 EngTotalAverageFuelEconomy 1835;
BA_ "SigType" SG_ 3221225472 EngTotalAverageFuelEconomy 1;
BA_ "SPN" SG_ 3221225472 EngTotalAverageFuelRate 1834;
BA_ "SigType" SG_ 3221225472 EngTotalAverageFuelRate 1;
BA_ "SPN" SG_ 3221225472 PwertrainCircuitAirSupplyPressRq 6306;
BA_ "SigType" SG_ 3221225472 PwertrainCircuitAirSupplyPressRq 1;
BA_ "SPN" SG_ 3221225472 AirSuspensionSupplyPressRq 2608;
BA_ "SigType" SG_ 3221225472 AirSuspensionSupplyPressRq 1;
BA_ "SPN" SG_ 3221225472 AuxEquipmentSupplyPressRq 2607;
BA_ "SigType" SG_ 3221225472 AuxEquipmentSupplyPressRq 1;
BA_ "SPN" SG_ 3221225472 ServiceBrakeAirPressRqCircuit2 2606;
BA_ "SigType" SG_ 3221225472 ServiceBrakeAirPressRqCircuit2 1;
BA_ "SPN" SG_ 3221225472 ServiceBrakeAirPressRqCircuit1 2605;
BA_ "SigType" SG_ 3221225472 ServiceBrakeAirPressRqCircuit1 1;
BA_ "SPN" SG_ 3221225472 ParkingAnd_orTrailerAirPressRq 2604;
BA_ "SigType" SG_ 3221225472 ParkingAnd_orTrailerAirPressRq 1;
BA_ "SPN" SG_ 3221225472 PneumaticSupplyPressRq 2603;
BA_ "SigType" SG_ 3221225472 PneumaticSupplyPressRq 1;
BA_ "SPN" SG_ 3221225472 EngExtlShutdownAirSupplyPress 1320;
BA_ "SigType" SG_ 3221225472 EngExtlShutdownAirSupplyPress 1;
BA_ "SPN" SG_ 3221225472 NmbrOfSftwreIdentificationFields 965;
BA_ "SigType" SG_ 3221225472 NmbrOfSftwreIdentificationFields 1;
BA_ "SPN" SG_ 3221225472 SoftwareIdentification 234;
BA_ "SigType" SG_ 3221225472 SoftwareIdentification 8;
BA_ "SPN" SG_ 3221225472 ClntLvlEngPrtctionShutdownStatus 5566;
BA_ "SigType" SG_ 3221225472 ClntLvlEngPrtctionShutdownStatus 5;
BA_ "SPN" SG_ 3221225472 PTOShutdownHasShutdownEng 5404;
BA_ "SigType" SG_ 3221225472 PTOShutdownHasShutdownEng 5;
BA_ "SPN" SG_ 3221225472 EngAirShutoffStatus 3667;
BA_ "SigType" SG_ 3221225472 EngAirShutoffStatus 5;
BA_ "SPN" SG_ 3221225472 EngOverspeedTest 2812;
BA_ "SigType" SG_ 3221225472 EngOverspeedTest 4;
BA_ "SPN" SG_ 3221225472 EngAirShutoffCmdStatus 2813;
BA_ "SigType" SG_ 3221225472 EngAirShutoffCmdStatus 5;
BA_ "SPN" SG_ 3221225472 EngAlarmOutputCmdStatus 2814;
BA_ "SigType" SG_ 3221225472 EngAlarmOutputCmdStatus 5;
BA_ "SPN" SG_ 3221225472 EngAlarmAcknowledge 2815;
BA_ "SigType" SG_ 3221225472 EngAlarmAcknowledge 4;
BA_ "SPN" SG_ 3221225472 EngProtectionSystemConfig 1111;
BA_ "SigType" SG_ 3221225472 EngProtectionSystemConfig 5;
BA_ "SPN" SG_ 3221225472 EngProtectionSystemTimerState 1107;
BA_ "SigType" SG_ 3221225472 EngProtectionSystemTimerState 5;
BA_ "SPN" SG_ 3221225472 EngProtectionSystemTimerOverride 1108;
BA_ "SigType" SG_ 3221225472 EngProtectionSystemTimerOverride 5;
BA_ "SPN" SG_ 3221225472 EngPrtctnSystmApprachingShutdown 1109;
BA_ "SigType" SG_ 3221225472 EngPrtctnSystmApprachingShutdown 5;
BA_ "SPN" SG_ 3221225472 EngPrtectionSystemHasShutdownEng 1110;
BA_ "SigType" SG_ 3221225472 EngPrtectionSystemHasShutdownEng 5;
BA_ "SPN" SG_ 3221225472 EngWaitToStartLamp 1081;
BA_ "SigType" SG_ 3221225472 EngWaitToStartLamp 5;
BA_ "SPN" SG_ 3221225472 RefrigerantHighPressSwitch 605;
BA_ "SigType" SG_ 3221225472 RefrigerantHighPressSwitch 4;
BA_ "SPN" SG_ 3221225472 RefrigerantLowPressSwitch 875;
BA_ "SigType" SG_ 3221225472 RefrigerantLowPressSwitch 4;
BA_ "SPN" SG_ 3221225472 A_CHighPressFanSwitch 985;
BA_ "SigType" SG_ 3221225472 A_CHighPressFanSwitch 4;
BA_ "SPN" SG_ 3221225472 EngIdleShutdownTimerFunction 591;
BA_ "SigType" SG_ 3221225472 EngIdleShutdownTimerFunction 4;
BA_ "SPN" SG_ 3221225472 EngIdleShutdownTimerState 590;
BA_ "SigType" SG_ 3221225472 EngIdleShutdownTimerState 5;
BA_ "SPN" SG_ 3221225472 EngIdleShutdownTimerOverride 592;
BA_ "SigType" SG_ 3221225472 EngIdleShutdownTimerOverride 5;
BA_ "SPN" SG_ 3221225472 EngIdleShutdownDriverAlertMode 594;
BA_ "SigType" SG_ 3221225472 EngIdleShutdownDriverAlertMode 5;
BA_ "SPN" SG_ 3221225472 EngIdleShutdownHasShutdownEng 593;
BA_ "SigType" SG_ 3221225472 EngIdleShutdownHasShutdownEng 5;
BA_ "SPN" SG_ 3221225472 ArbitraryAddressCapable 2844;
BA_ "SPN" SG_ 3221225472 IndustryGroup 2846;
BA_ "SPN" SG_ 3221225472 VehicleSystemInstance 2843;
BA_ "SPN" SG_ 3221225472 ECUInstance 2840;
BA_ "SPN" SG_ 3221225472 FunctionInstance 2839;
BA_ "SPN" SG_ 3221225472 Function 2841;
BA_ "SPN" SG_ 3221225472 ManufacturerCode 2838;
BA_ "SPN" SG_ 3221225472 IdentityNumber 2837;
BA_ "SPN" SG_ 3221225472 SrviceDelay_OperationalTimeBased 916;
BA_ "SigType" SG_ 3221225472 SrviceDelay_OperationalTimeBased 1;
BA_ "SPN" SG_ 3221225472 ServiceComponentIdentificatio913 913;
BA_ "SigType" SG_ 3221225472 ServiceComponentIdentificatio913 1;
BA_ "SPN" SG_ 3221225472 ServiceDelay_CalendarTimeBased 915;
BA_ "SigType" SG_ 3221225472 ServiceDelay_CalendarTimeBased 1;
BA_ "SPN" SG_ 3221225472 ServiceComponentIdentificatio912 912;
BA_ "SigType" SG_ 3221225472 ServiceComponentIdentificatio912 1;
BA_ "SPN" SG_ 3221225472 ServiceDistance 914;
BA_ "SigType" SG_ 3221225472 ServiceDistance 1;
BA_ "SPN" SG_ 3221225472 ServiceComponentIdentification 911;
BA_ "SigType" SG_ 3221225472 ServiceComponentIdentification 1;
BA_ "SPN" SG_ 3221225472 TimeSinceLastService 1350;
BA_ "SigType" SG_ 3221225472 TimeSinceLastService 1;
BA_ "SPN" SG_ 3221225472 ServiceComponentIdentification 1379;
BA_ "SigType" SG_ 3221225472 ServiceComponentIdentification 1;
BA_ "SPN" SG_ 3221225472 MinContinuousRetarderTorque 1783;
BA_ "SigType" SG_ 3221225472 MinContinuousRetarderTorque 1;
BA_ "SPN" SG_ 3221225472 MaxContinuousRetarderTorque 1782;
BA_ "SigType" SG_ 3221225472 MaxContinuousRetarderTorque 1;
BA_ "SPN" SG_ 3221225472 MinContinuousRetarderSpeed 1781;
BA_ "SigType" SG_ 3221225472 MinContinuousRetarderSpeed 1;
BA_ "SPN" SG_ 3221225472 MaxContinuousRetarderSpeed 1780;
BA_ "SigType" SG_ 3221225472 MaxContinuousRetarderSpeed 1;
BA_ "SPN" SG_ 3221225472 HghLmtThrshldFrMnCntnsTrqFrmRtrd 1779;
BA_ "SigType" SG_ 3221225472 HghLmtThrshldFrMnCntnsTrqFrmRtrd 1;
BA_ "SPN" SG_ 3221225472 LwLmtThrshldFrMxTrqeFromRetarder 1778;
BA_ "SigType" SG_ 3221225472 LwLmtThrshldFrMxTrqeFromRetarder 1;
BA_ "SPN" SG_ 3221225472 HghLmtThrshldFrMnCntnsRPMFrmRtrd 1777;
BA_ "SigType" SG_ 3221225472 HghLmtThrshldFrMnCntnsRPMFrmRtrd 1;
BA_ "SPN" SG_ 3221225472 LwLmtThrshldFrMaxRPMFromRetarder 1776;
BA_ "SigType" SG_ 3221225472 LwLmtThrshldFrMaxRPMFromRetarder 1;
BA_ "SPN" SG_ 3221225472 DrvlineRetarderOverheatIndicator 5346;
BA_ "SigType" SG_ 3221225472 DrvlineRetarderOverheatIndicator 5;
BA_ "SPN" SG_ 3221225472 RetarderCoolantOutletTemp 5656;
BA_ "SigType" SG_ 3221225472 RetarderCoolantOutletTemp 1;
BA_ "SPN" SG_ 3221225472 HydRetarderOilTemp 120;
BA_ "SigType" SG_ 3221225472 HydRetarderOilTemp 1;
BA_ "SPN" SG_ 3221225472 HydRetarderPress 119;
BA_ "SigType" SG_ 3221225472 HydRetarderPress 1;
BA_ "SPN" SG_ 3221225472 SteerStraightAheadPosReset 3600;
BA_ "SigType" SG_ 3221225472 SteerStraightAheadPosReset 5;
BA_ "SPN" SG_ 3221225472 EngBuildHoursReset 1211;
BA_ "SigType" SG_ 3221225472 EngBuildHoursReset 5;
BA_ "SPN" SG_ 3221225472 EngIgntCtrlMaintenanceHoursReset 6219;
BA_ "SigType" SG_ 3221225472 EngIgntCtrlMaintenanceHoursReset 4;
BA_ "SPN" SG_ 3221225472 EngSprkPlgScndVltgeTrackingReset 6218;
BA_ "SigType" SG_ 3221225472 EngSprkPlgScndVltgeTrackingReset 5;
BA_ "SPN" SG_ 3221225472 ServiceComponentIdentification 1584;
BA_ "SigType" SG_ 3221225472 ServiceComponentIdentification 1;
BA_ "SPN" SG_ 3221225472 TripGroup2Proprietary 989;
BA_ "SigType" SG_ 3221225472 TripGroup2Proprietary 5;
BA_ "SPN" SG_ 3221225472 TireSensorInformation 6986;
BA_ "SigType" SG_ 3221225472 TireSensorInformation 4;
BA_ "SPN" SG_ 3221225472 TireConfigInformation 6985;
BA_ "SigType" SG_ 3221225472 TireConfigInformation 4;
BA_ "SPN" SG_ 3221225472 BinLiftCountReset 6898;
BA_ "SigType" SG_ 3221225472 BinLiftCountReset 4;
BA_ "SPN" SG_ 3221225472 TripGroup1 988;
BA_ "SigType" SG_ 3221225472 TripGroup1 5;
BA_ "SPN" SG_ 3221225472 PercentTorqueAtPeakTorquePoint5 555;
BA_ "SigType" SG_ 3221225472 PercentTorqueAtPeakTorquePoint5 1;
BA_ "SPN" SG_ 3221225472 RetarderSpeedAtPeakTorquePoint5 547;
BA_ "SigType" SG_ 3221225472 RetarderSpeedAtPeakTorquePoint5 1;
BA_ "SPN" SG_ 3221225472 PercentTorqueAtPoint4 554;
BA_ "SigType" SG_ 3221225472 PercentTorqueAtPoint4 1;
BA_ "SPN" SG_ 3221225472 RetarderSpeedAtPoint4 550;
BA_ "SigType" SG_ 3221225472 RetarderSpeedAtPoint4 1;
BA_ "SPN" SG_ 3221225472 PercentTorqueAtPoint3 553;
BA_ "SigType" SG_ 3221225472 PercentTorqueAtPoint3 1;
BA_ "SPN" SG_ 3221225472 RetarderSpeedAtPoint3 549;
BA_ "SigType" SG_ 3221225472 RetarderSpeedAtPoint3 1;
BA_ "SPN" SG_ 3221225472 PercentTorqueAtMaxSpeedPoint2 552;
BA_ "SigType" SG_ 3221225472 PercentTorqueAtMaxSpeedPoint2 1;
BA_ "SPN" SG_ 3221225472 MaxRetarderSpeedPoint2 548;
BA_ "SigType" SG_ 3221225472 MaxRetarderSpeedPoint2 1;
BA_ "SPN" SG_ 3221225472 PercentTorqueAtIdlePoint1 551;
BA_ "SigType" SG_ 3221225472 PercentTorqueAtIdlePoint1 1;
BA_ "SPN" SG_ 3221225472 RetarderSpeedAtIdlePoint1 546;
BA_ "SigType" SG_ 3221225472 RetarderSpeedAtIdlePoint1 1;
BA_ "SPN" SG_ 3221225472 RetarderCtrlMethod 557;
BA_ "SigType" SG_ 3221225472 RetarderCtrlMethod 1;
BA_ "SPN" SG_ 3221225472 RetarderLocation 902;
BA_ "SPN" SG_ 3221225472 RetarderType 901;
BA_ "SPN" SG_ 3221225472 EngOperationTimeSinceRebuild 1193;
BA_ "SigType" SG_ 3221225472 EngOperationTimeSinceRebuild 1;
BA_ "SPN" SG_ 3221225472 PowerTakeoffSetSpeed 187;
BA_ "SigType" SG_ 3221225472 PowerTakeoffSetSpeed 1;
BA_ "SPN" SG_ 3221225472 PowerTakeoffSpeed 186;
BA_ "SigType" SG_ 3221225472 PowerTakeoffSpeed 1;
BA_ "SPN" SG_ 3221225472 PowerTakeoffOilTemp 90;
BA_ "SigType" SG_ 3221225472 PowerTakeoffOilTemp 1;
BA_ "SPN" SG_ 3221225472 OprtrEngPTOGvrnrMmrySelectSwitch 2897;
BA_ "SigType" SG_ 3221225472 OprtrEngPTOGvrnrMmrySelectSwitch 4;
BA_ "SPN" SG_ 3221225472 EngRmtPTOGvrnrVrblSpedCtrlSwitch 978;
BA_ "SigType" SG_ 3221225472 EngRmtPTOGvrnrVrblSpedCtrlSwitch 4;
BA_ "SPN" SG_ 3221225472 EngRmtPTOGvrnrPrprgrmmdSpdCtrlSw 979;
BA_ "SigType" SG_ 3221225472 EngRmtPTOGvrnrPrprgrmmdSpdCtrlSw 4;
BA_ "SPN" SG_ 3221225472 EngPTOGvrnrCast_DecelerateSwitch 983;
BA_ "SigType" SG_ 3221225472 EngPTOGvrnrCast_DecelerateSwitch 4;
BA_ "SPN" SG_ 3221225472 ArbitraryAddressCapable 2844;
BA_ "SPN" SG_ 3221225472 IndustryGroup 2846;
BA_ "SPN" SG_ 3221225472 VehicleSystemInstance 2843;
BA_ "SPN" SG_ 3221225472 Function 2841;
BA_ "SPN" SG_ 3221225472 FunctionInstance 2839;
BA_ "SPN" SG_ 3221225472 ECUInstance 2840;
BA_ "SPN" SG_ 3221225472 ManufacturerCode 2838;
BA_ "SPN" SG_ 3221225472 IdentityNumber 2837;
BA_ "SPN" SG_ 3221225472 ArbitraryAddressCapable 2844;
BA_ "SPN" SG_ 3221225472 IndustryGroup 2846;
BA_ "SPN" SG_ 3221225472 VehicleSystemInstance 2843;
BA_ "SPN" SG_ 3221225472 Function 2841;
BA_ "SPN" SG_ 3221225472 FunctionInstance 2839;
BA_ "SPN" SG_ 3221225472 ECUInstance 2840;
BA_ "SPN" SG_ 3221225472 ManufacturerCode 2838;
BA_ "SPN" SG_ 3221225472 IdentityNumber 2837;
VAL_ 3221225472 SteerWheelAngleSensorType 3 "Not Available" 2 "Reserved" 1 "Absolute measuring principle" 0 "Relative measuring principle" ;
VAL_ 3221225472 TrailerVDCActive 3 "Not availble or not installed" 2 "Reserved" 1 "VDC active" 0 "VDC passive" ;
VAL_ 3221225472 YCBrakeCtrlActive 3 "Don't care/Take no action" 2 "Reserved" 1 "YC brake control active" 0 "YC brake control passive but installed" ;
VAL_ 3221225472 YCEngCtrlActive 3 "Don't care/Take no action" 2 "Reserved" 1 "YC engine control active" 0 "YC engine control passive but installed" ;
VAL_ 3221225472 ROPBrakeCtrlActive 3 "Don't care/Take no action" 2 "Reserved" 1 "ROP brake control active" 0 "ROP brake control passive but installed" ;
VAL_ 3221225472 ROPEngCtrlActive 3 "Don't care/Take no action" 2 "Reserved" 1 "ROP engine control active" 0 "ROP engine control passive but installed" ;
VAL_ 3221225472 VDCBrakeLightRq 3 "Don't care/Take no action" 2 "Reserved" 1 "Turn brake light on" 0 "Turn brake light not on" ;
VAL_ 3221225472 VDCFullyOperational 3 "Don't care/Take no action" 2 "Reserved" 1 "Fully operational" 0 "Not fully operational" ;
VAL_ 3221225472 VDCInformationSignal 3 "Don't care/Take no action" 2 "Reserved" 1 "On" 0 "Off" ;
VAL_ 3221225472 EngRequestedTorqueHighResolution 7 "+0.875%" 1 "+0.125%" 0 "+0.000%" ;
VAL_ 3221225472 TSC1CtrlPurpose 31 "P32 = Temporary PWT Control" 4 "P5 = Engine Protection" 3 "P4 = Road Speed Governor" 2 "P3 = PTO Governor" 1 "P2 = Cruise Control" 0 "P1 = Accel Pedal/Operator Select" ;
VAL_ 3221225472 TSC1TransRate 4 "100 ms transmission rate" 3 "250 ms transmission rate" 2 "500 ms transmission rate" 1 "750 ms transmission rate" 0 "1000 ms transmission rate" 7 "TSC1 rates of 10 ms to eng" 6 "20 ms transmission rate" 5 "50 ms transmission rate" ;
VAL_ 3221225472 OverrideCtrlModePriority 3 "Low priority" 2 "Medium priority" 1 "High priority" 0 "Highest priority" ;
VAL_ 3221225472 EngRequestedSpeedCtrlConditions 3 "Stability Opt and/or lockup c2" 2 "Stability Opt and/or lockup c1" 1 "Stability Opt non-lockup cond" 0 "Transient Opt non-lockup cond" ;
VAL_ 3221225472 EngOverrideCtrlMode 3 "Speed/torque limit control" 2 "Torque control" 1 "Speed control" 0 "Override disabled" ;
VAL_ 3221225472 TransitRunStatus 3 "Not available" 2 "Error condition" 0 "Off" ;
VAL_ 3221225472 VehicleUseStatus 3 "Not available" 2 "Error condition" 1 "Unauthorized use" 0 "Normal use" ;
VAL_ 3221225472 SilentAlarmStatus 3 "Not available" 2 "Error condition" 1 "On" 0 "Off" ;
VAL_ 3221225472 TypeOfPassengerCount 255 "not available" 254 "error indicator" 4 "exiting passenger, second passenger stream)" 3 "boarding passenger, second passenger stream)" 2 "exiting passenger" 1 "boarding passenger" 0 "absolute passenger count" ;
VAL_ 3221225472 FareboxAlarmIdentifier 25 "Maintenance access out of service" 24 "Maintenance access in service considered an alarm condition" 23 "Paper currency jam cleared" 22 "Paper currency jam" 21 "Pass/transfer jam cleared" 20 "Pass/transfer jam" 19 "Farebox reset to automatic mode" 18 "Farebox set in manual bypass" 17 "Coin dejam operated" 16 "Card/pass box full" 15 "Card/pass box less than 75 full" 14 "Card/pass box 75 full" 13 "Currency box full" 12 "Currency box less than 75 full" 11 "Currency box 75 full" 10 "Coinbox full" 9 "Coinbox 75 full" 8 "Insufficient fare accepted" 7 "Cashbox opened in service considered an alarm condition" 6 "Cashbox door timeout" 5 "Cashbox restored" 4 "Cashbox removed" 3 "Probe completed" 2 "Probe started" 1 "Voltage restored" 0 "Voltage dropout" ;
VAL_ 3221225472 FareboxEmergencyStatus 3 "Not available" 2 "Error Condition" 1 "Emergency condition" 0 "Non-emergency condition" ;
VAL_ 3221225472 TransferType 5 "Out" 4 "In" 3 "West" 2 "East" 1 "South" 0 "North" ;
VAL_ 3221225472 TypeOfService 1 "Express service" 0 "Local service" ;
VAL_ 3221225472 PaymentDetails 5 "Card" 4 "Pass" 3 "Ticket" 2 "Token" 1 "Cash" 0 "Not an upgrade" ;
VAL_ 3221225472 TypeOfFare 6 "Pass B" 5 "Pass A" 4 "Ticket B" 3 "Ticket A" 2 "Token B" 1 "Token A" 0 "Cash/No detail" ;
VAL_ 3221225472 TransactionType 7 "Free" 6 "Transfer" 5 "Permit" 4 "Card" 3 "Pass" 2 "Ticket" 1 "Token" 0 "Cash" ;
VAL_ 3221225472 TripDirection 5 "Out" 4 "In" 3 "West" 2 "East" 1 "South" 0 "North" ;
VAL_ 3221225472 TripStatus 7 "Undefined" 6 "Layover end" 5 "Layover start" 4 "Undefined" 3 "Undefined" 2 "Trip end" 1 "Trip start" 0 "Undefined" ;
VAL_ 3221225472 FareboxServiceStatus 3 "Not available" 2 "Error Condition" 1 "Farebox in service" 0 "Farebox out of service" ;
VAL_ 3221225472 StrobeActivationCtrlStatus 3 "Not available" 2 "Error condition" 1 "Activate strobe" 0 "Deactivate strobe" ;
VAL_ 3221225472 TransitDoorEnable 3 "Not available" 2 "Error condition" 1 "Transit door status will override strobe activation" 0 "Ignore transit door status" ;
VAL_ 3221225472 PriorityOfRespSentByEmitter 15 "- Not available" 14 "- Error condition" 11 "- Priority set by hardware to high priority" 10 "- Priority set by hardware to probe priority" 9 "- Priority set by hardware to low priority" 3 "- High priority" 2 "- Probe priority" 1 "- Low priority" 0 "- Reserved" ;
VAL_ 3221225472 IntrsctnPrmptionRequest_Response 3 "Not available" 2 "Error condition" 1 "Message is a response from the emitter" 0 "Message is a request directed to the emitter" ;
VAL_ 3221225472 TransitRouteIDUsage 3 "Not available" 2 "Error condition" 1 "Transit route ID used for interleaved data" 0 "Transit route ID not used for interleaved data" ;
VAL_ 3221225472 RangeCodeEnable 3 "Not available" 2 "Error condition" 1 "Range code used for interleaved data" 0 "Range code not used for interleaved data" ;
VAL_ 3221225472 PCUTrilerTagOrPushSolenoidStatus 3 "Not Available" 2 "Error" 1 "On" 0 "Off" ;
VAL_ 3221225472 PCUSupplySolenoidStatus 3 "Not Available" 2 "Error" 1 "On" 0 "Off" ;
VAL_ 3221225472 PCUCtrlSolenoidStatus 3 "Not Available" 2 "Error" 1 "On" 0 "Off" ;
VAL_ 3221225472 PCUDeflateSolenoidStatus 3 "Not Available" 2 "Error" 1 "On" 0 "Off" ;
VAL_ 3221225472 TirePressSupplySwitchStatus 3 "Not Available" 2 "Error" 1 "On" 0 "Off" ;
VAL_ 3221225472 PCUSteerSolenoidStatus 3 "Not Available" 2 "Error" 1 "On" 0 "Off" ;
VAL_ 3221225472 PCUDriveSolenoidStatus 3 "Not Available" 2 "Error" 1 "On" 0 "Off" ;
VAL_ 3221225472 DriveChannelMode 15 "Not available" 14 "Error Condition" 6 "Pressure Check" 5 "Deflate Wait" 4 "Inflate Wait" 3 "Confirm" 2 "Deflate" 1 "Inflate" 0 "Maintain" ;
VAL_ 3221225472 Trailer_tagChannelMode 15 "Not available" 14 "Error Condition" 6 "Pressure Check" 5 "Deflate Wait" 4 "Inflate Wait" 3 "Confirm" 2 "Deflate" 1 "Inflate" 0 "Maintain" ;
VAL_ 3221225472 SteerChannelMode 1 "Inflate" 0 "Maintain" 15 "Not available" 14 "Error Condition" 6 "Pressure Check" 5 "Deflate Wait" 4 "Inflate Wait" 3 "Confirm" 2 "Deflate" ;
VAL_ 3221225472 ExTirePressSupport 3 "Not Available/Not Supported" 2 "Error" 1 "Using Extended Tire Pressure" 0 "Not Using Extended Tire Pressure" ;
VAL_ 3221225472 TirePressThresholdDetection_13 7 "NotAvailable" 6 "ErrorIndicator" 5 "NotDefined" 4 "ExtrmUndrPrssTrPrssrIsAtALvlWhr" 3 "UndrPrssTrPrssrIsLwrThnThPrssrD" 2 "NWrnngPrssTrPrssrIsWthnThThrshl" 1 "OvrPrssTrPrssrIsHghrThnThPrssrD" 0 "ExtrmOvrPrssTrPrssrIsAtALvlWhrT" ;
VAL_ 3221225472 TirePressThresholdDetection_12 7 "NotAvailable" 6 "ErrorIndicator" 5 "NotDefined" 4 "ExtrmUndrPrssTrPrssrIsAtALvlWhr" 3 "UndrPrssTrPrssrIsLwrThnThPrssrD" 2 "NWrnngPrssTrPrssrIsWthnThThrshl" 1 "OvrPrssTrPrssrIsHghrThnThPrssrD" 0 "ExtrmOvrPrssTrPrssrIsAtALvlWhrT" ;
VAL_ 3221225472 TirePressThresholdDetection_11 7 "NotAvailable" 6 "ErrorIndicator" 5 "NotDefined" 4 "ExtrmUndrPrssTrPrssrIsAtALvlWhr" 3 "UndrPrssTrPrssrIsLwrThnThPrssrD" 2 "NWrnngPrssTrPrssrIsWthnThThrshl" 1 "OvrPrssTrPrssrIsHghrThnThPrssrD" 0 "ExtrmOvrPrssTrPrssrIsAtALvlWhrT" ;
VAL_ 3221225472 TirePressThresholdDetection_10 7 "NotAvailable" 6 "ErrorIndicator" 5 "NotDefined" 4 "ExtrmUndrPrssTrPrssrIsAtALvlWhr" 3 "UndrPrssTrPrssrIsLwrThnThPrssrD" 2 "NWrnngPrssTrPrssrIsWthnThThrshl" 1 "OvrPrssTrPrssrIsHghrThnThPrssrD" 0 "ExtrmOvrPrssTrPrssrIsAtALvlWhrT" ;
VAL_ 3221225472 TirePressThresholdDetection_01 7 "NotAvailable" 6 "ErrorIndicator" 5 "NotDefined" 4 "ExtrmUndrPrssTrPrssrIsAtALvlWhr" 3 "UndrPrssTrPrssrIsLwrThnThPrssrD" 2 "NWrnngPrssTrPrssrIsWthnThThrshl" 1 "OvrPrssTrPrssrIsHghrThnThPrssrD" 0 "ExtrmOvrPrssTrPrssrIsAtALvlWhrT" ;
VAL_ 3221225472 CTIWheelSensorStatus_33 3 "NotSupported" 2 "NotDefined" 1 "On" 0 "Off_IsolatedFromCTIPressCtrl" ;
VAL_ 3221225472 CTIWheelSensorStatus_32 3 "NotSupported" 2 "NotDefined" 1 "On" 0 "Off_IsolatedFromCTIPressCtrl" ;
VAL_ 3221225472 CTIWheelSensorStatus_31 3 "NotSupported" 2 "NotDefined" 1 "On" 0 "Off_IsolatedFromCTIPressCtrl" ;
VAL_ 3221225472 CTIWheelSensorStatus_30 3 "NotSupported" 2 "NotDefined" 1 "On" 0 "Off_IsolatedFromCTIPressCtrl" ;
VAL_ 3221225472 CTIWheelSensorStatus_23 3 "NotSupported" 2 "NotDefined" 1 "On" 0 "Off_IsolatedFromCTIPressCtrl" ;
VAL_ 3221225472 CTIWheelSensorStatus_22 3 "NotSupported" 2 "NotDefined" 1 "On" 0 "Off_IsolatedFromCTIPressCtrl" ;
VAL_ 3221225472 CTIWheelSensorStatus_21 3 "NotSupported" 2 "NotDefined" 1 "On" 0 "Off_IsolatedFromCTIPressCtrl" ;
VAL_ 3221225472 CTIWheelSensorStatus_20 3 "NotSupported" 2 "NotDefined" 1 "On" 0 "Off_IsolatedFromCTIPressCtrl" ;
VAL_ 3221225472 CTIWheelSensorStatus_13 3 "NotSupported" 2 "NotDefined" 1 "On" 0 "Off_IsolatedFromCTIPressCtrl" ;
VAL_ 3221225472 CTIWheelSensorStatus_12 3 "NotSupported" 2 "NotDefined" 1 "On" 0 "Off_IsolatedFromCTIPressCtrl" ;
VAL_ 3221225472 CTIWheelSensorStatus_11 3 "NotSupported" 2 "NotDefined" 1 "On" 0 "Off_IsolatedFromCTIPressCtrl" ;
VAL_ 3221225472 CTIWheelSensorStatus_10 3 "NotSupported" 2 "NotDefined" 1 "On" 0 "Off_IsolatedFromCTIPressCtrl" ;
VAL_ 3221225472 CTIWheelSensorStatus_01 3 "NotSupported" 2 "NotDefined" 1 "On" 0 "Off_IsolatedFromCTIPressCtrl" ;
VAL_ 3221225472 CTIWheelEndElectricalFault_33 3 "NotSupported" 2 "Error" 1 "NotDefined" 0 "Ok" ;
VAL_ 3221225472 CTIWheelEndElectricalFault_32 3 "NotSupported" 2 "Error" 1 "NotDefined" 0 "Ok" ;
VAL_ 3221225472 CTIWheelEndElectricalFault_31 3 "NotSupported" 2 "Error" 1 "NotDefined" 0 "Ok" ;
VAL_ 3221225472 CTIWheelEndElectricalFault_30 3 "NotSupported" 2 "Error" 1 "NotDefined" 0 "Ok" ;
VAL_ 3221225472 CTIWheelEndElectricalFault_23 3 "NotSupported" 2 "Error" 1 "NotDefined" 0 "Ok" ;
VAL_ 3221225472 CTIWheelEndElectricalFault_22 3 "NotSupported" 2 "Error" 1 "NotDefined" 0 "Ok" ;
VAL_ 3221225472 CTIWheelEndElectricalFault_21 3 "NotSupported" 2 "Error" 1 "NotDefined" 0 "Ok" ;
VAL_ 3221225472 CTIWheelEndElectricalFault_20 3 "NotSupported" 2 "Error" 1 "NotDefined" 0 "Ok" ;
VAL_ 3221225472 CTIWheelEndElectricalFault_13 3 "NotSupported" 2 "Error" 1 "NotDefined" 0 "Ok" ;
VAL_ 3221225472 CTIWheelEndElectricalFault_12 3 "NotSupported" 2 "Error" 1 "NotDefined" 0 "Ok" ;
VAL_ 3221225472 CTIWheelEndElectricalFault_11 3 "NotSupported" 2 "Error" 1 "NotDefined" 0 "Ok" ;
VAL_ 3221225472 CTIWheelEndElectricalFault_10 3 "NotSupported" 2 "Error" 1 "NotDefined" 0 "Ok" ;
VAL_ 3221225472 CTIWheelEndElectricalFault_01 3 "NotSupported" 2 "Error" 1 "NotDefined" 0 "Ok" ;
VAL_ 3221225472 CTITireStatus_33 3 "NotSupported" 2 "Error" 1 "TireLeakDetected" 0 "Ok" ;
VAL_ 3221225472 CTITireStatus_32 3 "NotSupported" 2 "Error" 1 "TireLeakDetected" 0 "Ok" ;
VAL_ 3221225472 CTITireStatus_31 3 "NotSupported" 2 "Error" 1 "TireLeakDetected" 0 "Ok" ;
VAL_ 3221225472 CTITireStatus_30 3 "NotSupported" 2 "Error" 1 "TireLeakDetected" 0 "Ok" ;
VAL_ 3221225472 CTITireStatus_23 3 "NotSupported" 2 "Error" 1 "TireLeakDetected" 0 "Ok" ;
VAL_ 3221225472 CTITireStatus_22 3 "NotSupported" 2 "Error" 1 "TireLeakDetected" 0 "Ok" ;
VAL_ 3221225472 CTITireStatus_21 3 "NotSupported" 2 "Error" 1 "TireLeakDetected" 0 "Ok" ;
VAL_ 3221225472 CTITireStatus_20 3 "NotSupported" 2 "Error" 1 "TireLeakDetected" 0 "Ok" ;
VAL_ 3221225472 CTITireStatus_13 3 "NotSupported" 2 "Error" 1 "TireLeakDetected" 0 "Ok" ;
VAL_ 3221225472 CTITireStatus_12 3 "NotSupported" 2 "Error" 1 "TireLeakDetected" 0 "Ok" ;
VAL_ 3221225472 CTITireStatus_11 3 "NotSupported" 2 "Error" 1 "TireLeakDetected" 0 "Ok" ;
VAL_ 3221225472 CTITireStatus_10 3 "NotSupported" 2 "Error" 1 "TireLeakDetected" 0 "Ok" ;
VAL_ 3221225472 CTITireStatus_01 3 "NotSupported" 2 "Error" 1 "TireLeakDetected" 0 "Ok" ;
VAL_ 3221225472 TirePressThresholdDetection_33 7 "NotAvailable" 6 "ErrorIndicator" 5 "NotDefined" 4 "ExtrmUndrPrssTrPrssrIsAtALvlWhr" 3 "UndrPrssTrPrssrIsLwrThnThPrssrD" 2 "NWrnngPrssTrPrssrIsWthnThThrshl" 1 "OvrPrssTrPrssrIsHghrThnThPrssrD" 0 "ExtrmOvrPrssTrPrssrIsAtALvlWhrT" ;
VAL_ 3221225472 TirePressThresholdDetection_32 7 "NotAvailable" 6 "ErrorIndicator" 5 "NotDefined" 4 "ExtrmUndrPrssTrPrssrIsAtALvlWhr" 3 "UndrPrssTrPrssrIsLwrThnThPrssrD" 2 "NWrnngPrssTrPrssrIsWthnThThrshl" 1 "OvrPrssTrPrssrIsHghrThnThPrssrD" 0 "ExtrmOvrPrssTrPrssrIsAtALvlWhrT" ;
VAL_ 3221225472 TirePressThresholdDetection_31 7 "NotAvailable" 6 "ErrorIndicator" 5 "NotDefined" 4 "ExtrmUndrPrssTrPrssrIsAtALvlWhr" 3 "UndrPrssTrPrssrIsLwrThnThPrssrD" 2 "NWrnngPrssTrPrssrIsWthnThThrshl" 1 "OvrPrssTrPrssrIsHghrThnThPrssrD" 0 "ExtrmOvrPrssTrPrssrIsAtALvlWhrT" ;
VAL_ 3221225472 TirePressThresholdDetection_30 7 "NotAvailable" 6 "ErrorIndicator" 5 "NotDefined" 4 "ExtrmUndrPrssTrPrssrIsAtALvlWhr" 3 "UndrPrssTrPrssrIsLwrThnThPrssrD" 2 "NWrnngPrssTrPrssrIsWthnThThrshl" 1 "OvrPrssTrPrssrIsHghrThnThPrssrD" 0 "ExtrmOvrPrssTrPrssrIsAtALvlWhrT" ;
VAL_ 3221225472 TirePressThresholdDetection_23 7 "NotAvailable" 6 "ErrorIndicator" 5 "NotDefined" 4 "ExtrmUndrPrssTrPrssrIsAtALvlWhr" 3 "UndrPrssTrPrssrIsLwrThnThPrssrD" 2 "NWrnngPrssTrPrssrIsWthnThThrshl" 1 "OvrPrssTrPrssrIsHghrThnThPrssrD" 0 "ExtrmOvrPrssTrPrssrIsAtALvlWhrT" ;
VAL_ 3221225472 TirePressThresholdDetection_22 7 "NotAvailable" 6 "ErrorIndicator" 5 "NotDefined" 4 "ExtrmUndrPrssTrPrssrIsAtALvlWhr" 3 "UndrPrssTrPrssrIsLwrThnThPrssrD" 2 "NWrnngPrssTrPrssrIsWthnThThrshl" 1 "OvrPrssTrPrssrIsHghrThnThPrssrD" 0 "ExtrmOvrPrssTrPrssrIsAtALvlWhrT" ;
VAL_ 3221225472 TirePressThresholdDetection_21 7 "NotAvailable" 6 "ErrorIndicator" 5 "NotDefined" 4 "ExtrmUndrPrssTrPrssrIsAtALvlWhr" 3 "UndrPrssTrPrssrIsLwrThnThPrssrD" 2 "NWrnngPrssTrPrssrIsWthnThThrshl" 1 "OvrPrssTrPrssrIsHghrThnThPrssrD" 0 "ExtrmOvrPrssTrPrssrIsAtALvlWhrT" ;
VAL_ 3221225472 TirePressThresholdDetection_20 7 "NotAvailable" 6 "ErrorIndicator" 5 "NotDefined" 4 "ExtrmUndrPrssTrPrssrIsAtALvlWhr" 3 "UndrPrssTrPrssrIsLwrThnThPrssrD" 2 "NWrnngPrssTrPrssrIsWthnThThrshl" 1 "OvrPrssTrPrssrIsHghrThnThPrssrD" 0 "ExtrmOvrPrssTrPrssrIsAtALvlWhrT" ;
VAL_ 3221225472 TirePressThresholdDetection_00 7 "NotAvailable" 6 "ErrorIndicator" 5 "NotDefined" 4 "ExtrmUndrPrssTrPrssrIsAtALvlWhr" 3 "UndrPrssTrPrssrIsLwrThnThPrssrD" 2 "NWrnngPrssTrPrssrIsWthnThThrshl" 1 "OvrPrssTrPrssrIsHghrThnThPrssrD" 0 "ExtrmOvrPrssTrPrssrIsAtALvlWhrT" ;
VAL_ 3221225472 CTIWheelSensorStatus_00 3 "NotSupported" 2 "NotDefined" 1 "On" 0 "Off_IsolatedFromCTIPressCtrl" ;
VAL_ 3221225472 CTIWheelEndElectricalFault_00 3 "NotSupported" 2 "Error" 1 "NotDefined" 0 "Ok" ;
VAL_ 3221225472 CTITireStatus_00 3 "NotSupported" 2 "Error" 1 "TireLeakDetected" 0 "Ok" ;
VAL_ 3221225472 EngTrbWstgateActuator1TempStatus 7 "Not available" 6 "Error" 5 "Not Defined" 4 "Low Most severe" 3 "Low Least severe" 2 "In Range" 1 "High Least severe" 0 "High Most severe" ;
VAL_ 3221225472 DirectionIndicator 3 "Not available" 2 "Error" 1 "Reverse" 0 "Forward" ;
VAL_ 3221225472 TachographPerformance 3 "Not available" 2 "Error" 1 "Performance analysis" 0 "Normal performance" ;
VAL_ 3221225472 HandlingInformation 3 "Not available" 2 "Error" 1 "Handling information" 0 "No handling information" ;
VAL_ 3221225472 SystemEvent 3 "Not available" 2 "Error" 1 "Tachograph event" 0 "No tachograph event" ;
VAL_ 3221225472 DriverCardDriver2 3 "Not available" 2 "Error" 1 "Driver card present" 0 "Driver card not present" ;
VAL_ 3221225472 Driver2TimeRelatedStates 15 "Not available" 14 "Error" 13 "Other" 6 "Limit #6" 5 "Limit #5" 4 "Limit #4" 3 "Limit #3" 2 "Limit #2" 1 "Limit #1" 0 "Normal/No limits reached" ;
VAL_ 3221225472 VehicleOverspeed 3 "Not available" 2 "Error" 1 "Overspeed" 0 "No overspeed" ;
VAL_ 3221225472 DriverCardDriver1 3 "Not available" 2 "Error" 1 "Driver card present" 0 "Driver card not present" ;
VAL_ 3221225472 Driver1TimeRelatedStates 15 "Not available" 14 "Error" 13 "Other" 6 "Limit #6" 5 "Limit #5" 4 "Limit #4" 3 "Limit #3" 2 "Limit #2" 1 "Limit #1" 0 "Normal/No limits reached" ;
VAL_ 3221225472 VehicleMotion 3 "- Not available" 2 "- Error" 1 "Vehicle motion detected" 0 "Vehicle motion not detected" ;
VAL_ 3221225472 Driver2WorkingState 7 "Not available" 6 "Error" 3 "Drive" 2 "Work" 1 "Driver available" 0 "Rest" ;
VAL_ 3221225472 Driver1WorkingState 7 "Not available" 6 "Error" 3 "Drive" 2 "Work" 1 "Driver available" 0 "Rest" ;
VAL_ 3221225472 AutoNeutralReq 3 "Don't Care / Take No Action" 2 "Reserved" 1 "Request to shift to Auto-Neutral state" 0 "No request to shift to Auto-Neutral state" ;
VAL_ 3221225472 TransMode8 3 "Take no action" 2 "Reserved" 1 "Enable" 0 "Disable" ;
VAL_ 3221225472 TransMode7 3 "Take no action" 2 "Reserved" 1 "Enable" 0 "Disable" ;
VAL_ 3221225472 TransMode6 3 "Take no action" 2 "Reserved" 1 "Enable" 0 "Disable" ;
VAL_ 3221225472 TransMode5 3 "Take no action" 2 "Reserved" 1 "Enable" 0 "Disable" ;
VAL_ 3221225472 TrnsShftSlectorDisplayModeSwitch 3 "Not Available" 2 "Error" 1 "On" 0 "Off" ;
VAL_ 3221225472 TransRequestedLaunchGear 10 "Launch the vehicle in Reverse 2" 9 "Launch the vehicle in Reverse 1" 8 "Launch the vehicle in 8th gear" 7 "Launch the vehicle in 7th gear" 6 "Launch the vehicle in 6th gear" 5 "Launch the vehicle in 5th gear" 4 "Launch the vehicle in 4th gear" 3 "Launch the vehicle in 3rd gear" 2 "Launch the vehicle in 2nd gear" 1 "Launch the vehicle in 1st gear" 0 "No specific launch gear requested" 15 "Not Available" 14 "Error" 13 "Allow transmission to select the optimum launch gear" 12 "Launch the vehicle in Reverse 4 " 11 "Launch the vehicle in Reverse 3" ;
VAL_ 3221225472 TransMode4 3 "Take no action" 2 "Reserved" 1 "Enable" 0 "Disable" ;
VAL_ 3221225472 TransMode3 3 "Take no action" 2 "Reserved" 1 "Enable" 0 "Disable" ;
VAL_ 3221225472 TransMode2 3 "Take no action" 2 "Reserved" 1 "Enable" 0 "Disable" ;
VAL_ 3221225472 TransMode1 3 "Take no action" 2 "Reserved" 1 "Enable" 0 "Disable" ;
VAL_ 3221225472 TransLoadReductionInhibitRq 3 "Don't care/take no action" 2 "Reserved" 1 "Inhibit or abort transmission load reduction functions" 0 "Allow or resume transmission load reduction functions" ;
VAL_ 3221225472 DisengageDiffLockRqCentralRear 3 "Take no action" 2 "Reserved" 1 "Disengage differential lock" 0 "Engage differential lock" ;
VAL_ 3221225472 DisengageDiffLockRqCentralFront 3 "Take no action" 2 "Reserved" 1 "Disengage differential lock" 0 "Engage differential lock" ;
VAL_ 3221225472 DisengageDiffLockRqCentral 3 "Take no action" 2 "Reserved" 1 "Disengage differential lock" 0 "Engage differential lock" ;
VAL_ 3221225472 DisengageDiffLockRqRearAxle2 3 "Take no action" 2 "Reserved" 1 "Disengage differential lock" 0 "Engage differential lock" ;
VAL_ 3221225472 DisengageDiffLockRqRearAxle1 3 "Take no action" 2 "Reserved" 1 "Disengage differential lock" 0 "Engage differential lock" ;
VAL_ 3221225472 DisengageDiffLockRqFrontAxle2 3 "Take no action" 2 "Reserved" 1 "Disengage differential lock" 0 "Engage differential lock" ;
VAL_ 3221225472 DisengageDiffLockRqFrontAxle1 3 "Take no action" 2 "Reserved" 1 "Disengage differential lock" 0 "Engage differential lock" ;
VAL_ 3221225472 TransRequestedGear 223 "Reverse Selector Position" 224 "Position unknown and/or no buttons pressed" 225 "Press of momentary button to reselect current position" 226 "Between ‘Reverse' and ‘Park' shift selector positions" 227 "Between ‘Neutral' and ‘Reverse' shift selector positions" 228 "Between ‘Drive' and ‘Neutral' shift selector positions" 229 "Between D-1 and ‘Drive' shift selector positions" 230 "Between D-2 and D-1 shift selector positions" 231 "Between D-3 and D-2 shift selector positions" 232 "Between D-4 and D-3 shift selector positions" 233 "Between D-5 and D-4 shift selector positions" 234 "Between D-6 and D-5 shift selector positions" 235 "Between D-7 and D-6 shift selector positions" 236 "Between two forward shift selector positions" 237 "Between two reverse shift selector positions" 238 "Between two shift selector positions" 239 "D-7: 7th forward selector position referenced from ‘Drive'" 240 "D-6: 6th forward selector position referenced from ‘Drive'" 241 "D-5: 5th forward selector position referenced from ‘Drive'" 242 "D-4: 4th forward selector position referenced from ‘Drive'" 243 "D-3: 3rd forward selector position referenced from ‘Drive'" 244 "D-2: 2nd forward selector position referenced from ‘Drive'" 245 "D-1: 1st forward selector position referenced from ‘Drive'" 246 "Downshift 2 gears from current position" 247 "Downshift 1 gear from current position" 248 "Upshift 2 gears from current position" 249 "Upshift 1 gear from current position" 250 "Forward ‘Low' position" 251 "‘Park' position" 252 "Forward Drive Position" 253 "Hold current gear" ;
VAL_ 3221225472 TransReverseGearShiftInhibitRq 3 "Take no action" 2 "Reserved " 1 "Inhibit shifts into Reverse gear" 0 "Allow shifts into Reverse gear" ;
VAL_ 3221225472 DisengageDrivelineRq 3 "Take no action" 2 "Reserved" 1 "Disengage driveline" 0 "Allow driveline engagement" ;
VAL_ 3221225472 TrnsTrqeConverterLockupDisableRq 3 "Take no action" 2 "Reserved" 1 "Disable torque converter lockup" 0 "Allow torque converter lockup" ;
VAL_ 3221225472 TransGearShiftInhibitRq 3 "Take no action " 2 "Reserved" 1 "Gear shifts are inhibited " 0 "Gear shifts are allowed " ;
VAL_ 3221225472 EngTurboOilLevelSwitch 3 "Not available" 2 "Error" 1 "Oil present at turbocharger" 0 "No oil present at turbocharger" ;
VAL_ 3221225472 ClntLvlEngPrtctionShutdownStatus 3 "Not Available" 2 "Reserved" 1 "Enabled" 0 "Disabled" ;
VAL_ 3221225472 PTOShutdownHasShutdownEng 3 "Not available" 2 "Error" 1 "Yes" 0 "No" ;
VAL_ 3221225472 EngAirShutoffStatus 2 "Error" 1 "Air flow restricted" 0 "Air flow allowed to engine" 3 "Not Available" ;
VAL_ 3221225472 EngOverspeedTest 3 "Not Available" 2 "Reserved" 1 "Engine Overspeed Test Active" 0 "Engine Overspeed Test Not Active" ;
VAL_ 3221225472 EngAirShutoffCmdStatus 3 "Not Available" 2 "Reserved" 1 "Air Shutoff Enabled" 0 "Air Shutoff Disabled" ;
VAL_ 3221225472 EngAlarmOutputCmdStatus 3 "Not Available" 2 "Reserved" 1 "Engine Alarm Output Command Active" 0 "Engine Alarm Output Command Not Active" ;
VAL_ 3221225472 EngAlarmAcknowledge 3 "Not Available" 2 "Error" 1 "Engine Alarm Acknowledge Active" 0 "Engine Alarm Acknowledge  Not Active " ;
VAL_ 3221225472 EngProtectionSystemConfig 3 "Not available" 2 "Error" 1 "Enabled in calibration" 0 "Disabled in calibration" ;
VAL_ 3221225472 EngProtectionSystemTimerState 3 "Not available" 2 "Error" 1 "Active" 0 "Inactive" ;
VAL_ 3221225472 EngProtectionSystemTimerOverride 3 "Not available" 2 "Error" 1 "Active" 0 "Inactive" ;
VAL_ 3221225472 EngPrtctnSystmApprachingShutdown 3 "Not available" 2 "Error" 1 "Approaching" 0 "Not approaching" ;
VAL_ 3221225472 EngPrtectionSystemHasShutdownEng 3 "Not available" 2 "Error" 1 "Yes" 0 "No" ;
VAL_ 3221225472 EngWaitToStartLamp 3 "Not Available" 2 "Error" 1 "On" 0 "Off" ;
VAL_ 3221225472 RefrigerantHighPressSwitch 3 "Not available" 2 "Error" 1 "Pressure too high" 0 "Pressure normal" ;
VAL_ 3221225472 RefrigerantLowPressSwitch 3 "Not available" 2 "Error" 1 "Pressure too low" 0 "Pressure normal" ;
VAL_ 3221225472 A_CHighPressFanSwitch 3 "Not available" 2 "Error" 1 "Pressure high" 0 "Pressure normal" ;
VAL_ 3221225472 EngIdleShutdownTimerFunction 3 "Not available" 2 "Error" 1 "Enabled in calibration" 0 "Disabled in calibration" ;
VAL_ 3221225472 EngIdleShutdownTimerState 3 "Not available" 2 "Error" 1 "Active" 0 "Inactive" ;
VAL_ 3221225472 EngIdleShutdownTimerOverride 3 "Not available" 2 "Error" 1 "Active" 0 "Inactive" ;
VAL_ 3221225472 EngIdleShutdownDriverAlertMode 3 "Not available" 2 "Error" 1 "Active" 0 "Inactive" ;
VAL_ 3221225472 EngIdleShutdownHasShutdownEng 3 "Not available" 2 "Error" 1 "Yes" 0 "No" ;
VAL_ 3221225472 VehicleSystem5 127 "Not Available" 0 "Ind. Process Cntl Stationary" ;
VAL_ 3221225472 VehicleSystem4 125 "Entertainment" 120 "Display" 85 "External Environment" 75 "Sensor Comm Interface" 35 "Electrical Generation" 100 "Deck, Cargo and Fishing Eqt" 90 "Internal Environment" 80 "Instrumentation/General Systems (deprecate)" 70 "Communications" 60 "Navigation" 50 "Propulsion" 40 "SteeringAndControlSurfaces" 30 "Electrical Distribution" 25 "Inter/Intranetwork Device" 20 "Safety Systems" 10 "System Tools" 127 "Not Available" 0 "Non-specific System" ;
VAL_ 3221225472 VehicleSystem3 8 "Grader" 7 "Four Wheel Drive Loader" 6 "Forklift" 5 "Excavator" 4 "Crawler" 3 "Backhoe" 2 "Articulated Dump Truck" 1 "Skid Steer Loader" 127 "Not Available" 0 "Non-specific System" ;
VAL_ 3221225472 VehicleSystem2 25 "Slurry Applicators" 24 "Utility Vehicles" 23 "Mulchers" 22 "Timber Processing Machines" 21 "Timber loaders" 20 "Forwarders" 19 "Timber Harvesters" 17 "Sensor Systems" 16 "Skidder" 15 "Earth Work" 14 "Special Crops" 13 "Powered Auxiliary Device" 12 "Farm Yard Operations" 11 "Transport/Trailer" 10 "Irrigation" 9 "Forage" 8 "Root Harvesters" 7 "Harvesters" 6 "Sprayers" 5 "Fertilizers" 4 "Planters/Seeders" 3 "Secondary Tillage" 2 "Tillage" 1 "Tractor" 127 "Not Available" 0 "Non-specific System" ;
VAL_ 3221225472 VehicleSystem1 2 "Trailer" 1 "Tractor" 127 "Not Available" 0 "Non-specific System" ;
VAL_ 3221225472 IndustryGroup 6 "Reserved for SAE" 7 "Reserved for SAE" 5 "IndustrialProcessCtrlStationary" 4 "Marine" 3 "Construction" 2 "Agricultural and Forestry" 1 "On-Highway" 0 "Global" ;
VAL_ 3221225472 VehicleSystem 0 "Non-specific System" 127 "Not Available" ;
VAL_ 3221225472 Function 255 "Not Available" 127 "Reserved" 126 "Reserved" 125 "Reserved" 124 "Reserved" 123 "Reserved" 122 "Reserved" 121 "Reserved" 120 "Reserved" 119 "Reserved" 118 "Reserved" 117 "Reserved" 116 "Reserved" 115 "Reserved" 114 "Reserved" 113 "Reserved" 112 "Reserved" 111 "Reserved" 110 "Reserved" 109 "Reserved" 108 "Reserved" 107 "Reserved" 106 "Reserved" 105 "Reserved" 104 "Reserved" 103 "Reserved" 102 "Reserved" 101 "Reserved" 42 "Water Pump Control" 41 "Lighting - Operator Controls" 40 "Seat Control" 39 "Ignition Control Module" 38 "Tire Pressure Control" 37 "Cab Controller" 36 "Pneumatic - System Controller" 35 "Suspension - System Controller" 34 "Hydraulic Pump Controller" 33 "System Monitor" 32 "Headway Controller" 31 "Propulsion Battery Charger" 30 "Management Computer" 29 "Virtual Terminal (in cab)" 28 "Off Vehicle Gateway" 27 "Power TakeOff (Secondary or Front)" 26 "Body Controller" 25 "Network Interconnect ECU" 24 "Vehicle Security" 23 "Vehicle Navigation" 22 "Aerodynamic Control" 21 "Cab Climate Control" 20 "Trip Recorder" 19 "Instrument Cluster" 18 "Suspension - Drive Axle" 17 "Suspension - Steer Axle" 16 "Steering Controller" 15 "Fuel System" 14 "Cruise Control" 13 "Retarder - Driveline" 12 "Retarder - Engine" 11 "Brakes - Drive Axle" 10 "Brakes - Steer Axle" 9 "Brakes - System Controller" 8 "Axle - Drive" 7 "Axle - Steering" 6 "Power TakeOff - (Main or Rear)" 5 "Shift Control/Console" 4 "Battery Pack Monitor" 3 "Transmission" 2 "Electric Propulsion Control" 1 "Auxiliary Power Unit (APU)" 0 "Engine" 100 "Reserved" 99 "Reserved" 98 "Reserved" 97 "Reserved" 96 "Reserved" 95 "Reserved" 94 "Reserved" 93 "Reserved" 92 "Reserved" 91 "Reserved" 90 "Reserved" 89 "Reserved" 88 "Reserved" 87 "Reserved" 86 "Reserved" 85 "Reserved" 84 "Reserved" 83 "Reserved" 82 "Reserved" 81 "Reserved" 80 "Electric Powertrain" 79 "Power Systems Manager" 78 "Fire Suppression System" 77 "Fuel Properties Sensor" 76 "Temperature Sensor" 75 "Supplemental Fan" 74 "Lubrication System" 73 "Rollover Detection Control" 72 "Coolant Valve Controller" 71 "Transfer Case Control" 70 "Auxiliary Regeneration Device" 69 "EngEmissionAftertreatementSys" 68 "AftertreatmentSystemGasMeasur" 67 "Electrical System Controller" 66 "I/O Controller" 65 "Gas Flow Measurement" 64 "Endurance Braking" 63 "Engine Valve Controller" 62 "On-Board Diagnostic Unit" 61 "File Server/Printer" 60 "Cab Display" 59 "Starter" 58 "Fan Drive Control" 57 "Steering Column Unit" 56 "Communications Unit, Radio" 55 "Communications Unit, Satellite" 54 "Communications Unit, Cellular" 53 "Alternator/Charging System" 52 "Chassis Controller" 51 "FwdLooking Collision Warn Sys" 50 "Auxiliary Heater" 49 "Clutch/Converter Control" 48 "Ramp Control" 47 "Information System Controller" 46 "Oil Sensor Unit" 45 "Veh Dynamic Stability Cntl" 44 "Exhaust Emission Control" 43 "Transmission Display" ;
VAL_ 3221225472 ManufacturerCode 806 "Charge" 0 "Reserved" ;
VAL_ 3221225472 DrvlineRetarderOverheatIndicator 3 "Not available" 2 "Driveline Retarder Overheat Indicator is flashing" 1 "Driveline Retarder Overheat Indicator is on continuously" 0 "Driveline Retarder Overheat Indicator is off" ;
VAL_ 3221225472 SteerStraightAheadPosReset 3 "Not applicable" 2 "Reserved" 1 "Reset" 0 "Take no action" ;
VAL_ 3221225472 EngBuildHoursReset 3 "Take no action" 2 "Reserved" 1 "Reset" 0 "Do not reset" ;
VAL_ 3221225472 EngIgntCtrlMaintenanceHoursReset 3 "Take no action" 2 "Reserved" 1 "Reset" 0 "Do not reset" ;
VAL_ 3221225472 EngSprkPlgScndVltgeTrackingReset 3 "Take no action" 2 "Reserved" 1 "Reset" 0 "Do not reset" ;
VAL_ 3221225472 TripGroup2Proprietary 3 "Not applicable" 2 "Reserved" 1 "Reset" 0 "Take no action" ;
VAL_ 3221225472 TireSensorInformation 3 "Not applicable" 2 "Reserved" 1 "Reset" 0 "Take no action" ;
VAL_ 3221225472 TireConfigInformation 3 "Not Applicable" 2 "Reserved" 1 "Reset" 0 "Take No Action" ;
VAL_ 3221225472 BinLiftCountReset 3 "Take no action" 2 "Reserved" 1 "Reset" 0 "Do not reset" ;
VAL_ 3221225472 TripGroup1 3 "Not applicable" 2 "Reserved" 1 "Reset" 0 "Take no action" ;
VAL_ 3221225472 RetarderLocation 15 "Not available" 14 "Other" 5 "Trailer" 4 "(Secondary)    Driveline" 3 "(Secondary) Transmission Output" 2 "(Primary)  Transmission Input" 1 "(Primary)  Engine Exhaust Brake" 0 "(Primary) CompRlseOrExhaust" ;
VAL_ 3221225472 RetarderType 15 "Not available" 14 "Other" 4 "Exhaust" 3 "Compression Release" 2 "Cooled Friction" 1 "Hydraulic" 0 "Electric/Magnetic" ;
VAL_ 3221225472 OprtrEngPTOGvrnrMmrySelectSwitch 3 "not available" 2 "error" 1 "PTO set speed memory 2 selected" 0 "PTO set speed memory 1 selected" ;
VAL_ 3221225472 EngRmtPTOGvrnrVrblSpedCtrlSwitch 3 "Not Available" 2 "Error" 1 "On" 0 "Off" ;
VAL_ 3221225472 EngRmtPTOGvrnrPrprgrmmdSpdCtrlSw 3 "Not Available" 2 "Error" 1 "On" 0 "Off" ;
VAL_ 3221225472 EngPTOGvrnrCast_DecelerateSwitch 3 "Not Available" 2 "Error" 1 "On" 0 "Off" ;
VAL_ 3221225472 IndustryGroup 6 "Reserved for SAE" 7 "Reserved for SAE" 5 "IndustrialProcessCtrlStationary" 4 "Marine" 3 "Construction" 2 "Agricultural and Forestry" 1 "On-Highway" 0 "Global" ;
VAL_ 3221225472 Function 255 "Not Available" 127 "Reserved" 126 "Reserved" 125 "Reserved" 124 "Reserved" 123 "Reserved" 122 "Reserved" 121 "Reserved" 120 "Reserved" 119 "Reserved" 118 "Reserved" 117 "Reserved" 116 "Reserved" 115 "Reserved" 114 "Reserved" 113 "Reserved" 112 "Reserved" 111 "Reserved" 110 "Reserved" 109 "Reserved" 108 "Reserved" 107 "Reserved" 106 "Reserved" 105 "Reserved" 104 "Reserved" 103 "Reserved" 102 "Reserved" 101 "Reserved" 42 "Water Pump Control" 41 "Lighting - Operator Controls" 40 "Seat Control" 39 "Ignition Control Module" 38 "Tire Pressure Control" 37 "Cab Controller" 36 "Pneumatic - System Controller" 35 "Suspension - System Controller" 34 "Hydraulic Pump Controller" 33 "System Monitor" 32 "Headway Controller" 31 "Propulsion Battery Charger" 30 "Management Computer" 29 "Virtual Terminal (in cab)" 28 "Off Vehicle Gateway" 27 "Power TakeOff (Secondary or Front)" 26 "Body Controller" 25 "Network Interconnect ECU" 24 "Vehicle Security" 23 "Vehicle Navigation" 22 "Aerodynamic Control" 21 "Cab Climate Control" 20 "Trip Recorder" 19 "Instrument Cluster" 18 "Suspension - Drive Axle" 17 "Suspension - Steer Axle" 16 "Steering Controller" 15 "Fuel System" 14 "Cruise Control" 13 "Retarder - Driveline" 12 "Retarder - Engine" 11 "Brakes - Drive Axle" 10 "Brakes - Steer Axle" 9 "Brakes - System Controller" 8 "Axle - Drive" 7 "Axle - Steering" 6 "Power TakeOff - (Main or Rear)" 5 "Shift Control/Console" 4 "Battery Pack Monitor" 3 "Transmission" 2 "Electric Propulsion Control" 1 "Auxiliary Power Unit (APU)" 0 "Engine" 100 "Reserved" 99 "Reserved" 98 "Reserved" 97 "Reserved" 96 "Reserved" 95 "Reserved" 94 "Reserved" 93 "Reserved" 92 "Reserved" 91 "Reserved" 90 "Reserved" 89 "Reserved" 88 "Reserved" 87 "Reserved" 86 "Reserved" 85 "Reserved" 84 "Reserved" 83 "Reserved" 82 "Reserved" 81 "Reserved" 80 "Electric Powertrain" 79 "Power Systems Manager" 78 "Fire Suppression System" 77 "Fuel Properties Sensor" 76 "Temperature Sensor" 75 "Supplemental Fan" 74 "Lubrication System" 73 "Rollover Detection Control" 72 "Coolant Valve Controller" 71 "Transfer Case Control" 70 "Auxiliary Regeneration Device" 69 "EngEmissionAftertreatementSys" 68 "AftertreatmentSystemGasMeasur" 67 "Electrical System Controller" 66 "I/O Controller" 65 "Gas Flow Measurement" 64 "Endurance Braking" 63 "Engine Valve Controller" 62 "On-Board Diagnostic Unit" 61 "File Server/Printer" 60 "Cab Display" 59 "Starter" 58 "Fan Drive Control" 57 "Steering Column Unit" 56 "Communications Unit, Radio" 55 "Communications Unit, Satellite" 54 "Communications Unit, Cellular" 53 "Alternator/Charging System" 52 "Chassis Controller" 51 "FwdLooking Collision Warn Sys" 50 "Auxiliary Heater" 49 "Clutch/Converter Control" 48 "Ramp Control" 47 "Information System Controller" 46 "Oil Sensor Unit" 45 "Veh Dynamic Stability Cntl" 44 "Exhaust Emission Control" 43 "Transmission Display" ;
VAL_ 3221225472 VehicleSystem 0 "Non-specific System" 127 "Not Available" ;
VAL_ 3221225472 ManufacturerCode 806 "Charge" 0 "Reserved" ;
VAL_ 3221225472 VehicleSystem5 127 "Not Available" 0 "Ind. Process Cntl Stationary" ;
VAL_ 3221225472 VehicleSystem4 125 "Entertainment" 120 "Display" 85 "External Environment" 75 "Sensor Comm Interface" 35 "Electrical Generation" 100 "Deck, Cargo and Fishing Eqt" 90 "Internal Environment" 80 "Instrumentation/General Systems (deprecate)" 70 "Communications" 60 "Navigation" 50 "Propulsion" 40 "SteeringAndControlSurfaces" 30 "Electrical Distribution" 25 "Inter/Intranetwork Device" 20 "Safety Systems" 10 "System Tools" 127 "Not Available" 0 "Non-specific System" ;
VAL_ 3221225472 VehicleSystem3 8 "Grader" 7 "Four Wheel Drive Loader" 6 "Forklift" 5 "Excavator" 4 "Crawler" 3 "Backhoe" 2 "Articulated Dump Truck" 1 "Skid Steer Loader" 127 "Not Available" 0 "Non-specific System" ;
VAL_ 3221225472 VehicleSystem2 25 "Slurry Applicators" 24 "Utility Vehicles" 23 "Mulchers" 22 "Timber Processing Machines" 21 "Timber loaders" 20 "Forwarders" 19 "Timber Harvesters" 17 "Sensor Systems" 16 "Skidder" 15 "Earth Work" 14 "Special Crops" 13 "Powered Auxiliary Device" 12 "Farm Yard Operations" 11 "Transport/Trailer" 10 "Irrigation" 9 "Forage" 8 "Root Harvesters" 7 "Harvesters" 6 "Sprayers" 5 "Fertilizers" 4 "Planters/Seeders" 3 "Secondary Tillage" 2 "Tillage" 1 "Tractor" 127 "Not Available" 0 "Non-specific System" ;
VAL_ 3221225472 VehicleSystem1 2 "Trailer" 1 "Tractor" 127 "Not Available" 0 "Non-specific System" ;
VAL_ 3221225472 IndustryGroup 6 "Reserved for SAE" 7 "Reserved for SAE" 5 "IndustrialProcessCtrlStationary" 4 "Marine" 3 "Construction" 2 "Agricultural and Forestry" 1 "On-Highway" 0 "Global" ;
VAL_ 3221225472 Function 255 "Not Available" 127 "Reserved" 126 "Reserved" 125 "Reserved" 124 "Reserved" 123 "Reserved" 122 "Reserved" 121 "Reserved" 120 "Reserved" 119 "Reserved" 118 "Reserved" 117 "Reserved" 116 "Reserved" 115 "Reserved" 114 "Reserved" 113 "Reserved" 112 "Reserved" 111 "Reserved" 110 "Reserved" 109 "Reserved" 108 "Reserved" 107 "Reserved" 106 "Reserved" 105 "Reserved" 104 "Reserved" 103 "Reserved" 102 "Reserved" 101 "Reserved" 42 "Water Pump Control" 41 "Lighting - Operator Controls" 40 "Seat Control" 39 "Ignition Control Module" 38 "Tire Pressure Control" 37 "Cab Controller" 36 "Pneumatic - System Controller" 35 "Suspension - System Controller" 34 "Hydraulic Pump Controller" 33 "System Monitor" 32 "Headway Controller" 31 "Propulsion Battery Charger" 30 "Management Computer" 29 "Virtual Terminal (in cab)" 28 "Off Vehicle Gateway" 27 "Power TakeOff (Secondary or Front)" 26 "Body Controller" 25 "Network Interconnect ECU" 24 "Vehicle Security" 23 "Vehicle Navigation" 22 "Aerodynamic Control" 21 "Cab Climate Control" 20 "Trip Recorder" 19 "Instrument Cluster" 18 "Suspension - Drive Axle" 17 "Suspension - Steer Axle" 16 "Steering Controller" 15 "Fuel System" 14 "Cruise Control" 13 "Retarder - Driveline" 12 "Retarder - Engine" 11 "Brakes - Drive Axle" 10 "Brakes - Steer Axle" 9 "Brakes - System Controller" 8 "Axle - Drive" 7 "Axle - Steering" 6 "Power TakeOff - (Main or Rear)" 5 "Shift Control/Console" 4 "Battery Pack Monitor" 3 "Transmission" 2 "Electric Propulsion Control" 1 "Auxiliary Power Unit (APU)" 0 "Engine" 100 "Reserved" 99 "Reserved" 98 "Reserved" 97 "Reserved" 96 "Reserved" 95 "Reserved" 94 "Reserved" 93 "Reserved" 92 "Reserved" 91 "Reserved" 90 "Reserved" 89 "Reserved" 88 "Reserved" 87 "Reserved" 86 "Reserved" 85 "Reserved" 84 "Reserved" 83 "Reserved" 82 "Reserved" 81 "Reserved" 80 "Electric Powertrain" 79 "Power Systems Manager" 78 "Fire Suppression System" 77 "Fuel Properties Sensor" 76 "Temperature Sensor" 75 "Supplemental Fan" 74 "Lubrication System" 73 "Rollover Detection Control" 72 "Coolant Valve Controller" 71 "Transfer Case Control" 70 "Auxiliary Regeneration Device" 69 "EngEmissionAftertreatementSys" 68 "AftertreatmentSystemGasMeasur" 67 "Electrical System Controller" 66 "I/O Controller" 65 "Gas Flow Measurement" 64 "Endurance Braking" 63 "Engine Valve Controller" 62 "On-Board Diagnostic Unit" 61 "File Server/Printer" 60 "Cab Display" 59 "Starter" 58 "Fan Drive Control" 57 "Steering Column Unit" 56 "Communications Unit, Radio" 55 "Communications Unit, Satellite" 54 "Communications Unit, Cellular" 53 "Alternator/Charging System" 52 "Chassis Controller" 51 "FwdLooking Collision Warn Sys" 50 "Auxiliary Heater" 49 "Clutch/Converter Control" 48 "Ramp Control" 47 "Information System Controller" 46 "Oil Sensor Unit" 45 "Veh Dynamic Stability Cntl" 44 "Exhaust Emission Control" 43 "Transmission Display" ;
VAL_ 3221225472 ManufacturerCode 806 "Charge" 0 "Reserved" ;
VAL_ 3221225472 VehicleSystem 0 "Non-specific System" 127 "Not Available" ;
VAL_ 3221225472 VehicleSystem5 127 "Not Available" 0 "Ind. Process Cntl Stationary" ;
VAL_ 3221225472 VehicleSystem4 125 "Entertainment" 120 "Display" 85 "External Environment" 75 "Sensor Comm Interface" 35 "Electrical Generation" 100 "Deck, Cargo and Fishing Eqt" 90 "Internal Environment" 80 "Instrumentation/General Systems (deprecate)" 70 "Communications" 60 "Navigation" 50 "Propulsion" 40 "SteeringAndControlSurfaces" 30 "Electrical Distribution" 25 "Inter/Intranetwork Device" 20 "Safety Systems" 10 "System Tools" 127 "Not Available" 0 "Non-specific System" ;
VAL_ 3221225472 VehicleSystem3 8 "Grader" 7 "Four Wheel Drive Loader" 6 "Forklift" 5 "Excavator" 4 "Crawler" 3 "Backhoe" 2 "Articulated Dump Truck" 1 "Skid Steer Loader" 127 "Not Available" 0 "Non-specific System" ;
VAL_ 3221225472 VehicleSystem2 25 "Slurry Applicators" 24 "Utility Vehicles" 23 "Mulchers" 22 "Timber Processing Machines" 21 "Timber loaders" 20 "Forwarders" 19 "Timber Harvesters" 17 "Sensor Systems" 16 "Skidder" 15 "Earth Work" 14 "Special Crops" 13 "Powered Auxiliary Device" 12 "Farm Yard Operations" 11 "Transport/Trailer" 10 "Irrigation" 9 "Forage" 8 "Root Harvesters" 7 "Harvesters" 6 "Sprayers" 5 "Fertilizers" 4 "Planters/Seeders" 3 "Secondary Tillage" 2 "Tillage" 1 "Tractor" 127 "Not Available" 0 "Non-specific System" ;
VAL_ 3221225472 VehicleSystem1 2 "Trailer" 1 "Tractor" 127 "Not Available" 0 "Non-specific System" ;
