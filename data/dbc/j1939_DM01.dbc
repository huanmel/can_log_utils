VERSION ""

NS_ :

BS_:

BU_: PowertrainControlModule AtmosphericSensor SafetyRestraintSystem2 Aftertreatment_2_GasOutlet Aftertreatment_2_GasIntake DieselPartFilterControl Turbocharger SafetyRestraintSystem1 CabDisplay2 Aftertreatment_1_GasOutlet Aftertreatment_1_GasIntake OnBoardDataLogger OffBoardDiagnosticTool2 OffBoardDiagnosticTool1 FileServer ParkingBrakeController SeatController2 FanDriveController SteeringColumnUnit CommunicationUnitRadio CommunicationUnitSatellite CommunicationUnitCellular PropulsionBatteryCharger ChassisController2 ChassisController1 EngineValveControl AuxiliaryHeater2 AuxiliaryHeater1 ClutchUnit RampControl InformationSystem1 SuspensionSystemController2 OilSensor VehicleDynamicStability ExhaustEmissionController TransmissionDisplay2 TransmissionDisplay1 ClimateControl2 WaterPumpController RearAxleSteeringController LightingOperatorControl SeatController1 IgnitionController2 IgnitionController1 TirePressureController CabController2 CabController1 PneumaticSystemController SuspensionSystemController1 HydraulicPumpController EnduranceBrakingSystem RetarderExhaustEngine2 OnBoardDiagnosticUnit HeadwayController RetarderExhaustEngine1 CabDisplay1 ManagementComputer VirtualTerminal OffVehicleGateway PowerTakeOffFront HitchControl AuxiliaryValveControl BodyController TractorTrailerBridge1 StarterSystem ElectricalSystem VehicleSecurity VehicleNavigation AerodynamicControl ElectricalChargingSystem ClimateControl1 TripRecorder InstrumentCluster SuspensionDriveAxle2 SuspensionDriveAxle1 SuspensionSteerAxle SteeringController FuelSystem CruiseControl RetarderDriveline RetarderEngine BrakesDriveAxle2 BrakesDriveAxle1 BrakesSystemController BrakesSteerAxle AxleDrive2 AxleDrive1 AxleSteering PowerTakeOff ShiftConsoleSecondary ShiftConsolePrimary Transmission2 Transmission1 Engine2 Engine1

BO_ 3221225472 VECTOR__INDEPENDENT_SIG_MSG: 0 Vector__XXX
 SG_ EngPTOGovernorSetSwitch : 0|2@1+ (1,0) [0|3] "" Vector__XXX
 SG_ EngPTOGovernorResumeSwitch : 0|2@1+ (1,0) [0|3] "" Vector__XXX
 SG_ EngPTOGovernorEnableSwitch : 0|2@1+ (1,0) [0|3] "" Vector__XXX
 SG_ EngPTOGovernorAccelerateSwitch : 0|2@1+ (1,0) [0|3] "" Vector__XXX
 SG_ RmtPTOGvrnrPrprgrmmdSpdCtrlSwtch : 0|2@1+ (1,0) [0|3] "" Vector__XXX
 SG_ AuxInputIgnoreSwitch : 0|2@1+ (1,0) [0|3] "" Vector__XXX
 SG_ RearWasherFunction : 0|3@1+ (1,0) [0|7] "" Vector__XXX
 SG_ FrontOperatorWasherSwitch : 0|3@1+ (1,0) [0|7] "" Vector__XXX
 SG_ FrontNonoperatorWasherSwitch : 0|3@1+ (1,0) [0|7] "" Vector__XXX
 SG_ RearWiperDelayCtrl : 0|8@1+ (0.4,0) [0|100] "%" Vector__XXX
 SG_ FrontNonoperatorWiperDelayCtrl : 0|8@1+ (0.4,0) [0|100] "%" Vector__XXX
 SG_ FrontOperatorWiperDelayCtrl : 0|8@1+ (0.4,0) [0|100] "%" Vector__XXX
 SG_ RearWiperSwitch : 0|4@1+ (1,0) [0|15] "" Vector__XXX
 SG_ FrontOperatorWiperSwitch : 0|4@1+ (1,0) [0|15] "" Vector__XXX
 SG_ FrontNonoperatorWiperSwitch : 0|4@1+ (1,0) [0|15] "" Vector__XXX
 SG_ EngTorqueCurveSelectionCmd : 0|4@1+ (1,0) [0|15] "" Vector__XXX
 SG_ EngAltDroopAuxInputSelect : 0|4@1+ (1,0) [0|15] "" Vector__XXX
 SG_ EngAltDroopRemoteAccelSelect : 0|4@1+ (1,0) [0|15] "" Vector__XXX
 SG_ EngAltDroopAccel2Select : 0|4@1+ (1,0) [0|15] "" Vector__XXX
 SG_ EngAltDroopAccel1Select : 0|4@1+ (1,0) [0|15] "" Vector__XXX
 SG_ EngAltRatingSelect : 0|8@1+ (1,0) [0|255] "" Vector__XXX
 SG_ EngAltLowIdleSwitch : 0|2@1+ (1,0) [0|3] "" Vector__XXX
 SG_ EngSynchronizationSwitch : 0|2@1+ (1,0) [0|3] "" Vector__XXX
 SG_ EngAuxGovernorSwitch : 0|2@1+ (1,0) [0|3] "" Vector__XXX
 SG_ EngTorqueCurveSelection : 0|4@1+ (1,0) [0|15] "" Vector__XXX
 SG_ EngAltDroopAuxInputSelectState : 0|4@1+ (1,0) [0|15] "" Vector__XXX
 SG_ EngAltDropRemoteAccelSelectState : 0|4@1+ (1,0) [0|15] "" Vector__XXX
 SG_ EngAltDroopAccel2SelectState : 0|4@1+ (1,0) [0|15] "" Vector__XXX
 SG_ EngAltDroopAccel1SelectState : 0|4@1+ (1,0) [0|15] "" Vector__XXX
 SG_ EngAltRatingSelectState : 0|8@1+ (1,0) [0|255] "" Vector__XXX
 SG_ EngAltLowIdleSelectState : 0|2@1+ (1,0) [0|3] "" Vector__XXX
 SG_ EngMultiUnitSyncState : 0|2@1+ (1,0) [0|3] "" Vector__XXX
 SG_ EngAuxGovernorState : 0|2@1+ (1,0) [0|3] "" Vector__XXX
 SG_ OprtorsDesiredDelayedLampOffTime : 0|16@1+ (1,0) [0|64255] "s" Vector__XXX
 SG_ OperatorsDesiredBacklight : 0|8@1+ (0.4,0) [0|100] "%" Vector__XXX
 SG_ HighLowBeamSwitch : 0|2@1+ (1,0) [0|3] "" Vector__XXX
 SG_ HazardLightSwitch : 0|2@1+ (1,0) [0|3] "" Vector__XXX
 SG_ TurnSignalSwitch : 0|4@1+ (1,0) [0|15] "" Vector__XXX
 SG_ MainLightSwitch : 0|4@1+ (1,0) [0|15] "" Vector__XXX
 SG_ WorkLightSwitch : 0|4@1+ (1,0) [0|15] "" Vector__XXX
 SG_ MaxVehicleSpeedLimit7 : 0|8@1+ (1,0) [0|250] "km/h" Vector__XXX
 SG_ MaxVehicleSpeedLimit6 : 0|8@1+ (1,0) [0|250] "km/h" Vector__XXX
 SG_ MaxVehicleSpeedLimit5 : 0|8@1+ (1,0) [0|250] "km/h" Vector__XXX
 SG_ MaxVehicleSpeedLimit4 : 0|8@1+ (1,0) [0|250] "km/h" Vector__XXX
 SG_ MaxVehicleSpeedLimit3 : 0|8@1+ (1,0) [0|250] "km/h" Vector__XXX
 SG_ MaxVehicleSpeedLimit2 : 0|8@1+ (1,0) [0|250] "km/h" Vector__XXX
 SG_ MaxVehicleSpeedLimit1 : 0|8@1+ (1,0) [0|250] "km/h" Vector__XXX
 SG_ OprtrsBlackOutIntensitySelection : 0|8@1+ (0.4,0) [0|100] "%" Vector__XXX
 SG_ BlackOutWorkLampSelect : 0|2@1+ (1,0) [0|3] "" Vector__XXX
 SG_ NightVisionIlluminatorSelect : 0|2@1+ (1,0) [0|3] "" Vector__XXX
 SG_ BlackOutBrake_StopLampSelect : 0|2@1+ (1,0) [0|3] "" Vector__XXX
 SG_ ConvoyDrivingLampSelect : 0|2@1+ (1,0) [0|3] "" Vector__XXX
 SG_ ConvoyLampSelect : 0|2@1+ (1,0) [0|3] "" Vector__XXX
 SG_ FrontBlackOutMarkerLampSelect : 0|2@1+ (1,0) [0|3] "" Vector__XXX
 SG_ RearBlackOutMarkerSelect : 0|2@1+ (1,0) [0|3] "" Vector__XXX
 SG_ SlowVesselModeStatus : 0|2@1+ (1,0) [0|3] "" Vector__XXX
 SG_ TrollingModeStatus : 0|2@1+ (1,0) [0|3] "" Vector__XXX
 SG_ EngThrttlSynchrnzationModeStatus : 0|4@1+ (1,0) [0|15] "" Vector__XXX
 SG_ EngMainBearing12Temp : 0|16@1+ (0.03125,-273) [-273|1734.96875] "°C" Vector__XXX
 SG_ EngMainBearing11Temp : 0|16@1+ (0.03125,-273) [-273|1734.96875] "°C" Vector__XXX
 SG_ EngMainBearing10Temp : 0|16@1+ (0.03125,-273) [-273|1734.96875] "°C" Vector__XXX
 SG_ EngMainBearing9Temp : 0|16@1+ (0.03125,-273) [-273|1734.96875] "°C" Vector__XXX
 SG_ EngMainBearing8Temp : 0|16@1+ (0.03125,-273) [-273|1734.96875] "°C" Vector__XXX
 SG_ EngMainBearing7Temp : 0|16@1+ (0.03125,-273) [-273|1734.96875] "°C" Vector__XXX
 SG_ EngMainBearing6Temp : 0|16@1+ (0.03125,-273) [-273|1734.96875] "°C" Vector__XXX
 SG_ EngMainBearing5Temp : 0|16@1+ (0.03125,-273) [-273|1734.96875] "°C" Vector__XXX
 SG_ EngMainBearing4Temp : 0|16@1+ (0.03125,-273) [-273|1734.96875] "°C" Vector__XXX
 SG_ EngMainBearing3Temp : 0|16@1+ (0.03125,-273) [-273|1734.96875] "°C" Vector__XXX
 SG_ EngMainBearing2Temp : 0|16@1+ (0.03125,-273) [-273|1734.96875] "°C" Vector__XXX
 SG_ EngMainBearing1Temp : 0|16@1+ (0.03125,-273) [-273|1734.96875] "°C" Vector__XXX
 SG_ DisplayDeadbands : 0|4@1+ (1,0) [0|15] "" Vector__XXX
 SG_ LEDPatternCtrl : 0|4@1+ (1,0) [0|15] "" Vector__XXX
 SG_ LEDDisplayDeadbandCtrl : 0|4@1+ (1,0) [0|15] "" Vector__XXX
 SG_ LEDDisplayModeCtrl : 0|4@1+ (1,0) [0|15] "" Vector__XXX
 SG_ LEDDisplayData1 : 0|8@1+ (1,0) [0|255] "" Vector__XXX
 SG_ AbsLaserStrikePos : 0|16@1+ (0.1,0) [0|6425.5] "mm" Vector__XXX
 SG_ LaserStrikeDataLatency : 0|16@1+ (5.12E-005,0) [0|3.289856] "s" Vector__XXX
 SG_ LaserReceiverType : 0|8@1+ (1,0) [0|250] "" Vector__XXX
 SG_ LaserStrikeVerticalDeviation : 0|16@1+ (0.1,-3200) [-3200|3225.5] "mm" Vector__XXX
 SG_ LaserTracerInformation : 0|8@1+ (1,0) [0|255] "" Vector__XXX
 SG_ LEDDisplayData2 : 0|8@1+ (1,0) [0|255] "" Vector__XXX
 SG_ LaserTracerHorizontalDeviation : 0|8@1+ (1,0) [0|200] "%" Vector__XXX
 SG_ LaserTracerVerticalDistance : 0|16@1+ (0.1,0) [0|6400] "mm" Vector__XXX
 SG_ LaserTracerTargetDeviation : 0|16@1+ (0.1,-3200) [-3200|3225.5] "mm" Vector__XXX
 SG_ BldeHeightSetPointHighResolution : 0|32@1+ (1E-007,-209.7152) [-209.7152|209.7152] "m" Vector__XXX
 SG_ ModifyLevelingSystemSetPoint : 0|16@1+ (0.1,-3200) [-3200|3225.5] "mm" Vector__XXX
 SG_ StElvtnSensor2ReferenceElevation : 0|2@1+ (1,0) [0|3] "" Vector__XXX
 SG_ StElvtnSensor1ReferenceElevation : 0|2@1+ (1,0) [0|3] "" Vector__XXX
 SG_ SdshftDsrdBldeOffsetOperatorCtrl : 0|4@1+ (1,0) [0|15] "" Vector__XXX
 SG_ SdshiftBladeCtrlModeOperatorCtrl : 0|4@1+ (1,0) [0|15] "" Vector__XXX
 SG_ RghtDsredBladeOffsetOperatorCtrl : 0|4@1+ (1,0) [0|15] "" Vector__XXX
 SG_ LftDsiredBladeOffsetOperatorCtrl : 0|4@1+ (1,0) [0|15] "" Vector__XXX
 SG_ RightBladeCtrlModeOperatorCtrl : 0|4@1+ (1,0) [0|15] "" Vector__XXX
 SG_ LeftBladeCtrlModeOperatorCtrl : 0|4@1+ (1,0) [0|15] "" Vector__XXX
 SG_ BladeAutoModeCmd : 0|4@1+ (1,0) [0|15] "" Vector__XXX
 SG_ DesiredGradeOffsetSwitch : 0|4@1+ (1,0) [0|15] "" Vector__XXX
 SG_ BladeCtrlModeSwitch : 0|4@1+ (1,0) [0|15] "" Vector__XXX
 SG_ MastPos : 0|16@1+ (0.1,-3200) [-3200|3225.5] "mm" Vector__XXX
 SG_ FlexibleFuelPercentage : 0|16@1+ (0.0025,0) [0|100] "%" Vector__XXX
 SG_ EngThrottleValve2Pos : 0|8@1+ (0.4,0) [0|100] "%" Vector__XXX
 SG_ EngThrottleValve1Pos : 0|8@1+ (0.4,0) [0|100] "%" Vector__XXX
 SG_ EngAverageFuelEconomy : 0|16@1+ (0.001953125,0) [0|125.498046875] "km/L" Vector__XXX
 SG_ EngInstantaneousFuelEconomy : 0|16@1+ (0.001953125,0) [0|125.498046875] "km/L" Vector__XXX
 SG_ EngFuelRate : 0|16@1+ (0.05,0) [0|3212.75] "L/h" Vector__XXX
 SG_ EngTotalFuelUsed : 0|32@1+ (0.5,0) [0|2105540607.5] "L" Vector__XXX
 SG_ EngTripFuel : 0|32@1+ (0.5,0) [0|2105540607.5] "L" Vector__XXX
 SG_ FrontWheelDriveActuatorStatus : 0|2@1+ (1,0) [0|3] "" Vector__XXX
 SG_ FMSstandardSWversionSupported : 0|32@1+ (1,0) [0|255] "" Vector__XXX
 SG_ FMSstandardRequestsSupported : 0|2@1+ (1,0) [0|3] "" Vector__XXX
 SG_ FMSstandardDiagnosticsSupported : 0|2@1+ (1,0) [0|3] "" Vector__XXX
 SG_ DrverAlertnessWarningSystemState : 0|3@1+ (1,0) [0|7] "" Vector__XXX
 SG_ DriverAlertnessLevel : 0|8@1+ (0.4,0) [0|100] "%" Vector__XXX
 SG_ LnDpartureIndicationEnableStatus : 0|2@1+ (1,0) [0|3] "" Vector__XXX
 SG_ LaneTrackingStatusLeftSide : 0|2@1+ (1,0) [0|3] "" Vector__XXX
 SG_ LaneTrackingStatusRightSide : 0|2@1+ (1,0) [0|3] "" Vector__XXX
 SG_ LaneDepartureImminentLeftSide : 0|2@1+ (1,0) [0|3] "" Vector__XXX
 SG_ LaneDepartureImminentRightSide : 0|2@1+ (1,0) [0|3] "" Vector__XXX
 SG_ LaneDepartureRight : 0|2@1+ (1,0) [0|3] "" Vector__XXX
 SG_ LaneDepartureLeft : 0|2@1+ (1,0) [0|3] "" Vector__XXX
 SG_ DriverAlertnessWarning : 0|3@1+ (1,0) [0|7] "" Vector__XXX
 SG_ EngFuelLeakage2 : 0|2@1+ (1,0) [0|3] "" Vector__XXX
 SG_ EngFuelLeakage1 : 0|2@1+ (1,0) [0|3] "" Vector__XXX
 SG_ FanDriveBypassCmdStatus : 0|8@1+ (0.4,0) [0|100] "%" Vector__XXX
 SG_ HydFanMotorPress : 0|16@1+ (0.5,0) [0|32127.5] "kPa" Vector__XXX
 SG_ FanSpeed : 0|16@1+ (0.125,0) [0|8031.875] "rpm" Vector__XXX
 SG_ FanDriveState : 0|4@1+ (1,0) [0|15] "" Vector__XXX
 SG_ EstPercentFanSpeed : 0|8@1+ (0.4,0) [0|100] "%" Vector__XXX
 SG_ EngTorqueLimit6AxleInput : 0|16@1+ (2,0) [0|128510] "Nm" Vector__XXX
 SG_ EngTorqueLimit5Switch : 0|16@1+ (1,0) [0|64255] "Nm" Vector__XXX
 SG_ EngTorqueLimit4Trans : 0|16@1+ (1,0) [0|64255] "Nm" Vector__XXX
 SG_ EngTorqueLimit3Trans : 0|16@1+ (1,0) [0|64255] "Nm" Vector__XXX
 SG_ TransGearRatio3 : 0|16@1+ (0.01,0) [0|642.55] "" Vector__XXX
 SG_ EngTorqueLimit2Trans : 0|16@1+ (1,0) [0|64255] "Nm" Vector__XXX
 SG_ TransGearRatio2 : 0|16@1+ (0.01,0) [0|642.55] "" Vector__XXX
 SG_ EngTorqueLimit1Trans : 0|16@1+ (1,0) [0|64255] "Nm" Vector__XXX
 SG_ TransGearRatio1 : 0|16@1+ (0.01,0) [0|642.55] "" Vector__XXX
 SG_ EngTorqueLimitFeature : 0|3@1+ (1,0) [0|7] "" Vector__XXX
 SG_ TorqueLimitingFeatureStatus : 0|2@1+ (1,0) [0|3] "" Vector__XXX
 SG_ CalibRecordDurationTime : 0|32@1+ (0.05,0) [0|210554060.75] "h" Vector__XXX
 SG_ CalibRecordStartYear : 0|8@1+ (1,1985) [1985|2235] "years" Vector__XXX
 SG_ CalibRecordStartDay : 0|8@1+ (0.25,0) [0.25|31.75] "days" Vector__XXX
 SG_ CalibRecordStartMonth : 0|8@1+ (1,0) [1|12] "months" Vector__XXX
 SG_ EngPeakTorque2 : 0|16@1+ (1,0) [0|64255] "Nm" Vector__XXX
 SG_ EngPeakTorque1 : 0|16@1+ (1,0) [0|64255] "Nm" Vector__XXX
 SG_ EngPower : 0|16@1+ (0.5,0) [0|32127.5] "kW" Vector__XXX
 SG_ NumberOfEngTorqueHistoryRecords : 0|8@1+ (1,0) [0|250] "records" Vector__XXX
 SG_ TransClutch_ConverterInputSpeed : 0|16@1+ (0.125,0) [0|8031.875] "rpm" Vector__XXX
 SG_ TransTorqueConverterRatio : 0|16@1+ (0.001,0) [0|64.255] "" Vector__XXX
 SG_ TransAutoNeutralSt : 0|2@1+ (1,0) [0|3] "" Vector__XXX
 SG_ TransWarningIndicator : 0|2@1+ (1,0) [0|3] "" Vector__XXX
 SG_ TrnsRverseGearShiftInhibitStatus : 0|2@1+ (1,0) [0|3] "" Vector__XXX
 SG_ TransMode8Indicator : 0|2@1+ (1,0) [0|3] "" Vector__XXX
 SG_ TransMode7Indicator : 0|2@1+ (1,0) [0|3] "" Vector__XXX
 SG_ TransMode6Indicator : 0|2@1+ (1,0) [0|3] "" Vector__XXX
 SG_ TransMode5Indicator : 0|2@1+ (1,0) [0|3] "" Vector__XXX
 SG_ TransRequestedGearFeedback : 0|8@1+ (1,-125) [-125|125] "" Vector__XXX
 SG_ TransMode1Indicator : 0|2@1+ (1,0) [0|3] "" Vector__XXX
 SG_ TransMode2Indicator : 0|2@1+ (1,0) [0|3] "" Vector__XXX
 SG_ TransMode3Indicator : 0|2@1+ (1,0) [0|3] "" Vector__XXX
 SG_ TransMode4Indicator : 0|2@1+ (1,0) [0|3] "" Vector__XXX
 SG_ TransShiftInhibitIndicator : 0|2@1+ (1,0) [0|3] "" Vector__XXX
 SG_ TransEngCrankEnable : 0|2@1+ (1,0) [0|3] "" Vector__XXX
 SG_ ActiveShiftConsoleIndicator : 0|2@1+ (1,0) [0|3] "" Vector__XXX
 SG_ TransReadyForBrakeRelease : 0|2@1+ (1,0) [0|3] "" Vector__XXX
 SG_ TrnsRqstedRangeDisplayFlashState : 0|2@1+ (1,0) [0|3] "" Vector__XXX
 SG_ TrnsRqstedRangeDisplayBlankState : 0|2@1+ (1,0) [0|3] "" Vector__XXX
 SG_ TransServiceIndicator : 0|2@1+ (1,0) [0|3] "" Vector__XXX
 SG_ TransAirSupplyPressIndicator : 0|2@1+ (1,0) [0|3] "" Vector__XXX
 SG_ TransMode10Indicator : 0|2@1+ (1,0) [0|3] "" Vector__XXX
 SG_ TransMode9Indicator : 0|2@1+ (1,0) [0|3] "" Vector__XXX
 SG_ TrnsCrrentRangeDisplayBlankState : 0|2@1+ (1,0) [0|3] "" Vector__XXX
 SG_ ClutchLifeRemaining : 0|8@1+ (0.4,0) [0|100] "%" Vector__XXX
 SG_ LowestPossibleGear : 0|8@1+ (1,-125) [-125|125] "" Vector__XXX
 SG_ HighestPossibleGear : 0|8@1+ (1,-125) [-125|125] "" Vector__XXX
 SG_ RecommendedGear : 0|8@1+ (1,-125) [-125|125] "" Vector__XXX
 SG_ TransForwardDirectionSwitch : 0|2@1+ (1,0) [0|3] "" Vector__XXX
 SG_ TransNeutralSwitch : 0|2@1+ (1,0) [0|3] "" Vector__XXX
 SG_ TransReverseDirectionSwitch : 0|2@1+ (1,0) [0|3] "" Vector__XXX
 SG_ TransLowRangeSenseSwitch : 0|2@1+ (1,0) [0|3] "" Vector__XXX
 SG_ TransHighRangeSenseSwitch : 0|2@1+ (1,0) [0|3] "" Vector__XXX
 SG_ TransSynchronizerBrakeValue : 0|8@1+ (0.4,0) [0|100] "%" Vector__XXX
 SG_ TransSynchronizerClutchValue : 0|8@1+ (0.4,0) [0|100] "%" Vector__XXX
 SG_ TransInertiaBrakeActuator : 0|2@1+ (1,0) [0|3] "" Vector__XXX
 SG_ TransDefuelActuator : 0|2@1+ (1,0) [0|3] "" Vector__XXX
 SG_ TransLockupClutchActuator : 0|2@1+ (1,0) [0|3] "" Vector__XXX
 SG_ TransClutchActuator : 0|2@1+ (1,0) [0|3] "" Vector__XXX
 SG_ TransSplitterIndirectActuator : 0|2@1+ (1,0) [0|3] "" Vector__XXX
 SG_ TransSplitterDirectActuator : 0|2@1+ (1,0) [0|3] "" Vector__XXX
 SG_ TransRangeLowActuator : 0|2@1+ (1,0) [0|3] "" Vector__XXX
 SG_ TransRangeHighActuator : 0|2@1+ (1,0) [0|3] "" Vector__XXX
 SG_ TransShiftFingerGearActuator2 : 0|2@1+ (1,0) [0|3] "" Vector__XXX
 SG_ TransShiftFingerRailActuator2 : 0|2@1+ (1,0) [0|3] "" Vector__XXX
 SG_ TransShiftFingerGearActuator1 : 0|2@1+ (1,0) [0|3] "" Vector__XXX
 SG_ TransShiftFingerRailActuator1 : 0|2@1+ (1,0) [0|3] "" Vector__XXX
 SG_ TrnsShftFngerCenterRailIndicator : 0|2@1+ (1,0) [0|3] "" Vector__XXX
 SG_ TrnsShftFngerEngagementIndicator : 0|2@1+ (1,0) [0|3] "" Vector__XXX
 SG_ TransShiftFingerNeutralIndicator : 0|2@1+ (1,0) [0|3] "" Vector__XXX
 SG_ TransShiftFingerRailPos : 0|8@1+ (0.4,0) [0|100] "%" Vector__XXX
 SG_ TransShiftFingerGearPos : 0|8@1+ (0.4,0) [0|100] "%" Vector__XXX
 SG_ TransCurrentRange : 0|16@1+ (1,0) [0|255] "" Vector__XXX
 SG_ TransRequestedRange : 0|16@1+ (1,0) [0|255] "" Vector__XXX
 SG_ TransCurrentGear : 0|8@1+ (1,-125) [-125|125] "" Vector__XXX
 SG_ TransActualGearRatio : 0|16@1+ (0.001,0) [0|64.255] "" Vector__XXX
 SG_ TransSelectedGear : 0|8@1+ (1,-125) [-125|125] "" Vector__XXX
 SG_ SrcAddrssOfCntrllngDvcFrTrnsCtrl : 0|8@1+ (1,0) [0|253] "" Vector__XXX
 SG_ TransInputShaftSpeed : 0|16@1+ (0.125,0) [0|8031.875] "rpm" Vector__XXX
 SG_ MomentaryEngMaxPowerEnable : 0|2@1+ (1,0) [0|3] "" Vector__XXX
 SG_ ProgressiveShiftDisable : 0|2@1+ (1,0) [0|3] "" Vector__XXX
 SG_ EngMomentaryOverspeedEnable : 0|2@1+ (1,0) [0|3] "" Vector__XXX
 SG_ TransOutputShaftSpeed : 0|16@1+ (0.125,0) [0|8031.875] "rpm" Vector__XXX
 SG_ TrnsTrqCnvrtrLckpTrnstnInProcess : 0|2@1+ (1,0) [0|3] "" Vector__XXX
 SG_ TransShiftInProcess : 0|2@1+ (1,0) [0|3] "" Vector__XXX
 SG_ TrnsTorqueConverterLockupEngaged : 0|2@1+ (1,0) [0|3] "" Vector__XXX
 SG_ TransDrivelineEngaged : 0|2@1+ (1,0) [0|3] "" Vector__XXX
 SG_ EngChargeAirCooler1OutletTemp : 0|16@1+ (0.03125,-273) [-273|1734.96875] "°C" Vector__XXX
 SG_ EngIntkVlvActuationSystemOilTemp : 0|16@1+ (0.03125,-273) [-273|1734.96875] "°C" Vector__XXX
 SG_ EngIntakeManifold1AirTemp : 0|16@1+ (0.03125,-273) [-273|1734.96875] "°C" Vector__XXX
 SG_ EngExhaustGasRecirculation1Temp : 0|16@1+ (0.03125,-273) [-273|1734.96875] "°C" Vector__XXX
 SG_ EngExhstGsRcirculation1DiffPress : 0|16@1+ (0.0078125,-250) [-250|251.99] "kPa" Vector__XXX
 SG_ EngECUTemp : 0|16@1+ (0.03125,-273) [-273|1734.96875] "°C" Vector__XXX
 SG_ EngOilTemp2 : 0|16@1+ (0.03125,-273) [-273|1734.96875] "°C" Vector__XXX
 SG_ EngIntercoolerThermostatOpening : 0|8@1+ (0.4,0) [0|100] "%" Vector__XXX
 SG_ EngIntercoolerTemp : 0|8@1+ (1,-40) [-40|210] "°C" Vector__XXX
 SG_ EngTurboOilTemp : 0|16@1+ (0.03125,-273) [-273|1734.96875] "°C" Vector__XXX
 SG_ EngOilTemp1 : 0|16@1+ (0.03125,-273) [-273|1734.96875] "°C" Vector__XXX
 SG_ EngFuelTemp1 : 0|8@1+ (1,-40) [-40|210] "°C" Vector__XXX
 SG_ EngExhaustManifoldBank1Temp2 : 0|16@1+ (0.03125,-273) [-273|1734.96875] "°C" Vector__XXX
 SG_ EngExhaustManifoldBank2Temp2 : 0|16@1+ (0.03125,-273) [-273|1734.96875] "°C" Vector__XXX
 SG_ EngExhaustGasTempLeftManifold : 0|16@1+ (0.03125,-273) [-273|1734.96875] "°C" Vector__XXX
 SG_ EngExhaustGasTempRightManifold : 0|16@1+ (0.03125,-273) [-273|1734.96875] "°C" Vector__XXX
 SG_ TypeOfSteerTrans : 0|4@1+ (1,0) [0|15] "" Vector__XXX
 SG_ TypeOfSteerForces : 0|4@1+ (1,0) [0|15] "" Vector__XXX
 SG_ SteerType : 0|4@1+ (1,0) [0|15] "" Vector__XXX
 SG_ SteerableLiftAxleLoweringInhibit : 0|2@1+ (1,0) [0|3] "" Vector__XXX
 SG_ StatusOfSteerAxle : 0|4@1+ (1,0) [0|15] "" Vector__XXX
 SG_ ActualInnerWheelSteerAngle : 0|16@1+ (0.00390625,-125) [-125|125] "deg" Vector__XXX
 SG_ CrsCtrlRetarderActiveSpeedOffset : 0|16@1+ (0.00390625,-125) [0|125.996] "km/h" Vector__XXX
 SG_ TransOutputRetarder : 0|2@1+ (1,0) [0|3] "" Vector__XXX
 SG_ ActlMxAvlblRetarderPercentTorque : 0|8@1+ (1,-125) [-125|0] "%" Vector__XXX
 SG_ RetarderSelectionNonengine : 0|8@1+ (0.4,0) [0|100] "%" Vector__XXX
 SG_ DrvrsDemandRetarderPercentTorque : 0|8@1+ (1,-125) [-125|0] "%" Vector__XXX
 SG_ SrcAddrssOfCntrllngDvcFrRtrdrCtr : 0|8@1+ (1,0) [0|253] "" Vector__XXX
 SG_ RetarderRoadSpeedExceeded : 0|2@1+ (1,0) [0|3] "" Vector__XXX
 SG_ RetarderRoadSpeedLimitSwitch : 0|2@1+ (1,0) [0|3] "" Vector__XXX
 SG_ RetarderRequestingBrakeLight : 0|2@1+ (1,0) [0|3] "" Vector__XXX
 SG_ EngCoolantLoadIncrease : 0|2@1+ (1,0) [0|3] "" Vector__XXX
 SG_ IntendedRetarderPercentTorque : 0|8@1+ (1,-125) [-125|0] "%" Vector__XXX
 SG_ ActualRetarderPercentTorque : 0|8@1+ (1,-125) [-125|0] "%" Vector__XXX
 SG_ RetarderEnableShiftAssistSwitch : 0|2@1+ (1,0) [0|3] "" Vector__XXX
 SG_ RetarderEnableBrakeAssistSwitch : 0|2@1+ (1,0) [0|3] "" Vector__XXX
 SG_ RetarderTorqueMode : 0|4@1+ (1,0) [0|15] "" Vector__XXX
 SG_ EngExhaustGasPort20Temp : 0|16@1+ (0.03125,-273) [-273|1734.96875] "°C" Vector__XXX
 SG_ EngExhaustGasPort19Temp : 0|16@1+ (0.03125,-273) [-273|1734.96875] "°C" Vector__XXX
 SG_ EngExhaustGasPort18Temp : 0|16@1+ (0.03125,-273) [-273|1734.96875] "°C" Vector__XXX
 SG_ EngExhaustGasPort17Temp : 0|16@1+ (0.03125,-273) [-273|1734.96875] "°C" Vector__XXX
 SG_ EngExhaustGasPort16Temp : 0|16@1+ (0.03125,-273) [-273|1734.96875] "°C" Vector__XXX
 SG_ EngExhaustGasPort15Temp : 0|16@1+ (0.03125,-273) [-273|1734.96875] "°C" Vector__XXX
 SG_ EngExhaustGasPort14Temp : 0|16@1+ (0.03125,-273) [-273|1734.96875] "°C" Vector__XXX
 SG_ EngExhaustGasPort13Temp : 0|16@1+ (0.03125,-273) [-273|1734.96875] "°C" Vector__XXX
 SG_ EngExhaustGasPort12Temp : 0|16@1+ (0.03125,-273) [-273|1734.96875] "°C" Vector__XXX
 SG_ EngExhaustGasPort11Temp : 0|16@1+ (0.03125,-273) [-273|1734.96875] "°C" Vector__XXX
 SG_ EngExhaustGasPort10Temp : 0|16@1+ (0.03125,-273) [-273|1734.96875] "°C" Vector__XXX
 SG_ EngExhaustGasPort9Temp : 0|16@1+ (0.03125,-273) [-273|1734.96875] "°C" Vector__XXX
 SG_ EngExhaustGasPort8Temp : 0|16@1+ (0.03125,-273) [-273|1734.96875] "°C" Vector__XXX
 SG_ EngExhaustGasPort7Temp : 0|16@1+ (0.03125,-273) [-273|1734.96875] "°C" Vector__XXX
 SG_ EngExhaustGasPort6Temp : 0|16@1+ (0.03125,-273) [-273|1734.96875] "°C" Vector__XXX
 SG_ EngExhaustGasPort5Temp : 0|16@1+ (0.03125,-273) [-273|1734.96875] "°C" Vector__XXX
 SG_ EngExhaustGasPort4Temp : 0|16@1+ (0.03125,-273) [-273|1734.96875] "°C" Vector__XXX
 SG_ EngExhaustGasPort3Temp : 0|16@1+ (0.03125,-273) [-273|1734.96875] "°C" Vector__XXX
 SG_ EngExhaustGasPort2Temp : 0|16@1+ (0.03125,-273) [-273|1734.96875] "°C" Vector__XXX
 SG_ EngExhaustGasPort1Temp : 0|16@1+ (0.03125,-273) [-273|1734.96875] "°C" Vector__XXX
 SG_ PayloadCapacityPercentage : 0|8@1+ (1,0) [0|250] "%" Vector__XXX
 SG_ PayloadCarryBackWeight : 0|16@1+ (2,0) [0|128510] "kg" Vector__XXX
 SG_ PayloadWeightConfidence : 0|8@1+ (0.5,0) [0|100] "%" Vector__XXX
 SG_ PayloadWeight : 0|24@1+ (2,0) [0|32899070] "kg" Vector__XXX
 SG_ PayloadPercentage : 0|8@1+ (1,0) [0|250] "%" Vector__XXX
 SG_ DataMemoryUsage : 0|8@1+ (0.4,0) [0|100] "%" Vector__XXX
 SG_ KeepAliveBatteryConsumption : 0|16@1+ (1,0) [0|64255] "mAh" Vector__XXX
 SG_ TravelVelocityCtrlPos : 0|8@1+ (1,-125) [-125|125] "%" Vector__XXX
 SG_ EngExhstGsOxygnSnsrClsdLpOprtion : 0|2@1+ (1,0) [0|3] "" Vector__XXX
 SG_ EngExhstGsOxygnSnsrFlngCrrection : 0|8@1+ (1,-125) [-125|125] "%" Vector__XXX
 SG_ EngActualExhaustOxygen : 0|16@1+ (0.0025,0) [0|160.6375] "%" Vector__XXX
 SG_ EngDesiredExhaustOxygen : 0|16@1+ (0.0025,0) [0|160.6375] "%" Vector__XXX
 SG_ EngDesiredRatedExhaustOxygen : 0|16@1+ (0.0025,0) [0|160.6375] "%" Vector__XXX
 SG_ Joystick3Button13PressedStatus : 0|2@1+ (1,0) [0|3] "" Vector__XXX
 SG_ Joystick3Button14PressedStatus : 0|2@1+ (1,0) [0|3] "" Vector__XXX
 SG_ Joystick3Button15PressedStatus : 0|2@1+ (1,0) [0|3] "" Vector__XXX
 SG_ Joystick3Button16PressedStatus : 0|2@1+ (1,0) [0|3] "" Vector__XXX
 SG_ Jystick3GripXAxisDetentPosStatus : 0|2@1+ (1,0) [0|3] "" Vector__XXX
 SG_ Jystick3GripYAxisDetentPosStatus : 0|2@1+ (1,0) [0|3] "" Vector__XXX
 SG_ Jystick3ThetaAxisDetentPosStatus : 0|2@1+ (1,0) [0|3] "" Vector__XXX
 SG_ Joystick3ThetaAxisPos : 0|10@1+ (0.1,0) [0|100] "%" Vector__XXX
 SG_ Jystck3ThtAxsClckwsPstvPosStatus : 0|2@1+ (1,0) [0|3] "" Vector__XXX
 SG_ Jystck3ThetaAxisNeutralPosStatus : 0|2@1+ (1,0) [0|3] "" Vector__XXX
 SG_ Joystick3GripYAxisPos : 0|10@1+ (0.1,0) [0|100] "%" Vector__XXX
 SG_ Jystck3GrpYAxsLvrFrwrdPstvPsStts : 0|2@1+ (1,0) [0|3] "" Vector__XXX
 SG_ Jystck3GrpYAxsLvrBckNgtvPsStatus : 0|2@1+ (1,0) [0|3] "" Vector__XXX
 SG_ Jystck3GripYAxisNeutralPosStatus : 0|2@1+ (1,0) [0|3] "" Vector__XXX
 SG_ Joystick3GripXAxisPos : 0|10@1+ (0.1,0) [0|100] "%" Vector__XXX
 SG_ Jystck3GrpXAxsLvrRghtPstvPsSttus : 0|2@1+ (1,0) [0|3] "" Vector__XXX
 SG_ Jystck3GrpXAxsLvrLftNgtvPsStatus : 0|2@1+ (1,0) [0|3] "" Vector__XXX
 SG_ Jystck3GripXAxisNeutralPosStatus : 0|2@1+ (1,0) [0|3] "" Vector__XXX
 SG_ Jystck3ThtAxsCntrClckwsNgtvPsStt : 0|2@1+ (1,0) [0|3] "" Vector__XXX
 SG_ Joystick2Button13PressedStatus : 0|2@1+ (1,0) [0|3] "" Vector__XXX
 SG_ Joystick2Button14PressedStatus : 0|2@1+ (1,0) [0|3] "" Vector__XXX
 SG_ Joystick2Button15PressedStatus : 0|2@1+ (1,0) [0|3] "" Vector__XXX
 SG_ Joystick2Button16PressedStatus : 0|2@1+ (1,0) [0|3] "" Vector__XXX
 SG_ Jystick2GripXAxisDetentPosStatus : 0|2@1+ (1,0) [0|3] "" Vector__XXX
 SG_ Jystick2GripYAxisDetentPosStatus : 0|2@1+ (1,0) [0|3] "" Vector__XXX
 SG_ Jystick2ThetaAxisDetentPosStatus : 0|2@1+ (1,0) [0|3] "" Vector__XXX
 SG_ Joystick2ThetaAxisPos : 0|10@1+ (0.1,0) [0|100] "%" Vector__XXX
 SG_ Jystck2ThtAxsClckwsPstvPosStatus : 0|2@1+ (1,0) [0|3] "" Vector__XXX
 SG_ Jystck2ThetaAxisNeutralPosStatus : 0|2@1+ (1,0) [0|3] "" Vector__XXX
 SG_ Joystick2GripYAxisPos : 0|10@1+ (0.1,0) [0|100] "%" Vector__XXX
 SG_ Jystck2GrpYAxsLvrFrwrdPstvPsStts : 0|2@1+ (1,0) [0|3] "" Vector__XXX
 SG_ Jystck2GrpYAxsLvrBckNgtvPsStatus : 0|2@1+ (1,0) [0|3] "" Vector__XXX
 SG_ Jystck2GripYAxisNeutralPosStatus : 0|2@1+ (1,0) [0|3] "" Vector__XXX
 SG_ Joystick2GripXAxisPos : 0|10@1+ (0.1,0) [0|100] "%" Vector__XXX
 SG_ Jystck2GrpXAxsLvrRghtPstvPsSttus : 0|2@1+ (1,0) [0|3] "" Vector__XXX
 SG_ Jystck2GrpXAxsLvrLftNgtvPsStatus : 0|2@1+ (1,0) [0|3] "" Vector__XXX
 SG_ Jystck2GripXAxisNeutralPosStatus : 0|2@1+ (1,0) [0|3] "" Vector__XXX
 SG_ Jystck2ThtAxsCntrClckwsNgtvPsStt : 0|2@1+ (1,0) [0|3] "" Vector__XXX
 SG_ Joystick1Button13PressedStatus : 0|2@1+ (1,0) [0|3] "" Vector__XXX
 SG_ Joystick1Button14PressedStatus : 0|2@1+ (1,0) [0|3] "" Vector__XXX
 SG_ Joystick1Button15PressedStatus : 0|2@1+ (1,0) [0|3] "" Vector__XXX
 SG_ Joystick1Button16PressedStatus : 0|2@1+ (1,0) [0|3] "" Vector__XXX
 SG_ Jystick1GripXAxisDetentPosStatus : 0|2@1+ (1,0) [0|3] "" Vector__XXX
 SG_ Jystick1GripYAxisDetentPosStatus : 0|2@1+ (1,0) [0|3] "" Vector__XXX
 SG_ Jystick1ThetaAxisDetentPosStatus : 0|2@1+ (1,0) [0|3] "" Vector__XXX
 SG_ Joystick1ThetaAxisPos : 0|10@1+ (0.1,0) [0|100] "%" Vector__XXX
 SG_ Jystck1ThtAxsClckwsPstvPosStatus : 0|2@1+ (1,0) [0|3] "" Vector__XXX
 SG_ Jystck1ThetaAxisNeutralPosStatus : 0|2@1+ (1,0) [0|3] "" Vector__XXX
 SG_ Joystick1GripYAxisPos : 0|10@1+ (0.1,0) [0|100] "%" Vector__XXX
 SG_ Jystck1GrpYAxsLvrFrwrdPstvPsStts : 0|2@1+ (1,0) [0|3] "" Vector__XXX
 SG_ Jystck1GrpYAxsLvrBckNgtvPsStatus : 0|2@1+ (1,0) [0|3] "" Vector__XXX
 SG_ Aftrtrtmnt1DslExhstFldPrprtsPrlm : 0|2@1+ (1,0) [0|3] "" Vector__XXX
 SG_ Joystick1GripXAxisPos : 0|10@1+ (0.1,0) [0|100] "%" Vector__XXX
 SG_ Jystck1GrpXAxsLvrRghtPstvPsSttus : 0|2@1+ (1,0) [0|3] "" Vector__XXX
 SG_ Jystck1GrpXAxsLvrLftNgtvPsStatus : 0|2@1+ (1,0) [0|3] "" Vector__XXX
 SG_ Jystck1GripXAxisNeutralPosStatus : 0|2@1+ (1,0) [0|3] "" Vector__XXX
 SG_ Jystck1ThtAxsCntrClckwsNgtvPsStt : 0|2@1+ (1,0) [0|3] "" Vector__XXX
 SG_ EngFuelRackPos : 0|8@1+ (0.4,0) [0|100] "%" Vector__XXX
 SG_ EngGasMassFlowRate1 : 0|16@1+ (0.05,0) [0|3212.75] "kg/h" Vector__XXX
 SG_ InstantaneousEstBrakePower : 0|16@1+ (0.5,0) [0|32127.5] "kW" Vector__XXX
 SG_ EngExhaustGasPress1 : 0|16@1+ (0.0078125,-250) [-250|251.99] "kPa" Vector__XXX
 SG_ EngPrefilterOilPress : 0|8@1+ (4,0) [0|1000] "kPa" Vector__XXX
 SG_ TotalECURunTime : 0|32@1+ (0.05,0) [0|210554060.75] "h" Vector__XXX
 SG_ TotalECUDistance : 0|32@1+ (0.125,0) [0|526385151.875] "km" Vector__XXX
 SG_ EngExhstGsRcrcltion2MassFlowRate : 0|16@1+ (0.05,0) [0|3212.75] "kg/h" Vector__XXX
 SG_ EngIntakeAirMassFlowRate : 0|16@1+ (0.05,0) [0|3212.75] "kg/h" Vector__XXX
 SG_ EngExhstGsRcrcltion1MassFlowRate : 0|16@1+ (0.05,0) [0|3212.75] "kg/h" Vector__XXX
 SG_ EngFuelSupplyPumpIntakePress : 0|8@1+ (2,0) [0|500] "kPa" Vector__XXX
 SG_ FuelPumpPrimerStatus : 0|2@1+ (1,0) [0|3] "" Vector__XXX
 SG_ EngVentilationStatus : 0|3@1+ (1,0) [0|7] "" Vector__XXX
 SG_ EngCoolantPreheatedState : 0|2@1+ (1,0) [0|3] "" Vector__XXX
 SG_ EngOilPreHeatedState : 0|2@1+ (1,0) [0|3] "" Vector__XXX
 SG_ EngOilPrimingState : 0|2@1+ (1,0) [0|3] "" Vector__XXX
 SG_ EngOilPrimingPumpSwitch : 0|2@1+ (1,0) [0|3] "" Vector__XXX
 SG_ EngOilFilterOutletPress : 0|8@1+ (4,0) [0|1000] "kPa" Vector__XXX
 SG_ EngWasteOilReservoirLevel : 0|8@1+ (0.4,0) [0|100] "%" Vector__XXX
 SG_ EngFuelFilterDiffPress : 0|8@1+ (2,0) [0|500] "kPa" Vector__XXX
 SG_ EngOilLevelRemoteReservoir : 0|8@1+ (0.4,0) [0|100] "%" Vector__XXX
 SG_ EngThrottleValve1DiffPress : 0|16@1+ (0.1,0) [0|6425.5] "kPa" Vector__XXX
 SG_ EngExhstGsRcrclation1OutletPress : 0|8@1+ (2,0) [0|500] "kPa" Vector__XXX
 SG_ EngExhstVlvActtionSystemOilPress : 0|16@1+ (0.00390625,0) [0|250.996] "MPa" Vector__XXX
 SG_ EngExhstGsRcrclation1IntakePress : 0|8@1+ (2,0) [0|500] "kPa" Vector__XXX
 SG_ EngIntkVlvActationSystemOilPress : 0|16@1+ (0.00390625,0) [0|250.996] "MPa" Vector__XXX
 SG_ EngInjectorMeteringRail2Press : 0|16@1+ (0.00390625,0) [0|250.996] "MPa" Vector__XXX
 SG_ EngInjectorTimingRail1Press : 0|16@1+ (0.00390625,0) [0|250.996] "MPa" Vector__XXX
 SG_ EngInjectorMeteringRail1Press : 0|16@1+ (0.00390625,0) [0|250.996] "MPa" Vector__XXX
 SG_ EngInjectionCtrlPress : 0|16@1+ (0.00390625,0) [0|250.996] "MPa" Vector__XXX
 SG_ EngCoolantLevel : 0|8@1+ (0.4,0) [0|100] "%" Vector__XXX
 SG_ EngCoolantPress : 0|8@1+ (2,0) [0|500] "kPa" Vector__XXX
 SG_ EngCrankcasePress : 0|16@1+ (0.0078125,-250) [-250|251.99] "kPa" Vector__XXX
 SG_ EngOilLevel : 0|8@1+ (0.4,0) [0|100] "%" Vector__XXX
 SG_ EngExCrankcaseBlowbyPress : 0|8@1+ (0.05,0) [0|12.5] "kPa" Vector__XXX
 SG_ SafetyWireStatus : 0|2@1+ (1,0) [0|3] "" Vector__XXX
 SG_ ElectricalLoad : 0|16@1+ (0.5,0) [0|32127.5] "kW" Vector__XXX
 SG_ EngVrblGeometryTurbo1ActuatorPos : 0|8@1+ (0.4,0) [0|100] "%" Vector__XXX
 SG_ EngVriableGeometryTurbo1CtrlMode : 0|2@1+ (1,0) [0|3] "" Vector__XXX
 SG_ EngFuelCtrlCtrlMode : 0|2@1+ (1,0) [0|3] "" Vector__XXX
 SG_ EngVrblGmtryTrbArCtrlShtoffValve : 0|2@1+ (1,0) [0|3] "" Vector__XXX
 SG_ EngExhstGsRcirculation1ValveCtrl : 0|16@1+ (0.0025,0) [0|100] "%" Vector__XXX
 SG_ EngTrb1ClclatedTurbineOutletTemp : 0|16@1+ (0.03125,-273) [-273|1734.96875] "°C" Vector__XXX
 SG_ EngTrb1ClclatedTurbineIntakeTemp : 0|16@1+ (0.03125,-273) [-273|1734.96875] "°C" Vector__XXX
 SG_ EngFuelFilterDiffPress : 0|8@1+ (2,0) [0|500] "kPa" Vector__XXX

CM_ SG_ 3221225472 EngPTOGovernorSetSwitch "Switch signal of the PTO control activator which indicates that the activator is in the position to 'set' the engine PTO governor set speed.

00 - Off
01 - On
10 - Error
11 - Not available";
CM_ SG_ 3221225472 EngPTOGovernorResumeSwitch "Switch signal of the PTO control activator which indicates that the activator is in the position to 'resume' a previously established PTO governor set speed.

00 - Off
01 - On
10 - Error
11 - Not available";
CM_ SG_ 3221225472 EngPTOGovernorEnableSwitch "Switch signal which indicates that the PTO governor toggle switch is in the enabled (ON) position and therefore it is possible to manage the PTO control function.

00 - Off
01 - On
10 - Error
11 - Not available";
CM_ SG_ 3221225472 EngPTOGovernorAccelerateSwitch "Switch signal of the PTO control activator which indicates that the activator is in the position to 'accelerate' the PTO governor set speed.

00 - Off
01 - On
10 - Error
11 - Not available";
CM_ SG_ 3221225472 RmtPTOGvrnrPrprgrmmdSpdCtrlSwtch "Switch signal which indicates that the remote PTO governor toggle switch #2 is in the enabled (ON) position. If the toggle switch is enabled and other conditions are satisfied then the remote PTO governor control feature is activated and the PTO ...";
CM_ SG_ 3221225472 AuxInputIgnoreSwitch "Switch signal which overrides other switch input's ability to disable an engine's operating condition.
00 - Off
01 - On
10 - Error
11 - Not Available
This switch input can be used to prevent the PTO from disengaging if another switch input's ...";
CM_ SG_ 3221225472 RearWasherFunction "State of operation selected by operator switch for the rear washer.   The parameter, 'Front Operator Washer Switch' should be used for the control information if this parameter is 'Not Available' and the associated washer still needs to be ...";
CM_ SG_ 3221225472 FrontOperatorWasherSwitch "State of operation selected by operator switch for the washer in front of the operator position. This parameter, 'Front Operator Washer Switch' should be used for the control information if either of the other washer switch parameters  is 'Not ...";
CM_ SG_ 3221225472 FrontNonoperatorWasherSwitch "State of operation selected by operator switch for the front washer not in front of the operator position.  The parameter, 'Front Operator Washer Switch' should be used for the control information if this parameter  is 'Not Available' and the ...";
CM_ SG_ 3221225472 RearWiperDelayCtrl "Time between cycles of the rear wiper (i.e. from end of cycle 'n' to start of cycle 'n+1') as selected by the operator control (switch, etc.) in percentage of position with maximum position corresponding to maximum delay selectable.  The parameter, ...";
CM_ SG_ 3221225472 FrontNonoperatorWiperDelayCtrl "Time between cycles of the front non-operator side wiper (i.e. from end of cycle 'n' to start of cycle 'n+1') as selected by the operator control (switch, etc.) in percentage of position with maximum position corresponding to maximum delay ...";
CM_ SG_ 3221225472 FrontOperatorWiperDelayCtrl "Time between cycles of the front operator side wiper (i.e. from end of cycle 'n' to start of cycle 'n+1') as selected by the operator control (switch, etc.) in percentage of position with maximum position corresponding to maximum delay selectable ...";
CM_ SG_ 3221225472 RearWiperSwitch "State of operation selected by operator switch for the rear wiper.  The parameter, 'Front Operator Washer Switch' should be used for the control information if this parameter is 'Not Available' and the associated washer still needs to be controlled.
 ...";
CM_ SG_ 3221225472 FrontOperatorWiperSwitch "State of operation selected by operator switch for the Wiper in front of the operator position. This parameter, 'Front Operator Wiper Switch' should be used for the control information if either of the other wiper switch parameters is 'Not ...";
CM_ SG_ 3221225472 FrontNonoperatorWiperSwitch "State of operation selected by operator switch for the front wiper not in front of the operator position.  The parameter, 'Front Operator Washer Switch' should be used for the control information if this parameter is 'Not Available' and the ...";
CM_ SG_ 3221225472 EngTorqueCurveSelectionCmd "This parameter will allow selection of a torque curve that is higher than the base curve.
0 - Indicates that this parameter is not presently requesting a different torque curve be used
1 - Indicates that Torque Curve 1 is selected
2 - Indicates ...";
CM_ SG_ 3221225472 EngAltDroopAuxInputSelect "In some off-highway applications it may be desirable to have multiple droop settings available across the range of engine operation.  For example, in an agricultural tractor application, this functionality allows a higher engine speed during low ...";
CM_ SG_ 3221225472 EngAltDroopRemoteAccelSelect "In some off-highway applications it may be desirable to have multiple droop settings available across the range of engine operation.  For example, in an agricultural tractor application, this functionality allows a higher engine speed during low ...";
CM_ SG_ 3221225472 EngAltDroopAccel2Select "In some off-highway applications it may be desirable to have multiple droop settings available across the range of engine operation.  For example, in an agricultural tractor application, this functionality allows a higher engine speed during low ...";
CM_ SG_ 3221225472 EngAltDroopAccel1Select "In some off-highway applications it may be desirable to have multiple droop settings available across the range of engine operation.  For example, in an agricultural tractor application, this functionality allows a higher engine speed during low ...";
CM_ SG_ 3221225472 EngAltRatingSelect "In some off-highway applications it may be desirable to have multiple engine ratings available for selection by the operator. There is the default engine rating, which provides the maximum available power across the range of operation. There are ...";
CM_ SG_ 3221225472 EngAltLowIdleSwitch "Operator switch which selects between two low idle speeds, default and alternate.
The normal programmed low idle is the default low idle, and when the Alternate Low Idle switch is activated, a alternate preprogrammed low idle speed is selected. The ...";
CM_ SG_ 3221225472 EngSynchronizationSwitch "This is the On/Off operation of the Multiple Unit Synchronization functionality. When it is enabled (i.e. On) the master engine will synchronize one or more slave engines to operate at the same speed. This switch position indicates whether this ...";
CM_ SG_ 3221225472 EngAuxGovernorSwitch "This is the On/Off operation of the Auxiliary Governor feature switch. This feature is used to allow engine speed to be controlled by an auxiliary input such as pressure or tailshaft speed. This switch position indicates whether this feature is ...";
CM_ SG_ 3221225472 EngTorqueCurveSelection "This parameter will report the selected torque curve, as indicated by SPN 6796.
0 - Indicates that the engine is using a torque that is not presently selected by SPN 6796
1 - Indicates that Torque Curve 1 is selected
2 - Indicates that Torque ...";
CM_ SG_ 3221225472 EngAltDroopAuxInputSelectState "In some off-highway applications it may be desirable to have multiple droop settings available across the range of engine operation.  For example, in an agricultural tractor application, this functionality allows a higher engine speed during low ...";
CM_ SG_ 3221225472 EngAltDropRemoteAccelSelectState "In some off-highway applications it may be desirable to have multiple droop settings available across the range of engine operation.  For example, in an agricultural tractor application, this functionality allows a higher engine speed during low ...";
CM_ SG_ 3221225472 EngAltDroopAccel2SelectState "In some off-highway applications it may be desirable to have multiple droop settings available across the range of engine operation.  For example, in an agricultural tractor application, this functionality allows a higher engine speed during low ...";
CM_ SG_ 3221225472 EngAltDroopAccel1SelectState "In some off-highway applications it may be desirable to have multiple droop settings available across the range of engine operation.  For example, in an agricultural tractor application, this functionality allows a higher engine speed during low ...";
CM_ SG_ 3221225472 EngAltRatingSelectState "This parameter reflects the control state that has been achieved based on the input from the SPN 2882.  In some off-highway applications it may be desirable to have multiple engine ratings available for selection by the operator.  There is the ...";
CM_ SG_ 3221225472 EngAltLowIdleSelectState "In many applications, it is desirable that an alternate low idle speed setting be made available via switch input. The normal programmed low idle is the default low idle, and when the Alternate Low Idle feature is activated, an alternate ...";
CM_ SG_ 3221225472 EngMultiUnitSyncState "This feature is widely used in Industry to operate multiple engines from a single command source. A master engine will 'synchronize' one or more slave engines to operate at the same speed. This feature is requested by an operator switch, this ...";
CM_ SG_ 3221225472 EngAuxGovernorState "This is the Engine Auxiliary Governor feature. This feature is used to allow engine speed to be controlled by an auxiliary input such as pressure or tailshaft speed. This feature is requested by an operator switch, this parameter indicates the state ...";
CM_ SG_ 3221225472 OprtorsDesiredDelayedLampOffTime "A 16 bit parameter to be associated with Delayed Off position (1000 binary) of the Main Light Switch.  This parameter indicates the time the operator wishes to have elapse following the Main Light switch being placed in Delayed Off position before ...";
CM_ SG_ 3221225472 OperatorsDesiredBacklight "A 8 bit parameter to indicate the level of back lighting the operator has selected for displays.  This is to be differentiated from the Illumination Brightness Percent (SPN:1487 PGN:53248 Cab Illumination Message) which is sent to the displays to ...";
CM_ SG_ 3221225472 HighLowBeamSwitch "A 2 bit parameter to indicate the selected position of the operator's high/low beam select switch.

00  Low Beam Selected
01  High Beam Selected
10  Error
11  Not available (do not change)";
CM_ SG_ 3221225472 HazardLightSwitch "A 2 bit parameter to indicate the selected position of the operator's hazard light switch.

00   Hazard Lamps to be Off
01   Hazard Lamps to be Flashing
10   Error
11   Not available (do not change)";
CM_ SG_ 3221225472 TurnSignalSwitch "A 4 bit parameter to indicate the selected position of the operator's turn signal switch.
0000   No Turn being signaled
0001   Left Turn to be Flashing
0010   Right turn to be Flashing
0011 - 1101   Reserved
1110   Error (to include both left ...";
CM_ SG_ 3221225472 MainLightSwitch "A 4 bit parameter to indicate the selected position of the operator's main light switch.
0000 Off - The position by which the operator selects that none of the lamps are to be on.
0001 Park On - The position by which the operator selects that the ...";
CM_ SG_ 3221225472 WorkLightSwitch "A 4 bit parameter to indicate the selected position of the operator's work light switch. In Ag applications the work lights are often refereed to as field lights.  In on-highway applications the work lights are often referred to as clearance lights ...";
CM_ SG_ 3221225472 MaxVehicleSpeedLimit7 "The highest of the seven lowest vehicle speed limits";
CM_ SG_ 3221225472 MaxVehicleSpeedLimit6 "The highest of the six lowest vehicle speed limits";
CM_ SG_ 3221225472 MaxVehicleSpeedLimit5 "The highest of the five lowest vehicle speed limits";
CM_ SG_ 3221225472 MaxVehicleSpeedLimit4 "The highest of the four lowest vehicle speed limits";
CM_ SG_ 3221225472 MaxVehicleSpeedLimit3 "The highest of the three lowest vehicle speed limits";
CM_ SG_ 3221225472 MaxVehicleSpeedLimit2 "The highest of the two lowest vehicle speed limits";
CM_ SG_ 3221225472 MaxVehicleSpeedLimit1 "The lowest Maximum Vehicle Speed Limit. This value is the similar to SPN 74. However, SPN 74 was not specifically defined to convey  the applied vehicle speed limit or what was possible to be applied. This new SPN is the lowest vehicle speed limit ...";
CM_ SG_ 3221225472 OprtrsBlackOutIntensitySelection "Operators Selection of lamp intensity in black out mode.  This parameter provides the operators selected illumination intensity as a percentage of available full scale.  This parameter would be typically used as a dash or instrument cluster ...";
CM_ SG_ 3221225472 BlackOutWorkLampSelect "Black Out Work Lamp Selection

00 Off
01 On
10 Reserved
11 Not Supported";
CM_ SG_ 3221225472 NightVisionIlluminatorSelect "Night Vision Illuminator Selection

00 Off
01 On
10 Reserved
11 Not Supported";
CM_ SG_ 3221225472 BlackOutBrake_StopLampSelect "Black Out Brake/Stop Lamp Selection

00 Off
01 On
10 Reserved
11 Not Supported";
CM_ SG_ 3221225472 ConvoyDrivingLampSelect "Black Out Convoy Driving Lamp Selection

00 Off
01 On
10 Reserved
11 Not Supported";
CM_ SG_ 3221225472 ConvoyLampSelect "Black Out Convoy Lamp Selection

00 Off
01 On
10 Reserved
11 Not Supported";
CM_ SG_ 3221225472 FrontBlackOutMarkerLampSelect "Front Black Out Marker Lamp Selection

00 Off
01 On
10 Reserved
11 Not Supported";
CM_ SG_ 3221225472 RearBlackOutMarkerSelect "Rear Black Out Marker Selection

00 Off
01 On
10 Reserved
11 Not Supported";
CM_ SG_ 3221225472 SlowVesselModeStatus "The status of the Slow Vessel Mode.  Slow Vessel Mode puts the engine in a lower-than-normal low idle speed during docking or other slow vessel operations.
00 Slow vessel mode is OFF.
01 Slow vessel mode is ACTIVE.
10 Reserved
11 Take no action
 ...";
CM_ SG_ 3221225472 TrollingModeStatus "The status of the Trolling Mode.  Trolling mode limits the top speed.  Full range travel of the throttle level spans from low idle engine speed to maximum trolling speed.
00 Trolling mode is OFF.
01 Trolling mode is ACTIVE.
10 Reserved
11 Take ...";
CM_ SG_ 3221225472 EngThrttlSynchrnzationModeStatus "The status of the Throttle Synchronization Mode. Throttle Synchronization Mode is used to indicate which throttle, if any, is currently being used for the synchronized throttle.
0000 Not Synchronized
0001 Synchronized Center
0010 Synchronized ...";
CM_ SG_ 3221225472 EngMainBearing12Temp "Temperature of the main bearing which supports the crankshaft of the engine.";
CM_ SG_ 3221225472 EngMainBearing11Temp "Temperature of the main bearing which supports the crankshaft of the engine.";
CM_ SG_ 3221225472 EngMainBearing10Temp "Temperature of the main bearing which supports the crankshaft of the engine.";
CM_ SG_ 3221225472 EngMainBearing9Temp "Temperature of the main bearing which supports the crankshaft of the engine.";
CM_ SG_ 3221225472 EngMainBearing8Temp "Temperature of the main bearing which supports the crankshaft of the engine.";
CM_ SG_ 3221225472 EngMainBearing7Temp "Temperature of the main bearing which supports the crankshaft of the engine.";
CM_ SG_ 3221225472 EngMainBearing6Temp "Temperature of the main bearing which supports the crankshaft of the engine.";
CM_ SG_ 3221225472 EngMainBearing5Temp "Temperature of the main bearing which supports the crankshaft of the engine.";
CM_ SG_ 3221225472 EngMainBearing4Temp "Temperature of the main bearing which supports the crankshaft of the engine.";
CM_ SG_ 3221225472 EngMainBearing3Temp "Temperature of the main bearing which supports the crankshaft of the engine.";
CM_ SG_ 3221225472 EngMainBearing2Temp "Temperature of the main bearing which supports the crankshaft of the engine.";
CM_ SG_ 3221225472 EngMainBearing1Temp "Temperature of the main bearing which supports the crankshaft of the engine.";
CM_ SG_ 3221225472 DisplayDeadbands "Sets Display Deadbands mode.

0000 - Narrow = +/- 4.5mm
0001 - Standard = +/- 12mm
0010 - Wide = +/- 24mm
0011 - 1110 Reserved
1111 Not Available";
CM_ SG_ 3221225472 LEDPatternCtrl "Sets LED Pattern control mode on laser leveling systems.

0000 - 5 Channel
0001 - Offset
0010 - 7 Channel
0011 - 1110 Reserved
1111 Not Available";
CM_ SG_ 3221225472 LEDDisplayDeadbandCtrl "This parameter informs the system what the selected Display deadband will be.
0000    +/- 4.5 mm  (0.015 feet, 0.18 inches)
0001    +/- 12 mm   (0.040 feet, 0.45 inches)
0010    +/- 24 mm   (0.080 feet, 0.96 inches)
0011    +/- 5  mm    (0.017 ...";
CM_ SG_ 3221225472 LEDDisplayModeCtrl "This parameter informs the system what the selected Display mode will be.
0000 - Center On-Grade Display Mode 1 ( 5 CHANNEL )
0001 - Offset On-Grade Display Mode
0010 - Center On-Grade Display Mode 2 ( 7 CHANNEL )
0011 - 1110 Reserved
1111 - ...";
CM_ SG_ 3221225472 LEDDisplayData1 "Informs display devices how to display the current vertical position.
Values which are less than 128 decimal are bit-mapped values and any combination of these values is considered a valid value.  For example communicating the 'High Fine LED on' ...";
CM_ SG_ 3221225472 AbsLaserStrikePos "Laser Strike location on the survey type  laser receiver.";
CM_ SG_ 3221225472 LaserStrikeDataLatency "Time from laser strike to CAN message transmission.  This parameter will be reported by survey receiver type devices only. Byte 3 (SPN 2576) of  PGN 65141 identifies the type of Laser Receiver.";
CM_ SG_ 3221225472 LaserReceiverType "Identifies which type of Laser Receiver transmitted the message.

0 = Reserved 
1 = Linear Laser Receiver
2 = 1 Meter Survey Receiver
3 = 2 Meter Survey Receiver
4 = 2.5 Meter Survey Receiver
5-250 = Reserved";
CM_ SG_ 3221225472 LaserStrikeVerticalDeviation "The calculated distance from the laser strike position to the current land leveling system reference point.";
CM_ SG_ 3221225472 LaserTracerInformation "Provides the status of the laser tracer to the operator.
00000001 Laser power is on
00000010 Laser is ready
00000100 Valid target (1 = yes)
00001000 Previous pass (1 = yes)
00010000 Stringline (1 = yes)
00100000 Curb (1 = yes)
All other ...";
CM_ SG_ 3221225472 LEDDisplayData2 "Informs display devices how to display the current position of the laser tracer.
Values which are less than 128 decimal are bit-mapped values and any combination of these values is considered a valid value.  For example communicating the 'Up LED ...";
CM_ SG_ 3221225472 LaserTracerHorizontalDeviation "The calculated percent deviation between the target distance and the center of the laser tracer.";
CM_ SG_ 3221225472 LaserTracerVerticalDistance "The elevation of the laser tracer sensor in a laser leveling system.";
CM_ SG_ 3221225472 LaserTracerTargetDeviation "The calculated distance for the laser target to the current laser tracer reference point.

Parameter specific parameter: 0xFE03 indicates that the sensor can not sense the laser";
CM_ SG_ 3221225472 BldeHeightSetPointHighResolution "High resolution for the laser guided blade set point.  The high resolution required for more accurate control and 'accurate' unit conversions.

Negative values are below grade, positive values are above grade, zero is on grade.";
CM_ SG_ 3221225472 ModifyLevelingSystemSetPoint "Used to control and coordinate the set point for the leveling system.
Operating Range: -3200 to +3200 mm, negative values are below current position, positive values are above current position, zero is no change.
Parameter specific parameter:
 ...";
CM_ SG_ 3221225472 StElvtnSensor2ReferenceElevation "Command from a display or other external device (i.e. remote switch) to the land leveling system controller instructing the controller to set the reference elvation based on data received from the corresponding land leveling sensor.
00 = Do not Set ...";
CM_ SG_ 3221225472 StElvtnSensor1ReferenceElevation "Command from a display or other external device (i.e. remote switch) to the land leveling system controller instructing the controller to set the reference elvation based on data received from the corresponding land leveling sensor.
00 = Do not Set ...";
CM_ SG_ 3221225472 SdshftDsrdBldeOffsetOperatorCtrl "This parameter indicates the side-shift blade control mode operator control state the user has set for the land leveling system.  When an implement moves in a side-shift direction, it moves from side to side, usually along its longitudinal axis.
 ...";
CM_ SG_ 3221225472 SdshiftBladeCtrlModeOperatorCtrl "This parameter indicates the side-shift offset operator control state the user has set for the land leveling system. When an implement moves in a side-shift direction, it moves from side to side, usually along its longitudinal axis. The desired ...";
CM_ SG_ 3221225472 RghtDsredBladeOffsetOperatorCtrl "This parameter indicates the right blade offset operator control state the user has set for the land leveling system.  The right desired blade offset value is the offset measured from a given reference point to the bottom right edge of the blade ...";
CM_ SG_ 3221225472 LftDsiredBladeOffsetOperatorCtrl "This parameter indicates the left blade offset operator control state the user has set for the land leveling system.  The left desired blade offset value is the offset measured from a given reference point to the bottom left edge of the blade. This ...";
CM_ SG_ 3221225472 RightBladeCtrlModeOperatorCtrl "This parameter indicates the right blade control mode operator control state the user has set for the land leveling system.  The operator control value directly relates to the current operator control state correlating to the left edge of the blade ...";
CM_ SG_ 3221225472 LeftBladeCtrlModeOperatorCtrl "This parameter indicates the left blade control mode operator control state the user has set for the land leveling system.  The operator control value directly relates to the current operator control state correlating to the left edge of the blade ...";
CM_ SG_ 3221225472 BladeAutoModeCmd "Allows other controllers to command to the primary control system what they think is the appropriate auto control mode to be engaged in, based on the information they have available to them.  When in automatic mode, the blade automatically adjusts ...";
CM_ SG_ 3221225472 DesiredGradeOffsetSwitch "Indicates the grade offset switch state the user has set for the land leveling system.  The desired grade offset value is the vertical offset measured from a given elevation reference point to the bottom edge of the blade.  This parameter is ...";
CM_ SG_ 3221225472 BladeCtrlModeSwitch "Indicates the blade control mode switch state the user has set for the land leveling system.  The switch value directly correlates to the current switch state, regardless of the switch being used.  This parameter is intended for use in systems using ...";
CM_ SG_ 3221225472 MastPos "Used to monitor the position of the sensor attached to the land leveling mast.";
CM_ SG_ 3221225472 FlexibleFuelPercentage "Measured signal that indicates the percentage of alcohol in the fuel currently being used.  0% means no alcohol in fuel, 100% means alcohol as fuel and nothing else.
EXAMPLE: If a Bi-fuel vehicle has less than 10% ethanol in the gasoline/petrol, ...";
CM_ SG_ 3221225472 EngThrottleValve2Pos "The sensed position feedback of the valve, coming from a second electrical actuator for a second throttle plate, used to regulate the supply of a fluid, usually air or fuel//air mixture.  0% represents no supply and 100% is full supply. SPN 51 is ...";
CM_ SG_ 3221225472 EngThrottleValve1Pos "The position of the valve used to regulate the supply of a fluid, usually air or fuel/air mixture, to an engine.  0% represents no supply and 100% is full supply.";
CM_ SG_ 3221225472 EngAverageFuelEconomy "Average of instantaneous fuel economy for that segment of vehicle operation of interest.";
CM_ SG_ 3221225472 EngInstantaneousFuelEconomy "Current fuel economy at current vehicle velocity.

0xFB00 = Infinite (for example, during engine motoring)";
CM_ SG_ 3221225472 EngFuelRate "Amount of fuel consumed by engine per unit of time.

NOTE - See SPN 1600 for alternate resolution.";
CM_ SG_ 3221225472 EngTotalFuelUsed "Accumulated amount of fuel used during vehicle operation.  See SPN 5054 for alternate resolution.";
CM_ SG_ 3221225472 EngTripFuel "Fuel consumed during all or part of a journey.  See SPN 5053 for alternate resolution.";
CM_ SG_ 3221225472 FrontWheelDriveActuatorStatus "Feedback on the front wheel drive actuator.

00 Front Wheel Drive Actuator not engaged
01 Front Wheel Drive Actuator engaged
10 Error
11 Not Available";
CM_ SG_ 3221225472 FMSstandardSWversionSupported "Information that identifies which issue level of the FMS-standard document the software included in the FMS gateway supports. Four bytes, representing xx.yy type revision level identification.
Information to be ASCII equivalent of the numeric ...";
CM_ SG_ 3221225472 FMSstandardRequestsSupported "Status signal which indicates if the FMS Vehicle Interface (FMS Gateway) will respond to requests from the FMS device for the PGNs listed in the FMS Interface Specification.
This mode is to support FMS  gateway devices that only operate in a ...";
CM_ SG_ 3221225472 FMSstandardDiagnosticsSupported "Status signal which indicates if the FMS Vehicle Interface (FMS Gateway) supports the handling of diagnostic messages from the vehicle network onto the FMS network.
The FMS gateway does NOT support the re-broadcast of diagnostics messages present ...";
CM_ SG_ 3221225472 DrverAlertnessWarningSystemState "Indicates the various system state in the driver alertness warning system. This signal can be used independent of the technology and ECU used to estimate the driver alertness condition.
000 = System installed but disabled
001 = Initializing
010 = ...";
CM_ SG_ 3221225472 DriverAlertnessLevel "Indicates the alertness level of the driver measured by the driver alertness warning system. 100 % means driver is fully attentive. This signal can be used independent of the technology and ECU used to estimate the driver alertness condition.";
CM_ SG_ 3221225472 LnDpartureIndicationEnableStatus "Indicates whether lane departure indication is active.

00 Lane Departure indication disabled
01 Lane Departure Indication enabled 
10 Reserved
11 Not Used";
CM_ SG_ 3221225472 LaneTrackingStatusLeftSide "Indicates whether the left side is tracking lane.

00 Not Tracking Left side
01 Tracking Left side
10 Reserved
11 Don't care/Take no action";
CM_ SG_ 3221225472 LaneTrackingStatusRightSide "Indicates whether right side is tracking lane.

00 Not Tracking Right side
01 Tracking Right side
10 Reserved
11 Don't Care/take no action";
CM_ SG_ 3221225472 LaneDepartureImminentLeftSide "Indicates departure imminent on left side of lane.

00 Not imminent
01 Imminent
10 Reserved
11 Not used";
CM_ SG_ 3221225472 LaneDepartureImminentRightSide "Indicates departure imminent on right side of lane.

00 Not imminent
01 Imminent
10 Reserved
11 Not Used";
CM_ SG_ 3221225472 LaneDepartureRight "Indicates that the middle of vehicle departs the lane on the right side. The parameter indicates that the vehicle is changing the lane to the right.
00   Middle of the vehicle does not depart the lane to the right side
01   Middle of the vehicle ...";
CM_ SG_ 3221225472 LaneDepartureLeft "Indicates that the middle of vehicle departs the lane on the left side. The parameter indicates that the vehicle is changing the lane to the left.
00   Middle of the vehicle does not depart the lane to the left side
01   Middle of the vehicle ...";
CM_ SG_ 3221225472 DriverAlertnessWarning "Indicates when a distracted driving condition is detected. This signal can be used independent of the technology and ECU used to estimate the distracted driver condition.
000 = No distracted driving condition detected
001 = Level 1 - Mild ...";
CM_ SG_ 3221225472 EngFuelLeakage2 "Status signal which indicates fuel leakage in the fuel rail of the engine. Location can be either before or after the fuel pump.  

00 - no leakage detected
01 - leakage detected
10 - Error
11 - Not available";
CM_ SG_ 3221225472 EngFuelLeakage1 "Status signal which indicates fuel leakage in the fuel rail of the engine. Location can be either before or after the fuel pump.  

00 - no leakage detected
01 - leakage detected
10 - Error
11 - Not available";
CM_ SG_ 3221225472 FanDriveBypassCmdStatus "Status of the Fan Drive Bypass Command as being commanded by the ECU.  The fan drive bypass diverts pump pressure away from the hydraulic motor to maintain the fan drive pressure.  0% is defined as no bypass (i.e. diverting no fan drive pressure) ...";
CM_ SG_ 3221225472 HydFanMotorPress "The hydraulic pressure used to drive the fan system, sensed before the hydraulic fan motor.";
CM_ SG_ 3221225472 FanSpeed "The speed of the fan associated with engine coolant system.";
CM_ SG_ 3221225472 FanDriveState "This parameter is used to indicate the current state or mode of operation by the fan drive.
0000 Fan off
0001 Engine system-General
0010 Excessive engine air temperature
0011 Excessive engine oil temperature
0100 Excessive engine coolant ...";
CM_ SG_ 3221225472 EstPercentFanSpeed "Estimated fan speed as a ratio of the fan drive (current speed) to the fully engaged fan drive (maximum fan speed).  A two state fan (off/on) will use 0% and 100% respectively.  A three state fan (off/intermediate/on) will use 0%, 50% and 100% ...";
CM_ SG_ 3221225472 EngTorqueLimit6AxleInput "Limit applied to the engine output torque based on the maximum allowable axle input torque.  Axle input torque is calculated as the current engine torque output multiplied by the transmission gear ratio.";
CM_ SG_ 3221225472 EngTorqueLimit5Switch "Limit applied to the engine output torque based on activation of an ECU switch input.";
CM_ SG_ 3221225472 EngTorqueLimit4Trans "Limit applied to the engine output torque during vehicle operation in transmission gear ratios numerically less than or equal to transmission gear ratio 3 (see SPN 1259).";
CM_ SG_ 3221225472 EngTorqueLimit3Trans "Limit applied to the engine output torque during vehicle operation in transmission gear ratios numerically less than or equal to transmission gear ratio 2 (see SPN 1257) and numerically greater than transmission gear ratio 3 (see.SPN 1259).  For ...";
CM_ SG_ 3221225472 TransGearRatio3 "Gear ratio value stored in the ECU that is used to define a range of transmission gears for which a limit is applied to the engine output torque.  Transmission gear ratio 3 should be the numerically highest transmission gear ratio breakpoint less ...";
CM_ SG_ 3221225472 EngTorqueLimit2Trans "Limit applied to the engine output torque during vehicle operation in transmission gear ratios numerically less than or equal to transmission gear ratio 1 (see SPN 1255) and numerically greater than transmission gear ratio 2 (see.SPN 1257).  For ...";
CM_ SG_ 3221225472 TransGearRatio2 "Gear ratio value stored in the ECU that is used to define a range of transmission gears for which a limit is applied to the engine output torque.  Transmission gear ratio 2 should be the numerically highest transmission gear ratio breakpoint less ...";
CM_ SG_ 3221225472 EngTorqueLimit1Trans "Limit applied to the engine output torque during vehicle operation in transmission gear ratios numerically greater than transmission gear ratio 1 (see SPN 1255).";
CM_ SG_ 3221225472 TransGearRatio1 "Gear ratio value stored in the ECU that is used to define a range of transmission gears for which a limit is applied to the engine output torque.  Transmission gear ratio 1 should be the numerically highest transmission gear ratio breakpoint that ...";
CM_ SG_ 3221225472 EngTorqueLimitFeature "Torque limit rating described in the current record.
000 Reserved
001 Highest torque rating
010 First torque rating
011 Previous torque rating (rating prior to the current rating)
100 Current torque rating
101-110 Reserved
111 Not available
 ...";
CM_ SG_ 3221225472 TorqueLimitingFeatureStatus "Status of an ECU feature which limits the torque output of the engine. 

00 - Disabled
01 - Enabled
10 - Error
11 - Not available";
CM_ SG_ 3221225472 CalibRecordDurationTime "Duration in hours for which the engine operated in the conditions captured in the current record.";
CM_ SG_ 3221225472 CalibRecordStartYear "Calendar year timestamp when an ECU record was established.

NOTE - A value of 0 for the year identifies the year 1985; a value of 1 identifies 1986; etc.";
CM_ SG_ 3221225472 CalibRecordStartDay "Calendar day timestamp when an ECU record was established.

NOTE - A value of 0 for the date is null.  The values 1, 2, 3, and 4 are used to identify the first day of the month; 5, 6, 7, and 8 identify the second day of the month; etc.";
CM_ SG_ 3221225472 CalibRecordStartMonth "Calendar month timestamp when an ECU record was established.

NOTE - A value of 0 for the month is null.  The value 1 identifies January; 2 identifies February; etc.";
CM_ SG_ 3221225472 EngPeakTorque2 "Maximum torque output of the current ECU calibration when the engine operates on torque curve 2.  For calibrations that support two torque curves, this parameter shall be assigned the value of the higher curve.  For calibrations that support only ...";
CM_ SG_ 3221225472 EngPeakTorque1 "Maximum torque output of the current ECU calibration when the engine operates on torque curve 1.  For calibrations that support two torque curves, this parameter shall be assigned the value of the lower curve.  For calibrations that support only one ...";
CM_ SG_ 3221225472 EngPower "Advertised engine power capability.  Advertised power is what a customer will find on a sales sheet for an engine with a certain calibration.";
CM_ SG_ 3221225472 NumberOfEngTorqueHistoryRecords "Number of torque history records contained in the engine torque history PGN.  A value of 0 is broadcast if no torque history records are stored in the ECU.";
CM_ SG_ 3221225472 TransClutch_ConverterInputSpeed "Rotational velocity of the input to a transmission's master clutch or torque converter. In most cases the rotational velocity will be the same as engine flywheel speed unless there is an intermediate device, such as a power divider, between the ...";
CM_ SG_ 3221225472 TransTorqueConverterRatio "Ratio of the transmissions torque converter output torque to torque converter input torque at current speed.
The ratio of 1.000 ( 03 E8 hex ) indicates torque converter lockup.
If the ratio is less than 1 and the ratio can not be properly ...";
CM_ SG_ 3221225472 TransAutoNeutralSt "Indicates the transmission response to a Neutral request from SPN 7695 [Transmission Auto-Neutral (Manual Return) Request] or other vehicle input configured for Auto-Neutral (Manual Return) functionality. The applicability of the states and state ...";
CM_ SG_ 3221225472 TransWarningIndicator "Signal from transmission indicating that some aspect of its operation is not functioning correctly, and as a result, transmission operation may be altered or restricted.  The indicator is typically a lamp.  Distinctions in meaning between the ...";
CM_ SG_ 3221225472 TrnsRverseGearShiftInhibitStatus "Reflects the status of transmission reverse inhibit activity in response to requests via SPN 4242 - Transmission Reverse Gear Shift Inhibit Request.  Typically broadcast by the transmission controller.
00 = Reverse gear shifts are currently allowed
 ...";
CM_ SG_ 3221225472 TransMode8Indicator "This state signal is the transmission's indication that it is operating under transmission mode 8 (SPN 4249) as commanded via the TC1 message (PGN 256).  The definition of the transmission mode is left to the discretion of the transmission ...";
CM_ SG_ 3221225472 TransMode7Indicator "This state signal is the transmission's indication that it is operating under transmission mode 7 (SPN 4248) as commanded via the TC1 message (PGN 256).  The definition of the transmission mode is left to the discretion of the transmission ...";
CM_ SG_ 3221225472 TransMode6Indicator "This state signal is the transmission's indication that it is operating under transmission mode 6 (SPN 4247) as commanded via the TC1 message (PGN 256).  The definition of the transmission mode is left to the discretion of the transmission ...";
CM_ SG_ 3221225472 TransMode5Indicator "This state signal is the transmission's indication that it is operating under transmission mode 5 (SPN 4246) as commanded via the TC1 message (PGN 256).  The definition of the transmission mode is left to the discretion of the transmission ...";
CM_ SG_ 3221225472 TransRequestedGearFeedback "Feedback of the SPN 525 Transmission Requested Gear input as received from the shift selector, ABS or engine via PGN 256, Transmission Control 1 (TC1) or other transmission selector input.  Scaling, values and parameter specific indicators are ...";
CM_ SG_ 3221225472 TransMode1Indicator "This state signal is the transmission's indication that it is operating under transmission mode 1 (SPN 1852) as commanded via the TC1 message (PGN 256).  The definition of the transmission mode is left to the discretion of the transmission ...";
CM_ SG_ 3221225472 TransMode2Indicator "This state signal is the transmission's indication that it is operating under transmission mode 2 (SPN 1853) as commanded via the TC1 message (PGN 256).  The definition of the transmission mode is left to the discretion of the transmission ...";
CM_ SG_ 3221225472 TransMode3Indicator "This state signal is the transmission's indication that it is operating under transmission mode 3 (SPN 1854) as commanded via the TC1 message (PGN 256).  The definition of the transmission mode is left to the discretion of the transmission ...";
CM_ SG_ 3221225472 TransMode4Indicator "This state signal is the transmission's indication that it is operating under transmission mode 4 (SPN 1855) as commanded via the TC1 message (PGN 256).  The definition of the transmission mode is left to the discretion of the transmission ...";
CM_ SG_ 3221225472 TransShiftInhibitIndicator "State signal indicating a transmission request for the Shift Inhibit Indicator to be active or inactive. The shift inhibit indicator can be of lamp or text form, located on (but not limited to) the shift console, instrument cluster, or cab display ...";
CM_ SG_ 3221225472 TransEngCrankEnable "State signal from the transmission indicating if the transmission's status is such that engine cranking is allowed (i.e.  at a minimum, transmission is in neutral and the driveline is disengaged).  As sender of this information, the transmission is ...";
CM_ SG_ 3221225472 ActiveShiftConsoleIndicator "Signal from transmission control unit indicating which shift console (primary or secondary) it currently considers as the active shift selector input.
00        Primary shift console is active
01        Secondary shift console is active
10 ...";
CM_ SG_ 3221225472 TransReadyForBrakeRelease "This parameter indicates that enough torque / motive force is available at the transmission output shaft to release all the brakes without a risk of unintentional movement in the opposite direction.
00 - Transmission Not Ready for Brake Release
01 ...";
CM_ SG_ 3221225472 TrnsRqstedRangeDisplayFlashState "State signal indicating a transmission request for the display of the Transmission Requested Range parameter (SPN 162) to flash or not to flash. The ‘Transmission Requested Range Display Flash State' indicator can be utilized by (but not limited to) ...";
CM_ SG_ 3221225472 TrnsRqstedRangeDisplayBlankState "State signal indicating a transmission request for the display of the Transmission Requested Range parameter (SPN162) to be blanked or not blanked.  The ‘Transmission Requested Range Display Blank State' indicator can be utilized by (but not limited ...";
CM_ SG_ 3221225472 TransServiceIndicator "Signal from transmission indicating that some aspect of the gearbox requires servicing, such as the oil, filter, clutch(es) or other component.
00  Transmission Service Indicator is off
01  Transmission Service Indicator is on continuously
10 ...";
CM_ SG_ 3221225472 TransAirSupplyPressIndicator "Indicates whether transmission air supply is sufficient
000   Normal Pressure Range - The transmission supply air pressure is within the normal operational range.
001   Low pressure - The transmission supply air pressure is within a range that may ...";
CM_ SG_ 3221225472 TransMode10Indicator "Indicates that the transmission is operating under transmission mode 10 (SPN 6570) as commanded via the TC2 message (PGN 3328). The definition of the transmission mode is left to the discretion of the transmission manufacturer.
00 Transmission Mode ...";
CM_ SG_ 3221225472 TransMode9Indicator "Indicates that the transmission is operating under transmission mode 9 (SPN 6569) as commanded via the TC2 message (PGN 3328). The definition of the transmission mode is left to the discretion of the transmission manufacturer.
00 Transmission Mode ...";
CM_ SG_ 3221225472 TrnsCrrentRangeDisplayBlankState "State signal indicating a transmission request for the display of the Transmission Current Range parameter (SPN 163) to be blanked or not blanked.  The 'Transmission Current Range Display Blank State' indicator can be utilized by (but not limited ...";
CM_ SG_ 3221225472 ClutchLifeRemaining "Signal which indicates the actual clutch life remaining in percent. One hundred percent means the clutch is brand new and zero percent means the clutch is at the end of its life.";
CM_ SG_ 3221225472 LowestPossibleGear "The transmission calculates this gear continuously.  Together with the highest possible gear (see SPN 1115), it enables a management computer to know the exact range of available gears.";
CM_ SG_ 3221225472 HighestPossibleGear "The transmission calculates this gear continuously.  Together with the lowest possible gear (see  SPN 1114), it enables a management computer to know the exact range of available gears.";
CM_ SG_ 3221225472 RecommendedGear "The transmission calculates this gear continuously.  In dangerous situations this gear may be selected to gain back vehicle control.";
CM_ SG_ 3221225472 TransForwardDirectionSwitch "Identifies the status of the switch that indicates forward direction.

00 - Off
01 - On
10 - Error
11 - Not available";
CM_ SG_ 3221225472 TransNeutralSwitch "Identifies the status of the switch that indicates neutral.

00 - Off
01 - On
10 - Error
11 - Not available";
CM_ SG_ 3221225472 TransReverseDirectionSwitch "Identifies the status of the switch that indicates reverse direction.

00 - Off
01 - On
10 - Error
11 - Not available";
CM_ SG_ 3221225472 TransLowRangeSenseSwitch "Identifies the status of the switch that represents low range.

00 - Off
01 - On
10 - Error
11 - Not available";
CM_ SG_ 3221225472 TransHighRangeSenseSwitch "Identifies the status of the switch that represents high range.

00 - Off
01 - On
10 - Error
11 - Not available";
CM_ SG_ 3221225472 TransSynchronizerBrakeValue "The current modulated value for the air supply to the synchronizer brake.";
CM_ SG_ 3221225472 TransSynchronizerClutchValue "The current modulated value for the air supply to the synchronizer clutch.";
CM_ SG_ 3221225472 TransInertiaBrakeActuator "Identifies the status of the actuator that controls the inertia brake.

00 - Off
01 - On
10 - Error
11 - Not available";
CM_ SG_ 3221225472 TransDefuelActuator "Identifies the status of the actuator that controls the engine defuel mechanism.

00 - Off
01 - On
10 - Error
11 - Not available";
CM_ SG_ 3221225472 TransLockupClutchActuator "Identifies the status of the actuator that controls the torque converter lockup clutch.

00 - Off
01 - On
10 - Error
11 - Not available";
CM_ SG_ 3221225472 TransClutchActuator "Identifies the status of the actuator that controls the clutch.

00 - Off
01 - On
10 - Error
11 - Not available";
CM_ SG_ 3221225472 TransSplitterIndirectActuator "Identifies the status of the splitter indirect actuator in the auxiliary unit.

00 - Off
01 - On
10 - Error
11 - Not available";
CM_ SG_ 3221225472 TransSplitterDirectActuator "Identifies the status of the splitter direct actuator in the auxiliary unit.

00 - Off
01 - On
10 - Error
11 - Not available";
CM_ SG_ 3221225472 TransRangeLowActuator "Identifies the status of the range low actuator in the auxiliary unit.

00 - Off
01 - On
10 - Error
11 - Not available";
CM_ SG_ 3221225472 TransRangeHighActuator "Identifies the status of the range high actuator in the auxiliary unit.

00 -Off
01 -On
10 - Error
11 - Not available";
CM_ SG_ 3221225472 TransShiftFingerGearActuator2 "Identifies the status of the actuator that moves the shift finger identified as gear actuator #2.

00 - Off
01 - On
10 - Error
11 - Not available";
CM_ SG_ 3221225472 TransShiftFingerRailActuator2 "Identifies the status of the actuator that moves the shift finger identified as rail actuator #2.

00 - Off
01 - On
10 - Error
11 - Not available";
CM_ SG_ 3221225472 TransShiftFingerGearActuator1 "Identifies the status of the actuator that moves the shift finger identified as gear actuator #1.

00 - Off
01 - On
10 - Error
11 - Not available";
CM_ SG_ 3221225472 TransShiftFingerRailActuator1 "Identifies the status of the actuator that moves the shift finger identified as rail actuator #1.

00 - Off
01 - On
10 - Error
11 - Not available";
CM_ SG_ 3221225472 TrnsShftFngerCenterRailIndicator "Identifies the status of the shift finger in the center rail position.

00 - Off
01 - On
10 - Error
11 - Not available";
CM_ SG_ 3221225472 TrnsShftFngerEngagementIndicator "Identifies the status of the shift finger in the engagement position.

00 - Off
01 - On
10 - Error
11 - Not available";
CM_ SG_ 3221225472 TransShiftFingerNeutralIndicator "Indicates the status of the shift finger in the neutral position.

00 - Off
01 - On
10 - Error
11 - Not available";
CM_ SG_ 3221225472 TransShiftFingerRailPos "The current position of the shift finger in the rail direction.";
CM_ SG_ 3221225472 TransShiftFingerGearPos "The current position of the shift finger in the gear direction.";
CM_ SG_ 3221225472 TransCurrentRange "Range currently being commanded by the transmission control system. Characters may include P, Rx, Rx-1...R2, R1, R, Nx, Nx-1...N2, N1, N, D, D1, D2..., Dx, L, L1, L2..., Lx-1, 1, 2, 3,... If only one displayed character is required, the second ...";
CM_ SG_ 3221225472 TransRequestedRange "Range selected by the operator.  Characters may include P, Rx, Rx-1...R2, R1, R, Nx, Nx-1...N2, N1, N, D, D1, D2..., Dx, L, L1, L2..., Lx-1, 1, 2, 3,...  If only one displayed character is required, the second character shall be used and the first ...";
CM_ SG_ 3221225472 TransCurrentGear "The gear currently engaged in the transmission or the last gear engaged while the transmission is in the process of shifting to the new or selected gear.  Transitions toward a destination gear will not be indicated.  Once the selected gear has been ...";
CM_ SG_ 3221225472 TransActualGearRatio "Actual ratio of input shaft speed to output shaft speed.";
CM_ SG_ 3221225472 TransSelectedGear "The gear that the transmission will attempt to achieve during the current shift if a shift is in progress, or the next shift if one is pending (i.e., waiting for torque reduction to initiate the shift).";
CM_ SG_ 3221225472 SrcAddrssOfCntrllngDvcFrTrnsCtrl "The source address of the SAE J1939 device currently controlling the transmission. Its value may be the source address of the ECU transmitting the message (which means that no external SAE J1939 message is providing the active command) or the source ...";
CM_ SG_ 3221225472 TransInputShaftSpeed "Rotational velocity of the primary shaft transferring power into the transmission.  When a torque converter is present, it is the output of the torque converter.
Note:
Single input shaft transmissions should use SPN 161 (Transmission Input Shaft ...";
CM_ SG_ 3221225472 MomentaryEngMaxPowerEnable "Momentarily Requesting highest torque map from the engine control

00 not requesting maximum power available
01 momentarily requesting maximum power available
10 fault
11 not available";
CM_ SG_ 3221225472 ProgressiveShiftDisable "Command signal used to indicate that progressive shifting by the engine should be disallowed.

00 Progressive shift is not disabled
01 Progressive shift is disabled
10 Reserved
11 Take no action";
CM_ SG_ 3221225472 EngMomentaryOverspeedEnable "Command signal used to indicate that the engine speed may be boosted up to the maximum engine overspeed value to accommodate transmission downshifts.  The maximum time for overspeed is limited by the time defined in the engine configuration message ...";
CM_ SG_ 3221225472 TransOutputShaftSpeed "Calculated speed of the transmission output shaft.";
CM_ SG_ 3221225472 TrnsTrqCnvrtrLckpTrnstnInProcess "State signal indicating whether or not the transmission torque converter lock up clutch is transitioning between being applied and being released.  The broadcast value should be set to 01 as soon as an apply or release of the lockup clutch is ...";
CM_ SG_ 3221225472 TransShiftInProcess "Indicates that the transmission is in process of shifting from the current gear to the selected gear. This state is generally ACTIVE during the entire time that the transmission controls the vehicle during a shift. This includes any transmission ...";
CM_ SG_ 3221225472 TrnsTorqueConverterLockupEngaged "State signal which indicates whether the torque converter lockup is engaged.

00 Torque converter lockup disengaged
01 Torque converter lockup engaged
10 Error
11 Not available";
CM_ SG_ 3221225472 TransDrivelineEngaged "Driveline engaged indicates the transmission controlled portion of the driveline is engaged sufficiently to allow a transfer of torque through the transmission.  Driveline engaged is ACTIVE whenever the transmission is in gear and the clutch (if ...";
CM_ SG_ 3221225472 EngChargeAirCooler1OutletTemp "Temperature of combustion air after it exits from the Charge Air Cooler 1 but before any mixing of recirculated exhaust gas.";
CM_ SG_ 3221225472 EngIntkVlvActuationSystemOilTemp "The temperature of the oil in the hydraulic system that powers the intake valve actuation system.";
CM_ SG_ 3221225472 EngIntakeManifold1AirTemp "Temperature of pre-combustion air found in intake manifold of engine air supply system. The higher resolution is required for control purposes.";
CM_ SG_ 3221225472 EngExhaustGasRecirculation1Temp "Temperature of Recirculated Exhaust Gas.  This should not be used for Exhaust Gas Recirculation Mixer Intake Temperature.  See SPN 5020.";
CM_ SG_ 3221225472 EngExhstGsRcirculation1DiffPress "Differential pressure across the Exhaust Gas Recirculation (EGR) system";
CM_ SG_ 3221225472 EngECUTemp "Temperature of the engine electronic control unit.";
CM_ SG_ 3221225472 EngOilTemp2 "Temperature of the engine lubricant.

Note:  If there is only one engine oil temperature measurement, SPN 175 should be used. 

See also SPNs 175 and 5925 for additional engine oil temperature measurements.";
CM_ SG_ 3221225472 EngIntercoolerThermostatOpening "The current position of the thermostat used to regulate the temperature of the engine charge air cooler.  A value of 0% represents the thermostat being completely closed and 100% represents the thermostat being completely open.";
CM_ SG_ 3221225472 EngIntercoolerTemp "Temperature of liquid found in the intercooler located after the turbocharger.";
CM_ SG_ 3221225472 EngTurboOilTemp "Temperature of the turbocharger lubricant.";
CM_ SG_ 3221225472 EngOilTemp1 "Temperature of the engine lubricant.
Note:  If there is only one engine oil temperature measurement, this SPN should be used.  This is the SPN that is typically displayed on an on-highway truck instrument cluster.
See also SPNs 1135 and 5925 for ...";
CM_ SG_ 3221225472 EngFuelTemp1 "Temperature of fuel (or gas) of the first fuel type. See SPN 3468 for a second temperature measurement of the first fuel type.";
CM_ SG_ 3221225472 EngExhaustManifoldBank1Temp2 "Temperature of combustion byproducts measured by a second sensor in engine bank 1 (left bank) exhaust manifold. This should be used for the sensor toward the rear of the engine on the bank 1 manifold.";
CM_ SG_ 3221225472 EngExhaustManifoldBank2Temp2 "Temperature of combustion byproducts measured by a second sensor in engine bank 2 (right bank) exhaust manifold. This should be used for the sensor toward the rear of the engine on the bank 2 manifold.";
CM_ SG_ 3221225472 EngExhaustGasTempLeftManifold "Temperature of combustion byproducts measured in engine bank 1 (left bank) exhaust manifold.  Single manifold engines should use exhaust temperature (SPN 173).";
CM_ SG_ 3221225472 EngExhaustGasTempRightManifold "Temperature of combustion byproducts measured in engine bank 2 (right bank) exhaust manifold.  Single manifold engines should use exhaust temperature (SPN 173).";
CM_ SG_ 3221225472 TypeOfSteerTrans "Type of Steering Transmission (Ref. ECE Regulation 79 paragraph 2.6)
0000             Purely mechanical steering transmission
0001             Purely hydraulic steering transmission
0010             Purely electric steering transmission
0011 ...";
CM_ SG_ 3221225472 TypeOfSteerForces "Type of Steering Forces (Ref. ECE Regulation 79 paragraph 2.5)
0000             Manual steering equipment
0001             Power assisted steering equipment
0010             Full power steering equipment
0011             Self tracking steering ...";
CM_ SG_ 3221225472 SteerType "Indicates the different types of steering systems (ref. ECE Regulation 79 paragraph 2.5)
0000             Main steering system
0001             Auxiliary steering equipment
0010-1110   Reserved for Assignment by SAE
1111             Not ...";
CM_ SG_ 3221225472 SteerableLiftAxleLoweringInhibit "A signal which indicates if lowering of lifted axle is allowed or inhibited.

00      Lowering allowed
01      Lowering inhibited
10      Reserved
11      Not available";
CM_ SG_ 3221225472 StatusOfSteerAxle "A signal which indicates different states of the steering axle
0000               Axle steering not active (adhesion steering)
0001               Axle steering active
0010               Axle centered
0011               Axle centered, because of ...";
CM_ SG_ 3221225472 ActualInnerWheelSteerAngle "Signal which indicates the actual inner wheel steering angle.  The steering angle is the angle of wheel turn relative to the vehicle x-axis (yaw angle of inner wheel). See Figure SPN2927_A for explanation of positive and negative angles.  This ...";
CM_ SG_ 3221225472 CrsCtrlRetarderActiveSpeedOffset "The additional speed above the operator selected cruise control set speed at which the retarder will activate when cruise control is active.";
CM_ SG_ 3221225472 TransOutputRetarder "Identifies the status of the transmission output retarder.

00 - Off
01 - On
10 - Error
11 - Not available";
CM_ SG_ 3221225472 ActlMxAvlblRetarderPercentTorque "This is the maximum amount of torque that the retarder can immediately deliver.   It is the same as the maximum torque shown in the Retarder's Configuration message, but allows for a much faster rate of change than could be communicated by reissuing ...";
CM_ SG_ 3221225472 RetarderSelectionNonengine "The 'Retarder Selection, non-engine' is the position of the driver's selector for retarders that are not part of the engine system, expressed as percent and determined by the ratio of current position to the maximum possible position. The physical ...";
CM_ SG_ 3221225472 DrvrsDemandRetarderPercentTorque "The Drivers demand retarder - percent torque is the maximum torque selected by the driver when one or more modes  are selected by the driver, such as hand lever, switch, constant torque, constant velocity, etc.";
CM_ SG_ 3221225472 SrcAddrssOfCntrllngDvcFrRtrdrCtr "The source address of the SAE J1939 device currently controlling the retarder.  It is used to expand the torque mode parameter (see SPN 899) in cases where control is in response to an ECU that is not listed in Table SPN899_A.  Its value may be the ...";
CM_ SG_ 3221225472 RetarderRoadSpeedExceeded "Retarder Road Speed Exceeded Status:

00   Road speed is below threshold 
01   Road speed is above threshold and retarder is allowed to be activated
10   Reserved
11   Don't care/Take no action";
CM_ SG_ 3221225472 RetarderRoadSpeedLimitSwitch "Retarder road speed limit switch states:
00   Road speed limiting by retarder is disabled
01   Road speed limiting by retarder is enabled.  The road speed that the retarder will limit will be determined when the switch transitions from 00 to 01
 ...";
CM_ SG_ 3221225472 RetarderRequestingBrakeLight "Indicates that whether the retarder is requesting that the brake lights are illuminated.
00 - Retarder is not requesting that the brake lights are illuminated
01 - Retarder is requesting that the brake lights are illuminated
10 - Reserved
11 - ...";
CM_ SG_ 3221225472 EngCoolantLoadIncrease "Status of an event, external to the engine, that may increase the nominal temperature of the engine coolant liquid.

00 - No coolant load increase
01 - Coolant load increase possible
10 - Error
11 - Not available";
CM_ SG_ 3221225472 IntendedRetarderPercentTorque "Braking torque of retarder that the retarder is currently trying to achieve.  This value takes into account all static limitations, but not the limitations due to the dynamic behavior of the retarder.  This value, if unchanged over a certain time, ...";
CM_ SG_ 3221225472 ActualRetarderPercentTorque "Actual braking torque of the retarder as a percent of retarder configuration reference torque SPN 556.

Note:  Refer to section 5.2.1 in SAE J1939-71.";
CM_ SG_ 3221225472 RetarderEnableShiftAssistSwitch "Switch signal which indicates whether the operator wishes the retarder to be enabled for transmission shift assist.  The retarder does not check this switch, nor does the enabling of this switch engage the retarder.  When this switch is 'enabled,' ...";
CM_ SG_ 3221225472 RetarderEnableBrakeAssistSwitch "Switch signal which indicates whether the operator wishes the retarder to be enabled for vehicle braking assist. The retarder does not check this switch, nor does the enabling of this switch engage the retarder. When this switch is 'enabled,' the ...";
CM_ SG_ 3221225472 RetarderTorqueMode "State signal which indicates which retarder torque mode is currently generating, limiting, or controlling the torque.  Note that the modes are not in prioritized order. Not all modes may be relevant for a given device.  Some devices may not ...";
CM_ SG_ 3221225472 EngExhaustGasPort20Temp "Temperature at the cylinder exhaust port of the engine.";
CM_ SG_ 3221225472 EngExhaustGasPort19Temp "Temperature at the cylinder exhaust port of the engine.";
CM_ SG_ 3221225472 EngExhaustGasPort18Temp "Temperature at the cylinder exhaust port of the engine.";
CM_ SG_ 3221225472 EngExhaustGasPort17Temp "Temperature at the cylinder exhaust port of the engine.";
CM_ SG_ 3221225472 EngExhaustGasPort16Temp "Temperature at the cylinder exhaust port of the engine.";
CM_ SG_ 3221225472 EngExhaustGasPort15Temp "Temperature at the cylinder exhaust port of the engine.";
CM_ SG_ 3221225472 EngExhaustGasPort14Temp "Temperature at the cylinder exhaust port of the engine.";
CM_ SG_ 3221225472 EngExhaustGasPort13Temp "Temperature at the cylinder exhaust port of the engine.";
CM_ SG_ 3221225472 EngExhaustGasPort12Temp "Temperature at the cylinder exhaust port of the engine.";
CM_ SG_ 3221225472 EngExhaustGasPort11Temp "Temperature at the cylinder exhaust port of the engine.";
CM_ SG_ 3221225472 EngExhaustGasPort10Temp "Temperature at the cylinder exhaust port of the engine.";
CM_ SG_ 3221225472 EngExhaustGasPort9Temp "Temperature at the cylinder exhaust port of the engine.";
CM_ SG_ 3221225472 EngExhaustGasPort8Temp "Temperature at the cylinder exhaust port of the engine.";
CM_ SG_ 3221225472 EngExhaustGasPort7Temp "Temperature at the cylinder exhaust port of the engine.";
CM_ SG_ 3221225472 EngExhaustGasPort6Temp "Temperature at the cylinder exhaust port of the engine.";
CM_ SG_ 3221225472 EngExhaustGasPort5Temp "Temperature at the cylinder exhaust port of the engine.";
CM_ SG_ 3221225472 EngExhaustGasPort4Temp "Temperature at the cylinder exhaust port of the engine.";
CM_ SG_ 3221225472 EngExhaustGasPort3Temp "Temperature at the cylinder exhaust port of the engine.";
CM_ SG_ 3221225472 EngExhaustGasPort2Temp "Temperature at the cylinder exhaust port of the engine.";
CM_ SG_ 3221225472 EngExhaustGasPort1Temp "Temperature at the cylinder exhaust port of the engine.";
CM_ SG_ 3221225472 PayloadCapacityPercentage "The current equipment payload plus the weight of any after-factory modifications reported as a percentage of the equipment's maximum payload capacity. The equipment's maximum payload capacity is the maximum capacity of the equipment before the added ...";
CM_ SG_ 3221225472 PayloadCarryBackWeight "The payload weight left on the machine after the last payload dump event.";
CM_ SG_ 3221225472 PayloadWeightConfidence "The level of confidence of the real time payload weight measurement (SPN 6851). Higher confidence values indicate greater probability the real time payload weight is the actual weight and providing feedback on the potential for improving system ...";
CM_ SG_ 3221225472 PayloadWeight "The current payload weight carried by the machine.";
CM_ SG_ 3221225472 PayloadPercentage "The current payload of the equipment, reported as a percentage of the equipment's rated payload limit.";
CM_ SG_ 3221225472 DataMemoryUsage "The used storage capacity of the data buffer memory internal to an ECU, such as a data logger.";
CM_ SG_ 3221225472 KeepAliveBatteryConsumption "The capacity consumed from the direct battery connection since the key was last turned off.  This value is maintained and does not accumulate while the key switch is on.  The value is reset to 0 when the key switch is turned to the off position.";
CM_ SG_ 3221225472 TravelVelocityCtrlPos "The position of the travel velocity control component reported as a percentage of the control's full displacement in each direction respectively.  Positive position values indicate forward travel direction;  negative position values indicate ...";
CM_ SG_ 3221225472 EngExhstGsOxygnSnsrClsdLpOprtion "Indicates whether the engine is using the exhaust oxygen sensor to control the air/fuel ratio.
00 Engine not using the exhaust oxygen sensor (open loop)
01 Engine using the exhaust oxygen sensor for a closed loop operation
10 Reserved
11 Don't ...";
CM_ SG_ 3221225472 EngExhstGsOxygnSnsrFlngCrrection "The amount of fueling change required by the system based on the measured exhaust oxygen value compared to the maximum fueling change permitted by the system, expressed as percentages.";
CM_ SG_ 3221225472 EngActualExhaustOxygen "The actual amount of oxygen in the exhaust represented as a percentage by volume with respect to the total volume of exhaust gases leaving the engine.";
CM_ SG_ 3221225472 EngDesiredExhaustOxygen "The desired amount of oxygen in the exhaust represented as a percentage by volume with respect to the total volume of exhaust gases leaving the engine.";
CM_ SG_ 3221225472 EngDesiredRatedExhaustOxygen "The desired amount of oxygen in the exhaust at rated conditions represented as a percentage by volume with respect to the total volume of exhaust gases leaving the engine.";
CM_ SG_ 3221225472 Joystick3Button13PressedStatus "Reports when the joystick button has been pressed.

00 Button not pressed
01 Button pressed
10 Error Indicator
11 Not Available";
CM_ SG_ 3221225472 Joystick3Button14PressedStatus "Reports when the joystick button has been pressed.

00 Button not pressed
01 Button pressed
10 Error Indicator
11 Not Available";
CM_ SG_ 3221225472 Joystick3Button15PressedStatus "Reports when the joystick button has been pressed.

00 Button not pressed
01 Button pressed
10 Error Indicator
11 Not Available";
CM_ SG_ 3221225472 Joystick3Button16PressedStatus "Reports when the joystick button has been pressed.

00 Button not pressed
01 Button pressed
10 Error Indicator
11 Not Available";
CM_ SG_ 3221225472 Jystick3GripXAxisDetentPosStatus "Reports when the current joystick grip position is in the detent position for that axis of travel.

00 Not in the Detent Position
01 In the Detent Position
10 Error Indicator
11 Not Available";
CM_ SG_ 3221225472 Jystick3GripYAxisDetentPosStatus "Reports when the current joystick grip position is in the detent position for that axis of travel.

00 Not in the Detent Position
01 In the Detent Position
10 Error Indicator
11 Not Available";
CM_ SG_ 3221225472 Jystick3ThetaAxisDetentPosStatus "Reports when the current joystick position is in the detent position for that axis of travel.

00 Not in the Detent Position
01 In the Detent Position
10 Error Indicator
11 Not Available";
CM_ SG_ 3221225472 Joystick3ThetaAxisPos "The position of the joystick in the relative motion of travel from the neutral position.  Position value of 0 is Neutral and position value 1000 (100%) is the end of linear zone.  Value of 1022 indicates an error has occurred.";
CM_ SG_ 3221225472 Jystck3ThtAxsClckwsPstvPosStatus "Reports when the current joystick position is on the positive travel side (forward, right, clockwise, up) relative to the neutral position for that axis of travel.
00 Not on Positive side of Neutral
01 On positive side of Neutral
10 Error ...";
CM_ SG_ 3221225472 Jystck3ThetaAxisNeutralPosStatus "Reports when the current joystick position is in the neutral position for that axis of travel.  The neutral position measurement must be determined from some mechanism other than the axis position measurement device.
00 Not in Neutral Position
01 ...";
CM_ SG_ 3221225472 Joystick3GripYAxisPos "The position of the joystick grip in the relative motion of travel from the neutral position.  Position value of 0 is Neutral and position value 1000 (100%) is the end of linear zone.  Value of 1022 indicates an error has occurred.";
CM_ SG_ 3221225472 Jystck3GrpYAxsLvrFrwrdPstvPsStts "Reports when the current joystick grip position is on the positive travel side (forward, right, clockwise, up) relative to the neutral position for that axis of travel.
00 Not on Positive side of Neutral
01 On positive side of Neutral
10 Error ...";
CM_ SG_ 3221225472 Jystck3GrpYAxsLvrBckNgtvPsStatus "Reports when the current joystick grip position is on the negative travel side (back, left, counterclockwise, down) relative to the neutral position for that axis of travel.
00 Not on negative side of Neutral
01 On negative side of Neutral
10 ...";
CM_ SG_ 3221225472 Jystck3GripYAxisNeutralPosStatus "Reports when the current joystick grip position is in the neutral position for that axis of travel.  The neutral position measurement must be determined from some mechanism other than the axis position measurement device.
00 Not in Neutral Position
 ...";
CM_ SG_ 3221225472 Joystick3GripXAxisPos "The position of the joystick grip in the relative motion of travel from the neutral position.  Position value of 0 is Neutral and position value 1000 (100%) is the end of linear zone.  Value of 1022 indicates an error has occurred.";
CM_ SG_ 3221225472 Jystck3GrpXAxsLvrRghtPstvPsSttus "Reports when the current joystick grip position is on the positive travel side (forward, right, clockwise, up) relative to the neutral position for that axis of travel.
00 Not on Positive side of Neutral
01 On positive side of Neutral
10 Error ...";
CM_ SG_ 3221225472 Jystck3GrpXAxsLvrLftNgtvPsStatus "Reports when the current joystick grip position is on the negative travel side (back, left, counterclockwise, down) relative to the neutral position for that axis of travel.
00 Not on negative side of Neutral
01 On negative side of Neutral
10 ...";
CM_ SG_ 3221225472 Jystck3GripXAxisNeutralPosStatus "Reports when the current joystick grip position is in the neutral position for that axis of travel.  The neutral position measurement must be determined from some mechanism other than the axis position measurement device.
00 Not on negative side of ...";
CM_ SG_ 3221225472 Jystck3ThtAxsCntrClckwsNgtvPsStt "Reports when the current joystick position is on the negative travel side (back, left, counterclockwise, down) relative to the neutral position for that axis of travel.
00 Not on negative side of Neutral
01 On negative side of Neutral
10 Error ...";
CM_ SG_ 3221225472 Joystick2Button13PressedStatus "Reports when the joystick button has been pressed.

00 Button not pressed
01 Button pressed
10 Error Indicator
11 Not Available";
CM_ SG_ 3221225472 Joystick2Button14PressedStatus "Reports when the joystick button has been pressed.

00 Button not pressed
01 Button pressed
10 Error Indicator
11 Not Available";
CM_ SG_ 3221225472 Joystick2Button15PressedStatus "Reports when the joystick button has been pressed.

00 Button not pressed
01 Button pressed
10 Error Indicator
11 Not Available";
CM_ SG_ 3221225472 Joystick2Button16PressedStatus "Reports when the joystick button has been pressed.

00 Button not pressed
01 Button pressed
10 Error Indicator
11 Not Available";
CM_ SG_ 3221225472 Jystick2GripXAxisDetentPosStatus "Reports when the current joystick grip position is in the detent position for that axis of travel.

00 Not in the Detent Position
01 In the Detent Position
10 Error Indicator
11 Not Available";
CM_ SG_ 3221225472 Jystick2GripYAxisDetentPosStatus "Reports when the current joystick grip position is in the detent position for that axis of travel.

00 Not in the Detent Position
01 In the Detent Position
10 Error Indicator
11 Not Available";
CM_ SG_ 3221225472 Jystick2ThetaAxisDetentPosStatus "Reports when the current joystick position is in the detent position for that axis of travel.

00 Not in the Detent Position
01 In the Detent Position
10 Error Indicator
11 Not Available";
CM_ SG_ 3221225472 Joystick2ThetaAxisPos "The position of the joystick in the relative motion of travel from the neutral position.  Position value of 0 is Neutral and position value 1000 (100%) is the end of linear zone.  Value of 1022 indicates an error has occurred.";
CM_ SG_ 3221225472 Jystck2ThtAxsClckwsPstvPosStatus "Reports when the current joystick position is on the positive travel side (forward, right, clockwise, up) relative to the neutral position for that axis of travel.
00 Not on Positive side of Neutral
01 On positive side of Neutral
10 Error ...";
CM_ SG_ 3221225472 Jystck2ThetaAxisNeutralPosStatus "Reports when the current joystick position is in the neutral position for that axis of travel.  The neutral position measurement must be determined from some mechanism other than the axis position measurement device.
00 Not in Neutral Position
01 ...";
CM_ SG_ 3221225472 Joystick2GripYAxisPos "The position of the joystick grip in the relative motion of travel from the neutral position.  Position value of 0 is Neutral and position value 1000 (100%) is the end of linear zone.  Value of 1022 indicates an error has occurred.";
CM_ SG_ 3221225472 Jystck2GrpYAxsLvrFrwrdPstvPsStts "Reports when the current joystick grip position is on the positive travel side (forward, right, clockwise, up) relative to the neutral position for that axis of travel.
00 Not on Positive side of Neutral
01 On positive side of Neutral
10 Error ...";
CM_ SG_ 3221225472 Jystck2GrpYAxsLvrBckNgtvPsStatus "Reports when the current joystick grip position is on the negative travel side (back, left, counterclockwise, down) relative to the neutral position for that axis of travel.
00 Not on negative side of Neutral
01 On negative side of Neutral
10 ...";
CM_ SG_ 3221225472 Jystck2GripYAxisNeutralPosStatus "Reports when the current joystick grip position is in the neutral position for that axis of travel.  The neutral position measurement must be determined from some mechanism other than the axis position measurement device.
00 Not in Neutral Position
 ...";
CM_ SG_ 3221225472 Joystick2GripXAxisPos "The position of the joystick grip in the relative motion of travel from the neutral position.  Position value of 0 is Neutral and position value 1000 (100%) is the end of linear zone.  Value of 1022 indicates an error has occurred.";
CM_ SG_ 3221225472 Jystck2GrpXAxsLvrRghtPstvPsSttus "Reports when the current joystick grip position is on the positive travel side (forward, right, clockwise, up) relative to the neutral position for that axis of travel.
00 Not on Positive side of Neutral
01 On positive side of Neutral
10 Error ...";
CM_ SG_ 3221225472 Jystck2GrpXAxsLvrLftNgtvPsStatus "Reports when the current joystick grip position is on the negative travel side (back, left, counterclockwise, down) relative to the neutral position for that axis of travel.
00 Not on negative side of Neutral
01 On negative side of Neutral
10 ...";
CM_ SG_ 3221225472 Jystck2GripXAxisNeutralPosStatus "Reports when the current joystick grip position is in the neutral position for that axis of travel.  The neutral position measurement must be determined from some mechanism other than the axis position measurement device.
00 Not on negative side of ...";
CM_ SG_ 3221225472 Jystck2ThtAxsCntrClckwsNgtvPsStt "Reports when the current joystick position is on the negative travel side (back, left, counterclockwise, down) relative to the neutral position for that axis of travel.
00 Not on negative side of Neutral
01 On negative side of Neutral
10 Error ...";
CM_ SG_ 3221225472 Joystick1Button13PressedStatus "Reports when the joystick button has been pressed.

00 Button not pressed
01 Button pressed
10 Error Indicator
11 Not Available";
CM_ SG_ 3221225472 Joystick1Button14PressedStatus "Reports when the joystick button has been pressed.

00 Button not pressed
01 Button pressed
10 Error Indicator
11 Not Available";
CM_ SG_ 3221225472 Joystick1Button15PressedStatus "Reports when the joystick button has been pressed.

00 Button not pressed
01 Button pressed
10 Error Indicator
11 Not Available";
CM_ SG_ 3221225472 Joystick1Button16PressedStatus "Reports when the joystick button has been pressed.

00 Button not pressed
01 Button pressed
10 Error Indicator
11 Not Available";
CM_ SG_ 3221225472 Jystick1GripXAxisDetentPosStatus "Reports when the current joystick grip position is in the detent position for that axis of travel.

00 Not in the Detent Position
01 In the Detent Position
10 Error Indicator
11 Not Available";
CM_ SG_ 3221225472 Jystick1GripYAxisDetentPosStatus "Reports when the current joystick grip position is in the detent position for that axis of travel.

00 Not in the Detent Position
01 In the Detent Position
10 Error Indicator
11 Not Available";
CM_ SG_ 3221225472 Jystick1ThetaAxisDetentPosStatus "Reports when the current joystick position is in the detent position for that axis of travel.

00 Not in the Detent Position
01 In the Detent Position
10 Error Indicator
11 Not Available";
CM_ SG_ 3221225472 Joystick1ThetaAxisPos "The position of the joystick in the relative motion of travel from the neutral position.  Position value of 0 is Neutral and position value 1000 (100%) is the end of linear zone.  Value of 1022 indicates an error has occurred.";
CM_ SG_ 3221225472 Jystck1ThtAxsClckwsPstvPosStatus "Reports when the current joystick position is on the positive travel side (forward, right, clockwise, up) relative to the neutral position for that axis of travel.
00 Not on Positive side of Neutral
01 On positive side of Neutral
10 Error ...";
CM_ SG_ 3221225472 Jystck1ThetaAxisNeutralPosStatus "Reports when the current joystick position is in the neutral position for that axis of travel.  The neutral position measurement must be determined from some mechanism other than the axis position measurement device.
00 Not in Neutral Position
01 ...";
CM_ SG_ 3221225472 Joystick1GripYAxisPos "The position of the joystick grip in the relative motion of travel from the neutral position.  Position value of 0 is Neutral and position value 1000 (100%) is the end of linear zone.  Value of 1022 indicates an error has occurred.";
CM_ SG_ 3221225472 Jystck1GrpYAxsLvrFrwrdPstvPsStts "Reports when the current joystick grip position is on the positive travel side (forward, right, clockwise, up) relative to the neutral position for that axis of travel.
00 Not on Positive side of Neutral
01 On positive side of Neutral
10 Error ...";
CM_ SG_ 3221225472 Jystck1GrpYAxsLvrBckNgtvPsStatus "Reports when the current joystick grip position is on the negative travel side (back, left, counterclockwise, down) relative to the neutral position for that axis of travel.
00 Not on negative side of Neutral
01 On negative side of Neutral
10 ...";
CM_ SG_ 3221225472 Aftrtrtmnt1DslExhstFldPrprtsPrlm "Reports when the current joystick grip position is in the neutral position for that axis of travel.  The neutral position measurement must be determined from some mechanism other than the axis position measurement device.
00 Not in Neutral Position
 ...";
CM_ SG_ 3221225472 Joystick1GripXAxisPos "The position of the joystick grip in the relative motion of travel from the neutral position.  Position value of 0 is Neutral and position value 1000 (100%) is the end of linear zone.  Value of 1022 indicates an error has occurred.";
CM_ SG_ 3221225472 Jystck1GrpXAxsLvrRghtPstvPsSttus "Reports when the current joystick grip position is on the positive travel side (forward, right, clockwise, up) relative to the neutral position for that axis of travel.
00 Not on Positive side of Neutral
01 On positive side of Neutral
10 Error ...";
CM_ SG_ 3221225472 Jystck1GrpXAxsLvrLftNgtvPsStatus "Reports when the current joystick grip position is on the negative travel side (back, left, counterclockwise, down) relative to the neutral position for that axis of travel.
00 Not on negative side of Neutral
01 On negative side of Neutral
10 ...";
CM_ SG_ 3221225472 Jystck1GripXAxisNeutralPosStatus "Reports when the current joystick grip position is in the neutral position for that axis of travel.  The neutral position measurement must be determined from some mechanism other than the axis position measurement device.
00 Not in Neutral Position
 ...";
CM_ SG_ 3221225472 Jystck1ThtAxsCntrClckwsNgtvPsStt "Reports when the current joystick position is on the negative travel side (back, left, counterclockwise, down) relative to the neutral position for that axis of travel.
00 Not on negative side of Neutral
01 On negative side of Neutral
10 Error ...";
CM_ SG_ 3221225472 EngFuelRackPos "Measured position of the engine fuel rack.  A value of 0% rack represents no fueling and a value of 100% rack represents maximum fueling.";
CM_ SG_ 3221225472 EngGasMassFlowRate1 "Gas mass flow rate delivered to an engine through its first fuel control system.  See SPN 3467 for the second fuel control system.";
CM_ SG_ 3221225472 InstantaneousEstBrakePower "Estimate of the power developed by the engine.";
CM_ SG_ 3221225472 EngExhaustGasPress1 "Gage pressure of the exhaust gases as measured at the turbine intake of the turbocharger. This SPN to be used for inline engines or exhaust bank 1 of multiple bank engines.  See SPN 5749 for exhaust bank 2 and See SPN 6384 for alternate range and ...";
CM_ SG_ 3221225472 EngPrefilterOilPress "Gage pressure of the engine oil before the oil reaches the oil filter.   See SPN 7470 for alternate resolution.";
CM_ SG_ 3221225472 TotalECURunTime "Total time accumulated over the life of the ECU, from ignition switch ON to ignition switch OFF.  When the ECU is replaced this value shall be reset.";
CM_ SG_ 3221225472 TotalECUDistance "Total distance accumulated over the life of the ECU.  When the ECU is replaced this value shall be reset.";
CM_ SG_ 3221225472 EngExhstGsRcrcltion2MassFlowRate "Flow rate of gas through the second EGR system. Flow rate of the exhaust gas being recirculated from the 2nd EGR system into combustion air.";
CM_ SG_ 3221225472 EngIntakeAirMassFlowRate "Mass flow rate of fresh air entering the engine air intake, before any EGR mixer, if used.  Flow rate of fresh air conducted to the engine cylinders to support combustion.";
CM_ SG_ 3221225472 EngExhstGsRcrcltion1MassFlowRate "Flow rate of gas through the EGR system. Flow rate of the exhaust gas being recirculated into the combustion air.";
CM_ SG_ 3221225472 EngFuelSupplyPumpIntakePress "Gage pressure of fuel at the fuel supply pump intake.  See Figures SPN16_A & SPN16_B.

See also SPN 1381.";
CM_ SG_ 3221225472 FuelPumpPrimerStatus "Parameter used to transmit the actual status of the fuel priming system.  The fuel priming system is a system that purges air in the fuel lines and may assist fuel delivery to a second pump at lower speeds.
00 - Off
01 - On
10 - Error
11 - ...";
CM_ SG_ 3221225472 EngVentilationStatus "Engine ventilation control states.
000 = Sufficiently vented (all combustible gases have been evacuated from intake and exhaust systems)
001 = Ventilation needed (combustible gases may be present in intake and exhaust systems)
010 = Ventilation ...";
CM_ SG_ 3221225472 EngCoolantPreheatedState "Indicates whether the engine coolant is pre-heated sufficiently for starting purposes.
00 = Not sufficiently pre-heated
01 = Sufficiently pre-heated
10 = Unable to determine  engine coolant pre-heated sufficiently
11 = Not available or not ...";
CM_ SG_ 3221225472 EngOilPreHeatedState "Indicates whether the engine oil pre-heated sufficiently for starting purposes.

00 = Not sufficiently pre-heated
01 = Sufficiently pre-heated
10 = Unable to determine if engine oil is pre-heated sufficiently
11 = Not available or not installed";
CM_ SG_ 3221225472 EngOilPrimingState "Determination of whether or not the engine is (or has recently been) sufficiently lubricated for starting purposes.
00 = Not sufficiently lubricated
01 = Sufficiently lubricated
10 = Unable to determine if sufficiently lubricated
11 = Not ...";
CM_ SG_ 3221225472 EngOilPrimingPumpSwitch "Switch input for activating the engine oil priming pump.

00 = Off
01 = On
10 = Error
11 = Not available or not installed";
CM_ SG_ 3221225472 EngOilFilterOutletPress "Oil pressure (gage) measured just downstream of oil filter.Used in conjunction with SPN1208 (pre-filter oil pressure) to determine oil filter health.";
CM_ SG_ 3221225472 EngWasteOilReservoirLevel "Level of crankcase blowby emulsion collected by a container.  Normalized to percent, 0% represents completely empty and 100% represents completely full.";
CM_ SG_ 3221225472 EngFuelFilterDiffPress "Differential pressure measured across the fuel filter located between the fuel tank and the supply pump.  See Figures SPN16_A and SPN16_B.";
CM_ SG_ 3221225472 EngOilLevelRemoteReservoir "Ratio of current volume of engine oil in a remote reservoir to the maximum required volume.  If a single switch (on/off) is used, 20% and 100% respectively will be used where 100% means no oil needs to be added and 20% means oil needs to be added ...";
CM_ SG_ 3221225472 EngThrottleValve1DiffPress "The differential pressure between the intake and outlet of the throttle valve 1 (SPN 51).  The differential pressure is measured from the intake with respect to the outlet of the throttle valve.";
CM_ SG_ 3221225472 EngExhstGsRcrclation1OutletPress "EGR outlet pressure is measured immediately after the EGR valve.";
CM_ SG_ 3221225472 EngExhstVlvActtionSystemOilPress "The absolute pressure of the oil in the hydraulic system that powers the engine exhaust valve actuation system";
CM_ SG_ 3221225472 EngExhstGsRcrclation1IntakePress "EGR intake gage pressure is measured after the EGR cooler and before the EGR valve.";
CM_ SG_ 3221225472 EngIntkVlvActationSystemOilPress "The gage pressure of the oil in the hydraulic system that powers the engine intake valve actuation system";
CM_ SG_ 3221225472 EngInjectorMeteringRail2Press "The gage pressure of fuel in the metering rail #2 as delivered from the supply pump to the injector metering intake.  See Figure SPN16_A for fuel system related parameters.  Although the figure does not show rail #2 it does show the relationship of ...";
CM_ SG_ 3221225472 EngInjectorTimingRail1Press "The gage pressure of fuel in the timing rail delivered from the supply pump to the injector timing intake.";
CM_ SG_ 3221225472 EngInjectorMeteringRail1Press "The gage pressure of fuel in the primary, or first, metering rail as delivered from the supply pump to the injector metering intake.";
CM_ SG_ 3221225472 EngInjectionCtrlPress "The gage pressure of the engine oil in the hydraulic accumulator that powers an intensifier used for fuel injection.";
CM_ SG_ 3221225472 EngCoolantLevel "Ratio of volume of liquid found in engine cooling system to total cooling system volume.  Typical monitoring location is in the coolant expansion tank.";
CM_ SG_ 3221225472 EngCoolantPress "Gage pressure of liquid found in engine cooling system.

See SPN 20 for alternate range and resolution.";
CM_ SG_ 3221225472 EngCrankcasePress "First instance of the gage pressure inside engine crankcase.";
CM_ SG_ 3221225472 EngOilLevel "Ratio of current volume of engine sump oil to maximum required volume.";
CM_ SG_ 3221225472 EngExCrankcaseBlowbyPress "Differential crankcase blow-by pressure as measured through a tube with a venturi. 

(SPN 1264 is not to be used - obsolete)";
CM_ SG_ 3221225472 SafetyWireStatus "Status signal which indicates that the safety wire has been activated.  When the safety wire is activated, the engine will not operate.  This is used for maintenance purposes.
00 - Safety wire has not been activated
01 - Safety wire has been ...";
CM_ SG_ 3221225472 ElectricalLoad "Electrical power delivered by the engine to the electrical system connected to the generator.";
CM_ SG_ 3221225472 EngVrblGeometryTurbo1ActuatorPos "Sensor that measures the position of the variable geometry turbocharger actuator.  A  position of 0% indicates the actuator is in the position creating the smallest geometry turbocharger. A position of 100% represents the largest geometry ...";
CM_ SG_ 3221225472 EngVriableGeometryTurbo1CtrlMode "Indicates if the variable geometry turbocharger control status is either open loop or closed loop.

00 open loop
01 closed loop
10 SAE reserved
11 not available";
CM_ SG_ 3221225472 EngFuelCtrlCtrlMode "Indicates whether the Engine Fuel Control System is in open loop or closed loop.

00     Open loop
01     Closed loop
10     SAE reserved
11     Not available";
CM_ SG_ 3221225472 EngVrblGmtryTrbArCtrlShtoffValve "Isolates vehicle brake air from the Variable Geometry Turbocharger (VGT) system when engine is not running.  This valve prevents vehicle air from bleeding off through the VGT Control Valve when engine is not in use.  Primary vehicle air system from ...";
CM_ SG_ 3221225472 EngExhstGsRcirculation1ValveCtrl "Desired percentage of maximum Exhaust Gas Recirculation (EGR) valve 1 opening.  0% means valve is closed. 100% means maximum valve opening (full gas flow).";
CM_ SG_ 3221225472 EngTrb1ClclatedTurbineOutletTemp "Calculated value of turbocharger compressor outlet air temperature.  Temperature of air exiting the turbocharger compressor and before entering charge air cooler.  The estimate is based on turbo speed and measured turbocharger compressor intake ...";
CM_ SG_ 3221225472 EngTrb1ClclatedTurbineIntakeTemp "Calculated value of turbine intake temperature based on engine operating conditions, such as intake manifold temperature, charge fuel ratio, injection timing, and engine speed.  Use SPN 1180 for actual measured intake temperature.";
CM_ SG_ 3221225472 EngFuelFilterDiffPress "Change in fuel delivery pressure, measured across the filter, due to accumulation of solid or semisolid matter on the filter element.";
BA_DEF_ SG_  "SigType" ENUM  "Default","Range","RangeSigned","ASCII","Discrete","Control","ReferencePGN","DTC","StringDelimiter","StringLength","StringLengthControl","MessageCounter","MessageChecksum";
BA_DEF_ SG_  "GenSigStartValue" INT 0 2147483647;
BA_DEF_ SG_  "GenSigSendType" ENUM  "Cyclic","OnWrite","OnWriteWithRepetition","OnChange","OnChangeWithRepetition","IfActive","IfActiveWithRepetition","NoSigSendType";
BA_DEF_ SG_  "GenSigILSupport" ENUM  "No","Yes";
BA_DEF_ SG_  "GenSigEVName" STRING ;
BA_DEF_ SG_  "SPN" INT 0 524287;
BA_DEF_ BO_  "TpJ1939VarDlc" ENUM  "No","Yes";
BA_DEF_ BO_  "GenMsgILSupport" ENUM  "No","Yes";
BA_DEF_ BO_  "GenMsgRequestable" INT 0 1;
BA_DEF_ BO_  "GenMsgSendType" ENUM  "cyclic","NotUsed","NotUsed","NotUsed","NotUsed","NotUsed","NotUsed","IfActive","noMsgSendType";
BA_DEF_ BO_  "VFrameFormat" ENUM  "StandardCAN","ExtendedCAN","reserved","J1939PG";
BA_DEF_ SG_  "SystemSignalLongSymbol" STRING ;
BA_DEF_DEF_  "SigType" "Default";
BA_DEF_DEF_  "GenSigStartValue" 0;
BA_DEF_DEF_  "GenSigSendType" "NoSigSendType";
BA_DEF_DEF_  "GenSigILSupport" "Yes";
BA_DEF_DEF_  "GenSigEVName" "Env@Nodename_@Signame";
BA_DEF_DEF_  "SPN" 0;
BA_DEF_DEF_  "TpJ1939VarDlc" "No";
BA_DEF_DEF_  "GenMsgILSupport" "Yes";
BA_DEF_DEF_  "GenMsgRequestable" 1;
BA_DEF_DEF_  "GenMsgSendType" "noMsgSendType";
BA_DEF_DEF_  "VFrameFormat" "J1939PG";
BA_DEF_DEF_  "SystemSignalLongSymbol" "";
BA_ "SPN" SG_ 3221225472 EngPTOGovernorSetSwitch 984;
BA_ "SigType" SG_ 3221225472 EngPTOGovernorSetSwitch 4;
BA_ "SPN" SG_ 3221225472 EngPTOGovernorResumeSwitch 982;
BA_ "SigType" SG_ 3221225472 EngPTOGovernorResumeSwitch 4;
BA_ "SPN" SG_ 3221225472 EngPTOGovernorEnableSwitch 980;
BA_ "SigType" SG_ 3221225472 EngPTOGovernorEnableSwitch 4;
BA_ "SPN" SG_ 3221225472 EngPTOGovernorAccelerateSwitch 981;
BA_ "SigType" SG_ 3221225472 EngPTOGovernorAccelerateSwitch 4;
BA_ "SPN" SG_ 3221225472 RmtPTOGvrnrPrprgrmmdSpdCtrlSwtch 3447;
BA_ "SigType" SG_ 3221225472 RmtPTOGvrnrPrprgrmmdSpdCtrlSwtch 4;
BA_ "SPN" SG_ 3221225472 AuxInputIgnoreSwitch 3448;
BA_ "SigType" SG_ 3221225472 AuxInputIgnoreSwitch 4;
BA_ "SPN" SG_ 3221225472 RearWasherFunction 2868;
BA_ "SPN" SG_ 3221225472 FrontOperatorWasherSwitch 2866;
BA_ "SPN" SG_ 3221225472 FrontNonoperatorWasherSwitch 2867;
BA_ "SPN" SG_ 3221225472 RearWiperDelayCtrl 2871;
BA_ "SigType" SG_ 3221225472 RearWiperDelayCtrl 1;
BA_ "SPN" SG_ 3221225472 FrontNonoperatorWiperDelayCtrl 2870;
BA_ "SigType" SG_ 3221225472 FrontNonoperatorWiperDelayCtrl 1;
BA_ "SPN" SG_ 3221225472 FrontOperatorWiperDelayCtrl 2869;
BA_ "SigType" SG_ 3221225472 FrontOperatorWiperDelayCtrl 1;
BA_ "SPN" SG_ 3221225472 RearWiperSwitch 2865;
BA_ "SPN" SG_ 3221225472 FrontOperatorWiperSwitch 2863;
BA_ "SPN" SG_ 3221225472 FrontNonoperatorWiperSwitch 2864;
BA_ "SPN" SG_ 3221225472 EngTorqueCurveSelectionCmd 6796;
BA_ "SPN" SG_ 3221225472 EngAltDroopAuxInputSelect 2885;
BA_ "SPN" SG_ 3221225472 EngAltDroopRemoteAccelSelect 2886;
BA_ "SPN" SG_ 3221225472 EngAltDroopAccel2Select 2879;
BA_ "SPN" SG_ 3221225472 EngAltDroopAccel1Select 2881;
BA_ "SPN" SG_ 3221225472 EngAltRatingSelect 2882;
BA_ "SigType" SG_ 3221225472 EngAltRatingSelect 1;
BA_ "SPN" SG_ 3221225472 EngAltLowIdleSwitch 2883;
BA_ "SigType" SG_ 3221225472 EngAltLowIdleSwitch 4;
BA_ "SPN" SG_ 3221225472 EngSynchronizationSwitch 1377;
BA_ "SigType" SG_ 3221225472 EngSynchronizationSwitch 4;
BA_ "SPN" SG_ 3221225472 EngAuxGovernorSwitch 2884;
BA_ "SigType" SG_ 3221225472 EngAuxGovernorSwitch 4;
BA_ "SPN" SG_ 3221225472 EngTorqueCurveSelection 1568;
BA_ "SPN" SG_ 3221225472 EngAltDroopAuxInputSelectState 2895;
BA_ "SPN" SG_ 3221225472 EngAltDropRemoteAccelSelectState 2894;
BA_ "SPN" SG_ 3221225472 EngAltDroopAccel2SelectState 2893;
BA_ "SPN" SG_ 3221225472 EngAltDroopAccel1SelectState 2889;
BA_ "SPN" SG_ 3221225472 EngAltRatingSelectState 2888;
BA_ "SPN" SG_ 3221225472 EngAltLowIdleSelectState 2891;
BA_ "SigType" SG_ 3221225472 EngAltLowIdleSelectState 5;
BA_ "SPN" SG_ 3221225472 EngMultiUnitSyncState 2890;
BA_ "SigType" SG_ 3221225472 EngMultiUnitSyncState 5;
BA_ "SPN" SG_ 3221225472 EngAuxGovernorState 2896;
BA_ "SigType" SG_ 3221225472 EngAuxGovernorState 5;
BA_ "SPN" SG_ 3221225472 OprtorsDesiredDelayedLampOffTime 2877;
BA_ "SigType" SG_ 3221225472 OprtorsDesiredDelayedLampOffTime 1;
BA_ "SPN" SG_ 3221225472 OperatorsDesiredBacklight 2878;
BA_ "SigType" SG_ 3221225472 OperatorsDesiredBacklight 1;
BA_ "SPN" SG_ 3221225472 HighLowBeamSwitch 2874;
BA_ "SigType" SG_ 3221225472 HighLowBeamSwitch 4;
BA_ "SPN" SG_ 3221225472 HazardLightSwitch 2875;
BA_ "SigType" SG_ 3221225472 HazardLightSwitch 4;
BA_ "SPN" SG_ 3221225472 TurnSignalSwitch 2876;
BA_ "SPN" SG_ 3221225472 MainLightSwitch 2872;
BA_ "SPN" SG_ 3221225472 WorkLightSwitch 2873;
BA_ "SPN" SG_ 3221225472 MaxVehicleSpeedLimit7 2594;
BA_ "SigType" SG_ 3221225472 MaxVehicleSpeedLimit7 1;
BA_ "SPN" SG_ 3221225472 MaxVehicleSpeedLimit6 2593;
BA_ "SigType" SG_ 3221225472 MaxVehicleSpeedLimit6 1;
BA_ "SPN" SG_ 3221225472 MaxVehicleSpeedLimit5 2592;
BA_ "SigType" SG_ 3221225472 MaxVehicleSpeedLimit5 1;
BA_ "SPN" SG_ 3221225472 MaxVehicleSpeedLimit4 2591;
BA_ "SigType" SG_ 3221225472 MaxVehicleSpeedLimit4 1;
BA_ "SPN" SG_ 3221225472 MaxVehicleSpeedLimit3 2590;
BA_ "SigType" SG_ 3221225472 MaxVehicleSpeedLimit3 1;
BA_ "SPN" SG_ 3221225472 MaxVehicleSpeedLimit2 2589;
BA_ "SigType" SG_ 3221225472 MaxVehicleSpeedLimit2 1;
BA_ "SPN" SG_ 3221225472 MaxVehicleSpeedLimit1 2588;
BA_ "SigType" SG_ 3221225472 MaxVehicleSpeedLimit1 1;
BA_ "SPN" SG_ 3221225472 OprtrsBlackOutIntensitySelection 1844;
BA_ "SigType" SG_ 3221225472 OprtrsBlackOutIntensitySelection 1;
BA_ "SPN" SG_ 3221225472 BlackOutWorkLampSelect 1842;
BA_ "SigType" SG_ 3221225472 BlackOutWorkLampSelect 5;
BA_ "SPN" SG_ 3221225472 NightVisionIlluminatorSelect 1843;
BA_ "SigType" SG_ 3221225472 NightVisionIlluminatorSelect 5;
BA_ "SPN" SG_ 3221225472 BlackOutBrake_StopLampSelect 1841;
BA_ "SigType" SG_ 3221225472 BlackOutBrake_StopLampSelect 5;
BA_ "SPN" SG_ 3221225472 ConvoyDrivingLampSelect 1837;
BA_ "SigType" SG_ 3221225472 ConvoyDrivingLampSelect 5;
BA_ "SPN" SG_ 3221225472 ConvoyLampSelect 1838;
BA_ "SigType" SG_ 3221225472 ConvoyLampSelect 5;
BA_ "SPN" SG_ 3221225472 FrontBlackOutMarkerLampSelect 1839;
BA_ "SigType" SG_ 3221225472 FrontBlackOutMarkerLampSelect 5;
BA_ "SPN" SG_ 3221225472 RearBlackOutMarkerSelect 1840;
BA_ "SigType" SG_ 3221225472 RearBlackOutMarkerSelect 5;
BA_ "SPN" SG_ 3221225472 SlowVesselModeStatus 2617;
BA_ "SigType" SG_ 3221225472 SlowVesselModeStatus 5;
BA_ "SPN" SG_ 3221225472 TrollingModeStatus 2616;
BA_ "SigType" SG_ 3221225472 TrollingModeStatus 5;
BA_ "SPN" SG_ 3221225472 EngThrttlSynchrnzationModeStatus 2615;
BA_ "SPN" SG_ 3221225472 EngMainBearing12Temp 6830;
BA_ "SigType" SG_ 3221225472 EngMainBearing12Temp 1;
BA_ "SPN" SG_ 3221225472 EngMainBearing11Temp 1167;
BA_ "SigType" SG_ 3221225472 EngMainBearing11Temp 1;
BA_ "SPN" SG_ 3221225472 EngMainBearing10Temp 1166;
BA_ "SigType" SG_ 3221225472 EngMainBearing10Temp 1;
BA_ "SPN" SG_ 3221225472 EngMainBearing9Temp 1165;
BA_ "SigType" SG_ 3221225472 EngMainBearing9Temp 1;
BA_ "SPN" SG_ 3221225472 EngMainBearing8Temp 1164;
BA_ "SigType" SG_ 3221225472 EngMainBearing8Temp 1;
BA_ "SPN" SG_ 3221225472 EngMainBearing7Temp 1163;
BA_ "SigType" SG_ 3221225472 EngMainBearing7Temp 1;
BA_ "SPN" SG_ 3221225472 EngMainBearing6Temp 1162;
BA_ "SigType" SG_ 3221225472 EngMainBearing6Temp 1;
BA_ "SPN" SG_ 3221225472 EngMainBearing5Temp 1161;
BA_ "SigType" SG_ 3221225472 EngMainBearing5Temp 1;
BA_ "SPN" SG_ 3221225472 EngMainBearing4Temp 1160;
BA_ "SigType" SG_ 3221225472 EngMainBearing4Temp 1;
BA_ "SPN" SG_ 3221225472 EngMainBearing3Temp 1159;
BA_ "SigType" SG_ 3221225472 EngMainBearing3Temp 1;
BA_ "SPN" SG_ 3221225472 EngMainBearing2Temp 1158;
BA_ "SigType" SG_ 3221225472 EngMainBearing2Temp 1;
BA_ "SPN" SG_ 3221225472 EngMainBearing1Temp 1157;
BA_ "SigType" SG_ 3221225472 EngMainBearing1Temp 1;
BA_ "SPN" SG_ 3221225472 DisplayDeadbands 2577;
BA_ "SPN" SG_ 3221225472 LEDPatternCtrl 2578;
BA_ "SPN" SG_ 3221225472 LEDDisplayDeadbandCtrl 1806;
BA_ "SPN" SG_ 3221225472 LEDDisplayModeCtrl 1805;
BA_ "SPN" SG_ 3221225472 LEDDisplayData1 1573;
BA_ "SPN" SG_ 3221225472 AbsLaserStrikePos 2794;
BA_ "SigType" SG_ 3221225472 AbsLaserStrikePos 1;
BA_ "SPN" SG_ 3221225472 LaserStrikeDataLatency 2793;
BA_ "SigType" SG_ 3221225472 LaserStrikeDataLatency 1;
BA_ "SPN" SG_ 3221225472 LaserReceiverType 2576;
BA_ "SigType" SG_ 3221225472 LaserReceiverType 1;
BA_ "SPN" SG_ 3221225472 LaserStrikeVerticalDeviation 1574;
BA_ "SigType" SG_ 3221225472 LaserStrikeVerticalDeviation 1;
BA_ "SPN" SG_ 3221225472 LaserTracerInformation 1583;
BA_ "SPN" SG_ 3221225472 LEDDisplayData2 1582;
BA_ "SPN" SG_ 3221225472 LaserTracerHorizontalDeviation 1581;
BA_ "SigType" SG_ 3221225472 LaserTracerHorizontalDeviation 1;
BA_ "SPN" SG_ 3221225472 LaserTracerVerticalDistance 1580;
BA_ "SigType" SG_ 3221225472 LaserTracerVerticalDistance 1;
BA_ "SPN" SG_ 3221225472 LaserTracerTargetDeviation 1579;
BA_ "SigType" SG_ 3221225472 LaserTracerTargetDeviation 1;
BA_ "SPN" SG_ 3221225472 BldeHeightSetPointHighResolution 1759;
BA_ "SigType" SG_ 3221225472 BldeHeightSetPointHighResolution 1;
BA_ "SPN" SG_ 3221225472 ModifyLevelingSystemSetPoint 1575;
BA_ "SigType" SG_ 3221225472 ModifyLevelingSystemSetPoint 1;
BA_ "SPN" SG_ 3221225472 StElvtnSensor2ReferenceElevation 5406;
BA_ "SigType" SG_ 3221225472 StElvtnSensor2ReferenceElevation 5;
BA_ "SPN" SG_ 3221225472 StElvtnSensor1ReferenceElevation 5405;
BA_ "SigType" SG_ 3221225472 StElvtnSensor1ReferenceElevation 5;
BA_ "SPN" SG_ 3221225472 SdshftDsrdBldeOffsetOperatorCtrl 3339;
BA_ "SPN" SG_ 3221225472 SdshiftBladeCtrlModeOperatorCtrl 3338;
BA_ "SPN" SG_ 3221225472 RghtDsredBladeOffsetOperatorCtrl 3337;
BA_ "SPN" SG_ 3221225472 LftDsiredBladeOffsetOperatorCtrl 3336;
BA_ "SPN" SG_ 3221225472 RightBladeCtrlModeOperatorCtrl 3335;
BA_ "SPN" SG_ 3221225472 LeftBladeCtrlModeOperatorCtrl 3334;
BA_ "SPN" SG_ 3221225472 BladeAutoModeCmd 3158;
BA_ "SPN" SG_ 3221225472 DesiredGradeOffsetSwitch 3157;
BA_ "SPN" SG_ 3221225472 BladeCtrlModeSwitch 3156;
BA_ "SPN" SG_ 3221225472 MastPos 1576;
BA_ "SigType" SG_ 3221225472 MastPos 1;
BA_ "SPN" SG_ 3221225472 FlexibleFuelPercentage 5458;
BA_ "SigType" SG_ 3221225472 FlexibleFuelPercentage 1;
BA_ "SPN" SG_ 3221225472 EngThrottleValve2Pos 3673;
BA_ "SigType" SG_ 3221225472 EngThrottleValve2Pos 1;
BA_ "SPN" SG_ 3221225472 EngThrottleValve1Pos 51;
BA_ "SigType" SG_ 3221225472 EngThrottleValve1Pos 1;
BA_ "SPN" SG_ 3221225472 EngAverageFuelEconomy 185;
BA_ "SigType" SG_ 3221225472 EngAverageFuelEconomy 1;
BA_ "SPN" SG_ 3221225472 EngInstantaneousFuelEconomy 184;
BA_ "SigType" SG_ 3221225472 EngInstantaneousFuelEconomy 1;
BA_ "SPN" SG_ 3221225472 EngFuelRate 183;
BA_ "SigType" SG_ 3221225472 EngFuelRate 1;
BA_ "SPN" SG_ 3221225472 EngTotalFuelUsed 250;
BA_ "SigType" SG_ 3221225472 EngTotalFuelUsed 1;
BA_ "SPN" SG_ 3221225472 EngTripFuel 182;
BA_ "SigType" SG_ 3221225472 EngTripFuel 1;
BA_ "SPN" SG_ 3221225472 FrontWheelDriveActuatorStatus 2612;
BA_ "SigType" SG_ 3221225472 FrontWheelDriveActuatorStatus 4;
BA_ "SPN" SG_ 3221225472 FMSstandardSWversionSupported 2806;
BA_ "SigType" SG_ 3221225472 FMSstandardSWversionSupported 1;
BA_ "SPN" SG_ 3221225472 FMSstandardRequestsSupported 2805;
BA_ "SigType" SG_ 3221225472 FMSstandardRequestsSupported 5;
BA_ "SPN" SG_ 3221225472 FMSstandardDiagnosticsSupported 2804;
BA_ "SigType" SG_ 3221225472 FMSstandardDiagnosticsSupported 5;
BA_ "SPN" SG_ 3221225472 DrverAlertnessWarningSystemState 7475;
BA_ "SPN" SG_ 3221225472 DriverAlertnessLevel 7474;
BA_ "SigType" SG_ 3221225472 DriverAlertnessLevel 1;
BA_ "SPN" SG_ 3221225472 LnDpartureIndicationEnableStatus 1702;
BA_ "SigType" SG_ 3221225472 LnDpartureIndicationEnableStatus 5;
BA_ "SPN" SG_ 3221225472 LaneTrackingStatusLeftSide 1710;
BA_ "SigType" SG_ 3221225472 LaneTrackingStatusLeftSide 5;
BA_ "SPN" SG_ 3221225472 LaneTrackingStatusRightSide 1711;
BA_ "SigType" SG_ 3221225472 LaneTrackingStatusRightSide 5;
BA_ "SPN" SG_ 3221225472 LaneDepartureImminentLeftSide 1700;
BA_ "SigType" SG_ 3221225472 LaneDepartureImminentLeftSide 5;
BA_ "SPN" SG_ 3221225472 LaneDepartureImminentRightSide 1701;
BA_ "SigType" SG_ 3221225472 LaneDepartureImminentRightSide 5;
BA_ "SPN" SG_ 3221225472 LaneDepartureRight 3566;
BA_ "SigType" SG_ 3221225472 LaneDepartureRight 5;
BA_ "SPN" SG_ 3221225472 LaneDepartureLeft 3565;
BA_ "SigType" SG_ 3221225472 LaneDepartureLeft 5;
BA_ "SPN" SG_ 3221225472 DriverAlertnessWarning 7473;
BA_ "SPN" SG_ 3221225472 EngFuelLeakage2 1240;
BA_ "SigType" SG_ 3221225472 EngFuelLeakage2 5;
BA_ "SPN" SG_ 3221225472 EngFuelLeakage1 1239;
BA_ "SigType" SG_ 3221225472 EngFuelLeakage1 5;
BA_ "SPN" SG_ 3221225472 FanDriveBypassCmdStatus 4212;
BA_ "SigType" SG_ 3221225472 FanDriveBypassCmdStatus 1;
BA_ "SPN" SG_ 3221225472 HydFanMotorPress 4211;
BA_ "SigType" SG_ 3221225472 HydFanMotorPress 1;
BA_ "SPN" SG_ 3221225472 FanSpeed 1639;
BA_ "SigType" SG_ 3221225472 FanSpeed 1;
BA_ "SPN" SG_ 3221225472 FanDriveState 977;
BA_ "SPN" SG_ 3221225472 EstPercentFanSpeed 975;
BA_ "SigType" SG_ 3221225472 EstPercentFanSpeed 1;
BA_ "SPN" SG_ 3221225472 EngTorqueLimit6AxleInput 1263;
BA_ "SigType" SG_ 3221225472 EngTorqueLimit6AxleInput 1;
BA_ "SPN" SG_ 3221225472 EngTorqueLimit5Switch 1262;
BA_ "SigType" SG_ 3221225472 EngTorqueLimit5Switch 1;
BA_ "SPN" SG_ 3221225472 EngTorqueLimit4Trans 1261;
BA_ "SigType" SG_ 3221225472 EngTorqueLimit4Trans 1;
BA_ "SPN" SG_ 3221225472 EngTorqueLimit3Trans 1260;
BA_ "SigType" SG_ 3221225472 EngTorqueLimit3Trans 1;
BA_ "SPN" SG_ 3221225472 TransGearRatio3 1259;
BA_ "SigType" SG_ 3221225472 TransGearRatio3 1;
BA_ "SPN" SG_ 3221225472 EngTorqueLimit2Trans 1258;
BA_ "SigType" SG_ 3221225472 EngTorqueLimit2Trans 1;
BA_ "SPN" SG_ 3221225472 TransGearRatio2 1257;
BA_ "SigType" SG_ 3221225472 TransGearRatio2 1;
BA_ "SPN" SG_ 3221225472 EngTorqueLimit1Trans 1256;
BA_ "SigType" SG_ 3221225472 EngTorqueLimit1Trans 1;
BA_ "SPN" SG_ 3221225472 TransGearRatio1 1255;
BA_ "SigType" SG_ 3221225472 TransGearRatio1 1;
BA_ "SPN" SG_ 3221225472 EngTorqueLimitFeature 1632;
BA_ "SPN" SG_ 3221225472 TorqueLimitingFeatureStatus 1254;
BA_ "SigType" SG_ 3221225472 TorqueLimitingFeatureStatus 5;
BA_ "SPN" SG_ 3221225472 CalibRecordDurationTime 1253;
BA_ "SigType" SG_ 3221225472 CalibRecordDurationTime 1;
BA_ "SPN" SG_ 3221225472 CalibRecordStartYear 1252;
BA_ "SigType" SG_ 3221225472 CalibRecordStartYear 1;
BA_ "SPN" SG_ 3221225472 CalibRecordStartDay 1251;
BA_ "GenSigStartValue" SG_ 3221225472 CalibRecordStartDay 1;
BA_ "SigType" SG_ 3221225472 CalibRecordStartDay 1;
BA_ "SPN" SG_ 3221225472 CalibRecordStartMonth 1250;
BA_ "GenSigStartValue" SG_ 3221225472 CalibRecordStartMonth 1;
BA_ "SigType" SG_ 3221225472 CalibRecordStartMonth 1;
BA_ "SPN" SG_ 3221225472 EngPeakTorque2 1249;
BA_ "SigType" SG_ 3221225472 EngPeakTorque2 1;
BA_ "SPN" SG_ 3221225472 EngPeakTorque1 1248;
BA_ "SigType" SG_ 3221225472 EngPeakTorque1 1;
BA_ "SPN" SG_ 3221225472 EngPower 1247;
BA_ "SigType" SG_ 3221225472 EngPower 1;
BA_ "SPN" SG_ 3221225472 NumberOfEngTorqueHistoryRecords 1246;
BA_ "SigType" SG_ 3221225472 NumberOfEngTorqueHistoryRecords 1;
BA_ "SPN" SG_ 3221225472 TransClutch_ConverterInputSpeed 5052;
BA_ "SigType" SG_ 3221225472 TransClutch_ConverterInputSpeed 1;
BA_ "SPN" SG_ 3221225472 TransTorqueConverterRatio 3030;
BA_ "SigType" SG_ 3221225472 TransTorqueConverterRatio 1;
BA_ "SPN" SG_ 3221225472 TransAutoNeutralSt 7696;
BA_ "SigType" SG_ 3221225472 TransAutoNeutralSt 5;
BA_ "SPN" SG_ 3221225472 TransWarningIndicator 5344;
BA_ "SigType" SG_ 3221225472 TransWarningIndicator 5;
BA_ "SPN" SG_ 3221225472 TrnsRverseGearShiftInhibitStatus 4261;
BA_ "SigType" SG_ 3221225472 TrnsRverseGearShiftInhibitStatus 4;
BA_ "SPN" SG_ 3221225472 TransMode8Indicator 4253;
BA_ "SigType" SG_ 3221225472 TransMode8Indicator 4;
BA_ "SPN" SG_ 3221225472 TransMode7Indicator 4252;
BA_ "SigType" SG_ 3221225472 TransMode7Indicator 4;
BA_ "SPN" SG_ 3221225472 TransMode6Indicator 4251;
BA_ "SigType" SG_ 3221225472 TransMode6Indicator 4;
BA_ "SPN" SG_ 3221225472 TransMode5Indicator 4250;
BA_ "SigType" SG_ 3221225472 TransMode5Indicator 4;
BA_ "SPN" SG_ 3221225472 TransRequestedGearFeedback 3289;
BA_ "SigType" SG_ 3221225472 TransRequestedGearFeedback 1;
BA_ "SPN" SG_ 3221225472 TransMode1Indicator 2536;
BA_ "SigType" SG_ 3221225472 TransMode1Indicator 4;
BA_ "SPN" SG_ 3221225472 TransMode2Indicator 2537;
BA_ "SigType" SG_ 3221225472 TransMode2Indicator 4;
BA_ "SPN" SG_ 3221225472 TransMode3Indicator 2538;
BA_ "SigType" SG_ 3221225472 TransMode3Indicator 4;
BA_ "SPN" SG_ 3221225472 TransMode4Indicator 2539;
BA_ "SigType" SG_ 3221225472 TransMode4Indicator 4;
BA_ "SPN" SG_ 3221225472 TransShiftInhibitIndicator 1851;
BA_ "SigType" SG_ 3221225472 TransShiftInhibitIndicator 5;
BA_ "SPN" SG_ 3221225472 TransEngCrankEnable 2900;
BA_ "SigType" SG_ 3221225472 TransEngCrankEnable 5;
BA_ "SPN" SG_ 3221225472 ActiveShiftConsoleIndicator 2945;
BA_ "SigType" SG_ 3221225472 ActiveShiftConsoleIndicator 5;
BA_ "SPN" SG_ 3221225472 TransReadyForBrakeRelease 3086;
BA_ "SigType" SG_ 3221225472 TransReadyForBrakeRelease 5;
BA_ "SPN" SG_ 3221225472 TrnsRqstedRangeDisplayFlashState 1849;
BA_ "SigType" SG_ 3221225472 TrnsRqstedRangeDisplayFlashState 5;
BA_ "SPN" SG_ 3221225472 TrnsRqstedRangeDisplayBlankState 1850;
BA_ "SigType" SG_ 3221225472 TrnsRqstedRangeDisplayBlankState 5;
BA_ "SPN" SG_ 3221225472 TransServiceIndicator 4178;
BA_ "SigType" SG_ 3221225472 TransServiceIndicator 5;
BA_ "SPN" SG_ 3221225472 TransAirSupplyPressIndicator 6566;
BA_ "SigType" SG_ 3221225472 TransAirSupplyPressIndicator 4;
BA_ "SPN" SG_ 3221225472 TransMode10Indicator 6568;
BA_ "SigType" SG_ 3221225472 TransMode10Indicator 4;
BA_ "SPN" SG_ 3221225472 TransMode9Indicator 6567;
BA_ "SigType" SG_ 3221225472 TransMode9Indicator 4;
BA_ "SPN" SG_ 3221225472 TrnsCrrentRangeDisplayBlankState 4176;
BA_ "SigType" SG_ 3221225472 TrnsCrrentRangeDisplayBlankState 5;
BA_ "SPN" SG_ 3221225472 ClutchLifeRemaining 2983;
BA_ "SigType" SG_ 3221225472 ClutchLifeRemaining 1;
BA_ "SPN" SG_ 3221225472 LowestPossibleGear 1114;
BA_ "SigType" SG_ 3221225472 LowestPossibleGear 1;
BA_ "SPN" SG_ 3221225472 HighestPossibleGear 1115;
BA_ "SigType" SG_ 3221225472 HighestPossibleGear 1;
BA_ "SPN" SG_ 3221225472 RecommendedGear 1113;
BA_ "SigType" SG_ 3221225472 RecommendedGear 1;
BA_ "SPN" SG_ 3221225472 TransForwardDirectionSwitch 903;
BA_ "SigType" SG_ 3221225472 TransForwardDirectionSwitch 5;
BA_ "SPN" SG_ 3221225472 TransNeutralSwitch 604;
BA_ "SigType" SG_ 3221225472 TransNeutralSwitch 5;
BA_ "SPN" SG_ 3221225472 TransReverseDirectionSwitch 767;
BA_ "SigType" SG_ 3221225472 TransReverseDirectionSwitch 5;
BA_ "SPN" SG_ 3221225472 TransLowRangeSenseSwitch 779;
BA_ "SigType" SG_ 3221225472 TransLowRangeSenseSwitch 5;
BA_ "SPN" SG_ 3221225472 TransHighRangeSenseSwitch 778;
BA_ "SigType" SG_ 3221225472 TransHighRangeSenseSwitch 5;
BA_ "SPN" SG_ 3221225472 TransSynchronizerBrakeValue 54;
BA_ "SigType" SG_ 3221225472 TransSynchronizerBrakeValue 1;
BA_ "SPN" SG_ 3221225472 TransSynchronizerClutchValue 53;
BA_ "SigType" SG_ 3221225472 TransSynchronizerClutchValue 1;
BA_ "SPN" SG_ 3221225472 TransInertiaBrakeActuator 787;
BA_ "SigType" SG_ 3221225472 TransInertiaBrakeActuator 5;
BA_ "SPN" SG_ 3221225472 TransDefuelActuator 786;
BA_ "SigType" SG_ 3221225472 TransDefuelActuator 5;
BA_ "SPN" SG_ 3221225472 TransLockupClutchActuator 740;
BA_ "SigType" SG_ 3221225472 TransLockupClutchActuator 5;
BA_ "SPN" SG_ 3221225472 TransClutchActuator 788;
BA_ "SigType" SG_ 3221225472 TransClutchActuator 5;
BA_ "SPN" SG_ 3221225472 TransSplitterIndirectActuator 771;
BA_ "SigType" SG_ 3221225472 TransSplitterIndirectActuator 5;
BA_ "SPN" SG_ 3221225472 TransSplitterDirectActuator 770;
BA_ "SigType" SG_ 3221225472 TransSplitterDirectActuator 5;
BA_ "SPN" SG_ 3221225472 TransRangeLowActuator 769;
BA_ "SigType" SG_ 3221225472 TransRangeLowActuator 5;
BA_ "SPN" SG_ 3221225472 TransRangeHighActuator 768;
BA_ "SigType" SG_ 3221225472 TransRangeHighActuator 5;
BA_ "SPN" SG_ 3221225472 TransShiftFingerGearActuator2 784;
BA_ "SigType" SG_ 3221225472 TransShiftFingerGearActuator2 5;
BA_ "SPN" SG_ 3221225472 TransShiftFingerRailActuator2 783;
BA_ "SigType" SG_ 3221225472 TransShiftFingerRailActuator2 5;
BA_ "SPN" SG_ 3221225472 TransShiftFingerGearActuator1 773;
BA_ "SigType" SG_ 3221225472 TransShiftFingerGearActuator1 5;
BA_ "SPN" SG_ 3221225472 TransShiftFingerRailActuator1 772;
BA_ "SigType" SG_ 3221225472 TransShiftFingerRailActuator1 5;
BA_ "SPN" SG_ 3221225472 TrnsShftFngerCenterRailIndicator 782;
BA_ "SigType" SG_ 3221225472 TrnsShftFngerCenterRailIndicator 5;
BA_ "SPN" SG_ 3221225472 TrnsShftFngerEngagementIndicator 781;
BA_ "SigType" SG_ 3221225472 TrnsShftFngerEngagementIndicator 5;
BA_ "SPN" SG_ 3221225472 TransShiftFingerNeutralIndicator 780;
BA_ "SigType" SG_ 3221225472 TransShiftFingerNeutralIndicator 5;
BA_ "SPN" SG_ 3221225472 TransShiftFingerRailPos 60;
BA_ "SigType" SG_ 3221225472 TransShiftFingerRailPos 1;
BA_ "SPN" SG_ 3221225472 TransShiftFingerGearPos 59;
BA_ "SigType" SG_ 3221225472 TransShiftFingerGearPos 1;
BA_ "SPN" SG_ 3221225472 TransCurrentRange 163;
BA_ "SigType" SG_ 3221225472 TransCurrentRange 1;
BA_ "SPN" SG_ 3221225472 TransRequestedRange 162;
BA_ "SigType" SG_ 3221225472 TransRequestedRange 1;
BA_ "SPN" SG_ 3221225472 TransCurrentGear 523;
BA_ "SigType" SG_ 3221225472 TransCurrentGear 1;
BA_ "SPN" SG_ 3221225472 TransActualGearRatio 526;
BA_ "SigType" SG_ 3221225472 TransActualGearRatio 1;
BA_ "SPN" SG_ 3221225472 TransSelectedGear 524;
BA_ "SigType" SG_ 3221225472 TransSelectedGear 1;
BA_ "SPN" SG_ 3221225472 SrcAddrssOfCntrllngDvcFrTrnsCtrl 1482;
BA_ "SPN" SG_ 3221225472 TransInputShaftSpeed 161;
BA_ "SigType" SG_ 3221225472 TransInputShaftSpeed 1;
BA_ "SPN" SG_ 3221225472 MomentaryEngMaxPowerEnable 5015;
BA_ "SigType" SG_ 3221225472 MomentaryEngMaxPowerEnable 5;
BA_ "SPN" SG_ 3221225472 ProgressiveShiftDisable 607;
BA_ "SigType" SG_ 3221225472 ProgressiveShiftDisable 5;
BA_ "SPN" SG_ 3221225472 EngMomentaryOverspeedEnable 606;
BA_ "SigType" SG_ 3221225472 EngMomentaryOverspeedEnable 5;
BA_ "SPN" SG_ 3221225472 TransOutputShaftSpeed 191;
BA_ "SigType" SG_ 3221225472 TransOutputShaftSpeed 1;
BA_ "SPN" SG_ 3221225472 TrnsTrqCnvrtrLckpTrnstnInProcess 4816;
BA_ "SigType" SG_ 3221225472 TrnsTrqCnvrtrLckpTrnstnInProcess 4;
BA_ "SPN" SG_ 3221225472 TransShiftInProcess 574;
BA_ "SigType" SG_ 3221225472 TransShiftInProcess 4;
BA_ "SPN" SG_ 3221225472 TrnsTorqueConverterLockupEngaged 573;
BA_ "SigType" SG_ 3221225472 TrnsTorqueConverterLockupEngaged 5;
BA_ "SPN" SG_ 3221225472 TransDrivelineEngaged 560;
BA_ "SigType" SG_ 3221225472 TransDrivelineEngaged 4;
BA_ "SPN" SG_ 3221225472 EngChargeAirCooler1OutletTemp 2630;
BA_ "SigType" SG_ 3221225472 EngChargeAirCooler1OutletTemp 1;
BA_ "SPN" SG_ 3221225472 EngIntkVlvActuationSystemOilTemp 2986;
BA_ "SigType" SG_ 3221225472 EngIntkVlvActuationSystemOilTemp 1;
BA_ "SPN" SG_ 3221225472 EngIntakeManifold1AirTemp 1636;
BA_ "SigType" SG_ 3221225472 EngIntakeManifold1AirTemp 1;
BA_ "SPN" SG_ 3221225472 EngExhaustGasRecirculation1Temp 412;
BA_ "SigType" SG_ 3221225472 EngExhaustGasRecirculation1Temp 1;
BA_ "SPN" SG_ 3221225472 EngExhstGsRcirculation1DiffPress 411;
BA_ "SigType" SG_ 3221225472 EngExhstGsRcirculation1DiffPress 1;
BA_ "SPN" SG_ 3221225472 EngECUTemp 1136;
BA_ "SigType" SG_ 3221225472 EngECUTemp 1;
BA_ "SPN" SG_ 3221225472 EngOilTemp2 1135;
BA_ "SigType" SG_ 3221225472 EngOilTemp2 1;
BA_ "SPN" SG_ 3221225472 EngIntercoolerThermostatOpening 1134;
BA_ "SigType" SG_ 3221225472 EngIntercoolerThermostatOpening 1;
BA_ "SPN" SG_ 3221225472 EngIntercoolerTemp 52;
BA_ "SigType" SG_ 3221225472 EngIntercoolerTemp 1;
BA_ "SPN" SG_ 3221225472 EngTurboOilTemp 176;
BA_ "SigType" SG_ 3221225472 EngTurboOilTemp 1;
BA_ "SPN" SG_ 3221225472 EngOilTemp1 175;
BA_ "SigType" SG_ 3221225472 EngOilTemp1 1;
BA_ "SPN" SG_ 3221225472 EngFuelTemp1 174;
BA_ "SigType" SG_ 3221225472 EngFuelTemp1 1;
BA_ "SPN" SG_ 3221225472 EngExhaustManifoldBank1Temp2 5970;
BA_ "SigType" SG_ 3221225472 EngExhaustManifoldBank1Temp2 1;
BA_ "SPN" SG_ 3221225472 EngExhaustManifoldBank2Temp2 5969;
BA_ "SigType" SG_ 3221225472 EngExhaustManifoldBank2Temp2 1;
BA_ "SPN" SG_ 3221225472 EngExhaustGasTempLeftManifold 2434;
BA_ "SigType" SG_ 3221225472 EngExhaustGasTempLeftManifold 1;
BA_ "SPN" SG_ 3221225472 EngExhaustGasTempRightManifold 2433;
BA_ "SigType" SG_ 3221225472 EngExhaustGasTempRightManifold 1;
BA_ "SPN" SG_ 3221225472 TypeOfSteerTrans 2926;
BA_ "SPN" SG_ 3221225472 TypeOfSteerForces 2925;
BA_ "SPN" SG_ 3221225472 SteerType 2924;
BA_ "SPN" SG_ 3221225472 SteerableLiftAxleLoweringInhibit 2922;
BA_ "SigType" SG_ 3221225472 SteerableLiftAxleLoweringInhibit 5;
BA_ "SPN" SG_ 3221225472 StatusOfSteerAxle 2923;
BA_ "SPN" SG_ 3221225472 ActualInnerWheelSteerAngle 2927;
BA_ "SigType" SG_ 3221225472 ActualInnerWheelSteerAngle 1;
BA_ "SPN" SG_ 3221225472 CrsCtrlRetarderActiveSpeedOffset 7496;
BA_ "GenSigStartValue" SG_ 3221225472 CrsCtrlRetarderActiveSpeedOffset 32000;
BA_ "SigType" SG_ 3221225472 CrsCtrlRetarderActiveSpeedOffset 1;
BA_ "SPN" SG_ 3221225472 TransOutputRetarder 748;
BA_ "SigType" SG_ 3221225472 TransOutputRetarder 5;
BA_ "SPN" SG_ 3221225472 ActlMxAvlblRetarderPercentTorque 1717;
BA_ "SigType" SG_ 3221225472 ActlMxAvlblRetarderPercentTorque 1;
BA_ "SPN" SG_ 3221225472 RetarderSelectionNonengine 1716;
BA_ "SigType" SG_ 3221225472 RetarderSelectionNonengine 1;
BA_ "SPN" SG_ 3221225472 DrvrsDemandRetarderPercentTorque 1715;
BA_ "SigType" SG_ 3221225472 DrvrsDemandRetarderPercentTorque 1;
BA_ "SPN" SG_ 3221225472 SrcAddrssOfCntrllngDvcFrRtrdrCtr 1480;
BA_ "SPN" SG_ 3221225472 RetarderRoadSpeedExceeded 4234;
BA_ "SigType" SG_ 3221225472 RetarderRoadSpeedExceeded 5;
BA_ "SPN" SG_ 3221225472 RetarderRoadSpeedLimitSwitch 4233;
BA_ "SigType" SG_ 3221225472 RetarderRoadSpeedLimitSwitch 4;
BA_ "SPN" SG_ 3221225472 RetarderRequestingBrakeLight 1667;
BA_ "SigType" SG_ 3221225472 RetarderRequestingBrakeLight 5;
BA_ "SPN" SG_ 3221225472 EngCoolantLoadIncrease 1082;
BA_ "SigType" SG_ 3221225472 EngCoolantLoadIncrease 5;
BA_ "SPN" SG_ 3221225472 IntendedRetarderPercentTorque 1085;
BA_ "SigType" SG_ 3221225472 IntendedRetarderPercentTorque 1;
BA_ "SPN" SG_ 3221225472 ActualRetarderPercentTorque 520;
BA_ "SigType" SG_ 3221225472 ActualRetarderPercentTorque 1;
BA_ "SPN" SG_ 3221225472 RetarderEnableShiftAssistSwitch 572;
BA_ "SigType" SG_ 3221225472 RetarderEnableShiftAssistSwitch 4;
BA_ "SPN" SG_ 3221225472 RetarderEnableBrakeAssistSwitch 571;
BA_ "SigType" SG_ 3221225472 RetarderEnableBrakeAssistSwitch 4;
BA_ "SPN" SG_ 3221225472 RetarderTorqueMode 900;
BA_ "SPN" SG_ 3221225472 EngExhaustGasPort20Temp 1156;
BA_ "SigType" SG_ 3221225472 EngExhaustGasPort20Temp 1;
BA_ "SPN" SG_ 3221225472 EngExhaustGasPort19Temp 1155;
BA_ "SigType" SG_ 3221225472 EngExhaustGasPort19Temp 1;
BA_ "SPN" SG_ 3221225472 EngExhaustGasPort18Temp 1154;
BA_ "SigType" SG_ 3221225472 EngExhaustGasPort18Temp 1;
BA_ "SPN" SG_ 3221225472 EngExhaustGasPort17Temp 1153;
BA_ "SigType" SG_ 3221225472 EngExhaustGasPort17Temp 1;
BA_ "SPN" SG_ 3221225472 EngExhaustGasPort16Temp 1152;
BA_ "SigType" SG_ 3221225472 EngExhaustGasPort16Temp 1;
BA_ "SPN" SG_ 3221225472 EngExhaustGasPort15Temp 1151;
BA_ "SigType" SG_ 3221225472 EngExhaustGasPort15Temp 1;
BA_ "SPN" SG_ 3221225472 EngExhaustGasPort14Temp 1150;
BA_ "SigType" SG_ 3221225472 EngExhaustGasPort14Temp 1;
BA_ "SPN" SG_ 3221225472 EngExhaustGasPort13Temp 1149;
BA_ "SigType" SG_ 3221225472 EngExhaustGasPort13Temp 1;
BA_ "SPN" SG_ 3221225472 EngExhaustGasPort12Temp 1148;
BA_ "SigType" SG_ 3221225472 EngExhaustGasPort12Temp 1;
BA_ "SPN" SG_ 3221225472 EngExhaustGasPort11Temp 1147;
BA_ "SigType" SG_ 3221225472 EngExhaustGasPort11Temp 1;
BA_ "SPN" SG_ 3221225472 EngExhaustGasPort10Temp 1146;
BA_ "SigType" SG_ 3221225472 EngExhaustGasPort10Temp 1;
BA_ "SPN" SG_ 3221225472 EngExhaustGasPort9Temp 1145;
BA_ "SigType" SG_ 3221225472 EngExhaustGasPort9Temp 1;
BA_ "SPN" SG_ 3221225472 EngExhaustGasPort8Temp 1144;
BA_ "SigType" SG_ 3221225472 EngExhaustGasPort8Temp 1;
BA_ "SPN" SG_ 3221225472 EngExhaustGasPort7Temp 1143;
BA_ "SigType" SG_ 3221225472 EngExhaustGasPort7Temp 1;
BA_ "SPN" SG_ 3221225472 EngExhaustGasPort6Temp 1142;
BA_ "SigType" SG_ 3221225472 EngExhaustGasPort6Temp 1;
BA_ "SPN" SG_ 3221225472 EngExhaustGasPort5Temp 1141;
BA_ "SigType" SG_ 3221225472 EngExhaustGasPort5Temp 1;
BA_ "SPN" SG_ 3221225472 EngExhaustGasPort4Temp 1140;
BA_ "SigType" SG_ 3221225472 EngExhaustGasPort4Temp 1;
BA_ "SPN" SG_ 3221225472 EngExhaustGasPort3Temp 1139;
BA_ "SigType" SG_ 3221225472 EngExhaustGasPort3Temp 1;
BA_ "SPN" SG_ 3221225472 EngExhaustGasPort2Temp 1138;
BA_ "SigType" SG_ 3221225472 EngExhaustGasPort2Temp 1;
BA_ "SPN" SG_ 3221225472 EngExhaustGasPort1Temp 1137;
BA_ "SigType" SG_ 3221225472 EngExhaustGasPort1Temp 1;
BA_ "SPN" SG_ 3221225472 PayloadCapacityPercentage 6854;
BA_ "SigType" SG_ 3221225472 PayloadCapacityPercentage 1;
BA_ "SPN" SG_ 3221225472 PayloadCarryBackWeight 6853;
BA_ "SigType" SG_ 3221225472 PayloadCarryBackWeight 1;
BA_ "SPN" SG_ 3221225472 PayloadWeightConfidence 6852;
BA_ "SigType" SG_ 3221225472 PayloadWeightConfidence 1;
BA_ "SPN" SG_ 3221225472 PayloadWeight 6851;
BA_ "SPN" SG_ 3221225472 PayloadPercentage 2600;
BA_ "SigType" SG_ 3221225472 PayloadPercentage 1;
BA_ "SPN" SG_ 3221225472 DataMemoryUsage 2802;
BA_ "SigType" SG_ 3221225472 DataMemoryUsage 1;
BA_ "SPN" SG_ 3221225472 KeepAliveBatteryConsumption 2803;
BA_ "SigType" SG_ 3221225472 KeepAliveBatteryConsumption 1;
BA_ "SPN" SG_ 3221225472 TravelVelocityCtrlPos 2601;
BA_ "SigType" SG_ 3221225472 TravelVelocityCtrlPos 1;
BA_ "SPN" SG_ 3221225472 EngExhstGsOxygnSnsrClsdLpOprtion 1696;
BA_ "SigType" SG_ 3221225472 EngExhstGsOxygnSnsrClsdLpOprtion 5;
BA_ "SPN" SG_ 3221225472 EngExhstGsOxygnSnsrFlngCrrection 1695;
BA_ "SigType" SG_ 3221225472 EngExhstGsOxygnSnsrFlngCrrection 1;
BA_ "SPN" SG_ 3221225472 EngActualExhaustOxygen 1119;
BA_ "SigType" SG_ 3221225472 EngActualExhaustOxygen 1;
BA_ "SPN" SG_ 3221225472 EngDesiredExhaustOxygen 1118;
BA_ "SigType" SG_ 3221225472 EngDesiredExhaustOxygen 1;
BA_ "SPN" SG_ 3221225472 EngDesiredRatedExhaustOxygen 1117;
BA_ "SigType" SG_ 3221225472 EngDesiredRatedExhaustOxygen 1;
BA_ "SPN" SG_ 3221225472 Joystick3Button13PressedStatus 6739;
BA_ "SigType" SG_ 3221225472 Joystick3Button13PressedStatus 4;
BA_ "SPN" SG_ 3221225472 Joystick3Button14PressedStatus 6740;
BA_ "SigType" SG_ 3221225472 Joystick3Button14PressedStatus 4;
BA_ "SPN" SG_ 3221225472 Joystick3Button15PressedStatus 6741;
BA_ "SigType" SG_ 3221225472 Joystick3Button15PressedStatus 4;
BA_ "SPN" SG_ 3221225472 Joystick3Button16PressedStatus 6742;
BA_ "SigType" SG_ 3221225472 Joystick3Button16PressedStatus 4;
BA_ "SPN" SG_ 3221225472 Jystick3GripXAxisDetentPosStatus 2756;
BA_ "SigType" SG_ 3221225472 Jystick3GripXAxisDetentPosStatus 4;
BA_ "SPN" SG_ 3221225472 Jystick3GripYAxisDetentPosStatus 2757;
BA_ "SigType" SG_ 3221225472 Jystick3GripYAxisDetentPosStatus 4;
BA_ "SPN" SG_ 3221225472 Jystick3ThetaAxisDetentPosStatus 2758;
BA_ "SigType" SG_ 3221225472 Jystick3ThetaAxisDetentPosStatus 4;
BA_ "SPN" SG_ 3221225472 Joystick3ThetaAxisPos 2738;
BA_ "SPN" SG_ 3221225472 Jystck3ThtAxsClckwsPstvPosStatus 2743;
BA_ "SigType" SG_ 3221225472 Jystck3ThtAxsClckwsPstvPosStatus 4;
BA_ "SPN" SG_ 3221225472 Jystck3ThetaAxisNeutralPosStatus 2753;
BA_ "SigType" SG_ 3221225472 Jystck3ThetaAxisNeutralPosStatus 4;
BA_ "SPN" SG_ 3221225472 Joystick3GripYAxisPos 2737;
BA_ "SPN" SG_ 3221225472 Jystck3GrpYAxsLvrFrwrdPstvPsStts 2742;
BA_ "SigType" SG_ 3221225472 Jystck3GrpYAxsLvrFrwrdPstvPsStts 4;
BA_ "SPN" SG_ 3221225472 Jystck3GrpYAxsLvrBckNgtvPsStatus 2747;
BA_ "SigType" SG_ 3221225472 Jystck3GrpYAxsLvrBckNgtvPsStatus 4;
BA_ "SPN" SG_ 3221225472 Jystck3GripYAxisNeutralPosStatus 2752;
BA_ "SigType" SG_ 3221225472 Jystck3GripYAxisNeutralPosStatus 4;
BA_ "SPN" SG_ 3221225472 Joystick3GripXAxisPos 2736;
BA_ "SPN" SG_ 3221225472 Jystck3GrpXAxsLvrRghtPstvPsSttus 2741;
BA_ "SigType" SG_ 3221225472 Jystck3GrpXAxsLvrRghtPstvPsSttus 4;
BA_ "SPN" SG_ 3221225472 Jystck3GrpXAxsLvrLftNgtvPsStatus 2746;
BA_ "SigType" SG_ 3221225472 Jystck3GrpXAxsLvrLftNgtvPsStatus 4;
BA_ "SPN" SG_ 3221225472 Jystck3GripXAxisNeutralPosStatus 2751;
BA_ "SigType" SG_ 3221225472 Jystck3GripXAxisNeutralPosStatus 4;
BA_ "SPN" SG_ 3221225472 Jystck3ThtAxsCntrClckwsNgtvPsStt 2748;
BA_ "SigType" SG_ 3221225472 Jystck3ThtAxsCntrClckwsNgtvPsStt 4;
BA_ "SPN" SG_ 3221225472 Joystick2Button13PressedStatus 6735;
BA_ "SigType" SG_ 3221225472 Joystick2Button13PressedStatus 4;
BA_ "SPN" SG_ 3221225472 Joystick2Button14PressedStatus 6736;
BA_ "SigType" SG_ 3221225472 Joystick2Button14PressedStatus 4;
BA_ "SPN" SG_ 3221225472 Joystick2Button15PressedStatus 6737;
BA_ "SigType" SG_ 3221225472 Joystick2Button15PressedStatus 4;
BA_ "SPN" SG_ 3221225472 Joystick2Button16PressedStatus 6738;
BA_ "SigType" SG_ 3221225472 Joystick2Button16PressedStatus 4;
BA_ "SPN" SG_ 3221225472 Jystick2GripXAxisDetentPosStatus 2719;
BA_ "SigType" SG_ 3221225472 Jystick2GripXAxisDetentPosStatus 4;
BA_ "SPN" SG_ 3221225472 Jystick2GripYAxisDetentPosStatus 2720;
BA_ "SigType" SG_ 3221225472 Jystick2GripYAxisDetentPosStatus 4;
BA_ "SPN" SG_ 3221225472 Jystick2ThetaAxisDetentPosStatus 2721;
BA_ "SigType" SG_ 3221225472 Jystick2ThetaAxisDetentPosStatus 4;
BA_ "SPN" SG_ 3221225472 Joystick2ThetaAxisPos 2701;
BA_ "SPN" SG_ 3221225472 Jystck2ThtAxsClckwsPstvPosStatus 2706;
BA_ "SigType" SG_ 3221225472 Jystck2ThtAxsClckwsPstvPosStatus 4;
BA_ "SPN" SG_ 3221225472 Jystck2ThetaAxisNeutralPosStatus 2716;
BA_ "SigType" SG_ 3221225472 Jystck2ThetaAxisNeutralPosStatus 4;
BA_ "SPN" SG_ 3221225472 Joystick2GripYAxisPos 2700;
BA_ "SPN" SG_ 3221225472 Jystck2GrpYAxsLvrFrwrdPstvPsStts 2705;
BA_ "SigType" SG_ 3221225472 Jystck2GrpYAxsLvrFrwrdPstvPsStts 4;
BA_ "SPN" SG_ 3221225472 Jystck2GrpYAxsLvrBckNgtvPsStatus 2710;
BA_ "SigType" SG_ 3221225472 Jystck2GrpYAxsLvrBckNgtvPsStatus 4;
BA_ "SPN" SG_ 3221225472 Jystck2GripYAxisNeutralPosStatus 2715;
BA_ "SigType" SG_ 3221225472 Jystck2GripYAxisNeutralPosStatus 4;
BA_ "SPN" SG_ 3221225472 Joystick2GripXAxisPos 2699;
BA_ "SPN" SG_ 3221225472 Jystck2GrpXAxsLvrRghtPstvPsSttus 2704;
BA_ "SigType" SG_ 3221225472 Jystck2GrpXAxsLvrRghtPstvPsSttus 4;
BA_ "SPN" SG_ 3221225472 Jystck2GrpXAxsLvrLftNgtvPsStatus 2709;
BA_ "SigType" SG_ 3221225472 Jystck2GrpXAxsLvrLftNgtvPsStatus 4;
BA_ "SPN" SG_ 3221225472 Jystck2GripXAxisNeutralPosStatus 2714;
BA_ "SigType" SG_ 3221225472 Jystck2GripXAxisNeutralPosStatus 4;
BA_ "SPN" SG_ 3221225472 Jystck2ThtAxsCntrClckwsNgtvPsStt 2711;
BA_ "SigType" SG_ 3221225472 Jystck2ThtAxsCntrClckwsNgtvPsStt 4;
BA_ "SPN" SG_ 3221225472 Joystick1Button13PressedStatus 6731;
BA_ "SigType" SG_ 3221225472 Joystick1Button13PressedStatus 4;
BA_ "SPN" SG_ 3221225472 Joystick1Button14PressedStatus 6732;
BA_ "SigType" SG_ 3221225472 Joystick1Button14PressedStatus 4;
BA_ "SPN" SG_ 3221225472 Joystick1Button15PressedStatus 6733;
BA_ "SigType" SG_ 3221225472 Joystick1Button15PressedStatus 4;
BA_ "SPN" SG_ 3221225472 Joystick1Button16PressedStatus 6734;
BA_ "SigType" SG_ 3221225472 Joystick1Button16PressedStatus 4;
BA_ "SPN" SG_ 3221225472 Jystick1GripXAxisDetentPosStatus 2682;
BA_ "SigType" SG_ 3221225472 Jystick1GripXAxisDetentPosStatus 4;
BA_ "SPN" SG_ 3221225472 Jystick1GripYAxisDetentPosStatus 2683;
BA_ "SigType" SG_ 3221225472 Jystick1GripYAxisDetentPosStatus 4;
BA_ "SPN" SG_ 3221225472 Jystick1ThetaAxisDetentPosStatus 2684;
BA_ "SigType" SG_ 3221225472 Jystick1ThetaAxisDetentPosStatus 4;
BA_ "SPN" SG_ 3221225472 Joystick1ThetaAxisPos 2664;
BA_ "SPN" SG_ 3221225472 Jystck1ThtAxsClckwsPstvPosStatus 2669;
BA_ "SigType" SG_ 3221225472 Jystck1ThtAxsClckwsPstvPosStatus 4;
BA_ "SPN" SG_ 3221225472 Jystck1ThetaAxisNeutralPosStatus 2679;
BA_ "SigType" SG_ 3221225472 Jystck1ThetaAxisNeutralPosStatus 4;
BA_ "SPN" SG_ 3221225472 Joystick1GripYAxisPos 2663;
BA_ "SPN" SG_ 3221225472 Jystck1GrpYAxsLvrFrwrdPstvPsStts 2668;
BA_ "SigType" SG_ 3221225472 Jystck1GrpYAxsLvrFrwrdPstvPsStts 4;
BA_ "SPN" SG_ 3221225472 Jystck1GrpYAxsLvrBckNgtvPsStatus 2673;
BA_ "SigType" SG_ 3221225472 Jystck1GrpYAxsLvrBckNgtvPsStatus 4;
BA_ "SPN" SG_ 3221225472 Aftrtrtmnt1DslExhstFldPrprtsPrlm 2678;
BA_ "SigType" SG_ 3221225472 Aftrtrtmnt1DslExhstFldPrprtsPrlm 4;
BA_ "SPN" SG_ 3221225472 Joystick1GripXAxisPos 2662;
BA_ "SPN" SG_ 3221225472 Jystck1GrpXAxsLvrRghtPstvPsSttus 2667;
BA_ "SigType" SG_ 3221225472 Jystck1GrpXAxsLvrRghtPstvPsSttus 4;
BA_ "SPN" SG_ 3221225472 Jystck1GrpXAxsLvrLftNgtvPsStatus 2672;
BA_ "SigType" SG_ 3221225472 Jystck1GrpXAxsLvrLftNgtvPsStatus 4;
BA_ "SPN" SG_ 3221225472 Jystck1GripXAxisNeutralPosStatus 2677;
BA_ "SigType" SG_ 3221225472 Jystck1GripXAxisNeutralPosStatus 4;
BA_ "SPN" SG_ 3221225472 Jystck1ThtAxsCntrClckwsNgtvPsStt 2674;
BA_ "SigType" SG_ 3221225472 Jystck1ThtAxsCntrClckwsNgtvPsStt 4;
BA_ "SPN" SG_ 3221225472 EngFuelRackPos 1210;
BA_ "SigType" SG_ 3221225472 EngFuelRackPos 1;
BA_ "SPN" SG_ 3221225472 EngGasMassFlowRate1 1241;
BA_ "SigType" SG_ 3221225472 EngGasMassFlowRate1 1;
BA_ "SPN" SG_ 3221225472 InstantaneousEstBrakePower 1242;
BA_ "SigType" SG_ 3221225472 InstantaneousEstBrakePower 1;
BA_ "SPN" SG_ 3221225472 EngExhaustGasPress1 1209;
BA_ "SigType" SG_ 3221225472 EngExhaustGasPress1 1;
BA_ "SPN" SG_ 3221225472 EngPrefilterOilPress 1208;
BA_ "SigType" SG_ 3221225472 EngPrefilterOilPress 1;
BA_ "SPN" SG_ 3221225472 TotalECURunTime 1033;
BA_ "SigType" SG_ 3221225472 TotalECURunTime 1;
BA_ "SPN" SG_ 3221225472 TotalECUDistance 1032;
BA_ "SigType" SG_ 3221225472 TotalECUDistance 1;
BA_ "SPN" SG_ 3221225472 EngExhstGsRcrcltion2MassFlowRate 5257;
BA_ "SigType" SG_ 3221225472 EngExhstGsRcrcltion2MassFlowRate 1;
BA_ "SPN" SG_ 3221225472 EngIntakeAirMassFlowRate 132;
BA_ "SigType" SG_ 3221225472 EngIntakeAirMassFlowRate 1;
BA_ "SPN" SG_ 3221225472 EngExhstGsRcrcltion1MassFlowRate 2659;
BA_ "SigType" SG_ 3221225472 EngExhstGsRcrcltion1MassFlowRate 1;
BA_ "SPN" SG_ 3221225472 EngFuelSupplyPumpIntakePress 7104;
BA_ "SigType" SG_ 3221225472 EngFuelSupplyPumpIntakePress 1;
BA_ "SPN" SG_ 3221225472 FuelPumpPrimerStatus 4083;
BA_ "SigType" SG_ 3221225472 FuelPumpPrimerStatus 5;
BA_ "SPN" SG_ 3221225472 EngVentilationStatus 3554;
BA_ "SPN" SG_ 3221225472 EngCoolantPreheatedState 3553;
BA_ "SigType" SG_ 3221225472 EngCoolantPreheatedState 5;
BA_ "SPN" SG_ 3221225472 EngOilPreHeatedState 3552;
BA_ "SigType" SG_ 3221225472 EngOilPreHeatedState 5;
BA_ "SPN" SG_ 3221225472 EngOilPrimingState 3551;
BA_ "SigType" SG_ 3221225472 EngOilPrimingState 5;
BA_ "SPN" SG_ 3221225472 EngOilPrimingPumpSwitch 3550;
BA_ "SigType" SG_ 3221225472 EngOilPrimingPumpSwitch 4;
BA_ "SPN" SG_ 3221225472 EngOilFilterOutletPress 3549;
BA_ "SigType" SG_ 3221225472 EngOilFilterOutletPress 1;
BA_ "SPN" SG_ 3221225472 EngWasteOilReservoirLevel 3548;
BA_ "SigType" SG_ 3221225472 EngWasteOilReservoirLevel 1;
BA_ "SPN" SG_ 3221225472 EngFuelFilterDiffPress 1382;
BA_ "SigType" SG_ 3221225472 EngFuelFilterDiffPress 1;
BA_ "SPN" SG_ 3221225472 EngOilLevelRemoteReservoir 1380;
BA_ "SigType" SG_ 3221225472 EngOilLevelRemoteReservoir 1;
BA_ "SPN" SG_ 3221225472 EngThrottleValve1DiffPress 5631;
BA_ "SigType" SG_ 3221225472 EngThrottleValve1DiffPress 1;
BA_ "SPN" SG_ 3221225472 EngExhstGsRcrclation1OutletPress 5019;
BA_ "SigType" SG_ 3221225472 EngExhstGsRcrclation1OutletPress 1;
BA_ "SPN" SG_ 3221225472 EngExhstVlvActtionSystemOilPress 4287;
BA_ "SigType" SG_ 3221225472 EngExhstVlvActtionSystemOilPress 1;
BA_ "SPN" SG_ 3221225472 EngExhstGsRcrclation1IntakePress 3358;
BA_ "SigType" SG_ 3221225472 EngExhstGsRcrclation1IntakePress 1;
BA_ "SPN" SG_ 3221225472 EngIntkVlvActationSystemOilPress 2948;
BA_ "SigType" SG_ 3221225472 EngIntkVlvActationSystemOilPress 1;
BA_ "SPN" SG_ 3221225472 EngInjectorMeteringRail2Press 1349;
BA_ "SigType" SG_ 3221225472 EngInjectorMeteringRail2Press 1;
BA_ "SPN" SG_ 3221225472 EngInjectorTimingRail1Press 156;
BA_ "SigType" SG_ 3221225472 EngInjectorTimingRail1Press 1;
BA_ "SPN" SG_ 3221225472 EngInjectorMeteringRail1Press 157;
BA_ "SigType" SG_ 3221225472 EngInjectorMeteringRail1Press 1;
BA_ "SPN" SG_ 3221225472 EngInjectionCtrlPress 164;
BA_ "SigType" SG_ 3221225472 EngInjectionCtrlPress 1;
BA_ "SPN" SG_ 3221225472 EngCoolantLevel 111;
BA_ "SigType" SG_ 3221225472 EngCoolantLevel 1;
BA_ "SPN" SG_ 3221225472 EngCoolantPress 109;
BA_ "SigType" SG_ 3221225472 EngCoolantPress 1;
BA_ "SPN" SG_ 3221225472 EngCrankcasePress 101;
BA_ "SigType" SG_ 3221225472 EngCrankcasePress 1;
BA_ "SPN" SG_ 3221225472 EngOilLevel 98;
BA_ "SigType" SG_ 3221225472 EngOilLevel 1;
BA_ "SPN" SG_ 3221225472 EngExCrankcaseBlowbyPress 22;
BA_ "SigType" SG_ 3221225472 EngExCrankcaseBlowbyPress 1;
BA_ "SPN" SG_ 3221225472 SafetyWireStatus 1205;
BA_ "SigType" SG_ 3221225472 SafetyWireStatus 5;
BA_ "SPN" SG_ 3221225472 ElectricalLoad 1204;
BA_ "SigType" SG_ 3221225472 ElectricalLoad 1;
BA_ "SPN" SG_ 3221225472 EngVrblGeometryTurbo1ActuatorPos 2795;
BA_ "SigType" SG_ 3221225472 EngVrblGeometryTurbo1ActuatorPos 1;
BA_ "SPN" SG_ 3221225472 EngVriableGeometryTurbo1CtrlMode 5457;
BA_ "SigType" SG_ 3221225472 EngVriableGeometryTurbo1CtrlMode 5;
BA_ "SPN" SG_ 3221225472 EngFuelCtrlCtrlMode 5323;
BA_ "SigType" SG_ 3221225472 EngFuelCtrlCtrlMode 5;
BA_ "SPN" SG_ 3221225472 EngVrblGmtryTrbArCtrlShtoffValve 2792;
BA_ "SigType" SG_ 3221225472 EngVrblGmtryTrbArCtrlShtoffValve 5;
BA_ "SPN" SG_ 3221225472 EngExhstGsRcirculation1ValveCtrl 2791;
BA_ "SigType" SG_ 3221225472 EngExhstGsRcirculation1ValveCtrl 1;
BA_ "SPN" SG_ 3221225472 EngTrb1ClclatedTurbineOutletTemp 2790;
BA_ "SigType" SG_ 3221225472 EngTrb1ClclatedTurbineOutletTemp 1;
BA_ "SPN" SG_ 3221225472 EngTrb1ClclatedTurbineIntakeTemp 2789;
BA_ "SigType" SG_ 3221225472 EngTrb1ClclatedTurbineIntakeTemp 1;
BA_ "SPN" SG_ 3221225472 EngFuelFilterDiffPress 95;
BA_ "SigType" SG_ 3221225472 EngFuelFilterDiffPress 1;
VAL_ 3221225472 EngPTOGovernorSetSwitch 3 "Not Available" 2 "Error" 1 "On" 0 "Off" ;
VAL_ 3221225472 EngPTOGovernorResumeSwitch 3 "Not Available" 2 "Error" 1 "On" 0 "Off" ;
VAL_ 3221225472 EngPTOGovernorEnableSwitch 3 "Not Available" 2 "Error" 1 "On" 0 "Off" ;
VAL_ 3221225472 EngPTOGovernorAccelerateSwitch 3 "Not Available" 2 "Error" 1 "On" 0 "Off" ;
VAL_ 3221225472 RmtPTOGvrnrPrprgrmmdSpdCtrlSwtch 3 "Not Available" 2 "Error" 1 "On" 0 "Off" ;
VAL_ 3221225472 AuxInputIgnoreSwitch 3 "Not Available" 2 "Error" 1 "On" 0 "Off" ;
VAL_ 3221225472 RearWasherFunction 7 "Not available" 3 "High" 2 "Medium" 1 "Low" 0 "Off" ;
VAL_ 3221225472 FrontOperatorWasherSwitch 7 "Not available" 3 "High" 2 "Medium" 1 "Low" 0 "Off" ;
VAL_ 3221225472 FrontNonoperatorWasherSwitch 7 "Not available" 3 "High" 2 "Medium" 1 "Low" 0 "Off" ;
VAL_ 3221225472 RearWiperSwitch 15 "Not available" 6 "Mist" 5 "Delayed 2" 4 "Delayed 1" 3 "High" 2 "Medium" 1 "Low" 0 "Off" ;
VAL_ 3221225472 FrontOperatorWiperSwitch 15 "Not available" 6 "Mist" 5 "Delayed 2" 4 "Delayed 1" 3 "High" 2 "Medium" 1 "Low" 0 "Off" ;
VAL_ 3221225472 FrontNonoperatorWiperSwitch 15 "Not available" 6 "Mist" 5 "Delayed 2" 4 "Delayed 1" 3 "High" 2 "Medium" 1 "Low" 0 "Off" ;
VAL_ 3221225472 EngTorqueCurveSelectionCmd 15 "Not supported" 14 "SAE reserved" 2 "Indicates that Torque Curve 2 is selected" 1 "Indicates that Torque Curve 1 is selected" 0 "Indicates that this parameter is not presently requesting a different torque curve be used" ;
VAL_ 3221225472 EngAltDroopAuxInputSelect 15 "-  Not available" 14 "-  Error condition" 1 "thru 1101" 0 "- Normal Droop Setting is selected" ;
VAL_ 3221225472 EngAltDroopRemoteAccelSelect 15 "-  Not available" 14 "-  Error condition" 1 "thru 1101" 0 "- Normal Droop Setting is selected" ;
VAL_ 3221225472 EngAltDroopAccel2Select 15 "- Not available" 14 "-  Error condition" 1 "thru 1101" 0 "- Normal Droop Setting is selected" ;
VAL_ 3221225472 EngAltDroopAccel1Select 15 "- Not available" 14 "-  Error condition" 1 "thru 1101" 0 "- Normal Droop Setting is selected" ;
VAL_ 3221225472 EngAltRatingSelect 255 "Not available" 254 "Error condition." 3 "indicates that the Alternate Power Fueling 3 is selected" 2 "indicates that the Alternate Power Fueling 2 is selected" 1 "indicates that the Alternate Power Fueling 1 is selected" 0 "indicates that Maximum Power Fueling is selected" ;
VAL_ 3221225472 EngAltLowIdleSwitch 3 "Not available or Unused" 2 "Error" 1 "Alternate low idle point is selected" 0 "Default low idle point is selected" ;
VAL_ 3221225472 EngSynchronizationSwitch 3 "Not available or Unused" 2 "Error" 1 "Functionality is enabled" 0 "Functionality is disabled" ;
VAL_ 3221225472 EngAuxGovernorSwitch 3 "Not available" 2 "Error condition" 1 "Auxiliary Governor is enabled" 0 "Auxiliary Governor is disabled" ;
VAL_ 3221225472 EngTorqueCurveSelection 0 "Indicates that the engine is using a torque that is not presently selected by SPN 6796" 15 "Not supported" 14 "Error" 2 "Indicates that Torque Curve 2 is selected" 1 "Indicates that Torque Curve 1 is selected" ;
VAL_ 3221225472 EngAltDroopAuxInputSelectState 15 "-  Not available" 14 "-  SAE reserved" 1 "thru 1101" 0 "- Control state is Normal Droop Setting" ;
VAL_ 3221225472 EngAltDropRemoteAccelSelectState 15 "-  Not available" 14 "-  SAE reserved" 1 "thru 1101" 0 "- Control state is Normal Droop Setting" ;
VAL_ 3221225472 EngAltDroopAccel2SelectState 15 "-  Not available" 14 "-  SAE reserved" 1 "thru 1101" 0 "- Control's state is Normal Droop Setting" ;
VAL_ 3221225472 EngAltDroopAccel1SelectState 15 "-  Not available" 14 "-  SAE reserved" 1 "thru 1101" 0 "- Control state is Normal Droop Setting" ;
VAL_ 3221225472 EngAltRatingSelectState 255 "Not available" 254 "SAE reserved" 3 "Control state is Alternate Power Fueling 3" 2 "Control state is Alternate Power Fueling 2 " 1 "Control state is Alternate Power Fueling 1 " 0 "Control state is Maximum Power Fueling" ;
VAL_ 3221225472 EngAltLowIdleSelectState 3 "not available" 2 "SAE reserved" 1 "Alternate idle state" 0 "Normal idle state" ;
VAL_ 3221225472 EngMultiUnitSyncState 3 "Not available" 2 "SAE reserved" 1 "Control State is Functionality enabled" 0 "Control State is Functionality disabled" ;
VAL_ 3221225472 EngAuxGovernorState 3 "Not available" 2 "SAE reserved" 1 "Control State is Auxiliary Governor enabled" 0 "Control State is Auxiliary Governor disabled" ;
VAL_ 3221225472 HighLowBeamSwitch 3 "Not available" 2 "Error" 1 "High Beam Selected" 0 "Low Beam Selected" ;
VAL_ 3221225472 HazardLightSwitch 3 "Not available" 2 "Error" 1 "Hazard Lamps to be Flashing" 0 "Hazard Lamps to be Off" ;
VAL_ 3221225472 TurnSignalSwitch 15 "Not available" 14 "Error" 2 "Right turn to be Flashing" 1 "Left Turn to be Flashing" 0 "No Turn being signaled" ;
VAL_ 3221225472 MainLightSwitch 15 "Not available" 14 "Error" 8 "Delayed Off" 3 "Headlight and Park On" 2 "Headlight On" 1 "Park On" 0 "Off" ;
VAL_ 3221225472 WorkLightSwitch 15 "Not available" 14 "Error" 4 "Work Light Combination #4 On" 3 "Work Light Combination #3 On" 2 "Work Light Combination #2 On" 1 "Work Light Combination #1 On" 0 "Off" ;
VAL_ 3221225472 BlackOutWorkLampSelect 3 "Not Supported" 2 "Reserved" 1 "On" 0 "Off" ;
VAL_ 3221225472 NightVisionIlluminatorSelect 3 "Not Supported" 2 "Reserved" 1 "On" 0 "Off" ;
VAL_ 3221225472 BlackOutBrake_StopLampSelect 3 "Not Supported" 2 "Reserved" 1 "On" 0 "Off" ;
VAL_ 3221225472 ConvoyDrivingLampSelect 3 "Not Supported" 2 "Reserved" 1 "On" 0 "Off" ;
VAL_ 3221225472 ConvoyLampSelect 3 "Not Supported" 2 "Reserved" 1 "On" 0 "Off" ;
VAL_ 3221225472 FrontBlackOutMarkerLampSelect 3 "Not Supported" 2 "Reserved" 1 "On" 0 "Off" ;
VAL_ 3221225472 RearBlackOutMarkerSelect 3 "Not Supported" 2 "Reserved" 1 "On" 0 "Off" ;
VAL_ 3221225472 SlowVesselModeStatus 3 "Take no action" 2 "Reserved" 1 "Slow vessel mode is ACTIVE." 0 "Slow vessel mode is OFF." ;
VAL_ 3221225472 TrollingModeStatus 3 "Take no action" 2 "Reserved" 1 "Trolling mode is ACTIVE." 0 "Trolling mode is OFF." ;
VAL_ 3221225472 EngThrttlSynchrnzationModeStatus 15 "Take no action" 4 "Synchronized Master" 3 "Synchronized Starboard" 2 "Synchronized Port" 1 "Synchronized Center" 0 "Not Synchronized" ;
VAL_ 3221225472 DisplayDeadbands 15 "Not Available" 2 "- Wide = +/- 24mm" 1 "- Standard = +/- 12mm" 0 "- Narrow = +/- 4.5mm" ;
VAL_ 3221225472 LEDPatternCtrl 15 "Not Available" 2 "- 7 Channel" 1 "- Offset" 0 "- 5 Channel" ;
VAL_ 3221225472 LEDDisplayDeadbandCtrl 15 "Not Available or Not applicable" 4 "+/- 1 mm    " 3 "+/- 5  mm   " 2 "+/- 24 mm  " 1 "+/- 12 mm  " 0 "+/- 4.5 mm " ;
VAL_ 3221225472 LEDDisplayModeCtrl 15 "Not Available or Not Applicable" 2 "Center On-Grade Display Mode 2" 1 "Offset On-Grade Display Mode " 0 "Center On-Grade Display Mode 1" ;
VAL_ 3221225472 LEDDisplayData1 255 "Not Available" 254 "Error" 159 "No data" 149 "High Coarse" 148 "High Medium/Coarse" 147 "High Medium" 146 "High Medium/Fine" 145 "High Fine" 144 "On Grade" 132 "Low Fine" 131 "Low Medium/Fine" 130 "Low Medium" 129 "Low Medium/Coarse" 128 "Low Coarse" 32 "Low Coarse LED on" 16 "Low Fine LED on" 8 "On-grade LED on" 4 "High Fine LED on" 2 "High Coarse LED on" ;
VAL_ 3221225472 LaserReceiverType 4 "2.5 Meter Survey Receiver" 3 "2 Meter Survey Receiver" 2 "1 Meter Survey Receiver" 1 "Linear Laser Receiver" 0 "Reserved " ;
VAL_ 3221225472 LaserTracerInformation 32 "Curb" 16 "Stringline" 8 "Previous pass" 4 "Valid target" 2 "Laser is ready" 1 "Laser power is on" ;
VAL_ 3221225472 LEDDisplayData2 255 "Not Available" 254 "Error" 159 "No data" 149 "High Coarse" 148 "High Medium/Coarse" 147 "High Medium" 146 "High Medium/Fine" 145 "High Fine" 144 "On Grade" 132 "Low Fine" 131 "Low Medium/Fine" 130 "Low Medium" 129 "Low Medium/Coarse" 128 "Low Coarse" 64 "Right LED on" 32 "Left LED on" 16 "Down LED on" 8 "Up LED on" 4 "On-grade 'C' LED on" 2 "On-grade 'B' LED on" 1 "On-grade 'A' LED on" ;
VAL_ 3221225472 StElvtnSensor2ReferenceElevation 3 "Don't Care / Take No Action" 2 "Reserved" 1 "Set Reference Elevation" 0 "Do not Set Reference Elevation" ;
VAL_ 3221225472 StElvtnSensor1ReferenceElevation 3 "Don't Care / Take No Action" 2 "Reserved" 1 "Set Reference Elevation" 0 "Do not Set Reference Elevation" ;
VAL_ 3221225472 SdshftDsrdBldeOffsetOperatorCtrl 15 "Not Installed" 14 "Error Indicator" 3 "Automatic Operator Control Request" 2 "Manual Operator Control Request" 1 "Momentary Operator Control Request" 0 "No Operator Control Request" ;
VAL_ 3221225472 SdshiftBladeCtrlModeOperatorCtrl 15 "Not installed" 14 "Error Indicator" 2 "Decrement Operator Control Request" 1 "Increment Operator Control Request" 0 "No Operator Control Request" ;
VAL_ 3221225472 RghtDsredBladeOffsetOperatorCtrl 15 "Not installed" 14 "Error Indicator" 2 "Decrement Operator Control Request" 1 "Increment Operator Control Request" 0 "No Operator Control Request" ;
VAL_ 3221225472 LftDsiredBladeOffsetOperatorCtrl 15 "Not installed" 14 "Error Indicator" 2 "Decrement Operator Control Request" 1 "Increment Operator Control Request" 0 "No Operator Control Request" ;
VAL_ 3221225472 RightBladeCtrlModeOperatorCtrl 15 "Not Installed" 14 "Error Indicator" 3 "Automatic Operator Control Request" 2 "Manual Operator Control Request" 1 "Momentary Operator Control Request" 0 "No Change" ;
VAL_ 3221225472 LeftBladeCtrlModeOperatorCtrl 15 "Not Installed" 14 "Error Indicator" 3 "Automatic Operator Control Request" 2 "Manual Operator Control Request" 1 "Momentary Operator Control Request" 0 "No Change" ;
VAL_ 3221225472 BladeAutoModeCmd 15 "Not Supported" 14 "Error Indicator" 4 "Auto Not Allowed" 3 "Service Mode" 2 "Suspend Auto" 1 "Activity Allows Auto" 0 "Auto Allowed" ;
VAL_ 3221225472 DesiredGradeOffsetSwitch 15 "Not installed" 14 "Error Indicator" 2 "Decrement button pressed" 1 "Increment button pressed" 0 "No button pressed" ;
VAL_ 3221225472 BladeCtrlModeSwitch 15 "Not Installed" 14 "Error Indicator" 3 "Automatic button pressed" 2 "Manual button pressed" 1 "Mode button pressed" 0 "No button pressed" ;
VAL_ 3221225472 FrontWheelDriveActuatorStatus 3 "Not Available" 2 "Error" 1 "Front Wheel Drive Actuator engaged" 0 "Front Wheel Drive Actuator not engaged" ;
VAL_ 3221225472 FMSstandardRequestsSupported 3 "Don't care" 2 "Reserved" 1 "On request mode is supported" 0 "On request mode is not supported" ;
VAL_ 3221225472 FMSstandardDiagnosticsSupported 1 "Diagnostics Is Supported" 0 "Diagnostics Is Not Supported" 3 "Don't care" 2 "Reserved" ;
VAL_ 3221225472 DrverAlertnessWarningSystemState 7 "Not Available / Not Installed" 4 "System monitoring driver behavior" 3 "System available" 2 "System temporarily not available" 1 "Initializing" 0 "System installed but disabled" ;
VAL_ 3221225472 LnDpartureIndicationEnableStatus 3 "Not Used" 2 "Reserved" 1 "Lane Departure Indication enabled " 0 "Lane Departure indication disabled" ;
VAL_ 3221225472 LaneTrackingStatusLeftSide 3 "Don't care/Take no action" 2 "Reserved" 1 "Tracking Left side" 0 "Not Tracking Left side" ;
VAL_ 3221225472 LaneTrackingStatusRightSide 3 "Don't Care/take no action" 2 "Reserved" 1 "Tracking Right side" 0 "Not Tracking Right side" ;
VAL_ 3221225472 LaneDepartureImminentLeftSide 3 "Not used" 2 "Reserved" 1 "Imminent" 0 "Not imminent" ;
VAL_ 3221225472 LaneDepartureImminentRightSide 3 "Not Used" 2 "Reserved" 1 "Imminent" 0 "Not imminent" ;
VAL_ 3221225472 LaneDepartureRight 3 "Take no action" 2 "Reserved" 1 "Middle of the vehicle departs the lane to the right side" 0 "Middle of the vehicle does not depart the lane to the right side" ;
VAL_ 3221225472 LaneDepartureLeft 3 "Take no action" 2 "Reserved" 1 "Middle of the vehicle departs the lane to the left side" 0 "Middle of the vehicle does not depart the lane to the left side" ;
VAL_ 3221225472 DriverAlertnessWarning 7 "Not Available" 3 "Level 3" 2 "Level 2" 1 "Level 1" 0 "No distracted driving condition detected" ;
VAL_ 3221225472 EngFuelLeakage2 3 "Not available" 2 "Error" 1 "leakage detected" 0 "no leakage detected" ;
VAL_ 3221225472 EngFuelLeakage1 3 "Not available" 2 "Error" 1 "leakage detected" 0 "no leakage detected" ;
VAL_ 3221225472 FanDriveState 15 "Not available" 14 "Other" 13 "Engine brake" 12 "Timer" 11 "A/C system" 10 "Transmission retarder" 9 "Manual control" 8 "Reverse Operation" 7 "Default Operation" 6 "Excessive hydraulic oil temperature" 5 "Excessive transmission oil temperature" 4 "Excessive engine coolant temperature" 3 "Excessive engine oil temperature" 2 "Excessive engine air temperature" 1 "Engine system-General" 0 "Fan off" ;
VAL_ 3221225472 EngTorqueLimitFeature 7 "Not available" 4 "Current torque rating" 3 "Previous torque rating" 2 "First torque rating" 1 "Highest torque rating" 0 "Reserved" ;
VAL_ 3221225472 TorqueLimitingFeatureStatus 3 "Not available" 2 "Error" 1 "Enabled" 0 "Disabled" ;
VAL_ 3221225472 TransAutoNeutralSt 5 "Reserved" 4 "AutoNeutralReq_stateIsInhibited" 3 "AutoNeutralReq_stateAchieved" 2 "AutoNeutralReq_stateIsPending" 7 "Not Available" 6 "Error" 1 "NoReqAutoNeutrReqWldNotBeHonored" 0 "NoReqAutoNeutrReqWouldBeHonored" ;
VAL_ 3221225472 TransWarningIndicator 3 "Not available" 2 "Transmission Warning Indicator is flashing" 1 "Transmission Warning Indicator is on continuously" 0 "Transmission Warning Indicator is off" ;
VAL_ 3221225472 TrnsRverseGearShiftInhibitStatus 3 "Not Available" 2 "Error" 1 "Reverse gear shifts are currently inhibited" 0 "Reverse gear shifts are currently allowed" ;
VAL_ 3221225472 TransMode8Indicator 3 "Not available" 2 "Error" 1 "Transmission Mode 8 active" 0 "Transmission Mode 8 not active" ;
VAL_ 3221225472 TransMode7Indicator 3 "Not available" 2 "Error" 1 "Transmission Mode 7 active" 0 "Transmission Mode 7 not active" ;
VAL_ 3221225472 TransMode6Indicator 3 "Not available" 2 "Error" 1 "Transmission Mode 6 active" 0 "Transmission Mode 6 not active" ;
VAL_ 3221225472 TransMode5Indicator 3 "Not available" 2 "Error" 1 "Transmission Mode 5 active" 0 "Transmission Mode 5 not active" ;
VAL_ 3221225472 TransMode1Indicator 3 "Not available" 2 "Error" 1 "Transmission Mode 1 Active" 0 "Transmission Mode 1 not active" ;
VAL_ 3221225472 TransMode2Indicator 3 "Not available" 2 "Error" 1 "Transmission Mode 2 Active" 0 "Transmission Mode 2 not active" ;
VAL_ 3221225472 TransMode3Indicator 3 "Not available" 2 "Error" 1 "Transmission Mode 3 Active" 0 "Transmission Mode 3 not active" ;
VAL_ 3221225472 TransMode4Indicator 3 "Not available" 2 "Error" 1 "Transmission Mode 4 Active" 0 "Transmission Mode 4 not active" ;
VAL_ 3221225472 TransShiftInhibitIndicator 3 "Take no action" 2 "Active, flashing)" 1 "Active, on continuously)" 0 "Inactive" ;
VAL_ 3221225472 TransEngCrankEnable 3 "Not available" 2 "Error" 1 "Cranking enabled" 0 "Cranking disabled" ;
VAL_ 3221225472 ActiveShiftConsoleIndicator 3 "Not available" 2 "Reserved" 1 "Secondary shift console is active" 0 "Primary shift console is active" ;
VAL_ 3221225472 TransReadyForBrakeRelease 3 "Not available" 2 "Error" 1 "Transmission Ready for Brake Release" 0 "Transmission Not Ready for Brake Release" ;
VAL_ 3221225472 TrnsRqstedRangeDisplayFlashState 3 "Take no action" 2 "Reserved" 1 "Active" 0 "Inactive" ;
VAL_ 3221225472 TrnsRqstedRangeDisplayBlankState 3 "Take no action" 2 "Reserved" 1 "Active" 0 "Inactive" ;
VAL_ 3221225472 TransServiceIndicator 3 "Not available" 2 "Transmission Service Indicator is flashing" 1 "Transmission Service Indicator is on continuously" 0 "Transmission Service Indicator is off" ;
VAL_ 3221225472 TransAirSupplyPressIndicator 7 "Not available" 6 "Error indicator" 5 "Not defined" 4 "Over pressure" 3 "No pressure" 2 "Very low pressure" 1 "Low pressure" 0 "Normal Pressure Range" ;
VAL_ 3221225472 TransMode10Indicator 3 "Not available" 2 "Error indicator" 1 "Transmission Mode 10 active" 0 "Transmission Mode 10 not active" ;
VAL_ 3221225472 TransMode9Indicator 3 "Not available" 2 "Error indicator" 1 "Transmission Mode 9 active" 0 "Transmission Mode 9 not active" ;
VAL_ 3221225472 TransForwardDirectionSwitch 3 "Not Available" 2 "Error" 1 "On" 0 "Off" ;
VAL_ 3221225472 TransNeutralSwitch 3 "Not Available" 2 "Error" 1 "On" 0 "Off" ;
VAL_ 3221225472 TransReverseDirectionSwitch 3 "Not Available" 2 "Error" 1 "On" 0 "Off" ;
VAL_ 3221225472 TransLowRangeSenseSwitch 3 "Not Available" 2 "Error" 1 "On" 0 "Off" ;
VAL_ 3221225472 TransHighRangeSenseSwitch 3 "Not Available" 2 "Error" 1 "On" 0 "Off" ;
VAL_ 3221225472 TransInertiaBrakeActuator 3 "Not Available" 2 "Error" 1 "On" 0 "Off" ;
VAL_ 3221225472 TransDefuelActuator 3 "Not Available" 2 "Error" 1 "On" 0 "Off" ;
VAL_ 3221225472 TransLockupClutchActuator 3 "Not Available" 2 "Error" 1 "On" 0 "Off" ;
VAL_ 3221225472 TransClutchActuator 3 "Not Available" 2 "Error" 1 "On" 0 "Off" ;
VAL_ 3221225472 TransSplitterIndirectActuator 3 "Not Available" 2 "Error" 1 "On" 0 "Off" ;
VAL_ 3221225472 TransSplitterDirectActuator 3 "Not Available" 2 "Error" 1 "On" 0 "Off" ;
VAL_ 3221225472 TransRangeLowActuator 3 "Not Available" 2 "Error" 1 "On" 0 "Off" ;
VAL_ 3221225472 TransRangeHighActuator 3 "- Not available" 2 "- Error" 1 "-On" 0 "-Off" ;
VAL_ 3221225472 TransShiftFingerGearActuator2 3 "Not Available" 2 "Error" 1 "On" 0 "Off" ;
VAL_ 3221225472 TransShiftFingerRailActuator2 3 "Not Available" 2 "Error" 1 "On" 0 "Off" ;
VAL_ 3221225472 TransShiftFingerGearActuator1 3 "Not Available" 2 "Error" 1 "On" 0 "Off" ;
VAL_ 3221225472 TransShiftFingerRailActuator1 3 "Not Available" 2 "Error" 1 "On" 0 "Off" ;
VAL_ 3221225472 TrnsShftFngerCenterRailIndicator 3 "Not Available" 2 "Error" 1 "On" 0 "Off" ;
VAL_ 3221225472 TrnsShftFngerEngagementIndicator 3 "Not Available" 2 "Error" 1 "On" 0 "Off" ;
VAL_ 3221225472 TransShiftFingerNeutralIndicator 3 "Not Available" 2 "Error" 1 "On" 0 "Off" ;
VAL_ 3221225472 MomentaryEngMaxPowerEnable 3 "not available" 2 "fault" 1 "momentarily requesting maximum power available" 0 "not requesting maximum power available" ;
VAL_ 3221225472 ProgressiveShiftDisable 3 "Take no action" 2 "Reserved" 1 "Progressive shift is disabled" 0 "Progressive shift is not disabled" ;
VAL_ 3221225472 EngMomentaryOverspeedEnable 3 "Take no action" 2 "Reserved" 1 "Momentary engine overspeed is enabled" 0 "Momentary engine overspeed is disabled" ;
VAL_ 3221225472 TrnsTrqCnvrtrLckpTrnstnInProcess 3 "Not available" 2 "Error" 1 "Transition is in process" 0 "Transition is not in process" ;
VAL_ 3221225472 TransShiftInProcess 3 "-  Not available" 2 "-  Error" 1 "-  Shift in process" 0 "-  Shift is not in process " ;
VAL_ 3221225472 TrnsTorqueConverterLockupEngaged 3 "Not available" 2 "Error" 1 "Torque converter lockup engaged" 0 "Torque converter lockup disengaged" ;
VAL_ 3221225472 TransDrivelineEngaged 3 "Not available" 2 "Error" 1 "Driveline engaged" 0 "Driveline disengaged" ;
VAL_ 3221225472 TypeOfSteerTrans 15 "Not available" 3 "Hybrid steering transmission" 2 "Purely electric steering transmission" 1 "Purely hydraulic steering transmission" 0 "Purely mechanical steering transmission" ;
VAL_ 3221225472 TypeOfSteerForces 15 "Not Available" 3 "Self tracking steering equipment" 2 "Full power steering equipment" 1 "Power assisted steering equipment" 0 "Manual steering equipment" ;
VAL_ 3221225472 SteerType 15 "Not Available" 1 "Auxiliary steering equipment" 0 "Main steering system" ;
VAL_ 3221225472 SteerableLiftAxleLoweringInhibit 1 "Lowering inhibited" 0 "Lowering allowed" 3 "Not available" 2 "Reserved" ;
VAL_ 3221225472 StatusOfSteerAxle 15 "Not available" 5 "Axle steering in special mode" 4 "Axle not active because of an error" 3 "Axle centered,  because of an error" 2 "Axle centered" 1 "Axle steering active" 0 "Axle steering not active" ;
VAL_ 3221225472 TransOutputRetarder 3 "Not Available" 2 "Error" 1 "On" 0 "Off" ;
VAL_ 3221225472 RetarderRoadSpeedExceeded 3 "Don't care/Take no action" 2 "Reserved" 1 "AboveThresh_RetIsAllowedAct" 0 "Road speed is below threshold" ;
VAL_ 3221225472 RetarderRoadSpeedLimitSwitch 3 "Not Available" 2 "Error Indicator" 1 "Limiting by retarder is enabled" 0 "Limiting by retarder is disabled" ;
VAL_ 3221225472 RetarderRequestingBrakeLight 0 "notReqThatBrkLightsIlluminated" 3 "Not available/Take no action" 2 "Reserved" 1 "ReqThatBrkLightsIlluminated" ;
VAL_ 3221225472 EngCoolantLoadIncrease 3 "Not available" 2 "Error" 1 "Coolant load increase possible" 0 "No coolant load increase" ;
VAL_ 3221225472 RetarderEnableShiftAssistSwitch 3 "Not available" 2 "Error" 1 "Retarder, shift assist enabled" 0 "Retarder, shift assist disabled" ;
VAL_ 3221225472 RetarderEnableBrakeAssistSwitch 3 "Not available" 2 "Error" 1 "Retarder, brake assist enabled" 0 "Retarder, brake assist disabled" ;
VAL_ 3221225472 EngExhstGsOxygnSnsrClsdLpOprtion 3 "Don't Care/take no action" 2 "Reserved" 1 "Engine using the exhaust oxygen sensor for a closed loop operation" 0 "Engine not using the exhaust oxygen sensor" ;
VAL_ 3221225472 Joystick3Button13PressedStatus 3 "Not Available" 2 "Error Indicator" 1 "Button pressed" 0 "Button not pressed" ;
VAL_ 3221225472 Joystick3Button14PressedStatus 3 "Not Available" 2 "Error Indicator" 1 "Button pressed" 0 "Button not pressed" ;
VAL_ 3221225472 Joystick3Button15PressedStatus 3 "Not Available" 2 "Error Indicator" 1 "Button pressed" 0 "Button not pressed" ;
VAL_ 3221225472 Joystick3Button16PressedStatus 3 "Not Available" 2 "Error Indicator" 1 "Button pressed" 0 "Button not pressed" ;
VAL_ 3221225472 Jystick3GripXAxisDetentPosStatus 3 "Not Available" 2 "Error Indicator" 1 "In the Detent Position" 0 "Not in the Detent Position" ;
VAL_ 3221225472 Jystick3GripYAxisDetentPosStatus 3 "Not Available" 2 "Error Indicator" 1 "In the Detent Position" 0 "Not in the Detent Position" ;
VAL_ 3221225472 Jystick3ThetaAxisDetentPosStatus 3 "Not Available" 2 "Error Indicator" 1 "In the Detent Position" 0 "Not in the Detent Position" ;
VAL_ 3221225472 Jystck3ThtAxsClckwsPstvPosStatus 3 "Not Available" 2 "Error Indicator" 1 "On positive side of Neutral" 0 "Not on Positive side of Neutral" ;
VAL_ 3221225472 Jystck3ThetaAxisNeutralPosStatus 3 "Not Available" 2 "Error Indicator" 1 "In Neutral Position" 0 "Not in Neutral Position" ;
VAL_ 3221225472 Jystck3GrpYAxsLvrFrwrdPstvPsStts 3 "Not Available" 2 "Error Indicator" 1 "On positive side of Neutral" 0 "Not on Positive side of Neutral" ;
VAL_ 3221225472 Jystck3GrpYAxsLvrBckNgtvPsStatus 3 "Not Available" 2 "Error Indicator" 1 "On negative side of Neutral" 0 "Not on negative side of Neutral" ;
VAL_ 3221225472 Jystck3GripYAxisNeutralPosStatus 3 "Not Available" 2 "Error Indicator" 1 "In Neutral Position" 0 "Not in Neutral Position" ;
VAL_ 3221225472 Jystck3GrpXAxsLvrRghtPstvPsSttus 3 "Not Available" 2 "Error Indicator" 1 "On positive side of Neutral" 0 "Not on Positive side of Neutral" ;
VAL_ 3221225472 Jystck3GrpXAxsLvrLftNgtvPsStatus 3 "Not Available" 2 "Error Indicator" 1 "On negative side of Neutral" 0 "Not on negative side of Neutral" ;
VAL_ 3221225472 Jystck3GripXAxisNeutralPosStatus 3 "Not Available" 2 "Error Indicator" 1 "On negative side of Neutral" 0 "Not on negative side of Neutral" ;
VAL_ 3221225472 Jystck3ThtAxsCntrClckwsNgtvPsStt 3 "Not Available" 2 "Error Indicator" 1 "On negative side of Neutral" 0 "Not on negative side of Neutral" ;
VAL_ 3221225472 Joystick2Button13PressedStatus 3 "Not Available" 2 "Error Indicator" 1 "Button pressed" 0 "Button not pressed" ;
VAL_ 3221225472 Joystick2Button14PressedStatus 3 "Not Available" 2 "Error Indicator" 1 "Button pressed" 0 "Button not pressed" ;
VAL_ 3221225472 Joystick2Button15PressedStatus 3 "Not Available" 2 "Error Indicator" 1 "Button pressed" 0 "Button not pressed" ;
VAL_ 3221225472 Joystick2Button16PressedStatus 3 "Not Available" 2 "Error Indicator" 1 "Button pressed" 0 "Button not pressed" ;
VAL_ 3221225472 Jystick2GripXAxisDetentPosStatus 3 "Not Available" 2 "Error Indicator" 1 "In the Detent Position" 0 "Not in the Detent Position" ;
VAL_ 3221225472 Jystick2GripYAxisDetentPosStatus 3 "Not Available" 2 "Error Indicator" 1 "In the Detent Position" 0 "Not in the Detent Position" ;
VAL_ 3221225472 Jystick2ThetaAxisDetentPosStatus 3 "Not Available" 2 "Error Indicator" 1 "In the Detent Position" 0 "Not in the Detent Position" ;
VAL_ 3221225472 Jystck2ThtAxsClckwsPstvPosStatus 3 "Not Available" 2 "Error Indicator" 1 "On positive side of Neutral" 0 "Not on Positive side of Neutral" ;
VAL_ 3221225472 Jystck2ThetaAxisNeutralPosStatus 3 "Not Available" 2 "Error Indicator" 1 "In Neutral Position" 0 "Not in Neutral Position" ;
VAL_ 3221225472 Jystck2GrpYAxsLvrFrwrdPstvPsStts 3 "Not Available" 2 "Error Indicator" 1 "On positive side of Neutral" 0 "Not on Positive side of Neutral" ;
VAL_ 3221225472 Jystck2GrpYAxsLvrBckNgtvPsStatus 3 "Not Available" 2 "Error Indicator" 1 "On negative side of Neutral" 0 "Not on negative side of Neutral" ;
VAL_ 3221225472 Jystck2GripYAxisNeutralPosStatus 3 "Not Available" 2 "Error Indicator" 1 "In Neutral Position" 0 "Not in Neutral Position" ;
VAL_ 3221225472 Jystck2GrpXAxsLvrRghtPstvPsSttus 3 "Not Available" 2 "Error Indicator" 1 "On positive side of Neutral" 0 "Not on Positive side of Neutral" ;
VAL_ 3221225472 Jystck2GrpXAxsLvrLftNgtvPsStatus 3 "Not Available" 2 "Error Indicator" 1 "On negative side of Neutral" 0 "Not on negative side of Neutral" ;
VAL_ 3221225472 Jystck2GripXAxisNeutralPosStatus 3 "Not Available" 2 "Error Indicator" 1 "On negative side of Neutral" 0 "Not on negative side of Neutral" ;
VAL_ 3221225472 Jystck2ThtAxsCntrClckwsNgtvPsStt 3 "Not Available" 2 "Error Indicator" 1 "On negative side of Neutral" 0 "Not on negative side of Neutral" ;
VAL_ 3221225472 Joystick1Button13PressedStatus 3 "Not Available" 2 "Error Indicator" 1 "Button pressed" 0 "Button not pressed" ;
VAL_ 3221225472 Joystick1Button14PressedStatus 3 "Not Available" 2 "Error Indicator" 1 "Button pressed" 0 "Button not pressed" ;
VAL_ 3221225472 Joystick1Button15PressedStatus 3 "Not Available" 2 "Error Indicator" 1 "Button pressed" 0 "Button not pressed" ;
VAL_ 3221225472 Joystick1Button16PressedStatus 3 "Not Available" 2 "Error Indicator" 1 "Button pressed" 0 "Button not pressed" ;
VAL_ 3221225472 Jystick1GripXAxisDetentPosStatus 3 "Not Available" 2 "Error Indicator" 1 "In the Detent Position" 0 "Not in the Detent Position" ;
VAL_ 3221225472 Jystick1GripYAxisDetentPosStatus 3 "Not Available" 2 "Error Indicator" 1 "In the Detent Position" 0 "Not in the Detent Position" ;
VAL_ 3221225472 Jystick1ThetaAxisDetentPosStatus 3 "Not Available" 2 "Error Indicator" 1 "In the Detent Position" 0 "Not in the Detent Position" ;
VAL_ 3221225472 Jystck1ThtAxsClckwsPstvPosStatus 3 "Not Available" 2 "Error Indicator" 1 "On positive side of Neutral" 0 "Not on Positive side of Neutral" ;
VAL_ 3221225472 Jystck1ThetaAxisNeutralPosStatus 3 "Not Available" 2 "Error Indicator" 1 "In Neutral Position" 0 "Not in Neutral Position" ;
VAL_ 3221225472 Jystck1GrpYAxsLvrFrwrdPstvPsStts 3 "Not Available" 2 "Error Indicator" 1 "On positive side of Neutral" 0 "Not on Positive side of Neutral" ;
VAL_ 3221225472 Jystck1GrpYAxsLvrBckNgtvPsStatus 3 "Not Available" 2 "Error Indicator" 1 "On negative side of Neutral" 0 "Not on negative side of Neutral" ;
VAL_ 3221225472 Aftrtrtmnt1DslExhstFldPrprtsPrlm 3 "Not Available" 2 "Error Indicator" 1 "In Neutral Position" 0 "Not in Neutral Position" ;
VAL_ 3221225472 Jystck1GrpXAxsLvrRghtPstvPsSttus 3 "Not Available" 2 "Error Indicator" 1 "On positive side of Neutral" 0 "Not on Positive side of Neutral" ;
VAL_ 3221225472 Jystck1GrpXAxsLvrLftNgtvPsStatus 3 "Not Available" 2 "Error Indicator" 1 "On negative side of Neutral" 0 "Not on negative side of Neutral" ;
VAL_ 3221225472 Jystck1GripXAxisNeutralPosStatus 3 "Not Available" 2 "Error Indicator" 1 "In Neutral Position" 0 "Not in Neutral Position" ;
VAL_ 3221225472 Jystck1ThtAxsCntrClckwsNgtvPsStt 3 "Not Available" 2 "Error Indicator" 1 "On negative side of Neutral" 0 "Not on negative side of Neutral" ;
VAL_ 3221225472 FuelPumpPrimerStatus 3 "Unavailable" 2 "Error" 1 "On" 0 "Off" ;
VAL_ 3221225472 EngVentilationStatus 7 "Not available or not installe" 6 "Not able to determine if sufficiently vented" 5 "Reserved for SAE assignment " 4 "Reserved for SAE assignment" 3 "Currently venting" 2 "Ventilation delay" 1 "Ventilation needed" 0 "Sufficiently vented" ;
VAL_ 3221225472 EngCoolantPreheatedState 3 "Not available or not installed" 2 "Unable to determine  engine coolant pre-heated sufficiently" 1 "Sufficiently pre-heated" 0 "Not sufficiently pre-heated" ;
VAL_ 3221225472 EngOilPreHeatedState 1 "Sufficiently pre-heated" 3 "Not available or not installed" 2 "Unable to determine if engine oil is pre-heated sufficiently" 0 "Not sufficiently pre-heated" ;
VAL_ 3221225472 EngOilPrimingState 3 "Not available or not installed" 2 "Unable to determine if sufficiently lubricated" 1 "Sufficiently lubricated" 0 "Not sufficiently lubricated" ;
VAL_ 3221225472 EngOilPrimingPumpSwitch 3 "Not available or not installed" 2 "Error" 1 "On" 0 "Off" ;
VAL_ 3221225472 SafetyWireStatus 3 "Not available" 2 "Error" 1 "Safety wire has been activated" 0 "Safety wire has not been activated" ;
VAL_ 3221225472 EngVriableGeometryTurbo1CtrlMode 3 "not available" 2 "SAE reserved" 1 "closed loop" 0 "open loop" ;
VAL_ 3221225472 EngFuelCtrlCtrlMode 3 "Not available" 2 "SAE reserved" 1 "Closed loop" 0 "Open loop" ;
VAL_ 3221225472 EngVrblGmtryTrbArCtrlShtoffValve 3 "Not available" 2 "Reserved" 1 "VGT Air Control Shutoff Valve is On" 0 "VGT Air Control Shutoff Valve is Off" ;
