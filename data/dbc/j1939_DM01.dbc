VERSION ""

NS_ :

BS_:

BU_: PowertrainControlModule AtmosphericSensor SafetyRestraintSystem2 Aftertreatment_2_GasOutlet Aftertreatment_2_GasIntake DieselPartFilterControl Turbocharger SafetyRestraintSystem1 CabDisplay2 Aftertreatment_1_GasOutlet Aftertreatment_1_GasIntake OnBoardDataLogger OffBoardDiagnosticTool2 OffBoardDiagnosticTool1 FileServer ParkingBrakeController SeatController2 FanDriveController SteeringColumnUnit CommunicationUnitRadio CommunicationUnitSatellite CommunicationUnitCellular PropulsionBatteryCharger ChassisController2 ChassisController1 EngineValveControl AuxiliaryHeater2 AuxiliaryHeater1 ClutchUnit RampControl InformationSystem1 SuspensionSystemController2 OilSensor VehicleDynamicStability ExhaustEmissionController TransmissionDisplay2 TransmissionDisplay1 ClimateControl2 WaterPumpController RearAxleSteeringController LightingOperatorControl SeatController1 IgnitionController2 IgnitionController1 TirePressureController CabController2 CabController1 PneumaticSystemController SuspensionSystemController1 HydraulicPumpController EnduranceBrakingSystem RetarderExhaustEngine2 OnBoardDiagnosticUnit HeadwayController RetarderExhaustEngine1 CabDisplay1 ManagementComputer VirtualTerminal OffVehicleGateway PowerTakeOffFront HitchControl AuxiliaryValveControl BodyController TractorTrailerBridge1 StarterSystem ElectricalSystem VehicleSecurity VehicleNavigation AerodynamicControl ElectricalChargingSystem ClimateControl1 TripRecorder InstrumentCluster SuspensionDriveAxle2 SuspensionDriveAxle1 SuspensionSteerAxle SteeringController FuelSystem CruiseControl RetarderDriveline RetarderEngine BrakesDriveAxle2 BrakesDriveAxle1 BrakesSystemController BrakesSteerAxle AxleDrive2 AxleDrive1 AxleSteering PowerTakeOff ShiftConsoleSecondary ShiftConsolePrimary Transmission2 Transmission1 Engine2 Engine1

BO_ 3221225472 VECTOR__INDEPENDENT_SIG_MSG: 0 Vector__XXX
 SG_ UtilityAverageACFrequency : 0|16@1+ (0.0078125,0) [0|501.9921875] "Hz" Vector__XXX
 SG_ UtltyAvrgLneNeutralACRMSVoltage : 0|16@1+ (1,0) [0|64255] "V" Vector__XXX
 SG_ UtltyAvrageLineLineACRMSVoltage : 0|16@1+ (1,0) [0|64255] "V" Vector__XXX
 SG_ GnrtorOverallPowerFactorLagging : 0|2@1+ (1,0) [0|3] "" Vector__XXX
 SG_ GeneratorOverallPowerFactor : 0|16@1+ (6.103515625E-005,-1) [-1|1] "" Vector__XXX
 SG_ GeneratorTotalReactivePower : 0|32@1+ (1,-2000000000) [-2000000000|2211081215] "Var" Vector__XXX
 SG_ GeneratorTotalApparentPower : 0|32@1+ (1,-2000000000) [-2000000000|2211081215] "VA" Vector__XXX
 SG_ GeneratorTotalRealPower : 0|32@1+ (1,-2000000000) [-2000000000|2211081215] "W" Vector__XXX
 SG_ GeneratorTotalKWHoursImport : 0|32@1+ (1,0) [0|4211081215] "kWh" Vector__XXX
 SG_ GeneratorTotalKWHoursExport : 0|32@1+ (1,0) [0|4211081215] "kWh" Vector__XXX
 SG_ GnratorPhaseCPowerFactorLagging : 0|2@1+ (1,0) [0|3] "" Vector__XXX
 SG_ GeneratorPhaseCPowerFactor : 0|16@1+ (6.103515625E-005,-1) [-1|1] "" Vector__XXX
 SG_ GeneratorPhaseCReactivePower : 0|32@1+ (1,-2000000000) [-2000000000|2211081215] "Var" Vector__XXX
 SG_ GeneratorPhaseCApparentPower : 0|32@1+ (1,-2000000000) [-2000000000|2211081215] "VA" Vector__XXX
 SG_ GeneratorPhaseCRealPower : 0|32@1+ (1,-2000000000) [-2000000000|2211081215] "W" Vector__XXX
 SG_ GeneratorPhaseCACRMSCurrent : 0|16@1+ (1,0) [0|64255] "A" Vector__XXX
 SG_ GeneratorPhaseCACFrequency : 0|16@1+ (0.0078125,0) [0|501.9921875] "Hz" Vector__XXX
 SG_ GnrtrPhsCLneNeutralACRMSVoltage : 0|16@1+ (1,0) [0|64255] "V" Vector__XXX
 SG_ GnrtrPhseCALineLineACRMSVoltage : 0|16@1+ (1,0) [0|64255] "V" Vector__XXX
 SG_ GnratorPhaseBPowerFactorLagging : 0|2@1+ (1,0) [0|3] "" Vector__XXX
 SG_ GeneratorPhaseBPowerFactor : 0|16@1+ (6.103515625E-005,-1) [-1|1] "" Vector__XXX
 SG_ GeneratorPhaseBReactivePower : 0|32@1+ (1,-2000000000) [-2000000000|2211081215] "Var" Vector__XXX
 SG_ GeneratorPhaseBApparentPower : 0|32@1+ (1,-2000000000) [-2000000000|2211081215] "VA" Vector__XXX
 SG_ GeneratorPhaseBRealPower : 0|32@1+ (1,-2000000000) [-2000000000|2211081215] "W" Vector__XXX
 SG_ GeneratorPhaseBACRMSCurrent : 0|16@1+ (1,0) [0|64255] "A" Vector__XXX
 SG_ GeneratorPhaseBACFrequency : 0|16@1+ (0.0078125,0) [0|501.9921875] "Hz" Vector__XXX
 SG_ GnrtrPhsBLneNeutralACRMSVoltage : 0|16@1+ (1,0) [0|64255] "V" Vector__XXX
 SG_ GnrtrPhseBCLineLineACRMSVoltage : 0|16@1+ (1,0) [0|64255] "V" Vector__XXX
 SG_ GnratorPhaseAPowerFactorLagging : 0|2@1+ (1,0) [0|3] "" Vector__XXX
 SG_ GeneratorPhaseAPowerFactor : 0|16@1+ (6.103515625E-005,-1) [-1|1] "" Vector__XXX
 SG_ GeneratorPhaseAReactivePower : 0|32@1+ (1,-2000000000) [-2000000000|2211081215] "Var" Vector__XXX
 SG_ GeneratorPhaseAApparentPower : 0|32@1+ (1,-2000000000) [-2000000000|2211081215] "VA" Vector__XXX
 SG_ GeneratorPhaseARealPower : 0|32@1+ (1,-2000000000) [-2000000000|2211081215] "W" Vector__XXX
 SG_ GeneratorPhaseAACRMSCurrent : 0|16@1+ (1,0) [0|64255] "A" Vector__XXX
 SG_ GeneratorPhaseAACFrequency : 0|16@1+ (0.0078125,0) [0|501.9921875] "Hz" Vector__XXX
 SG_ GnrtrPhsALneNeutralACRMSVoltage : 0|16@1+ (1,0) [0|64255] "V" Vector__XXX
 SG_ GnrtrPhseABLineLineACRMSVoltage : 0|16@1+ (1,0) [0|64255] "V" Vector__XXX
 SG_ GeneratorAverageACRMSCurrent : 0|16@1+ (1,0) [0|64255] "A" Vector__XXX
 SG_ GeneratorAverageACFrequency : 0|16@1+ (0.0078125,0) [0|501.9921875] "Hz" Vector__XXX
 SG_ GnrtrAvrgLneNeutralACRMSVoltage : 0|16@1+ (1,0) [0|64255] "V" Vector__XXX
 SG_ GnrtrAvrageLineLineACRMSVoltage : 0|16@1+ (1,0) [0|64255] "V" Vector__XXX
 SG_ Bus1_UtilityACPhaseDifference : 0|16@1+ (0.0078125,-200) [-200|301.99] "deg" Vector__XXX
 SG_ Bus1_UtilityInSync : 0|2@1+ (1,0) [0|3] "" Vector__XXX
 SG_ Bus1_UtilityVoltageMatch : 0|2@1+ (1,0) [0|3] "" Vector__XXX
 SG_ Bus1_UtilityFrequencyMatch : 0|2@1+ (1,0) [0|3] "" Vector__XXX
 SG_ Bus1_UtilityPhaseMatch : 0|2@1+ (1,0) [0|3] "" Vector__XXX
 SG_ Bus1_UtilityDeadBus : 0|2@1+ (1,0) [0|3] "" Vector__XXX
 SG_ Bus1PhaseCACFrequency : 0|16@1+ (0.0078125,0) [0|501.9921875] "Hz" Vector__XXX
 SG_ Bs1PhseCLineNeutralACRMSVoltage : 0|16@1+ (1,0) [0|64255] "V" Vector__XXX
 SG_ Bus1PhaseCALineLineACRMSVoltage : 0|16@1+ (1,0) [0|64255] "V" Vector__XXX
 SG_ Bus1PhaseBACFrequency : 0|16@1+ (0.0078125,0) [0|501.9921875] "Hz" Vector__XXX
 SG_ Bs1PhseBLineNeutralACRMSVoltage : 0|16@1+ (1,0) [0|64255] "V" Vector__XXX
 SG_ Bus1PhaseBCLineLineACRMSVoltage : 0|16@1+ (1,0) [0|64255] "V" Vector__XXX
 SG_ Bus1PhaseAACFrequency : 0|16@1+ (0.0078125,0) [0|501.9921875] "Hz" Vector__XXX
 SG_ Bs1PhseALineNeutralACRMSVoltage : 0|16@1+ (1,0) [0|64255] "V" Vector__XXX
 SG_ Bus1PhaseABLineLineACRMSVoltage : 0|16@1+ (1,0) [0|64255] "V" Vector__XXX
 SG_ Bus1_GeneratorACPhaseDifference : 0|16@1+ (0.0078125,-200) [-200|301.99] "deg" Vector__XXX
 SG_ Bus1_GeneratorInSync : 0|2@1+ (1,0) [0|3] "" Vector__XXX
 SG_ Bus1_GeneratorVoltageMatch : 0|2@1+ (1,0) [0|3] "" Vector__XXX
 SG_ Bus1_GeneratorFrequencyMatch : 0|2@1+ (1,0) [0|3] "" Vector__XXX
 SG_ Bus1_GeneratorPhaseMatch : 0|2@1+ (1,0) [0|3] "" Vector__XXX
 SG_ Bus1_GeneratorDeadBus : 0|2@1+ (1,0) [0|3] "" Vector__XXX
 SG_ Bus1AverageACFrequency : 0|16@1+ (0.0078125,0) [0|501.9921875] "Hz" Vector__XXX
 SG_ Bs1AvrgeLineNeutralACRMSVoltage : 0|16@1+ (1,0) [0|64255] "V" Vector__XXX
 SG_ Bus1AverageLineLineACRMSVoltage : 0|16@1+ (1,0) [0|64255] "V" Vector__XXX
 SG_ AddressAssignment : 0|8@1+ (1,0) [0|255] "" Vector__XXX
 SG_ ReservedBit : 0|1@1+ (1,0) [0|0] "" Vector__XXX
 SG_ ShrtNameOfActualReportingDevice : 0|32@1+ (1,0) [0|0] "" Vector__XXX
 SG_ LengthOfDataForTheReportedPGN : 0|8@1+ (1,0) [0|255] "" Vector__XXX
 SG_ PGNofRequstedInformation : 0|24@1+ (1,0) [0|16777215] "" Vector__XXX
 SG_ SequenceNumber : 0|8@1+ (1,0) [0|255] "" Vector__XXX
 SG_ TotalNumberOfPacketsEoMA : 0|8@1+ (1,0) [0|255] "" Vector__XXX
 SG_ TotalMessageSizeEoMA : 0|16@1+ (1,0) [0|64255] "" Vector__XXX
 SG_ TotalMessageSizeBAM : 0|16@1+ (1,0) [0|64255] "" Vector__XXX
 SG_ TotalNumberOfPacketsBAM : 0|8@1+ (1,0) [0|255] "" Vector__XXX
 SG_ ConnectionAbortReason : 0|8@1+ (1,0) [0|255] "" Vector__XXX
 SG_ NextPacketNumberToBeSent : 0|8@1+ (1,0) [0|255] "" Vector__XXX
 SG_ NumOfPacketsThatCanBeSent : 0|8@1+ (1,0) [0|255] "" Vector__XXX
 SG_ PGNumber : 0|24@1+ (1,0) [0|16777200] "" Vector__XXX
 SG_ MaximumNumberOfPackets : 0|8@1+ (1,0) [0|255] "" Vector__XXX
 SG_ TotalNumberOfPackets : 0|8@1+ (1,0) [0|255] "" Vector__XXX
 SG_ TotalMessageSize : 0|16@1+ (1,0) [0|64255] "" Vector__XXX
 SG_ ControlByte : 0|8@1+ (1,0) [0|255] "" Vector__XXX
 SG_ ParameterGroupNumber : 0|24@1+ (1,0) [0|16777215] "" Vector__XXX
 SG_ UseTransferMode : 0|2@1+ (1,0) [0|3] "" Vector__XXX
 SG_ ParameterGroupNumber : 0|24@1+ (1,0) [0|16777215] "" Vector__XXX
 SG_ AdditionalAxleGroupLocation : 0|4@1+ (1,0) [0|15] "" Vector__XXX
 SG_ AxleGroupWeight : 0|16@1+ (2,0) [0|128510] "kg" Vector__XXX
 SG_ AxleGroupLocation : 0|4@1+ (1,0) [0|15] "" Vector__XXX
 SG_ AdditionalAxleGroupLocation : 0|4@1+ (1,0) [0|15] "" Vector__XXX
 SG_ AxleGroupFullWeightCalib : 0|16@1+ (2,0) [0|128510] "kg" Vector__XXX
 SG_ AxleGroupEmptyWeightCalib : 0|16@1+ (2,0) [0|128510] "kg" Vector__XXX
 SG_ AxleGroupLocation : 0|4@1+ (1,0) [0|15] "" Vector__XXX
 SG_ EngChrgeAirCoolerBypassValve2Cmd : 0|16@1+ (0.0025,0) [0|160.6375] "%" Vector__XXX
 SG_ EngChrgeAirCoolerBypassValve1Cmd : 0|16@1+ (0.0025,0) [0|160.6375] "%" Vector__XXX
 SG_ DsrdAftrclrClntThermostatOpening : 0|8@1+ (0.4,0) [0|100] "%" Vector__XXX
 SG_ DsrdAftercoolerCoolantIntakeTemp : 0|8@1+ (1,-40) [-40|210] "°C" Vector__XXX
 SG_ AftercoolerCoolantThermostatMode : 0|2@1+ (1,0) [0|3] "" Vector__XXX
 SG_ RarDriveAxleGroupWeightAvailable : 0|2@1+ (1,0) [0|3] "" Vector__XXX
 SG_ RarSteerAxleGroupWeightAvailable : 0|2@1+ (1,0) [0|3] "" Vector__XXX
 SG_ AddtnlTrlrAxlGrupWeightAvailable : 0|2@1+ (1,0) [0|3] "" Vector__XXX
 SG_ TrailerHAxleGroupWeightAvailable : 0|2@1+ (1,0) [0|3] "" Vector__XXX
 SG_ TrailerGAxleGroupWeightAvailable : 0|2@1+ (1,0) [0|3] "" Vector__XXX
 SG_ TrailerFAxleGroupWeightAvailable : 0|2@1+ (1,0) [0|3] "" Vector__XXX
 SG_ TrailerEAxleGroupWeightAvailable : 0|2@1+ (1,0) [0|3] "" Vector__XXX
 SG_ TrailerDAxleGroupWeightAvailable : 0|2@1+ (1,0) [0|3] "" Vector__XXX
 SG_ TrailerCAxleGroupWeightAvailable : 0|2@1+ (1,0) [0|3] "" Vector__XXX
 SG_ TrailerBAxleGroupWeightAvailable : 0|2@1+ (1,0) [0|3] "" Vector__XXX
 SG_ TrailerAAxleGroupWeightAvailable : 0|2@1+ (1,0) [0|3] "" Vector__XXX
 SG_ AddtnlTrctrAxlGrpWeightAvailable : 0|2@1+ (1,0) [0|3] "" Vector__XXX
 SG_ TagAxleGroupWeightAvailable : 0|2@1+ (1,0) [0|3] "" Vector__XXX
 SG_ DriveAxleGroupWeightAvailable : 0|2@1+ (1,0) [0|3] "" Vector__XXX
 SG_ LiftAxleGroupWeightAvailable : 0|2@1+ (1,0) [0|3] "" Vector__XXX
 SG_ SteerAxleGroupWeightAvailable : 0|2@1+ (1,0) [0|3] "" Vector__XXX
 SG_ ZeroNetVehicleWeightChange : 0|2@1+ (1,0) [0|3] "" Vector__XXX
 SG_ EngExhaustGasTempAverageBank2 : 0|16@1+ (0.03125,-273) [-273|1734.96875] "°C" Vector__XXX
 SG_ EngExhaustGasTempAverageBank1 : 0|16@1+ (0.03125,-273) [-273|1734.96875] "°C" Vector__XXX
 SG_ EngExhaustGasTempAverage : 0|16@1+ (0.03125,-273) [-273|1734.96875] "°C" Vector__XXX
 SG_ AETCTorqueValue14 : 0|16@1+ (1,0) [0|65535] "Nm" Vector__XXX
 SG_ AETCTorqueValue13 : 0|16@1+ (1,0) [0|65535] "Nm" Vector__XXX
 SG_ AETCTorqueValue12 : 0|16@1+ (1,0) [0|65535] "Nm" Vector__XXX
 SG_ AETCTorqueValue11 : 0|16@1+ (1,0) [0|65535] "Nm" Vector__XXX
 SG_ AETCTorqueValue10 : 0|16@1+ (1,0) [0|65535] "Nm" Vector__XXX
 SG_ AETCTorqueValue09 : 0|16@1+ (1,0) [0|65535] "Nm" Vector__XXX
 SG_ AETCTorqueValue08 : 0|16@1+ (1,0) [0|65535] "Nm" Vector__XXX
 SG_ AETCTorqueValue07 : 0|16@1+ (1,0) [0|65535] "Nm" Vector__XXX
 SG_ AETCTorqueValue06 : 0|16@1+ (1,0) [0|65535] "Nm" Vector__XXX
 SG_ AETCTorqueValue05 : 0|16@1+ (1,0) [0|65535] "Nm" Vector__XXX
 SG_ AETCTorqueValue04 : 0|16@1+ (1,0) [0|65535] "Nm" Vector__XXX
 SG_ AETCTorqueValue03 : 0|16@1+ (1,0) [0|65535] "Nm" Vector__XXX
 SG_ AETCTorqueValue02 : 0|16@1+ (1,0) [0|65535] "Nm" Vector__XXX
 SG_ AETCTorqueValue01 : 0|16@1+ (1,0) [0|65535] "Nm" Vector__XXX
 SG_ AETCSpeedValue14 : 0|16@1+ (0.125,0) [0|8191.875] "rpm" Vector__XXX
 SG_ AETCSpeedValue13 : 0|16@1+ (0.125,0) [0|8191.875] "rpm" Vector__XXX
 SG_ AETCSpeedValue12 : 0|16@1+ (0.125,0) [0|8191.875] "rpm" Vector__XXX
 SG_ AETCSpeedValue11 : 0|16@1+ (0.125,0) [0|8191.875] "rpm" Vector__XXX
 SG_ AETCSpeedValue10 : 0|16@1+ (0.125,0) [0|8191.875] "rpm" Vector__XXX
 SG_ AETCSpeedValue09 : 0|16@1+ (0.125,0) [0|8191.875] "rpm" Vector__XXX
 SG_ AETCSpeedValue08 : 0|16@1+ (0.125,0) [0|8191.875] "rpm" Vector__XXX
 SG_ AETCSpeedValue07 : 0|16@1+ (0.125,0) [0|8191.875] "rpm" Vector__XXX
 SG_ AETCSpeedValue06 : 0|16@1+ (0.125,0) [0|8191.875] "rpm" Vector__XXX
 SG_ AETCSpeedValue05 : 0|16@1+ (0.125,0) [0|8191.875] "rpm" Vector__XXX
 SG_ AETCSpeedValue04 : 0|16@1+ (0.125,0) [0|8191.875] "rpm" Vector__XXX
 SG_ AETCSpeedValue03 : 0|16@1+ (0.125,0) [0|8191.875] "rpm" Vector__XXX
 SG_ AETCSpeedValue02 : 0|16@1+ (0.125,0) [0|8191.875] "rpm" Vector__XXX
 SG_ AETCSpeedValue01 : 0|16@1+ (0.125,0) [0|8191.875] "rpm" Vector__XXX
 SG_ AETCTorqueValue00 : 0|16@1+ (1,0) [0|65535] "Nm" Vector__XXX
 SG_ AETCSpeedValue00 : 0|16@1+ (0.125,0) [0|8191.875] "rpm" Vector__XXX
 SG_ NumberOfAETCDataPoints : 0|4@1+ (1,0) [5|15] "" Vector__XXX
 SG_ AETCDataCollectionStandard : 0|4@1+ (1,0) [0|15] "" Vector__XXX
 SG_ RightHeadlampLightDistribution : 0|4@1+ (1,0) [0|15] "" Vector__XXX
 SG_ LeftHeadlampLightDistribution : 0|4@1+ (1,0) [0|15] "" Vector__XXX
 SG_ RightHeadlampDynamicBendingLight : 0|3@1+ (1,0) [0|7] "" Vector__XXX
 SG_ LeftHeadlampDynamicBendingLight : 0|3@1+ (1,0) [0|7] "" Vector__XXX
 SG_ AuxI_OChannel2 : 0|16@1+ (1,0) [0|64255] "" Vector__XXX
 SG_ AuxI_OChannel1 : 0|16@1+ (1,0) [0|64255] "" Vector__XXX
 SG_ AuxI_O13 : 0|2@1+ (1,0) [0|3] "" Vector__XXX
 SG_ AuxI_O14 : 0|2@1+ (1,0) [0|3] "" Vector__XXX
 SG_ AuxI_O15 : 0|2@1+ (1,0) [0|3] "" Vector__XXX
 SG_ AuxI_O16 : 0|2@1+ (1,0) [0|3] "" Vector__XXX
 SG_ AuxI_O09 : 0|2@1+ (1,0) [0|3] "" Vector__XXX
 SG_ AuxI_O10 : 0|2@1+ (1,0) [0|3] "" Vector__XXX
 SG_ AuxI_O11 : 0|2@1+ (1,0) [0|3] "" Vector__XXX
 SG_ AuxI_O12 : 0|2@1+ (1,0) [0|3] "" Vector__XXX
 SG_ AuxI_O05 : 0|2@1+ (1,0) [0|3] "" Vector__XXX
 SG_ AuxI_O06 : 0|2@1+ (1,0) [0|3] "" Vector__XXX
 SG_ AuxI_O07 : 0|2@1+ (1,0) [0|3] "" Vector__XXX
 SG_ AuxI_O08 : 0|2@1+ (1,0) [0|3] "" Vector__XXX
 SG_ AuxI_O01 : 0|2@1+ (1,0) [0|3] "" Vector__XXX
 SG_ AuxI_O02 : 0|2@1+ (1,0) [0|3] "" Vector__XXX
 SG_ AuxI_O03 : 0|2@1+ (1,0) [0|3] "" Vector__XXX
 SG_ AuxI_O04 : 0|2@1+ (1,0) [0|3] "" Vector__XXX
 SG_ AuxI_O45 : 0|2@1+ (1,0) [0|3] "" Vector__XXX
 SG_ AuxI_O46 : 0|2@1+ (1,0) [0|3] "" Vector__XXX
 SG_ AuxI_O47 : 0|2@1+ (1,0) [0|3] "" Vector__XXX
 SG_ AuxI_O48 : 0|2@1+ (1,0) [0|3] "" Vector__XXX
 SG_ AuxI_O41 : 0|2@1+ (1,0) [0|3] "" Vector__XXX
 SG_ AuxI_O42 : 0|2@1+ (1,0) [0|3] "" Vector__XXX
 SG_ AuxI_O43 : 0|2@1+ (1,0) [0|3] "" Vector__XXX
 SG_ AuxI_O44 : 0|2@1+ (1,0) [0|3] "" Vector__XXX
 SG_ AuxI_O37 : 0|2@1+ (1,0) [0|3] "" Vector__XXX
 SG_ AuxI_O38 : 0|2@1+ (1,0) [0|3] "" Vector__XXX
 SG_ AuxI_O39 : 0|2@1+ (1,0) [0|3] "" Vector__XXX
 SG_ AuxI_O40 : 0|2@1+ (1,0) [0|3] "" Vector__XXX
 SG_ AuxI_O33 : 0|2@1+ (1,0) [0|3] "" Vector__XXX
 SG_ AuxI_O34 : 0|2@1+ (1,0) [0|3] "" Vector__XXX
 SG_ AuxI_O35 : 0|2@1+ (1,0) [0|3] "" Vector__XXX
 SG_ AuxI_O36 : 0|2@1+ (1,0) [0|3] "" Vector__XXX
 SG_ AuxI_O29 : 0|2@1+ (1,0) [0|3] "" Vector__XXX
 SG_ AuxI_O30 : 0|2@1+ (1,0) [0|3] "" Vector__XXX
 SG_ AuxI_O31 : 0|2@1+ (1,0) [0|3] "" Vector__XXX
 SG_ AuxI_O32 : 0|2@1+ (1,0) [0|3] "" Vector__XXX
 SG_ AuxI_O25 : 0|2@1+ (1,0) [0|3] "" Vector__XXX
 SG_ AuxI_O26 : 0|2@1+ (1,0) [0|3] "" Vector__XXX
 SG_ AuxI_O27 : 0|2@1+ (1,0) [0|3] "" Vector__XXX
 SG_ AuxI_O28 : 0|2@1+ (1,0) [0|3] "" Vector__XXX
 SG_ AuxI_O21 : 0|2@1+ (1,0) [0|3] "" Vector__XXX
 SG_ AuxI_O22 : 0|2@1+ (1,0) [0|3] "" Vector__XXX
 SG_ AuxI_O23 : 0|2@1+ (1,0) [0|3] "" Vector__XXX
 SG_ AuxI_O24 : 0|2@1+ (1,0) [0|3] "" Vector__XXX
 SG_ AuxI_O17 : 0|2@1+ (1,0) [0|3] "" Vector__XXX
 SG_ AuxI_O18 : 0|2@1+ (1,0) [0|3] "" Vector__XXX
 SG_ AuxI_O19 : 0|2@1+ (1,0) [0|3] "" Vector__XXX
 SG_ AuxI_O20 : 0|2@1+ (1,0) [0|3] "" Vector__XXX
 SG_ AuxI_O77 : 0|2@1+ (1,0) [0|3] "" Vector__XXX
 SG_ AuxI_O78 : 0|2@1+ (1,0) [0|3] "" Vector__XXX
 SG_ AuxI_O79 : 0|2@1+ (1,0) [0|3] "" Vector__XXX
 SG_ AuxI_O80 : 0|2@1+ (1,0) [0|3] "" Vector__XXX
 SG_ AuxI_O73 : 0|2@1+ (1,0) [0|3] "" Vector__XXX
 SG_ AuxI_O74 : 0|2@1+ (1,0) [0|3] "" Vector__XXX
 SG_ AuxI_O75 : 0|2@1+ (1,0) [0|3] "" Vector__XXX
 SG_ AuxI_O76 : 0|2@1+ (1,0) [0|3] "" Vector__XXX
 SG_ AuxI_O69 : 0|2@1+ (1,0) [0|3] "" Vector__XXX
 SG_ AuxI_O70 : 0|2@1+ (1,0) [0|3] "" Vector__XXX
 SG_ AuxI_O71 : 0|2@1+ (1,0) [0|3] "" Vector__XXX
 SG_ AuxI_O72 : 0|2@1+ (1,0) [0|3] "" Vector__XXX
 SG_ AuxI_O65 : 0|2@1+ (1,0) [0|3] "" Vector__XXX
 SG_ AuxI_O66 : 0|2@1+ (1,0) [0|3] "" Vector__XXX
 SG_ AuxI_O67 : 0|2@1+ (1,0) [0|3] "" Vector__XXX
 SG_ AuxI_O68 : 0|2@1+ (1,0) [0|3] "" Vector__XXX
 SG_ AuxI_O61 : 0|2@1+ (1,0) [0|3] "" Vector__XXX
 SG_ AuxI_O62 : 0|2@1+ (1,0) [0|3] "" Vector__XXX
 SG_ AuxI_O63 : 0|2@1+ (1,0) [0|3] "" Vector__XXX
 SG_ AuxI_O64 : 0|2@1+ (1,0) [0|3] "" Vector__XXX
 SG_ AuxI_O57 : 0|2@1+ (1,0) [0|3] "" Vector__XXX
 SG_ AuxI_O58 : 0|2@1+ (1,0) [0|3] "" Vector__XXX
 SG_ AuxI_O59 : 0|2@1+ (1,0) [0|3] "" Vector__XXX
 SG_ AuxI_O60 : 0|2@1+ (1,0) [0|3] "" Vector__XXX
 SG_ AuxI_O53 : 0|2@1+ (1,0) [0|3] "" Vector__XXX
 SG_ AuxI_O54 : 0|2@1+ (1,0) [0|3] "" Vector__XXX
 SG_ AuxI_O55 : 0|2@1+ (1,0) [0|3] "" Vector__XXX
 SG_ AuxI_O56 : 0|2@1+ (1,0) [0|3] "" Vector__XXX
 SG_ AuxI_O49 : 0|2@1+ (1,0) [0|3] "" Vector__XXX
 SG_ AuxI_O50 : 0|2@1+ (1,0) [0|3] "" Vector__XXX
 SG_ AuxI_O51 : 0|2@1+ (1,0) [0|3] "" Vector__XXX
 SG_ AuxI_O52 : 0|2@1+ (1,0) [0|3] "" Vector__XXX
 SG_ AuxI_O109 : 0|2@1+ (1,0) [0|3] "" Vector__XXX
 SG_ AuxI_O110 : 0|2@1+ (1,0) [0|3] "" Vector__XXX
 SG_ AuxI_O111 : 0|2@1+ (1,0) [0|3] "" Vector__XXX
 SG_ AuxI_O112 : 0|2@1+ (1,0) [0|3] "" Vector__XXX
 SG_ AuxI_O105 : 0|2@1+ (1,0) [0|3] "" Vector__XXX
 SG_ AuxI_O106 : 0|2@1+ (1,0) [0|3] "" Vector__XXX
 SG_ AuxI_O107 : 0|2@1+ (1,0) [0|3] "" Vector__XXX
 SG_ AuxI_O108 : 0|2@1+ (1,0) [0|3] "" Vector__XXX
 SG_ AuxI_O101 : 0|2@1+ (1,0) [0|3] "" Vector__XXX
 SG_ AuxI_O102 : 0|2@1+ (1,0) [0|3] "" Vector__XXX
 SG_ AuxI_O103 : 0|2@1+ (1,0) [0|3] "" Vector__XXX
 SG_ AuxI_O104 : 0|2@1+ (1,0) [0|3] "" Vector__XXX
 SG_ AuxI_O97 : 0|2@1+ (1,0) [0|3] "" Vector__XXX
 SG_ AuxI_O98 : 0|2@1+ (1,0) [0|3] "" Vector__XXX
 SG_ AuxI_O99 : 0|2@1+ (1,0) [0|3] "" Vector__XXX
 SG_ AuxI_O100 : 0|2@1+ (1,0) [0|3] "" Vector__XXX
 SG_ AuxI_O93 : 0|2@1+ (1,0) [0|3] "" Vector__XXX
 SG_ AuxI_O94 : 0|2@1+ (1,0) [0|3] "" Vector__XXX
 SG_ AuxI_O95 : 0|2@1+ (1,0) [0|3] "" Vector__XXX
 SG_ AuxI_O96 : 0|2@1+ (1,0) [0|3] "" Vector__XXX
 SG_ AuxI_O89 : 0|2@1+ (1,0) [0|3] "" Vector__XXX
 SG_ AuxI_O90 : 0|2@1+ (1,0) [0|3] "" Vector__XXX
 SG_ AuxI_O91 : 0|2@1+ (1,0) [0|3] "" Vector__XXX
 SG_ AuxI_O92 : 0|2@1+ (1,0) [0|3] "" Vector__XXX
 SG_ AuxI_O85 : 0|2@1+ (1,0) [0|3] "" Vector__XXX
 SG_ AuxI_O86 : 0|2@1+ (1,0) [0|3] "" Vector__XXX
 SG_ AuxI_O87 : 0|2@1+ (1,0) [0|3] "" Vector__XXX
 SG_ AuxI_O88 : 0|2@1+ (1,0) [0|3] "" Vector__XXX
 SG_ AuxI_O81 : 0|2@1+ (1,0) [0|3] "" Vector__XXX
 SG_ AuxI_O82 : 0|2@1+ (1,0) [0|3] "" Vector__XXX
 SG_ AuxI_O83 : 0|2@1+ (1,0) [0|3] "" Vector__XXX
 SG_ AuxI_O84 : 0|2@1+ (1,0) [0|3] "" Vector__XXX
 SG_ TrailerBrakeStrokeAxle5Right : 0|3@1+ (1,0) [0|7] "" Vector__XXX
 SG_ TrailerBrakeStrokeAxle5Left : 0|3@1+ (1,0) [0|7] "" Vector__XXX
 SG_ TrailerBrakeStrokeAxle4Right : 0|3@1+ (1,0) [0|7] "" Vector__XXX
 SG_ TrailerBrakeStrokeAxle4Left : 0|3@1+ (1,0) [0|7] "" Vector__XXX
 SG_ TrailerBrakeStrokeAxle3Right : 0|3@1+ (1,0) [0|7] "" Vector__XXX
 SG_ TrailerBrakeStrokeAxle3Left : 0|3@1+ (1,0) [0|7] "" Vector__XXX
 SG_ TrailerBrakeStrokeAxle2Right : 0|3@1+ (1,0) [0|7] "" Vector__XXX
 SG_ TrailerBrakeStrokeAxle2Left : 0|3@1+ (1,0) [0|7] "" Vector__XXX
 SG_ TrailerBrakeStrokeAxle1Right : 0|3@1+ (1,0) [0|7] "" Vector__XXX
 SG_ TrailerBrakeStrokeAxle1Left : 0|3@1+ (1,0) [0|7] "" Vector__XXX
 SG_ TractorBrakeStrokeAxle5Right : 0|3@1+ (1,0) [0|7] "" Vector__XXX
 SG_ TractorBrakeStrokeAxle5Left : 0|3@1+ (1,0) [0|7] "" Vector__XXX
 SG_ TractorBrakeStrokeAxle4Right : 0|3@1+ (1,0) [0|7] "" Vector__XXX
 SG_ TractorBrakeStrokeAxle4Left : 0|3@1+ (1,0) [0|7] "" Vector__XXX
 SG_ TractorBrakeStrokeAxle3Right : 0|3@1+ (1,0) [0|7] "" Vector__XXX
 SG_ TractorBrakeStrokeAxle3Left : 0|3@1+ (1,0) [0|7] "" Vector__XXX
 SG_ TractorBrakeStrokeAxle2Right : 0|3@1+ (1,0) [0|7] "" Vector__XXX
 SG_ TractorBrakeStrokeAxle2Left : 0|3@1+ (1,0) [0|7] "" Vector__XXX
 SG_ TractorBrakeStrokeAxle1Right : 0|3@1+ (1,0) [0|7] "" Vector__XXX
 SG_ TractorBrakeStrokeAxle1Left : 0|3@1+ (1,0) [0|7] "" Vector__XXX
 SG_ RoadSurfaceTemp : 0|16@1+ (0.03125,-273) [-273|1734.96875] "°C" Vector__XXX
 SG_ EngAirIntakeTemp : 0|8@1+ (1,-40) [-40|210] "°C" Vector__XXX
 SG_ AmbientAirTemp : 0|16@1+ (0.03125,-273) [-273|1734.96875] "°C" Vector__XXX
 SG_ CabInteriorTemp : 0|16@1+ (0.03125,-273) [-273|1734.96875] "°C" Vector__XXX
 SG_ BarometricPress : 0|8@1+ (0.5,0) [0|125] "kPa" Vector__XXX
 SG_ EngAirStopPress : 0|8@1+ (4,0) [0|1000] "kPa" Vector__XXX
 SG_ EngAirStartPress6831 : 0|8@1+ (16,0) [0|4000] "kPa" Vector__XXX
 SG_ EngAirStartPress : 0|8@1+ (4,0) [0|1000] "kPa" Vector__XXX
 SG_ AirCompressorStatus : 0|2@1+ (1,0) [0|3] "" Vector__XXX
 SG_ AirSuspensionSupplyPress : 0|8@1+ (8,0) [0|2000] "kPa" Vector__XXX
 SG_ AuxEquipmentSupplyPress : 0|8@1+ (8,0) [0|2000] "kPa" Vector__XXX
 SG_ PowertrainCircuitAirSupplyPress : 0|8@1+ (8,0) [0|2000] "kPa" Vector__XXX
 SG_ ServiceBrakeCircuit2AirPress : 0|8@1+ (8,0) [0|2000] "kPa" Vector__XXX
 SG_ ServiceBrakeCircuit1AirPress : 0|8@1+ (8,0) [0|2000] "kPa" Vector__XXX
 SG_ ParkingAnd_orTrailerAirPress : 0|8@1+ (8,0) [0|2000] "kPa" Vector__XXX
 SG_ PneumaticSupplyPress : 0|8@1+ (8,0) [0|2000] "kPa" Vector__XXX
 SG_ SteerAxleLubePress : 0|8@1+ (4,0) [0|1000] "kPa" Vector__XXX
 SG_ SteerAxleTemp : 0|8@1+ (1,-40) [-40|210] "°C" Vector__XXX
 SG_ DriveAxleLubePress : 0|8@1+ (4,0) [0|1000] "kPa" Vector__XXX
 SG_ DriveAxleTemp : 0|8@1+ (1,-40) [-40|210] "°C" Vector__XXX
 SG_ DriveAxleLiftAirPress : 0|8@1+ (4,0) [0|1000] "kPa" Vector__XXX
 SG_ DriveAxleLocation : 0|8@1+ (1,0) [0|255] "" Vector__XXX
 SG_ EngGsMssFlwSnsrFuelingCorrection : 0|8@1+ (1,-125) [-125|125] "%" Vector__XXX
 SG_ GsFlInjctonPulseCorrectionFactor : 0|16@1+ (0.0078125,-251) [0|150] "%" Vector__XXX
 SG_ EngTurboWastegateValvePos : 0|8@1+ (0.4,0) [0|100] "%" Vector__XXX
 SG_ EngDesiredAbsIntakeManifoldPress : 0|16@1+ (0.1,0) [0|6425.5] "kPa" Vector__XXX
 SG_ EngGasFuelCorrectionFactor : 0|8@1+ (1,0) [0|250] "%" Vector__XXX
 SG_ RequestedACCDistanceMode : 0|3@1+ (1,0) [0|7] "" Vector__XXX
 SG_ ACCUsageDemand : 0|2@1+ (1,0) [0|3] "" Vector__XXX
 SG_ ForwardCollisionWarning : 0|2@1+ (1,0) [0|3] "" Vector__XXX
 SG_ ACCDistanceAlertSignal : 0|2@1+ (1,0) [0|3] "" Vector__XXX
 SG_ ACCSystemShutoffWarning : 0|2@1+ (1,0) [0|3] "" Vector__XXX
 SG_ ACCTargetDetected : 0|2@1+ (1,0) [0|3] "" Vector__XXX
 SG_ AdptiveCruiseCtrlSetDistanceMode : 0|3@1+ (1,0) [0|7] "" Vector__XXX
 SG_ AdaptiveCruiseCtrlMode : 0|3@1+ (1,0) [0|7] "" Vector__XXX
 SG_ AdaptiveCruiseCtrlSetSpeed : 0|8@1+ (1,0) [0|120] "km/h" Vector__XXX
 SG_ DistanceToForwardVehicle : 0|8@1+ (1,0) [0|250] "m" Vector__XXX
 SG_ SpeedOfForwardVehicle : 0|8@1+ (1,0) [0|250] "km/h" Vector__XXX
 SG_ ArticulationAngle : 0|8@1+ (1,-125) [-125|125] "deg" Vector__XXX
 SG_ RelativeHumidity : 0|8@1+ (0.4,0) [0|100] "%" Vector__XXX
 SG_ AuxLevel : 0|16@1+ (0.1,0) [0|6425.5] "mm" Vector__XXX
 SG_ AuxPress2 : 0|8@1+ (16,0) [0|4000] "kPa" Vector__XXX
 SG_ AuxPress1 : 0|8@1+ (16,0) [0|4000] "kPa" Vector__XXX
 SG_ AuxTemp2 : 0|8@1+ (1,-40) [-40|210] "°C" Vector__XXX
 SG_ AuxTemp1 : 0|8@1+ (1,-40) [-40|210] "°C" Vector__XXX
 SG_ LNGVaporizerCoolantOutletTemp : 0|8@1+ (1,-40) [-40|210] "°C" Vector__XXX
 SG_ EngGasFuelVentPress : 0|16@1+ (0.5,0) [0|32127.5] "kPa" Vector__XXX
 SG_ EngBlowerBypassValvePos : 0|8@1+ (0.4,0) [0|100] "%" Vector__XXX
 SG_ EngGasSupplyPress : 0|16@1+ (0.5,0) [0|32127.5] "kPa" Vector__XXX
 SG_ AddressBusy : 0|8@1+ (1,0) [0|255] "" Vector__XXX
 SG_ ControlByte_ACKM : 0|8@1+ (1,0) [0|255] "" Vector__XXX
 SG_ ParameterGroupNumber : 0|24@1+ (1,0) [0|16777215] "" Vector__XXX
 SG_ GroupFunctionValue : 0|8@1+ (1,0) [0|250] "" Vector__XXX
 SG_ AddressAccessDenied : 0|8@1+ (1,0) [0|255] "" Vector__XXX
 SG_ AddressNACK : 0|8@1+ (1,0) [0|255] "" Vector__XXX
 SG_ AddressAcknowledged : 0|8@1+ (1,0) [0|255] "" Vector__XXX
 SG_ Status2OfDoors : 0|2@1+ (1,0) [0|3] "" Vector__XXX
 SG_ Ramp_WheelChairLiftPos : 0|2@1+ (1,0) [0|3] "" Vector__XXX
 SG_ PosOfDoors : 0|4@1+ (1,0) [0|15] "" Vector__XXX
 SG_ FifthWheelRollWarningIndicator : 0|2@1+ (1,0) [0|3] "" Vector__XXX
 SG_ FifthWheelRollMoment : 0|16@1+ (10,-320000) [-320000|322550] "N" Vector__XXX
 SG_ FifthWheelDrawbarForce : 0|16@1+ (10,-320000) [-320000|322550] "N" Vector__XXX
 SG_ FifthWheelVerticalForce : 0|16@1+ (5,0) [0|321275] "N" Vector__XXX
 SG_ FifthWheelSliderLockIndicator : 0|2@1+ (1,0) [0|3] "" Vector__XXX
 SG_ FifthWheelSliderPos : 0|8@1+ (10,0) [0|2500] "mm" Vector__XXX
 SG_ FfthWhlLockCoupleStatusIndicator : 0|2@1+ (1,0) [0|3] "" Vector__XXX
 SG_ FfthWhlLckReadyToCoupleIndicator : 0|2@1+ (1,0) [0|3] "" Vector__XXX
 SG_ FifthWheelErrorStatus : 0|4@1+ (1,0) [0|15] "" Vector__XXX
 SG_ RollAndPitchMeasurementLatency : 0|8@1+ (0.5,0) [0|125] "ms" Vector__XXX
 SG_ PitchAndRollCompensated : 0|2@1+ (1,0) [0|3] "" Vector__XXX
 SG_ PitchRateFigureOfMerit : 0|2@1+ (1,0) [0|3] "" Vector__XXX
 SG_ RollAngleFigureOfMerit : 0|2@1+ (1,0) [0|3] "" Vector__XXX
 SG_ PitchAngleFigureOfMerit : 0|2@1+ (1,0) [0|3] "" Vector__XXX
 SG_ PitchRate : 0|16@1+ (0.002,-64) [-64|64.51] "deg/s" Vector__XXX
 SG_ RollAngle : 0|16@1+ (0.002,-64) [-64|64.51] "deg" Vector__XXX
 SG_ PitchAngle : 0|16@1+ (0.002,-64) [-64|64.51] "deg" Vector__XXX
 SG_ TransOilLevel1MeasurementStatus : 0|4@1+ (1,0) [0|15] "" Vector__XXX
 SG_ TransOilLevel1CountdownTimer : 0|4@1+ (1,0) [0|13] "" Vector__XXX
 SG_ TransOilLevel1High_Low : 0|8@1+ (0.5,-62.5) [-62.5|62.5] "L" Vector__XXX
 SG_ TransOilTemp1 : 0|16@1+ (0.03125,-273) [-273|1734.96875] "°C" Vector__XXX
 SG_ TransOilPress : 0|8@1+ (16,0) [0|4000] "kPa" Vector__XXX
 SG_ TransFilterDiffPress : 0|8@1+ (2,0) [0|500] "kPa" Vector__XXX
 SG_ TransOilLevel1 : 0|8@1+ (0.4,0) [0|100] "%" Vector__XXX
 SG_ ClutchPress : 0|8@1+ (16,0) [0|4000] "kPa" Vector__XXX
 SG_ KeyswitchBatteryPotential : 0|16@1+ (0.05,0) [0|3212.75] "V" Vector__XXX
 SG_ BatteryPotential_PowerInput1 : 0|16@1+ (0.05,0) [0|3212.75] "V" Vector__XXX
 SG_ ChargingSystemPotential : 0|16@1+ (0.05,0) [0|3212.75] "V" Vector__XXX
 SG_ WrelessCommunicationNetworkType2 : 0|8@1+ (1,0) [0|255] "" Vector__XXX
 SG_ NetworkSignalStrength2 : 0|8@1+ (0.4,0) [0|100] "%" Vector__XXX
 SG_ NetworkAntennaStatus2 : 0|8@1+ (1,0) [0|255] "" Vector__XXX
 SG_ NetworkServiceStatus2 : 0|8@1+ (1,0) [0|255] "" Vector__XXX
 SG_ NetworkTransceiverStatus2 : 0|8@1+ (1,0) [0|255] "" Vector__XXX
 SG_ WrelessCommunicationNetworkType1 : 0|8@1+ (1,0) [0|255] "" Vector__XXX
 SG_ NetworkSignalStrength1 : 0|8@1+ (0.4,0) [0|100] "%" Vector__XXX
 SG_ NetworkAntennaStatus1 : 0|8@1+ (1,0) [0|255] "" Vector__XXX
 SG_ NetworkServiceStatus1 : 0|8@1+ (1,0) [0|255] "" Vector__XXX
 SG_ NetworkTransceiverStatus1 : 0|8@1+ (1,0) [0|255] "" Vector__XXX
 SG_ VoltageRegulatorEnabled : 0|2@1+ (1,0) [0|3] "" Vector__XXX
 SG_ VoltageRegulatorSoftStartState : 0|2@1+ (1,0) [0|3] "" Vector__XXX
 SG_ VltgRgltrUndrfrqncyCmpnstnEnbld : 0|2@1+ (1,0) [0|3] "" Vector__XXX
 SG_ VltgRgltrVAr_PwrFctrOprtingMode : 0|3@1+ (1,0) [0|7] "" Vector__XXX
 SG_ VltgRglatorLoadCompensationMode : 0|3@1+ (1,0) [0|7] "" Vector__XXX
 SG_ GnrtrOtputVoltageBiasPercentage : 0|16@1+ (0.1,-100) [-100|100] "%" Vector__XXX
 SG_ GeneratorExcitationFieldCurrent : 0|16@1+ (0.05,0) [0|3212.75] "A" Vector__XXX
 SG_ GeneratorExcitationFieldVoltage : 0|16@1+ (0.05,-1606) [-1606|1606.75] "V" Vector__XXX

BO_ 2566836734 DM09: 8 Vector__XXX

BO_ 2566702846 DM57: 8 Vector__XXX
 SG_ EngOBDWarmUpSequence : 0|2@1+ (1,0) [0|3] "" Vector__XXX

BO_ 2566703102 DM56: 208 Vector__XXX
 SG_ CertificationEngineFamilyName : 64|64@1+ (1,0) [0|255] "" Vector__XXX
 SG_ ModelYear : 0|64@1+ (1,0) [0|255] "" Vector__XXX

BO_ 2566705918 DM54: 22 Vector__XXX
 SG_ DTC1 : 16|32@1+ (1,0) [0|4294967295] "" Vector__XXX
 SG_ FlashProtectLamp : 8|2@1+ (1,0) [0|3] "" Vector__XXX
 SG_ FlashAmberWarningLamp : 10|2@1+ (1,0) [0|3] "" Vector__XXX
 SG_ FlashRedStopLamp : 12|2@1+ (1,0) [0|3] "" Vector__XXX
 SG_ FlashMalfuncIndicatorLamp : 14|2@1+ (1,0) [0|3] "" Vector__XXX
 SG_ ProtectLampStatus : 0|2@1+ (1,0) [0|3] "" Vector__XXX
 SG_ AmberWarningLampStatus : 2|2@1+ (1,0) [0|3] "" Vector__XXX
 SG_ RedStopLampState : 4|2@1+ (1,0) [0|3] "" Vector__XXX
 SG_ MalfunctionIndicatorLampStatus : 6|2@1+ (1,0) [0|3] "" Vector__XXX
 SG_ DTC5 : 144|32@1+ (1,0) [0|4294967295] "" Vector__XXX
 SG_ DTC4 : 112|32@1+ (1,0) [0|4294967295] "" Vector__XXX
 SG_ DTC3 : 80|32@1+ (1,0) [0|4294967295] "" Vector__XXX
 SG_ DTC2 : 48|32@1+ (1,0) [0|4294967295] "" Vector__XXX

CM_ SG_ 3221225472 UtilityAverageACFrequency "Average AC frequency measured at the utility incomer.";
CM_ SG_ 3221225472 UtltyAvrgLneNeutralACRMSVoltage "The average Line to Neutral AC RMS voltage measured at the utility incomer .";
CM_ SG_ 3221225472 UtltyAvrageLineLineACRMSVoltage "Average Line to Line RMS voltage measured at the utility incomer .";
CM_ SG_ 3221225472 GnrtorOverallPowerFactorLagging "Lead/lag status for generator average power factor.

00 Leading
01 Lagging
10 Error
11 Not Available or Not Installed";
CM_ SG_ 3221225472 GeneratorOverallPowerFactor "The average power factor of the generator.";
CM_ SG_ 3221225472 GeneratorTotalReactivePower "The total reactive power delivered by the generator";
CM_ SG_ 3221225472 GeneratorTotalApparentPower "The total apparent power delivered by the generator.";
CM_ SG_ 3221225472 GeneratorTotalRealPower "Total real power delivered by the generator.";
CM_ SG_ 3221225472 GeneratorTotalKWHoursImport "The total kilowatt-hours that have been imported by the generator.";
CM_ SG_ 3221225472 GeneratorTotalKWHoursExport "The total kilowatt-hours that have been exported by the generator.";
CM_ SG_ 3221225472 GnratorPhaseCPowerFactorLagging "Lead/lag status for generator phase C power factor.

00 Leading
01 Lagging
10 Error
11 Not Available or Not Installed";
CM_ SG_ 3221225472 GeneratorPhaseCPowerFactor "The power factor of phases C of the generator.";
CM_ SG_ 3221225472 GeneratorPhaseCReactivePower "The reactive power delivered by phase C of the generator";
CM_ SG_ 3221225472 GeneratorPhaseCApparentPower "The apparent power delivered by phase C of the generator.";
CM_ SG_ 3221225472 GeneratorPhaseCRealPower "The real power delivered by phase C of the generator.";
CM_ SG_ 3221225472 GeneratorPhaseCACRMSCurrent "RMS current measured at the generator phase C output.";
CM_ SG_ 3221225472 GeneratorPhaseCACFrequency "AC frequency measured at the generator phase C output.";
CM_ SG_ 3221225472 GnrtrPhsCLneNeutralACRMSVoltage "Line to Neutral RMS voltage measured at the generator phase C output.";
CM_ SG_ 3221225472 GnrtrPhseCALineLineACRMSVoltage "Line to Line RMS voltage measured at the generator phase CA output.";
CM_ SG_ 3221225472 GnratorPhaseBPowerFactorLagging "Lead/lag status for generator phase B power factor.

00 Leading
01 Lagging
10 Error
11 Not Available or Not Installed";
CM_ SG_ 3221225472 GeneratorPhaseBPowerFactor "The power factor of phases B of the generator.";
CM_ SG_ 3221225472 GeneratorPhaseBReactivePower "The reactive power delivered by phase B of the generator";
CM_ SG_ 3221225472 GeneratorPhaseBApparentPower "The apparent power delivered by phase B of the generator.";
CM_ SG_ 3221225472 GeneratorPhaseBRealPower "The real power delivered by phase B of the generator.";
CM_ SG_ 3221225472 GeneratorPhaseBACRMSCurrent "RMS current measured at the generator phase B output.";
CM_ SG_ 3221225472 GeneratorPhaseBACFrequency "AC frequency measured at the generator phase B output.";
CM_ SG_ 3221225472 GnrtrPhsBLneNeutralACRMSVoltage "Line to Neutral RMS voltage measured at the generator phase B output.";
CM_ SG_ 3221225472 GnrtrPhseBCLineLineACRMSVoltage "Line to Line RMS voltage measured at the generator phase BC output.";
CM_ SG_ 3221225472 GnratorPhaseAPowerFactorLagging "Lead/lag status for generator phase A power factor.

00 Leading
01 Lagging
10 Error
11 Not Available or Not Installed";
CM_ SG_ 3221225472 GeneratorPhaseAPowerFactor "The power factor of phase A of the generator.";
CM_ SG_ 3221225472 GeneratorPhaseAReactivePower "The reactive power delivered by phase A of the generator";
CM_ SG_ 3221225472 GeneratorPhaseAApparentPower "The apparent power delivered by phase A of the generator.";
CM_ SG_ 3221225472 GeneratorPhaseARealPower "The real power delivered by phase A of the generator.";
CM_ SG_ 3221225472 GeneratorPhaseAACRMSCurrent "RMS current measured at the generator phase A output.";
CM_ SG_ 3221225472 GeneratorPhaseAACFrequency "AC frequency measured at the generator phase A output.";
CM_ SG_ 3221225472 GnrtrPhsALneNeutralACRMSVoltage "Line to Neutral RMS voltage measured at the generator phase A output.";
CM_ SG_ 3221225472 GnrtrPhseABLineLineACRMSVoltage "Line to Line RMS voltage measured at the generator phase AB output.";
CM_ SG_ 3221225472 GeneratorAverageACRMSCurrent "Average RMS current measured at the generator output.";
CM_ SG_ 3221225472 GeneratorAverageACFrequency "Average AC frequency measured at the generator output.";
CM_ SG_ 3221225472 GnrtrAvrgLneNeutralACRMSVoltage "The average Line to Neutral AC RMS voltage measured at the Generator output.";
CM_ SG_ 3221225472 GnrtrAvrageLineLineACRMSVoltage "Average Line to Line RMS voltage measured at the generator output.";
CM_ SG_ 3221225472 Bus1_UtilityACPhaseDifference "The phase difference between the Bus #1 voltage and Utility voltage.";
CM_ SG_ 3221225472 Bus1_UtilityInSync "Indicator of whether Bus #1 and Utility are properly synchronized for paralleling. This indicator will be based on parameters such as Voltage Match, Frequency Match, and Phase Match.
00 Not synchronized
01 Synchronized
10 Error
11 Not Available ...";
CM_ SG_ 3221225472 Bus1_UtilityVoltageMatch "Indicator of whether voltage difference between Bus #1 and Utility is adequate for paralleling. This indicator will be based on the measured AC voltages qualified using parameters such as Voltage Tolerance.
00 Voltages do not match
01 Voltages ...";
CM_ SG_ 3221225472 Bus1_UtilityFrequencyMatch "Indicator of whether frequency difference between Bus #1 and Utility is adequate for paralleling. This indicator will be based on the measured AC frequencies qualified using parameters such as Frequency Tolerance, Phase Tolerance, and Dwell Time.
 ...";
CM_ SG_ 3221225472 Bus1_UtilityPhaseMatch "Indicator of whether phase difference between Bus #1 and Utility is adequate for paralleling. This indicator will be based on the measured AC phase difference qualified using parameters such as Phase Tolerance and Dwell Time.
00 Phases do not match
 ...";
CM_ SG_ 3221225472 Bus1_UtilityDeadBus "Indicator of whether Bus #1 is considered dead for closing to the utility. This indicator will be based on parameters such as Bus #1 Voltage and dead bus threshold values.
00 Bus is not dead
01 Bus is dead
10 Error
11 Not Available or Not ...";
CM_ SG_ 3221225472 Bus1PhaseCACFrequency "AC frequency measured at bus #1 phase C.";
CM_ SG_ 3221225472 Bs1PhseCLineNeutralACRMSVoltage "Line to Neutral RMS voltage measured at bus #1 phase C.";
CM_ SG_ 3221225472 Bus1PhaseCALineLineACRMSVoltage "Line to Line RMS voltage measured at bus #1 phase CA.";
CM_ SG_ 3221225472 Bus1PhaseBACFrequency "AC frequency measured at bus #1 phase B.";
CM_ SG_ 3221225472 Bs1PhseBLineNeutralACRMSVoltage "Line to Neutral RMS voltage measured at bus #1 phase B.";
CM_ SG_ 3221225472 Bus1PhaseBCLineLineACRMSVoltage "Line to Line RMS voltage measured at bus #1 phase BC.";
CM_ SG_ 3221225472 Bus1PhaseAACFrequency "AC frequency measured at bus #1 phase A.";
CM_ SG_ 3221225472 Bs1PhseALineNeutralACRMSVoltage "Line to Neutral RMS voltage measured at bus #1 phase A.";
CM_ SG_ 3221225472 Bus1PhaseABLineLineACRMSVoltage "Line to Line RMS voltage measured at bus #1 phase AB.";
CM_ SG_ 3221225472 Bus1_GeneratorACPhaseDifference "The phase difference between the Bus #1 voltage and Generator voltage.";
CM_ SG_ 3221225472 Bus1_GeneratorInSync "Indicator of whether Bus #1 and Generator are properly synchronized for paralleling. This indicator will be based on parameters such as Voltage Match, Frequency Match, and Phase Match.
00 Not synchronized
01 Synchronized
10 Error
11 Not ...";
CM_ SG_ 3221225472 Bus1_GeneratorVoltageMatch "Indicator of whether voltage difference between Bus #1 and Generator is adequate for paralleling. This indicator will be based on the measured AC voltages qualified using parameters such as Voltage Tolerance.
00 Voltages do not match
01 Voltages ...";
CM_ SG_ 3221225472 Bus1_GeneratorFrequencyMatch "Indicator of whether frequency difference between Bus #1 and Generator is adequate for paralleling. This indicator will be based on the measured AC frequencies qualified using parameters such as Frequency Tolerance, Phase Tolerance, and Dwell Time.
 ...";
CM_ SG_ 3221225472 Bus1_GeneratorPhaseMatch "Indicator of whether phase difference between Bus #1 and Generator is adequate for paralleling. This indicator will be based on the measured AC phase difference qualified using parameters such as Phase Tolerance and Dwell Time.
00 Phases do not ...";
CM_ SG_ 3221225472 Bus1_GeneratorDeadBus "Indicator of whether Bus #1 is considered dead for closing to the generator. This indicator will be based on parameters such as Bus #1 Voltage and dead bus threshold values.
00 Bus is not dead
01 Bus is dead
10 Error
11 Not Available or Not ...";
CM_ SG_ 3221225472 Bus1AverageACFrequency "Average AC frequency measured at bus #1.";
CM_ SG_ 3221225472 Bs1AvrgeLineNeutralACRMSVoltage "The average Line to Neutral AC RMS voltage measured at bus #1 .";
CM_ SG_ 3221225472 Bus1AverageLineLineACRMSVoltage "Average Line to Line RMS voltage measured at bus #1 .";
CM_ SG_ 3221225472 AddressAssignment "This 8 bit field is the 9th byte of the data field of the Commanded Address message.  It contains the source address that is to be assigned to the CA that has the NAME corresponding to the one conveyed in the first eight bytes of this Commanded ...";
CM_ SG_ 3221225472 ReservedBit "Reserved for future definition by SAE. The reserved bit shall be set to zero.";
CM_ SG_ 3221225472 ShrtNameOfActualReportingDevice "Subset of the 64-bit NAME (SPN 2848), consisting of the most significant 32 bits, which identifies the controller application.  It excludes the manufacturer code and identity number.  It is sometimes used to identify a device for instance in the ...";
CM_ SG_ 3221225472 LengthOfDataForTheReportedPGN "Length of data reported with the associated PGN via the Transfer PGN.";
CM_ SG_ 3221225472 PGNofRequstedInformation "PGN associated with this transfer message";
CM_ SG_ 3221225472 SequenceNumber "Sequence Number (TP.DT)";
CM_ SG_ 3221225472 TotalNumberOfPacketsEoMA "Total number of packets received for RTS/CTS message.  Zero and one are not valid values.";
CM_ SG_ 3221225472 TotalMessageSizeEoMA "Total message size (in bytes) received for RTS/CTS message.  Messages shorter than 9 data bytes should be sent without utilizing the transport protocol.  Messages longer than 1785 can not use the RTS/CTS transport protocol.";
CM_ SG_ 3221225472 TotalMessageSizeBAM "Total message size (in bytes) for BAM  message.  Messages shorter than 9 data bytes should be sent without utilizing the transport protocol.  Messages longer than 1785 can not use the BAM transport protocol.";
CM_ SG_ 3221225472 TotalNumberOfPacketsBAM "Total number of packets for BAM message.  Zero and one are not valid values.";
CM_ SG_ 3221225472 ConnectionAbortReason "Reason for connection abort message.
1 Already in one or more connection managed sessions and cannot support another.
2 System resources were needed for another task so this connection managed session was terminated.
3 A timeout occurred and this ...";
CM_ SG_ 3221225472 NextPacketNumberToBeSent "Next Packet Number to be sent (TP.CM_CTS)";
CM_ SG_ 3221225472 NumOfPacketsThatCanBeSent "Number of Packets that can be sent (TP.CM_CTS)";
CM_ SG_ 3221225472 PGNumber "Requested PGN in the TP.CM_RTS message";
CM_ SG_ 3221225472 MaximumNumberOfPackets "Maximum number of packets for RTS/CTS message.  zero through four are not allowed";
CM_ SG_ 3221225472 TotalNumberOfPackets "Total number of packets for RTS/CTS message.  Zero and one are not valid values.";
CM_ SG_ 3221225472 TotalMessageSize "Total message size (in bytes) for RTS/CTS message.  Messages shorter than 9 data bytes should be sent without utilizing the transport protocol.  Messages longer than 1785 can not use the RTS/CTS transport protocol.";
CM_ SG_ 3221225472 ControlByte "Control byte (I.e. Group Function) associated with the Transport Protocol - Connection Management (PGN 60,416)
16 (dec) - Request to Send
17 (dec) - Clear to Send
19 (dec) - End of Message ACK
32 (dec) - Broadcast Announce Message
255 (dec) - ...";
CM_ SG_ 3221225472 ParameterGroupNumber "PGN which is requested by Request2 message";
CM_ SG_ 3221225472 UseTransferMode "Requester is to respond the Request 2 message via the Transfer PGN

00 No
01 Yes
10 Undefined
11 NA";
CM_ SG_ 3221225472 ParameterGroupNumber "Whenever it is necessary to identify a Parameter Group in the data field of a CAN data frame, it will be expressed in 24 bits.  The Parameter Group Number is a 24 bit value that has the following constituent components:  Reserved bit, Data Page bit, ...";
CM_ SG_ 3221225472 AdditionalAxleGroupLocation "Location of the axle group, listed from front of the vehicle to rear.  If the value of SPN 4073 is 15, then this SPN is used to indicate the axle group referred to by this PGN. Otherwise, this SPN should be broadcast as 15.
0 = Reserved
1 = Rear ...";
CM_ SG_ 3221225472 AxleGroupWeight "Total mass imposed on the road surface by all the tires in the axle group";
CM_ SG_ 3221225472 AxleGroupLocation "Specific axle group used in conjunction with and when communicating the axle group weight, listed from the front of the vehicle to the rear.
If the value of SPN 5935 is 15, then this SPN is used to indicate the axle group referred to by this PGN ...";
CM_ SG_ 3221225472 AdditionalAxleGroupLocation "Location of the axle group, listed from front of the vehicle to rear.  If the value of SPN 4074 is 15, then this SPN is used to indicate the axle group referred to by this PGN. Otherwise, this SPN should be broadcast as 15.
0 = Reserved
1 = Rear ...";
CM_ SG_ 3221225472 AxleGroupFullWeightCalib "The full weight calibration measurement of an axle group";
CM_ SG_ 3221225472 AxleGroupEmptyWeightCalib "The empty weight calibration measurement of an axle group";
CM_ SG_ 3221225472 AxleGroupLocation "Specific axle group used in conjunction with and when communicating the axle group calibration, listed from the front of the vehicle to the rear.
If the value of SPN 5936 is 15, then this SPN is used to indicate the axle group referred to by this ...";
CM_ SG_ 3221225472 EngChrgeAirCoolerBypassValve2Cmd "Desired percentage of charge air cooler Bypass Valve 2 opening. 0% means no air is bypassed. 100% means full bypass capacity.";
CM_ SG_ 3221225472 EngChrgeAirCoolerBypassValve1Cmd "Desired percentage of charge air cooler Bypass Valve 1 opening. 0% means no air is bypassed. 100% means full bypass capacity.";
CM_ SG_ 3221225472 DsrdAftrclrClntThermostatOpening "Used to transmit the desired position of the low temperature aftercooler temperature control valve.  0% represents the thermostat allows flow to completely bypass the aftercooler and 100% represents the flow is fully through the aftercooler.   If ...";
CM_ SG_ 3221225472 DsrdAftercoolerCoolantIntakeTemp "Indicates the desired temperature of the fluid in the low temperature aftercooler circuit to an electronic thermostat.  If the aftercooler coolant thermostat valve is operating in position control mode (see SPN 4198) then this value should be 0xFF.";
CM_ SG_ 3221225472 AftercoolerCoolantThermostatMode "Specifies if the aftercooler coolant thermostat valve will operate in temperature control mode or position control mode.

00 = temperature control mode
01 = position control mode (used for service only)
10 = reserved
11 = don't care/reserved";
CM_ SG_ 3221225472 RarDriveAxleGroupWeightAvailable "Indicates if a second (or rear) drive axle group weight is available.
00 = Rear drive axle group not present
01 = Rear drive axle group present
10 = Reserved
11 = Not available / not applicable
Note:  If there is only one drive axle, use SPN ...";
CM_ SG_ 3221225472 RarSteerAxleGroupWeightAvailable "Indicates if a second (or rear) steer axle group weight is available.
00 = Rear Steer axle group not present
01 = Rear Steer axle group present
10 = Reserved
11 = Not available / not applicable
Note:  If there is only one steer axle, use SPN ...";
CM_ SG_ 3221225472 AddtnlTrlrAxlGrupWeightAvailable "Indicates the availability of the additional trailer axle group for purposes of weight measurement

00 = Additional trailer axle group not present
01 = Additional trailer axle group present
10 = Reserved
11 = Not available / not applicable";
CM_ SG_ 3221225472 TrailerHAxleGroupWeightAvailable "Indicates the availability of the trailer H axle group for purposes of weight measurement

00 = Trailer H axle group not present
01 = Trailer H axle group present
10 = Reserved
11 = Not available / not applicable";
CM_ SG_ 3221225472 TrailerGAxleGroupWeightAvailable "Indicates the availability of the trailer G axle group for purposes of weight measurement

00 = Trailer G axle group not present
01 = Trailer G axle group present
10 = Reserved
11 = Not available / not applicable";
CM_ SG_ 3221225472 TrailerFAxleGroupWeightAvailable "Indicates the availability of the trailer F axle group for purposes of weight measurement

00 = Trailer F axle group not present
01 = Trailer F axle group present
10 = Reserved
11 = Not available / not applicable";
CM_ SG_ 3221225472 TrailerEAxleGroupWeightAvailable "Indicates the availability of the trailer E axle group for purposes of weight measurement

00 = Trailer E axle group not present
01 = Trailer E axle group present
10 = Reserved
11 = Not available / not applicable";
CM_ SG_ 3221225472 TrailerDAxleGroupWeightAvailable "Indicates the availability of the trailer D axle group for purposes of weight measurement

00 = Trailer D axle group not present
01 = Trailer D axle group present
10 = Reserved
11 = Not available / not applicable";
CM_ SG_ 3221225472 TrailerCAxleGroupWeightAvailable "Indicates the availability of the trailer C axle group for purposes of weight measurement

00 = Trailer C axle group not present
01 = Trailer C axle group present
10 = Reserved
11 = Not available / not applicable";
CM_ SG_ 3221225472 TrailerBAxleGroupWeightAvailable "Indicates the availability of the trailer B axle group for purposes of weight measurement

00 = Trailer B axle group not present
01 = Trailer B axle group present
10 = Reserved
11 = Not available / not applicable";
CM_ SG_ 3221225472 TrailerAAxleGroupWeightAvailable "Indicates the availability of the trailer A axle group for purposes of weight measurement

00 = Trailer A axle group not present
01 = Trailer A axle group present
10 = Reserved
11 = Not available / not applicable";
CM_ SG_ 3221225472 AddtnlTrctrAxlGrpWeightAvailable "Indicates the availability of the additional tractor axle group for purposes of weight measurement

00 = Additional tractor axle group not present
01 = Additional tractor axle group present
10 = Reserved
11 = Not available / not applicable";
CM_ SG_ 3221225472 TagAxleGroupWeightAvailable "Indicates the availability of the tag axle group for purposes of weight measurement

00 = Tag axle group not present
01 = Tag axle group present
10 = Reserved
11 = Not available / not applicable";
CM_ SG_ 3221225472 DriveAxleGroupWeightAvailable "Indicates the availability of the sole or forward-most drive axle group for purposes of weight measurement
00 = Drive axle group not present
01 = Drive axle group present
10 = Reserved
11 = Not available / not applicable
If there is only one ...";
CM_ SG_ 3221225472 LiftAxleGroupWeightAvailable "Indicates the availability of the lift axle group for purposes of weight measurement

00 = Lift axle group not present
01 = Lift axle group present
10 = Reserved
11 = Not available / not applicable";
CM_ SG_ 3221225472 SteerAxleGroupWeightAvailable "Indicates the availability of the sole or forward-most steer axle group for purposes of weight measurement
00 = Steer axle group not present
01 = Steer axle group present
10 = Reserved
11 = Not available / not applicable
If there is only one ...";
CM_ SG_ 3221225472 ZeroNetVehicleWeightChange "Zero Net Vehicle Weight Change command.  A controller receiving this command will record the current Gross Combination Weight as the new Zero, and future requests for Net Vehicle Weight Change will be answered with the difference between the (then) ...";
CM_ SG_ 3221225472 EngExhaustGasTempAverageBank2 "The calculated average temperature based upon all of the Bank 2 (right bank) engine exhaust port temperatures.  This is the average temperature based upon the exhaust port temperature measurements of each of the engine cylinders on the right bank ...";
CM_ SG_ 3221225472 EngExhaustGasTempAverageBank1 "The calculated average temperature based upon all of the Bank 1 (left bank) engine exhaust port temperatures.  This is the average temperature based upon the exhaust port temperature measurements of each of the engine cylinders on the left bank ...";
CM_ SG_ 3221225472 EngExhaustGasTempAverage "The calculated average temperature based upon all of the engine exhaust port temperatures.  This is the average temperature based upon the exhaust port temperature measurements at each of the engine cylinders.
Notes:
Use SPN 173 - Engine Exhaust ...";
CM_ SG_ 3221225472 AETCTorqueValue14 "Engine torque value of the data points in PGN 64912 – Advertised Engine Torque Curve (AETC).";
CM_ SG_ 3221225472 AETCTorqueValue13 "Engine torque value of the data points in PGN 64912 – Advertised Engine Torque Curve (AETC).";
CM_ SG_ 3221225472 AETCTorqueValue12 "Engine torque value of the data points in PGN 64912 – Advertised Engine Torque Curve (AETC).";
CM_ SG_ 3221225472 AETCTorqueValue11 "Engine torque value of the data points in PGN 64912 – Advertised Engine Torque Curve (AETC).";
CM_ SG_ 3221225472 AETCTorqueValue10 "Engine torque value of the data points in PGN 64912 – Advertised Engine Torque Curve (AETC).";
CM_ SG_ 3221225472 AETCTorqueValue09 "Engine torque value of the data points in PGN 64912 – Advertised Engine Torque Curve (AETC).";
CM_ SG_ 3221225472 AETCTorqueValue08 "Engine torque value of the data points in PGN 64912 – Advertised Engine Torque Curve (AETC).";
CM_ SG_ 3221225472 AETCTorqueValue07 "Engine torque value of the data points in PGN 64912 – Advertised Engine Torque Curve (AETC).";
CM_ SG_ 3221225472 AETCTorqueValue06 "Engine torque value of the data points in PGN 64912 – Advertised Engine Torque Curve (AETC).";
CM_ SG_ 3221225472 AETCTorqueValue05 "Engine torque value of the data points in PGN 64912 – Advertised Engine Torque Curve (AETC).";
CM_ SG_ 3221225472 AETCTorqueValue04 "Engine torque value of the data points in PGN 64912 – Advertised Engine Torque Curve (AETC).";
CM_ SG_ 3221225472 AETCTorqueValue03 "Engine torque value of the data points in PGN 64912 – Advertised Engine Torque Curve (AETC).";
CM_ SG_ 3221225472 AETCTorqueValue02 "Engine torque value of the data points in PGN 64912 – Advertised Engine Torque Curve (AETC).";
CM_ SG_ 3221225472 AETCTorqueValue01 "Engine torque value of the data points in PGN 64912 – Advertised Engine Torque Curve (AETC).";
CM_ SG_ 3221225472 AETCSpeedValue14 "Engine speed value of the data points in PGN 64912 – Advertised Engine Torque Curve (AETC).";
CM_ SG_ 3221225472 AETCSpeedValue13 "Engine speed value of the data points in PGN 64912 – Advertised Engine Torque Curve (AETC).";
CM_ SG_ 3221225472 AETCSpeedValue12 "Engine speed value of the data points in PGN 64912 – Advertised Engine Torque Curve (AETC).";
CM_ SG_ 3221225472 AETCSpeedValue11 "Engine speed value of the data points in PGN 64912 – Advertised Engine Torque Curve (AETC).";
CM_ SG_ 3221225472 AETCSpeedValue10 "Engine speed value of the data points in PGN 64912 – Advertised Engine Torque Curve (AETC).";
CM_ SG_ 3221225472 AETCSpeedValue09 "Engine speed value of the data points in PGN 64912 – Advertised Engine Torque Curve (AETC).";
CM_ SG_ 3221225472 AETCSpeedValue08 "Engine speed value of the data points in PGN 64912 – Advertised Engine Torque Curve (AETC).";
CM_ SG_ 3221225472 AETCSpeedValue07 "Engine speed value of the data points in PGN 64912 – Advertised Engine Torque Curve (AETC).";
CM_ SG_ 3221225472 AETCSpeedValue06 "Engine speed value of the data points in PGN 64912 – Advertised Engine Torque Curve (AETC).";
CM_ SG_ 3221225472 AETCSpeedValue05 "Engine speed value of the data points in PGN 64912 – Advertised Engine Torque Curve (AETC).";
CM_ SG_ 3221225472 AETCSpeedValue04 "Engine speed value of the data points in PGN 64912 – Advertised Engine Torque Curve (AETC).";
CM_ SG_ 3221225472 AETCSpeedValue03 "Engine speed value of the data points in PGN 64912 – Advertised Engine Torque Curve (AETC).";
CM_ SG_ 3221225472 AETCSpeedValue02 "Engine speed value of the data points in PGN 64912 – Advertised Engine Torque Curve (AETC).";
CM_ SG_ 3221225472 AETCSpeedValue01 "Engine speed value of the data points in PGN 64912 – Advertised Engine Torque Curve (AETC).";
CM_ SG_ 3221225472 AETCTorqueValue00 "Engine torque value of the data points in PGN 64912 – Advertised Engine Torque Curve (AETC).";
CM_ SG_ 3221225472 AETCSpeedValue00 "Engine speed value of the data points in PGN 64912 – Advertised Engine Torque Curve (AETC).";
CM_ SG_ 3221225472 NumberOfAETCDataPoints "Indicates the number of speed / torque data points contained in the Advertised Engine Torque Curve broadcast (AETC).  A minimum of 5 points is required, with a maximum of 15 points available as needed to accurately convey the curve.";
CM_ SG_ 3221225472 AETCDataCollectionStandard "Indicates the standardized method by which torque data was obtained for the Advertised Engine Torque Curve (AETC).  For example, in North America, heavy duty diesel engine specifications are typically based on SAE J1995.  Other applicable SAE, ISO, ...";
CM_ SG_ 3221225472 RightHeadlampLightDistribution "This parameter indicates what kind of light distribution is set by the AFS system for the right headlamp.
0000   Light distribution town - The basic light distribution for town light is generated with a symmetrical cut-off line (Class V)
0001 ...";
CM_ SG_ 3221225472 LeftHeadlampLightDistribution "This parameter indicates what kind of light distribution is set by the AFS system for the left headlamp.
0000   Light distribution town - The basic light distribution for town light is generated with a symmetrical cut-off line (Class V)
0001 ...";
CM_ SG_ 3221225472 RightHeadlampDynamicBendingLight "This parameter indicates whether the dynamic bending light of the left headlamp is working properly.
000   Dynamic bending light deactivated.  There is no problem but for some reasons (e.g. daylight present) the bending light is deactivated.
001 ...";
CM_ SG_ 3221225472 LeftHeadlampDynamicBendingLight "This parameter indicates whether the dynamic bending light of the left headlamp is working properly.
000   Dynamic bending light deactivated.  There is no problem but for some reasons (e.g. daylight present) the bending light is deactivated.
001 ...";
CM_ SG_ 3221225472 AuxI_OChannel2 "Auxiliary channel of data (16 bit) read by the ECU.  This data is in A/D counts and is manufacturer specific.  It may be configured uniquely per application.";
CM_ SG_ 3221225472 AuxI_OChannel1 "Auxiliary channel of data (16 bit) read by the ECU.  This data is in A/D counts and is manufacturer specific.  It may be configured uniquely per application.";
CM_ SG_ 3221225472 AuxI_O13 "Identifies the current status of auxiliary input/output functions that are configured uniquely per application.

00 - Auxiliary channel off
01 - Auxiliary channel on
10 - Error
11 - Not available";
CM_ SG_ 3221225472 AuxI_O14 "Identifies the current status of auxiliary input/output functions that are configured uniquely per application.

00 - Auxiliary channel off
01 - Auxiliary channel on
10 - Error
11 - Not available";
CM_ SG_ 3221225472 AuxI_O15 "Identifies the current status of auxiliary input/output functions that are configured uniquely per application.

00 - Auxiliary channel off
01 - Auxiliary channel on
10 - Error
11 - Not available";
CM_ SG_ 3221225472 AuxI_O16 "Identifies the current status of auxiliary input/output functions that are configured uniquely per application.

00 - Auxiliary channel off
01 - Auxiliary channel on
10 - Error
11 - Not available";
CM_ SG_ 3221225472 AuxI_O09 "Identifies the current status of auxiliary input/output functions that are configured uniquely per application.

00 - Auxiliary channel off
01 - Auxiliary channel on
10 - Error
11 - Not available";
CM_ SG_ 3221225472 AuxI_O10 "Identifies the current status of auxiliary input/output functions that are configured uniquely per application.

00 - Auxiliary channel off
01 - Auxiliary channel on
10 - Error
11 - Not available";
CM_ SG_ 3221225472 AuxI_O11 "Identifies the current status of auxiliary input/output functions that are configured uniquely per application.

00 - Auxiliary channel off
01 - Auxiliary channel on
10 - Error
11 - Not available";
CM_ SG_ 3221225472 AuxI_O12 "Identifies the current status of auxiliary input/output functions that are configured uniquely per application.

00 - Auxiliary channel off
01 - Auxiliary channel on
10 - Error
11 - Not available";
CM_ SG_ 3221225472 AuxI_O05 "Identifies the current status of auxiliary input/output functions that are configured uniquely per application.

00 - Auxiliary channel off
01 - Auxiliary channel on
10 - Error
11 - Not available";
CM_ SG_ 3221225472 AuxI_O06 "Identifies the current status of auxiliary input/output functions that are configured uniquely per application.

00 - Auxiliary channel off
01 - Auxiliary channel on
10 - Error
11 - Not available";
CM_ SG_ 3221225472 AuxI_O07 "Identifies the current status of auxiliary input/output functions that are configured uniquely per application.

00 - Auxiliary channel off
01 - Auxiliary channel on
10 - Error
11 - Not available";
CM_ SG_ 3221225472 AuxI_O08 "Identifies the current status of auxiliary input/output functions that are configured uniquely per application.

00 - Auxiliary channel off
01 - Auxiliary channel on
10 - Error
11 - Not available";
CM_ SG_ 3221225472 AuxI_O01 "Identifies the current status of auxiliary input/output functions that are configured uniquely per application.

00 - Auxiliary channel off
01 - Auxiliary channel on
10 - Error
11 - Not available";
CM_ SG_ 3221225472 AuxI_O02 "Identifies the current status of auxiliary input/output functions that are configured uniquely per application.

00 - Auxiliary channel off
01 - Auxiliary channel on
10 - Error
11 - Not available";
CM_ SG_ 3221225472 AuxI_O03 "Identifies the current status of auxiliary input/output functions that are configured uniquely per application.

00 - Auxiliary channel off
01 - Auxiliary channel on
10 - Error
11 - Not available";
CM_ SG_ 3221225472 AuxI_O04 "Identifies the current status of auxiliary input/output functions that are configured uniquely per application.

00 - Auxiliary channel off
01 - Auxiliary channel on
10 - Error
11 - Not available";
CM_ SG_ 3221225472 AuxI_O45 "Identifies the current status of auxiliary input/output functions that are configured uniquely per application.
00 - Auxiliary channel off
01 - Auxiliary channel on
10 - Error Indicator or Not Used , depending on application
11 - Not Available ...";
CM_ SG_ 3221225472 AuxI_O46 "Identifies the current status of auxiliary input/output functions that are configured uniquely per application.
00 - Auxiliary channel off
01 - Auxiliary channel on
10 - Error Indicator or Not Used , depending on application
11 - Not Available ...";
CM_ SG_ 3221225472 AuxI_O47 "Identifies the current status of auxiliary input/output functions that are configured uniquely per application.
00 - Auxiliary channel off
01 - Auxiliary channel on
10 - Error Indicator or Not Used , depending on application
11 - Not Available ...";
CM_ SG_ 3221225472 AuxI_O48 "Identifies the current status of auxiliary input/output functions that are configured uniquely per application.
00 - Auxiliary channel off
01 - Auxiliary channel on
10 - Error Indicator or Not Used , depending on application
11 - Not Available ...";
CM_ SG_ 3221225472 AuxI_O41 "Identifies the current status of auxiliary input/output functions that are configured uniquely per application.
00 - Auxiliary channel off
01 - Auxiliary channel on
10 - Error Indicator or Not Used , depending on application
11 - Not Available ...";
CM_ SG_ 3221225472 AuxI_O42 "Identifies the current status of auxiliary input/output functions that are configured uniquely per application.
00 - Auxiliary channel off
01 - Auxiliary channel on
10 - Error Indicator or Not Used , depending on application
11 - Not Available ...";
CM_ SG_ 3221225472 AuxI_O43 "Identifies the current status of auxiliary input/output functions that are configured uniquely per application.
00 - Auxiliary channel off
01 - Auxiliary channel on
10 - Error Indicator or Not Used , depending on application
11 - Not Available ...";
CM_ SG_ 3221225472 AuxI_O44 "Identifies the current status of auxiliary input/output functions that are configured uniquely per application.
00 - Auxiliary channel off
01 - Auxiliary channel on
10 - Error Indicator or Not Used , depending on application
11 - Not Available ...";
CM_ SG_ 3221225472 AuxI_O37 "Identifies the current status of auxiliary input/output functions that are configured uniquely per application.
00 - Auxiliary channel off
01 - Auxiliary channel on
10 - Error Indicator or Not Used , depending on application
11 - Not Available ...";
CM_ SG_ 3221225472 AuxI_O38 "Identifies the current status of auxiliary input/output functions that are configured uniquely per application.
00 - Auxiliary channel off
01 - Auxiliary channel on
10 - Error Indicator or Not Used , depending on application
11 - Not Available ...";
CM_ SG_ 3221225472 AuxI_O39 "Identifies the current status of auxiliary input/output functions that are configured uniquely per application.
00 - Auxiliary channel off
01 - Auxiliary channel on
10 - Error Indicator or Not Used , depending on application
11 - Not Available ...";
CM_ SG_ 3221225472 AuxI_O40 "Identifies the current status of auxiliary input/output functions that are configured uniquely per application.
00 - Auxiliary channel off
01 - Auxiliary channel on
10 - Error Indicator or Not Used , depending on application
11 - Not Available ...";
CM_ SG_ 3221225472 AuxI_O33 "Identifies the current status of auxiliary input/output functions that are configured uniquely per application.
00 - Auxiliary channel off
01 - Auxiliary channel on
10 - Error Indicator or Not Used , depending on application
11 - Not Available ...";
CM_ SG_ 3221225472 AuxI_O34 "Identifies the current status of auxiliary input/output functions that are configured uniquely per application.
00 - Auxiliary channel off
01 - Auxiliary channel on
10 - Error Indicator or Not Used , depending on application
11 - Not Available ...";
CM_ SG_ 3221225472 AuxI_O35 "Identifies the current status of auxiliary input/output functions that are configured uniquely per application.
00 - Auxiliary channel off
01 - Auxiliary channel on
10 - Error Indicator or Not Used , depending on application
11 - Not Available ...";
CM_ SG_ 3221225472 AuxI_O36 "Identifies the current status of auxiliary input/output functions that are configured uniquely per application.
00 - Auxiliary channel off
01 - Auxiliary channel on
10 - Error Indicator or Not Used , depending on application
11 - Not Available ...";
CM_ SG_ 3221225472 AuxI_O29 "Identifies the current status of auxiliary input/output functions that are configured uniquely per application.
00 - Auxiliary channel off
01 - Auxiliary channel on
10 - Error Indicator or Not Used , depending on application
11 - Not Available ...";
CM_ SG_ 3221225472 AuxI_O30 "Identifies the current status of auxiliary input/output functions that are configured uniquely per application.
00 - Auxiliary channel off
01 - Auxiliary channel on
10 - Error Indicator or Not Used , depending on application
11 - Not Available ...";
CM_ SG_ 3221225472 AuxI_O31 "Identifies the current status of auxiliary input/output functions that are configured uniquely per application.
00 - Auxiliary channel off
01 - Auxiliary channel on
10 - Error Indicator or Not Used , depending on application
11 - Not Available ...";
CM_ SG_ 3221225472 AuxI_O32 "Identifies the current status of auxiliary input/output functions that are configured uniquely per application.
00 - Auxiliary channel off
01 - Auxiliary channel on
10 - Error Indicator or Not Used , depending on application
11 - Not Available ...";
CM_ SG_ 3221225472 AuxI_O25 "Identifies the current status of auxiliary input/output functions that are configured uniquely per application.
00 - Auxiliary channel off
01 - Auxiliary channel on
10 - Error Indicator or Not Used , depending on application
11 - Not Available ...";
CM_ SG_ 3221225472 AuxI_O26 "Identifies the current status of auxiliary input/output functions that are configured uniquely per application.
00 - Auxiliary channel off
01 - Auxiliary channel on
10 - Error Indicator or Not Used , depending on application
11 - Not Available ...";
CM_ SG_ 3221225472 AuxI_O27 "Identifies the current status of auxiliary input/output functions that are configured uniquely per application.
00 - Auxiliary channel off
01 - Auxiliary channel on
10 - Error Indicator or Not Used , depending on application
11 - Not Available ...";
CM_ SG_ 3221225472 AuxI_O28 "Identifies the current status of auxiliary input/output functions that are configured uniquely per application.
00 - Auxiliary channel off
01 - Auxiliary channel on
10 - Error Indicator or Not Used , depending on application
11 - Not Available ...";
CM_ SG_ 3221225472 AuxI_O21 "Identifies the current status of auxiliary input/output functions that are configured uniquely per application.
00 - Auxiliary channel off
01 - Auxiliary channel on
10 - Error Indicator or Not Used , depending on application
11 - Not Available ...";
CM_ SG_ 3221225472 AuxI_O22 "Identifies the current status of auxiliary input/output functions that are configured uniquely per application.
00 - Auxiliary channel off
01 - Auxiliary channel on
10 - Error Indicator or Not Used , depending on application
11 - Not Available ...";
CM_ SG_ 3221225472 AuxI_O23 "Identifies the current status of auxiliary input/output functions that are configured uniquely per application.
00 - Auxiliary channel off
01 - Auxiliary channel on
10 - Error Indicator or Not Used , depending on application
11 - Not Available ...";
CM_ SG_ 3221225472 AuxI_O24 "Identifies the current status of auxiliary input/output functions that are configured uniquely per application.
00 - Auxiliary channel off
01 - Auxiliary channel on
10 - Error Indicator or Not Used , depending on application
11 - Not Available ...";
CM_ SG_ 3221225472 AuxI_O17 "Identifies the current status of auxiliary input/output functions that are configured uniquely per application.
00 - Auxiliary channel off
01 - Auxiliary channel on
10 - Error Indicator or Not Used , depending on application
11 - Not Available ...";
CM_ SG_ 3221225472 AuxI_O18 "Identifies the current status of auxiliary input/output functions that are configured uniquely per application.
00 - Auxiliary channel off
01 - Auxiliary channel on
10 - Error Indicator or Not Used , depending on application
11 - Not Available ...";
CM_ SG_ 3221225472 AuxI_O19 "Identifies the current status of auxiliary input/output functions that are configured uniquely per application.
00 - Auxiliary channel off
01 - Auxiliary channel on
10 - Error Indicator or Not Used , depending on application
11 - Not Available ...";
CM_ SG_ 3221225472 AuxI_O20 "Identifies the current status of auxiliary input/output functions that are configured uniquely per application.
00 - Auxiliary channel off
01 - Auxiliary channel on
10 - Error Indicator or Not Used , depending on application
11 - Not Available ...";
CM_ SG_ 3221225472 AuxI_O77 "Identifies the current status of auxiliary input/output functions that are configured uniquely per application.
00 - Auxiliary channel off
01 - Auxiliary channel on
10 - Error Indicator or Not Used , depending on application
11 - Not Available ...";
CM_ SG_ 3221225472 AuxI_O78 "Identifies the current status of auxiliary input/output functions that are configured uniquely per application.
00 - Auxiliary channel off
01 - Auxiliary channel on
10 - Error Indicator or Not Used , depending on application
11 - Not Available ...";
CM_ SG_ 3221225472 AuxI_O79 "Identifies the current status of auxiliary input/output functions that are configured uniquely per application.
00 - Auxiliary channel off
01 - Auxiliary channel on
10 - Error Indicator or Not Used , depending on application
11 - Not Available ...";
CM_ SG_ 3221225472 AuxI_O80 "Identifies the current status of auxiliary input/output functions that are configured uniquely per application.
00 - Auxiliary channel off
01 - Auxiliary channel on
10 - Error Indicator or Not Used , depending on application
11 - Not Available ...";
CM_ SG_ 3221225472 AuxI_O73 "Identifies the current status of auxiliary input/output functions that are configured uniquely per application.
00 - Auxiliary channel off
01 - Auxiliary channel on
10 - Error Indicator or Not Used , depending on application
11 - Not Available ...";
CM_ SG_ 3221225472 AuxI_O74 "Identifies the current status of auxiliary input/output functions that are configured uniquely per application.
00 - Auxiliary channel off
01 - Auxiliary channel on
10 - Error Indicator or Not Used , depending on application
11 - Not Available ...";
CM_ SG_ 3221225472 AuxI_O75 "Identifies the current status of auxiliary input/output functions that are configured uniquely per application.
00 - Auxiliary channel off
01 - Auxiliary channel on
10 - Error Indicator or Not Used , depending on application
11 - Not Available ...";
CM_ SG_ 3221225472 AuxI_O76 "Identifies the current status of auxiliary input/output functions that are configured uniquely per application.
00 - Auxiliary channel off
01 - Auxiliary channel on
10 - Error Indicator or Not Used , depending on application
11 - Not Available ...";
CM_ SG_ 3221225472 AuxI_O69 "Identifies the current status of auxiliary input/output functions that are configured uniquely per application.
00 - Auxiliary channel off
01 - Auxiliary channel on
10 - Error Indicator or Not Used , depending on application
11 - Not Available ...";
CM_ SG_ 3221225472 AuxI_O70 "Identifies the current status of auxiliary input/output functions that are configured uniquely per application.
00 - Auxiliary channel off
01 - Auxiliary channel on
10 - Error Indicator or Not Used , depending on application
11 - Not Available ...";
CM_ SG_ 3221225472 AuxI_O71 "Identifies the current status of auxiliary input/output functions that are configured uniquely per application.
00 - Auxiliary channel off
01 - Auxiliary channel on
10 - Error Indicator or Not Used , depending on application
11 - Not Available ...";
CM_ SG_ 3221225472 AuxI_O72 "Identifies the current status of auxiliary input/output functions that are configured uniquely per application.
00 - Auxiliary channel off
01 - Auxiliary channel on
10 - Error Indicator or Not Used , depending on application
11 - Not Available ...";
CM_ SG_ 3221225472 AuxI_O65 "Identifies the current status of auxiliary input/output functions that are configured uniquely per application.
00 - Auxiliary channel off
01 - Auxiliary channel on
10 - Error Indicator or Not Used , depending on application
11 - Not Available ...";
CM_ SG_ 3221225472 AuxI_O66 "Identifies the current status of auxiliary input/output functions that are configured uniquely per application.
00 - Auxiliary channel off
01 - Auxiliary channel on
10 - Error Indicator or Not Used , depending on application
11 - Not Available ...";
CM_ SG_ 3221225472 AuxI_O67 "Identifies the current status of auxiliary input/output functions that are configured uniquely per application.
00 - Auxiliary channel off
01 - Auxiliary channel on
10 - Error Indicator or Not Used , depending on application
11 - Not Available ...";
CM_ SG_ 3221225472 AuxI_O68 "Identifies the current status of auxiliary input/output functions that are configured uniquely per application.
00 - Auxiliary channel off
01 - Auxiliary channel on
10 - Error Indicator or Not Used , depending on application
11 - Not Available ...";
CM_ SG_ 3221225472 AuxI_O61 "Identifies the current status of auxiliary input/output functions that are configured uniquely per application.
00 - Auxiliary channel off
01 - Auxiliary channel on
10 - Error Indicator or Not Used , depending on application
11 - Not Available ...";
CM_ SG_ 3221225472 AuxI_O62 "Identifies the current status of auxiliary input/output functions that are configured uniquely per application.
00 - Auxiliary channel off
01 - Auxiliary channel on
10 - Error Indicator or Not Used , depending on application
11 - Not Available ...";
CM_ SG_ 3221225472 AuxI_O63 "Identifies the current status of auxiliary input/output functions that are configured uniquely per application.
00 - Auxiliary channel off
01 - Auxiliary channel on
10 - Error Indicator or Not Used , depending on application
11 - Not Available ...";
CM_ SG_ 3221225472 AuxI_O64 "Identifies the current status of auxiliary input/output functions that are configured uniquely per application.
00 - Auxiliary channel off
01 - Auxiliary channel on
10 - Error Indicator or Not Used , depending on application
11 - Not Available ...";
CM_ SG_ 3221225472 AuxI_O57 "Identifies the current status of auxiliary input/output functions that are configured uniquely per application.
00 - Auxiliary channel off
01 - Auxiliary channel on
10 - Error Indicator or Not Used , depending on application
11 - Not Available ...";
CM_ SG_ 3221225472 AuxI_O58 "Identifies the current status of auxiliary input/output functions that are configured uniquely per application.
00 - Auxiliary channel off
01 - Auxiliary channel on
10 - Error Indicator or Not Used , depending on application
11 - Not Available ...";
CM_ SG_ 3221225472 AuxI_O59 "Identifies the current status of auxiliary input/output functions that are configured uniquely per application.
00 - Auxiliary channel off
01 - Auxiliary channel on
10 - Error Indicator or Not Used , depending on application
11 - Not Available ...";
CM_ SG_ 3221225472 AuxI_O60 "Identifies the current status of auxiliary input/output functions that are configured uniquely per application.
00 - Auxiliary channel off
01 - Auxiliary channel on
10 - Error Indicator or Not Used , depending on application
11 - Not Available ...";
CM_ SG_ 3221225472 AuxI_O53 "Identifies the current status of auxiliary input/output functions that are configured uniquely per application.
00 - Auxiliary channel off
01 - Auxiliary channel on
10 - Error Indicator or Not Used , depending on application
11 - Not Available ...";
CM_ SG_ 3221225472 AuxI_O54 "Identifies the current status of auxiliary input/output functions that are configured uniquely per application.
00 - Auxiliary channel off
01 - Auxiliary channel on
10 - Error Indicator or Not Used , depending on application
11 - Not Available ...";
CM_ SG_ 3221225472 AuxI_O55 "Identifies the current status of auxiliary input/output functions that are configured uniquely per application.
00 - Auxiliary channel off
01 - Auxiliary channel on
10 - Error Indicator or Not Used , depending on application
11 - Not Available ...";
CM_ SG_ 3221225472 AuxI_O56 "Identifies the current status of auxiliary input/output functions that are configured uniquely per application.
00 - Auxiliary channel off
01 - Auxiliary channel on
10 - Error Indicator or Not Used , depending on application
11 - Not Available ...";
CM_ SG_ 3221225472 AuxI_O49 "Identifies the current status of auxiliary input/output functions that are configured uniquely per application.
00 - Auxiliary channel off
01 - Auxiliary channel on
10 - Error Indicator or Not Used , depending on application
11 - Not Available ...";
CM_ SG_ 3221225472 AuxI_O50 "Identifies the current status of auxiliary input/output functions that are configured uniquely per application.
00 - Auxiliary channel off
01 - Auxiliary channel on
10 - Error Indicator or Not Used , depending on application
11 - Not Available ...";
CM_ SG_ 3221225472 AuxI_O51 "Identifies the current status of auxiliary input/output functions that are configured uniquely per application.
00 - Auxiliary channel off
01 - Auxiliary channel on
10 - Error Indicator or Not Used , depending on application
11 - Not Available ...";
CM_ SG_ 3221225472 AuxI_O52 "Identifies the current status of auxiliary input/output functions that are configured uniquely per application.
00 - Auxiliary channel off
01 - Auxiliary channel on
10 - Error Indicator or Not Used , depending on application
11 - Not Available ...";
CM_ SG_ 3221225472 AuxI_O109 "Identifies the current status of auxiliary input/output functions that are configured uniquely per application.
00 - Auxiliary channel off
01 - Auxiliary channel on
10 - Error Indicator or Not Used , depending on application
11 - Not Available ...";
CM_ SG_ 3221225472 AuxI_O110 "Identifies the current status of auxiliary input/output functions that are configured uniquely per application.
00 - Auxiliary channel off
01 - Auxiliary channel on
10 - Error Indicator or Not Used , depending on application
11 - Not Available ...";
CM_ SG_ 3221225472 AuxI_O111 "Identifies the current status of auxiliary input/output functions that are configured uniquely per application.
00 - Auxiliary channel off
01 - Auxiliary channel on
10 - Error Indicator or Not Used , depending on application
11 - Not Available ...";
CM_ SG_ 3221225472 AuxI_O112 "Identifies the current status of auxiliary input/output functions that are configured uniquely per application.
00 - Auxiliary channel off
01 - Auxiliary channel on
10 - Error Indicator or Not Used , depending on application
11 - Not Available ...";
CM_ SG_ 3221225472 AuxI_O105 "Identifies the current status of auxiliary input/output functions that are configured uniquely per application.
00 - Auxiliary channel off
01 - Auxiliary channel on
10 - Error Indicator or Not Used , depending on application
11 - Not Available ...";
CM_ SG_ 3221225472 AuxI_O106 "Identifies the current status of auxiliary input/output functions that are configured uniquely per application.
00 - Auxiliary channel off
01 - Auxiliary channel on
10 - Error Indicator or Not Used , depending on application
11 - Not Available ...";
CM_ SG_ 3221225472 AuxI_O107 "Identifies the current status of auxiliary input/output functions that are configured uniquely per application.
00 - Auxiliary channel off
01 - Auxiliary channel on
10 - Error Indicator or Not Used , depending on application
11 - Not Available ...";
CM_ SG_ 3221225472 AuxI_O108 "Identifies the current status of auxiliary input/output functions that are configured uniquely per application.
00 - Auxiliary channel off
01 - Auxiliary channel on
10 - Error Indicator or Not Used , depending on application
11 - Not Available ...";
CM_ SG_ 3221225472 AuxI_O101 "Identifies the current status of auxiliary input/output functions that are configured uniquely per application.
00 - Auxiliary channel off
01 - Auxiliary channel on
10 - Error Indicator or Not Used , depending on application
11 - Not Available ...";
CM_ SG_ 3221225472 AuxI_O102 "Identifies the current status of auxiliary input/output functions that are configured uniquely per application.
00 - Auxiliary channel off
01 - Auxiliary channel on
10 - Error Indicator or Not Used , depending on application
11 - Not Available ...";
CM_ SG_ 3221225472 AuxI_O103 "Identifies the current status of auxiliary input/output functions that are configured uniquely per application.
00 - Auxiliary channel off
01 - Auxiliary channel on
10 - Error Indicator or Not Used , depending on application
11 - Not Available ...";
CM_ SG_ 3221225472 AuxI_O104 "Identifies the current status of auxiliary input/output functions that are configured uniquely per application.
00 - Auxiliary channel off
01 - Auxiliary channel on
10 - Error Indicator or Not Used , depending on application
11 - Not Available ...";
CM_ SG_ 3221225472 AuxI_O97 "Identifies the current status of auxiliary input/output functions that are configured uniquely per application.
00 - Auxiliary channel off
01 - Auxiliary channel on
10 - Error Indicator or Not Used , depending on application
11 - Not Available ...";
CM_ SG_ 3221225472 AuxI_O98 "Identifies the current status of auxiliary input/output functions that are configured uniquely per application.
00 - Auxiliary channel off
01 - Auxiliary channel on
10 - Error Indicator or Not Used , depending on application
11 - Not Available ...";
CM_ SG_ 3221225472 AuxI_O99 "Identifies the current status of auxiliary input/output functions that are configured uniquely per application.
00 - Auxiliary channel off
01 - Auxiliary channel on
10 - Error Indicator or Not Used , depending on application
11 - Not Available ...";
CM_ SG_ 3221225472 AuxI_O100 "Identifies the current status of auxiliary input/output functions that are configured uniquely per application.
00 - Auxiliary channel off
01 - Auxiliary channel on
10 - Error Indicator or Not Used , depending on application
11 - Not Available ...";
CM_ SG_ 3221225472 AuxI_O93 "Identifies the current status of auxiliary input/output functions that are configured uniquely per application.
00 - Auxiliary channel off
01 - Auxiliary channel on
10 - Error Indicator or Not Used , depending on application
11 - Not Available ...";
CM_ SG_ 3221225472 AuxI_O94 "Identifies the current status of auxiliary input/output functions that are configured uniquely per application.
00 - Auxiliary channel off
01 - Auxiliary channel on
10 - Error Indicator or Not Used , depending on application
11 - Not Available ...";
CM_ SG_ 3221225472 AuxI_O95 "Identifies the current status of auxiliary input/output functions that are configured uniquely per application.
00 - Auxiliary channel off
01 - Auxiliary channel on
10 - Error Indicator or Not Used , depending on application
11 - Not Available ...";
CM_ SG_ 3221225472 AuxI_O96 "Identifies the current status of auxiliary input/output functions that are configured uniquely per application.
00 - Auxiliary channel off
01 - Auxiliary channel on
10 - Error Indicator or Not Used , depending on application
11 - Not Available ...";
CM_ SG_ 3221225472 AuxI_O89 "Identifies the current status of auxiliary input/output functions that are configured uniquely per application.
00 - Auxiliary channel off
01 - Auxiliary channel on
10 - Error Indicator or Not Used , depending on application
11 - Not Available ...";
CM_ SG_ 3221225472 AuxI_O90 "Identifies the current status of auxiliary input/output functions that are configured uniquely per application.
00 - Auxiliary channel off
01 - Auxiliary channel on
10 - Error Indicator or Not Used , depending on application
11 - Not Available ...";
CM_ SG_ 3221225472 AuxI_O91 "Identifies the current status of auxiliary input/output functions that are configured uniquely per application.
00 - Auxiliary channel off
01 - Auxiliary channel on
10 - Error Indicator or Not Used , depending on application
11 - Not Available ...";
CM_ SG_ 3221225472 AuxI_O92 "Identifies the current status of auxiliary input/output functions that are configured uniquely per application.
00 - Auxiliary channel off
01 - Auxiliary channel on
10 - Error Indicator or Not Used , depending on application
11 - Not Available ...";
CM_ SG_ 3221225472 AuxI_O85 "Identifies the current status of auxiliary input/output functions that are configured uniquely per application.
00 - Auxiliary channel off
01 - Auxiliary channel on
10 - Error Indicator or Not Used , depending on application
11 - Not Available ...";
CM_ SG_ 3221225472 AuxI_O86 "Identifies the current status of auxiliary input/output functions that are configured uniquely per application.
00 - Auxiliary channel off
01 - Auxiliary channel on
10 - Error Indicator or Not Used , depending on application
11 - Not Available ...";
CM_ SG_ 3221225472 AuxI_O87 "Identifies the current status of auxiliary input/output functions that are configured uniquely per application.
00 - Auxiliary channel off
01 - Auxiliary channel on
10 - Error Indicator or Not Used , depending on application
11 - Not Available ...";
CM_ SG_ 3221225472 AuxI_O88 "Identifies the current status of auxiliary input/output functions that are configured uniquely per application.
00 - Auxiliary channel off
01 - Auxiliary channel on
10 - Error Indicator or Not Used , depending on application
11 - Not Available ...";
CM_ SG_ 3221225472 AuxI_O81 "Identifies the current status of auxiliary input/output functions that are configured uniquely per application.
00 - Auxiliary channel off
01 - Auxiliary channel on
10 - Error Indicator or Not Used , depending on application
11 - Not Available ...";
CM_ SG_ 3221225472 AuxI_O82 "Identifies the current status of auxiliary input/output functions that are configured uniquely per application.
00 - Auxiliary channel off
01 - Auxiliary channel on
10 - Error Indicator or Not Used , depending on application
11 - Not Available ...";
CM_ SG_ 3221225472 AuxI_O83 "Identifies the current status of auxiliary input/output functions that are configured uniquely per application.
00 - Auxiliary channel off
01 - Auxiliary channel on
10 - Error Indicator or Not Used , depending on application
11 - Not Available ...";
CM_ SG_ 3221225472 AuxI_O84 "Identifies the current status of auxiliary input/output functions that are configured uniquely per application.
00 - Auxiliary channel off
01 - Auxiliary channel on
10 - Error Indicator or Not Used , depending on application
11 - Not Available ...";
CM_ SG_ 3221225472 TrailerBrakeStrokeAxle5Right "Brake stroke status for right brake actuator on trailer axle 5.

000 - OK (Normal operation)
001 - Non-functioning
010 - Overstroke
011 - Dragging brake
100 - Reserved
101 - Reserved
110 - Sensor error
111 - Not available";
CM_ SG_ 3221225472 TrailerBrakeStrokeAxle5Left "Brake stroke status for left brake actuator on trailer axle 5.

000 - OK (Normal operation)
001 - Non-functioning
010 - Overstroke
011 - Dragging brake
100 - Reserved
101 - Reserved
110 - Sensor error
111 - Not available";
CM_ SG_ 3221225472 TrailerBrakeStrokeAxle4Right "Brake stroke status for right brake actuator on trailer axle 4.

000 - OK (Normal operation)
001 - Non-functioning
010 - Overstroke
011 - Dragging brake
100 - Reserved
101 - Reserved
110 - Sensor error
111 - Not available";
CM_ SG_ 3221225472 TrailerBrakeStrokeAxle4Left "Brake stroke status for left brake actuator on trailer axle 4.

000 - OK (Normal operation)
001 - Non-functioning
010 - Overstroke
011 - Dragging brake
100 - Reserved
101 - Reserved
110 - Sensor error
111 - Not available";
CM_ SG_ 3221225472 TrailerBrakeStrokeAxle3Right "Brake stroke status for right brake actuator on trailer axle 3.

000 - OK (Normal operation)
001 - Non-functioning
010 - Overstroke
011 - Dragging brake
100 - Reserved
101 - Reserved
110 - Sensor error
111 - Not available";
CM_ SG_ 3221225472 TrailerBrakeStrokeAxle3Left "Brake stroke status for left brake actuator on trailer axle 3.

000 - OK (Normal operation)
001 - Non-functioning
010 - Overstroke
011 - Dragging brake
100 - Reserved
101 - Reserved
110 - Sensor error
111 - Not available";
CM_ SG_ 3221225472 TrailerBrakeStrokeAxle2Right "Brake stroke status for right brake actuator on trailer axle 2.

000 - OK (Normal operation)
001 - Non-functioning
010 - Overstroke
011 - Dragging brake
100 - Reserved
101 - Reserved
110 - Sensor error
111 - Not available";
CM_ SG_ 3221225472 TrailerBrakeStrokeAxle2Left "Brake stroke status for left brake actuator on trailer axle 2.

000 - OK (Normal operation)
001 - Non-functioning
010 - Overstroke
011 - Dragging brake
100 - Reserved
101 - Reserved
110 - Sensor error
111 - Not available";
CM_ SG_ 3221225472 TrailerBrakeStrokeAxle1Right "Brake stroke status for right brake actuator on trailer axle 1.

000 - OK (Normal operation)
001 - Non-functioning
010 - Overstroke
011 - Dragging brake
100 - Reserved
101 - Reserved
110 - Sensor error
111 - Not available";
CM_ SG_ 3221225472 TrailerBrakeStrokeAxle1Left "Brake stroke status for left brake actuator on trailerr axle 1.

000 - OK (Normal operation)
001 - Non-functioning
010 - Overstroke
011 - Dragging brake
100 - Reserved
101 - Reserved
110 - Sensor error
111 - Not available";
CM_ SG_ 3221225472 TractorBrakeStrokeAxle5Right "Brake stroke status for right brake actuator on tractor axle 5.

000 - OK (Normal operation)
001 - Non-functioning
010 - Overstroke
011 - Dragging brake
100 - Reserved
101 - Reserved
110 - Sensor error
111 - Not available";
CM_ SG_ 3221225472 TractorBrakeStrokeAxle5Left "Brake stroke status for left brake actuator on tractor axle 5.

000 - OK (Normal operation)
001 - Non-functioning
010 - Overstroke
011 - Dragging brake
100 - Reserved
101 - Reserved
110 - Sensor error
111 - Not available";
CM_ SG_ 3221225472 TractorBrakeStrokeAxle4Right "Brake stroke status for right brake actuator on tractor axle 4.

000 - OK (Normal operation)
001 - Non-functioning
010 - Overstroke
011 - Dragging brake
100 - Reserved
101 - Reserved
110 - Sensor error
111 - Not available";
CM_ SG_ 3221225472 TractorBrakeStrokeAxle4Left "Brake stroke status for left brake actuator on tractor axle 4.

000 - OK (Normal operation)
001 - Non-functioning
010 - Overstroke
011 - Dragging brake
100 - Reserved
101 - Reserved
110 - Sensor error
111 - Not available";
CM_ SG_ 3221225472 TractorBrakeStrokeAxle3Right "Brake stroke status for right brake actuator on tractor axle 3.

000 - OK (Normal operation)
001 - Non-functioning
010 - Overstroke
011 - Dragging brake
100 - Reserved
101 - Reserved
110 - Sensor error
111 - Not available";
CM_ SG_ 3221225472 TractorBrakeStrokeAxle3Left "Brake stroke status for left brake actuator on tractor axle 3.

000 - OK (Normal operation)
001 - Non-functioning
010 - Overstroke
011 - Dragging brake
100 - Reserved
101 - Reserved
110 - Sensor error
111 - Not available";
CM_ SG_ 3221225472 TractorBrakeStrokeAxle2Right "Brake stroke status for right brake actuator on tractor axle 2.

000 - OK (Normal operation)
001 - Non-functioning
010 - Overstroke
011 - Dragging brake
100 - Reserved
101 - Reserved
110 - Sensor error
111 - Not available";
CM_ SG_ 3221225472 TractorBrakeStrokeAxle2Left "Brake stroke status for left brake actuator on tractor axle 2. 

000 - OK (Normal operation)
001 - Non-functioning
010 - Overstroke
011 - Dragging brake
100 - Reserved
101 - Reserved
110 - Sensor error
111 - Not available";
CM_ SG_ 3221225472 TractorBrakeStrokeAxle1Right "Brake stroke status for right brake actuator on tractor axle 1. 

000 - OK (Normal operation)
001 - Non-functioning
010 - Overstroke
011 - Dragging brake
100 - Reserved
101 - Reserved
110 - Sensor error
111 - Not available";
CM_ SG_ 3221225472 TractorBrakeStrokeAxle1Left "Brake stroke status for left brake actuator on tractor axle 1. 

000 - OK (Normal operation)  
001 - Non-functioning
010 - Overstroke 
011 - Dragging brake
100 - Reserved
101 - Reserved
110 - Sensor error
111 - Not available";
CM_ SG_ 3221225472 RoadSurfaceTemp "Indicated temperature of road surface over which vehicle is operating.";
CM_ SG_ 3221225472 EngAirIntakeTemp "Temperature of air entering vehicle air induction system.";
CM_ SG_ 3221225472 AmbientAirTemp "Temperature of air surrounding vehicle.";
CM_ SG_ 3221225472 CabInteriorTemp "Temperature of air inside the part of the vehicle that encloses the driver and vehicle operating controls.

Note: See also SPN 1691.  SPN 1662 is an additional diagnostic SPN associated with cab temperature.";
CM_ SG_ 3221225472 BarometricPress "Absolute air pressure of the atmosphere.";
CM_ SG_ 3221225472 EngAirStopPress "Gage pressure of air in an engine stopping system that utilizes compressed air to provide the force required to stop the crankshaft. Engine stopping air is typically used for emergency engine stopping.";
CM_ SG_ 3221225472 EngAirStartPress6831 "Gage pressure of air in an engine starting system that utilizes compressed air to provide the force required to rotate the crankshaft.

See SPN 82 for higher resolution.";
CM_ SG_ 3221225472 EngAirStartPress "Gage pressure of air in an engine starting system that utilizes compressed air to provide the force required to rotate the crankshaft.";
CM_ SG_ 3221225472 AirCompressorStatus "Indicates whether the air compressor is actively compressing air.  

00     Compressor not active
01     Compressor active
10     Error indicator
11     Not available";
CM_ SG_ 3221225472 AirSuspensionSupplyPress "The pneumatic pressure in the circuit for the electronically controlled air suspension system.";
CM_ SG_ 3221225472 AuxEquipmentSupplyPress "The pneumatic pressure in the auxiliary circuit.";
CM_ SG_ 3221225472 PowertrainCircuitAirSupplyPress "Supply pressure to carry the pressure information for the powertrain circuit. This circuit typically would feed powertrain components such as throttles, gearbox actuators and aftertreatment actuators for EGR and SCR systems.";
CM_ SG_ 3221225472 ServiceBrakeCircuit2AirPress "The pneumatic pressure in the secondary service brake circuit or reservoir, supplying the front axle.";
CM_ SG_ 3221225472 ServiceBrakeCircuit1AirPress "The pneumatic pressure in the primary service brake circuit or reservoir, supplying the rear axle.";
CM_ SG_ 3221225472 ParkingAnd_orTrailerAirPress "The pneumatic pressure in the circuit or reservoir for the parking brake and/or the trailer supply.";
CM_ SG_ 3221225472 PneumaticSupplyPress "The pneumatic pressure in the main reservoir, sometimes referred to as the wet tank.";
CM_ SG_ 3221225472 SteerAxleLubePress "The steering axle lubricant pressure.";
CM_ SG_ 3221225472 SteerAxleTemp "Temperature of lubricant in steering axle.";
CM_ SG_ 3221225472 DriveAxleLubePress "The drive axle lubricant pressure with location determined by Drive Axle Location (SPN 930).";
CM_ SG_ 3221225472 DriveAxleTemp "Temperature of axle lubricant in drive axle.";
CM_ SG_ 3221225472 DriveAxleLiftAirPress "Gage pressure of air in system that utilizes compressed air to provide force between axle and frame.";
CM_ SG_ 3221225472 DriveAxleLocation "To identify to which of several similar devices (such as tires or fuel tanks) the information applies.
The low order 4 bits represent a position number, counting left to right when facing in the direction of normal vehicle travel (forward).
The ...";
CM_ SG_ 3221225472 EngGsMssFlwSnsrFuelingCorrection "The amount of fuel the Gas Mass Flow Rate Sensor is sensing should be added or subtracted compared to the maximum amount of fuel the control system allows the sensor to add or subtract.";
CM_ SG_ 3221225472 GsFlInjctonPulseCorrectionFactor "A correction to the gaseous fuel injection pulse (expressed in msec) represented as a percentage.  100% means no correction, higher values indicate increased pulse time, lower values indicate decreased pulse time.";
CM_ SG_ 3221225472 EngTurboWastegateValvePos "The position of the turbocharger wastegate valve (not the electronic wastegate control valve).";
CM_ SG_ 3221225472 EngDesiredAbsIntakeManifoldPress "The desired absolute intake manifold pressure (turbo boost limit) of the engine.";
CM_ SG_ 3221225472 EngGasFuelCorrectionFactor "A correction to a predefined gaseous fuel energy (expressed in energy per unit volume) represented as a percentage.  The actual fuel energy used to control the engine is the product of the gaseous fuel correction factor and the energy of the gas.";
CM_ SG_ 3221225472 RequestedACCDistanceMode "The Requested Distance Control Mode to the ACC system from the operators interface.
The ACC Set Distance Mode (SPN 1589) indicates the selected Distance Control Mode for the ACC system. This parameter is the driver requested setting for this.
000 ...";
CM_ SG_ 3221225472 ACCUsageDemand "This parameter indicates the drivers demand to activate or deactivate ACC keeping distance control.

00 driver demand for not using ACC distance keeping control
01 driver demand for using ACC distance keeping control
10 reserved
11 don't care";
CM_ SG_ 3221225472 ForwardCollisionWarning "This parameter indicates if a collision is imminent and strong driver reaction either by braking hard or by an avoidance maneuver are imperative to prevent a collision.
00 No warning
01 Collision is imminent
10 Error indicator
11 not available
 ...";
CM_ SG_ 3221225472 ACCDistanceAlertSignal "Signal to indicate to the operator that the ACC system is not able to maintain the distance to the target. Example: Target stopping rapidly. This signal may be used to activate warning sounds or indicators.
00 ACC DAS Not Active
01 ACC DAS Active
 ...";
CM_ SG_ 3221225472 ACCSystemShutoffWarning "Signal to warn the driver of system deactivation due to non-driver actions. Example: Attempting to control vehicle speed below or above limits of ACC. This signal may be used to activate warning sounds or indicators.
00 ACC SSOW Not Active
01 ACC ...";
CM_ SG_ 3221225472 ACCTargetDetected "Signal to indicate to the driver that the ACC system has detected a target. 

00 No targets detected
01 Target detected
10 Reserved
11 Take no action";
CM_ SG_ 3221225472 AdptiveCruiseCtrlSetDistanceMode "Selected distance mode for adaptive cruise control.
000 ACC Distance mode #1 (largest distance)
001 ACC Distance mode #2
010 ACC Distance mode #3
011 ACC Distance mode #4
100 ACC Distance mode #5 (shortest distance)
101 Conventional cruise ...";
CM_ SG_ 3221225472 AdaptiveCruiseCtrlMode "This parameter is used to indicate the current state, or mode, of operation by the Adaptive Cruise Control (ACC) device. The states characterize independent system states (e.g., it is not possible to express distance control active and overtake mode ...";
CM_ SG_ 3221225472 AdaptiveCruiseCtrlSetSpeed "Value of the desired (chosen) velocity of the adaptive cruise control system.";
CM_ SG_ 3221225472 DistanceToForwardVehicle "Distance to the preceding vehicle situated within 250 m in the same lane and moving in the same direction.";
CM_ SG_ 3221225472 SpeedOfForwardVehicle "Absolute velocity of the preceding vehicle situated within 250 m in the same lane and moving in the same direction.";
CM_ SG_ 3221225472 ArticulationAngle "Angle of deflection of an articulated transit vehicle (rotation angle about the vehicles z-axis). A right turn (clockwise) is indicated with a positive angle and a left turn is indicated with a negative angle.  This parameter is defined according to ...";
CM_ SG_ 3221225472 RelativeHumidity "Measures humidity of combustion air prior to entry into turbocharger";
CM_ SG_ 3221225472 AuxLevel "Level measured by a sensor.";
CM_ SG_ 3221225472 AuxPress2 "Pressure measured by auxiliary pressure sensor #2.  Not to be used in place of existing SPNs.";
CM_ SG_ 3221225472 AuxPress1 "Pressure measured by auxiliary pressure sensor #1.  Not to be used in place of existing SPNs.";
CM_ SG_ 3221225472 AuxTemp2 "Temperature measured by auxiliary temperature sensor #2.  Not to be used in place of existing SPNs.";
CM_ SG_ 3221225472 AuxTemp1 "Temperature measured by auxiliary temperature sensor #1.  Not to be used in place of existing SPNs.";
CM_ SG_ 3221225472 LNGVaporizerCoolantOutletTemp "Temperature of coolant at outlet of liquified natural gas vaporizer. This parameter is also used to determine if coolant has reached freezing temperature.";
CM_ SG_ 3221225472 EngGasFuelVentPress "Gaseous fuel pressure through a vent pipe.";
CM_ SG_ 3221225472 EngBlowerBypassValvePos "Relative position of the blower bypass valve.";
CM_ SG_ 3221225472 EngGasSupplyPress "Gage pressure of gaseous fuel supply to fuel metering device.";
CM_ SG_ 3221225472 ControlByte_ACKM "Indicates the acknowledgement response.
0 - Positive Acknowledgment (ACK)
1 - Negative Acknowledgment (NACK)
2 - Access Denied (PGN supported but access denied)
3 - Cannot Respond (PGN supported but ECU cannot respond now) cannot respond with ...";
CM_ SG_ 3221225472 ParameterGroupNumber "PGN which is requested by the Request message";
CM_ SG_ 3221225472 GroupFunctionValue "Group Function of PGN being acknowledged. This field identifies for a device the specific group function of a PGN being acknowledged or declined.  This field is not used if the PGN being acknowledged or declined is not a group function PGN.";
CM_ SG_ 3221225472 Status2OfDoors "Composite indication of all bus door statuses. Enabled means the bus doors are able to be automatically opened or closed.

00   all bus doors are disabled
01   at least 1 bus door enabled 
10   error
11   not available";
CM_ SG_ 3221225472 Ramp_WheelChairLiftPos "Signal which indicates the actual position of the ramp / wheel chair lift.

00 Inside bus
01 Outside bus
10 Error
11 Not available";
CM_ SG_ 3221225472 PosOfDoors "Signal which indicates the actual position of the doors.

0000 At least 1 door is open
0001 Closing last door
0010 All doors closed
0011-1101 Not defined
1110 Error
1111 Not available";
CM_ SG_ 3221225472 FifthWheelRollWarningIndicator "Indicates to the vehicle operator that the roll moment has exceeded a preset limit. 

00 Limit not exceeded
01 Limit exceeded
10 error
11 Not Available";
CM_ SG_ 3221225472 FifthWheelRollMoment "Fifth wheel roll moment force - If the moment is positive, the trailer is rolling clockwise relative to the normal vehicle forward motion.";
CM_ SG_ 3221225472 FifthWheelDrawbarForce "Fifth wheel drawbar force, with the trailer held stationary a positive force is generated by the vehicle pulling forward.";
CM_ SG_ 3221225472 FifthWheelVerticalForce "The amount of load being applied to the fifth wheel by the trailer. Zero load is indicated without a trailer.";
CM_ SG_ 3221225472 FifthWheelSliderLockIndicator "Indicates to vehicle operator that the fifth wheel slider is in position and locked. 

00 Not Locked
01 Locked
10 Error
11 Not Available";
CM_ SG_ 3221225472 FifthWheelSliderPos "Slider position measurement. Zero equals fully back position, that is, the farthest to the rear of the vehicle.";
CM_ SG_ 3221225472 FfthWhlLockCoupleStatusIndicator "Indicates results of coupling operation to the vehicle operator. For incomplete couples further information can be obtained from the fifth wheel error status SPN.
00   Incomplete or bad couple, truck should not be moved
01   Successful couple ...";
CM_ SG_ 3221225472 FfthWhlLckReadyToCoupleIndicator "Indicates to the vehicle operator that the fifth wheel lock is open and ready to couple.

00   Lock not open, not ready to couple
01   Lock open, ready to couple
10   Error
11   Not Available";
CM_ SG_ 3221225472 FifthWheelErrorStatus "Fifth wheel error state which conveys information when coupling status is incomplete or bad.
0000    0 - Improper Couple
0001    1 - Locks Closed / No Kingpin at Startup
0010    2 - Kingpin / Locks Open at Startup
0011    3 - Not Used
0100    4 ...";
CM_ SG_ 3221225472 RollAndPitchMeasurementLatency "The estimated measurement latency of the measurement.  NOTE: This is only the sensor latency and does not include any additional latencies that might exist because of the CAN Bus or overall system implementation.
Latency is the time from sensor ...";
CM_ SG_ 3221225472 PitchAndRollCompensated "Compensated mode for the pitch and roll measurements.  Compensation is the use of multiple sensors together to enhance the output of pitch and roll measurements.

00 - Compensation Off
01 - Compensation On
10 - Error
11 - Not Available";
CM_ SG_ 3221225472 PitchRateFigureOfMerit "Figure of merit for the pitch rate measurement.

00 - Pitch rate fully functional.  Data is within sensor specification.   
01 - Pitch rate degraded.  Data is suspect due to environmental conditions.
10 - Error
11 - Not available";
CM_ SG_ 3221225472 RollAngleFigureOfMerit "Figure of merit for roll angle measurement.

00 - Roll angle fully functional.  Data is within sensor specification.   
01 - Roll angle degraded.  Data is suspect due to environmental conditions.
10 - Error
11 - Not available";
CM_ SG_ 3221225472 PitchAngleFigureOfMerit "Figure of merit for pitch angle measurement.

00 - Pitch angle fully functional.  Data is within sensor specification. 
01 - Pitch angle degraded.  Data is suspect due to environmental conditions.
10 - Error
11 - Not available";
CM_ SG_ 3221225472 PitchRate "Pitch rate is the rate-of-change of the pitch angle over time, where the pitch angle vector is in the direction of travel of the vehicle. The pitch rate for increasing ascent over time is reported with a positive value. This parameter is defined ...";
CM_ SG_ 3221225472 RollAngle "The angle between the vehicle y-axis and the ground plane (i.e. rotation about the X-axis).  The roll angle for a roll to the right is reported with a positive value. Roll angle is the same for both Z-Down and Z-Up axis systems, since both systems ...";
CM_ SG_ 3221225472 PitchAngle "The angle between the vehicle x-axis and the ground plane (i.e. rotation about the vehicle Y-axis).  The pitch angle for an angle of ascent is reported with a positive value. This parameter is defined according to a Z-Down axis system and the sign ...";
CM_ SG_ 3221225472 TransOilLevel1MeasurementStatus "Measurement status for the first instance of a transmission oil level indicator.  Indicates if conditions are acceptable to obtain a valid transmission oil level measurement as conveyed in SPN 124 Transmission Oil Level or SPN 3027 Transmission Oil ...";
CM_ SG_ 3221225472 TransOilLevel1CountdownTimer "Countdown timer for the first instance of a transmission oil level indicator.  Once all vehicle conditions (such as vehicle stopped, etc) are met, some transmissions may require a ‘settling time' to allow the fluid level to normalize.  This ...";
CM_ SG_ 3221225472 TransOilLevel1High_Low "First instance of a transmission oil level indicator. Conveys the amount of current volume of transmission sump oil compared to recommended volume. Positive values indicate overfill. Zero means the transmission fluild is filled to the recommended ...";
CM_ SG_ 3221225472 TransOilTemp1 "First instance of transmission lubricant temperature.";
CM_ SG_ 3221225472 TransOilPress "Gage pressure of lubrication fluid in transmission, measured after pump.";
CM_ SG_ 3221225472 TransFilterDiffPress "Change in transmission fluid pressure, measured after the filter, due to accumulation of solid or semisolid material on or in the filter.";
CM_ SG_ 3221225472 TransOilLevel1 "First instance of a transmission oil level indicator. Conveys the ratio of volume of transmission sump oil to recommended volume.";
CM_ SG_ 3221225472 ClutchPress "Gage pressure of oil within a wet clutch.";
CM_ SG_ 3221225472 KeyswitchBatteryPotential "Battery potential measured at the input of the electronic control unit supplied through a key switch or similar switching device.";
CM_ SG_ 3221225472 BatteryPotential_PowerInput1 "This parameter measures the first source of battery potential as measured at the input of the ECU/actuator etc. coming from one or more batteries, irrespective of the distance between the component and the battery.  This SPN is also used when ECUs ...";
CM_ SG_ 3221225472 ChargingSystemPotential "Electrical potential measured at the charging system output.  The charging system may be any device charging the batteries.  This includes alternators, generators, solid state charger and other charging devices.";
CM_ SG_ 3221225472 WrelessCommunicationNetworkType2 "Type of Wireless Communication Network

0 = Cellular network #1
1 = Cellular network #2
2 = Wireless LAN #1
3 = Wireless LAN #2
4 = Satellite network
5-250 = Reserved for Future Assignment
251-253 = Reserved
254 = Error
255 = Not Available";
CM_ SG_ 3221225472 NetworkSignalStrength2 "Indicates the signal strength for the wireless communications network type.";
CM_ SG_ 3221225472 NetworkAntennaStatus2 "Indicates the status of the antenna for the wireless communications network type

0 = Off
1 = On
2-250 = Reserved for Future Assignment
251-253 = Reserved
254 = Error
255 = Not Available";
CM_ SG_ 3221225472 NetworkServiceStatus2 "Indicates the status of the Service for the wireless communications network type
0 = Local Service
1 = Roaming Service
2 = Service not available
3 = Not Authorized to Operate on Service
4-250 = Reserved for Future Assignment
251-253 = Reserved
 ...";
CM_ SG_ 3221225472 NetworkTransceiverStatus2 "Indicates the status of the transceiver for the wireless communications network type

0 = Off
1 = On
2 = Not Authorized to Operate on Network
3-250 = Reserved for Future Assignment
251-253 = Reserved
254 = Error
255 = Not Available";
CM_ SG_ 3221225472 WrelessCommunicationNetworkType1 "Type of Wireless Communication Network

0 = Cellular network #1
1 = Cellular network #2
2 = Wireless LAN #1
3 = Wireless LAN #2
4 = Satellite network
5-250 = Reserved for Future Assignment
251-253 = Reserved
254 = Error
255 = Not Available";
CM_ SG_ 3221225472 NetworkSignalStrength1 "Indicates the signal strength for the wireless communications network type.";
CM_ SG_ 3221225472 NetworkAntennaStatus1 "Indicates the status of the antenna for the wireless communications network type

0 = Off
1 = On
2-250 = Reserved for Future Assignment
251-253 = Reserved
254 = Error
255 = Not Available";
CM_ SG_ 3221225472 NetworkServiceStatus1 "Indicates the status of the Service for the wireless communications network type
0 = Local Service
1 = Roaming Service
2 = Service not available
3 = Not Authorized to Operate on Service
4-250 = Reserved for Future Assignment
251-253 = Reserved
 ...";
CM_ SG_ 3221225472 NetworkTransceiverStatus1 "Indicates the status of the transceiver for the wireless communications network type

0 = Off
1 = On
2 = Not Authorized to Operate on Network
3-250 = Reserved for Future Assignment
251-253 = Reserved
254 = Error
255 = Not Available";
CM_ SG_ 3221225472 VoltageRegulatorEnabled "State signal indicating the Voltage Regulator is enabled.  This parameter indicates whether the regulator is regulating or not regulating generator output voltage.
00 - Not regulating voltage - unit disabled
01 - Regulating voltage
10 - Reserved
 ...";
CM_ SG_ 3221225472 VoltageRegulatorSoftStartState "State signal indicating the mode of the Voltage regulator soft start function.  Soft start controls the generator voltage overshoot by controlling the rate of rise of the generator output voltage at generator start up.
00 - Soft start is inactive
 ...";
CM_ SG_ 3221225472 VltgRgltrUndrfrqncyCmpnstnEnbld "State signal indicating the operating mode for underfrequency compensation.
00 - Underfrequency compensation disabled
01 - Underfrequency compensation enabled
10 - Reserved
11 - Not available
Note:
Underfrequency compensation is when the ...";
CM_ SG_ 3221225472 VltgRgltrVAr_PwrFctrOprtingMode "State signal indicating the operating mode for the Voltage regulator VAr/Power Factor
000 - VAr/Power Factor regulation disabled
001 - Power factor regulation enabled
010 - VAr regulation enabled
011 - Reserved
100 - Reserved
101 - Reserved
 ...";
CM_ SG_ 3221225472 VltgRglatorLoadCompensationMode "State signal indicating the voltage regulator load compensation mode.  Load compensation is when the voltage is adjusted based on the magnitude of load current
000 - load compensation disabled
001 - Voltage droop compensation enabled
010 - IR ...";
CM_ SG_ 3221225472 GnrtrOtputVoltageBiasPercentage "Measured signal that represents the voltage bias percentage of the generator ouptput voltage being requested by external to the voltage regulator.
Generator output voltage bias percentage is the amount of voltage in percent the generator output ...";
CM_ SG_ 3221225472 GeneratorExcitationFieldCurrent "Measured signal that represents the generator excitation field current.";
CM_ SG_ 3221225472 GeneratorExcitationFieldVoltage "Measured signal that represents the generator excitation field voltage.  Generator excitation field voltage is indicative of the amount of excitation current being supplied by the voltage regulator to the generator field.";
CM_ BO_ 2566836734 "Oxygen Sensor Test Results
SAE J1939 will not specify an implementation for this DM.  Oxygen sensor test and results should be communicated using DM7 and DM8";
CM_ BO_ 2566702846 "OBD Information";
CM_ SG_ 2566702846 EngOBDWarmUpSequence "Engine warm-up as defined by the applicable region's regulatory agency.  In the US, 'Engine OBD Warm-up' or 'Warm-up cycle' means sufficient vehicle operation such that coolant temperature rises by at least 22.2 °C (40 °F) from engine starting and ...";
CM_ BO_ 2566703102 "Engine Emissions Certification Information";
CM_ SG_ 2566703102 CertificationEngineFamilyName "The regulated family name per the applicable region's certification agency.  For engines certified in the US, this shall be the 12-character engine family name or test group as defined by EPA.  Up to 200 characters may be used.  The characters are ...";
CM_ SG_ 2566703102 ModelYear "The compliance model year of the OBD system of the engine and or vehicle.  For example in the US, this is associated with either a vehicle model year or an engine model year, depending on how the emissions and OBD are certified.  This message shall ...";
CM_ BO_ 2566705918 "Previously Active Service Only DTCs";
CM_ SG_ 2566705918 DTC1 "Diagnostic Trouble Code";
CM_ SG_ 2566705918 FlashProtectLamp "This parameter provides the capability to flash the engine protect lamp


00 - Slow Flash (1 Hz, 50 % duty cycle)
01 - Fast Flash (2 Hz or faster, 50% duty cycle)
10 - Reserved
11 - Unavailable / Do Not Flash";
CM_ SG_ 2566705918 FlashAmberWarningLamp "This parameter provides the capability to flash the AWL

00 - Slow Flash (1 Hz, 50 % duty cycle)
01 - Fast Flash (2 Hz or faster, 50% duty cycle)
10 - Reserved
11 - Unavailable / Do Not Flash";
CM_ SG_ 2566705918 FlashRedStopLamp "This parameter provides the capability to flash the RSL


00 - Slow Flash (1 Hz, 50 % duty cycle)
01 - Fast Flash (2 Hz or faster, 50% duty cycle)
10 - Reserved
11 - Unavailable / Do Not Flash";
CM_ SG_ 2566705918 FlashMalfuncIndicatorLamp "This parameter provides the capability to flash the MIL
00 - Slow Flash (1 Hz, 50 % duty cycle)
01 - Fast Flash (2 Hz or faster, 50% duty cycle)
10 - Class C DTC
11 - Unavailable / Do Not Flash
Note:  State 10 is for WWH OBD discriminatory ...";
CM_ SG_ 2566705918 ProtectLampStatus "This lamp is used to relay trouble code information that is reporting a problem with a vehicle system that is most probably not electronic subsystem related. For instance, engine coolant temperature is exceeding its prescribed temperature range.
00 ...";
CM_ SG_ 2566705918 AmberWarningLampStatus "This lamp is used to relay trouble code information that is reporting a problem with the vehicle system but the vehicle need not be immediately stopped. 

00     Lamp Off
01     Lamp On
10     Reserved
11     Not available";
CM_ SG_ 2566705918 RedStopLampState "This lamp is used to relay trouble code information that is of a severe enough condition that it warrants stopping the vehicle.

00     Lamp Off
01     Lamp On
10     Reserved
11     Not available";
CM_ SG_ 2566705918 MalfunctionIndicatorLampStatus "A lamp used to relay only emissions-related trouble code information. This lamp is only illuminated when there is an emission-related trouble code active.
00     Lamp Off
01     Lamp On
10     Short MIL for WWH OBD
11     Not available
Note ...";
CM_ SG_ 2566705918 DTC5 "Diagnostic Trouble Code";
CM_ SG_ 2566705918 DTC4 "Diagnostic Trouble Code";
CM_ SG_ 2566705918 DTC3 "Diagnostic Trouble Code";
CM_ SG_ 2566705918 DTC2 "Diagnostic Trouble Code";
BA_DEF_ SG_  "SigType" ENUM  "Default","Range","RangeSigned","ASCII","Discrete","Control","ReferencePGN","DTC","StringDelimiter","StringLength","StringLengthControl","MessageCounter","MessageChecksum";
BA_DEF_ SG_  "GenSigStartValue" INT 0 2147483647;
BA_DEF_ SG_  "GenSigSendType" ENUM  "Cyclic","OnWrite","OnWriteWithRepetition","OnChange","OnChangeWithRepetition","IfActive","IfActiveWithRepetition","NoSigSendType";
BA_DEF_ SG_  "GenSigILSupport" ENUM  "No","Yes";
BA_DEF_ SG_  "GenSigEVName" STRING ;
BA_DEF_ SG_  "SPN" INT 0 524287;
BA_DEF_ BO_  "TpJ1939VarDlc" ENUM  "No","Yes";
BA_DEF_ BO_  "GenMsgILSupport" ENUM  "No","Yes";
BA_DEF_ BO_  "GenMsgRequestable" INT 0 1;
BA_DEF_ BO_  "GenMsgSendType" ENUM  "cyclic","NotUsed","NotUsed","NotUsed","NotUsed","NotUsed","NotUsed","IfActive","noMsgSendType";
BA_DEF_ BO_  "VFrameFormat" ENUM  "StandardCAN","ExtendedCAN","reserved","J1939PG";
BA_DEF_ SG_  "SystemSignalLongSymbol" STRING ;
BA_DEF_DEF_  "SigType" "Default";
BA_DEF_DEF_  "GenSigStartValue" 0;
BA_DEF_DEF_  "GenSigSendType" "NoSigSendType";
BA_DEF_DEF_  "GenSigILSupport" "Yes";
BA_DEF_DEF_  "GenSigEVName" "Env@Nodename_@Signame";
BA_DEF_DEF_  "SPN" 0;
BA_DEF_DEF_  "TpJ1939VarDlc" "No";
BA_DEF_DEF_  "GenMsgILSupport" "Yes";
BA_DEF_DEF_  "GenMsgRequestable" 1;
BA_DEF_DEF_  "GenMsgSendType" "noMsgSendType";
BA_DEF_DEF_  "VFrameFormat" "J1939PG";
BA_DEF_DEF_  "SystemSignalLongSymbol" "";
BA_ "TpJ1939VarDlc" BO_ 2566702846 1;
BA_ "TpJ1939VarDlc" BO_ 2566703102 1;
BA_ "TpJ1939VarDlc" BO_ 2566705918 1;
BA_ "SPN" SG_ 3221225472 UtilityAverageACFrequency 2470;
BA_ "SigType" SG_ 3221225472 UtilityAverageACFrequency 1;
BA_ "SPN" SG_ 3221225472 UtltyAvrgLneNeutralACRMSVoltage 2478;
BA_ "SigType" SG_ 3221225472 UtltyAvrgLneNeutralACRMSVoltage 1;
BA_ "SPN" SG_ 3221225472 UtltyAvrageLineLineACRMSVoltage 2474;
BA_ "SigType" SG_ 3221225472 UtltyAvrageLineLineACRMSVoltage 1;
BA_ "SPN" SG_ 3221225472 GnrtorOverallPowerFactorLagging 2518;
BA_ "SigType" SG_ 3221225472 GnrtorOverallPowerFactorLagging 4;
BA_ "SPN" SG_ 3221225472 GeneratorOverallPowerFactor 2464;
BA_ "SigType" SG_ 3221225472 GeneratorOverallPowerFactor 1;
BA_ "SPN" SG_ 3221225472 GeneratorTotalReactivePower 2456;
BA_ "SigType" SG_ 3221225472 GeneratorTotalReactivePower 1;
BA_ "SPN" SG_ 3221225472 GeneratorTotalApparentPower 2460;
BA_ "SigType" SG_ 3221225472 GeneratorTotalApparentPower 1;
BA_ "SPN" SG_ 3221225472 GeneratorTotalRealPower 2452;
BA_ "SigType" SG_ 3221225472 GeneratorTotalRealPower 1;
BA_ "SPN" SG_ 3221225472 GeneratorTotalKWHoursImport 2469;
BA_ "SigType" SG_ 3221225472 GeneratorTotalKWHoursImport 1;
BA_ "SPN" SG_ 3221225472 GeneratorTotalKWHoursExport 2468;
BA_ "SigType" SG_ 3221225472 GeneratorTotalKWHoursExport 1;
BA_ "SPN" SG_ 3221225472 GnratorPhaseCPowerFactorLagging 2521;
BA_ "SigType" SG_ 3221225472 GnratorPhaseCPowerFactorLagging 4;
BA_ "SPN" SG_ 3221225472 GeneratorPhaseCPowerFactor 2467;
BA_ "SigType" SG_ 3221225472 GeneratorPhaseCPowerFactor 1;
BA_ "SPN" SG_ 3221225472 GeneratorPhaseCReactivePower 2459;
BA_ "SigType" SG_ 3221225472 GeneratorPhaseCReactivePower 1;
BA_ "SPN" SG_ 3221225472 GeneratorPhaseCApparentPower 2463;
BA_ "SigType" SG_ 3221225472 GeneratorPhaseCApparentPower 1;
BA_ "SPN" SG_ 3221225472 GeneratorPhaseCRealPower 2455;
BA_ "SigType" SG_ 3221225472 GeneratorPhaseCRealPower 1;
BA_ "SPN" SG_ 3221225472 GeneratorPhaseCACRMSCurrent 2451;
BA_ "SigType" SG_ 3221225472 GeneratorPhaseCACRMSCurrent 1;
BA_ "SPN" SG_ 3221225472 GeneratorPhaseCACFrequency 2439;
BA_ "SigType" SG_ 3221225472 GeneratorPhaseCACFrequency 1;
BA_ "SPN" SG_ 3221225472 GnrtrPhsCLneNeutralACRMSVoltage 2447;
BA_ "SigType" SG_ 3221225472 GnrtrPhsCLneNeutralACRMSVoltage 1;
BA_ "SPN" SG_ 3221225472 GnrtrPhseCALineLineACRMSVoltage 2443;
BA_ "SigType" SG_ 3221225472 GnrtrPhseCALineLineACRMSVoltage 1;
BA_ "SPN" SG_ 3221225472 GnratorPhaseBPowerFactorLagging 2520;
BA_ "SigType" SG_ 3221225472 GnratorPhaseBPowerFactorLagging 4;
BA_ "SPN" SG_ 3221225472 GeneratorPhaseBPowerFactor 2466;
BA_ "SigType" SG_ 3221225472 GeneratorPhaseBPowerFactor 1;
BA_ "SPN" SG_ 3221225472 GeneratorPhaseBReactivePower 2458;
BA_ "SigType" SG_ 3221225472 GeneratorPhaseBReactivePower 1;
BA_ "SPN" SG_ 3221225472 GeneratorPhaseBApparentPower 2462;
BA_ "SigType" SG_ 3221225472 GeneratorPhaseBApparentPower 1;
BA_ "SPN" SG_ 3221225472 GeneratorPhaseBRealPower 2454;
BA_ "SigType" SG_ 3221225472 GeneratorPhaseBRealPower 1;
BA_ "SPN" SG_ 3221225472 GeneratorPhaseBACRMSCurrent 2450;
BA_ "SigType" SG_ 3221225472 GeneratorPhaseBACRMSCurrent 1;
BA_ "SPN" SG_ 3221225472 GeneratorPhaseBACFrequency 2438;
BA_ "SigType" SG_ 3221225472 GeneratorPhaseBACFrequency 1;
BA_ "SPN" SG_ 3221225472 GnrtrPhsBLneNeutralACRMSVoltage 2446;
BA_ "SigType" SG_ 3221225472 GnrtrPhsBLneNeutralACRMSVoltage 1;
BA_ "SPN" SG_ 3221225472 GnrtrPhseBCLineLineACRMSVoltage 2442;
BA_ "SigType" SG_ 3221225472 GnrtrPhseBCLineLineACRMSVoltage 1;
BA_ "SPN" SG_ 3221225472 GnratorPhaseAPowerFactorLagging 2519;
BA_ "SigType" SG_ 3221225472 GnratorPhaseAPowerFactorLagging 4;
BA_ "SPN" SG_ 3221225472 GeneratorPhaseAPowerFactor 2465;
BA_ "SigType" SG_ 3221225472 GeneratorPhaseAPowerFactor 1;
BA_ "SPN" SG_ 3221225472 GeneratorPhaseAReactivePower 2457;
BA_ "SigType" SG_ 3221225472 GeneratorPhaseAReactivePower 1;
BA_ "SPN" SG_ 3221225472 GeneratorPhaseAApparentPower 2461;
BA_ "SigType" SG_ 3221225472 GeneratorPhaseAApparentPower 1;
BA_ "SPN" SG_ 3221225472 GeneratorPhaseARealPower 2453;
BA_ "SigType" SG_ 3221225472 GeneratorPhaseARealPower 1;
BA_ "SPN" SG_ 3221225472 GeneratorPhaseAACRMSCurrent 2449;
BA_ "SigType" SG_ 3221225472 GeneratorPhaseAACRMSCurrent 1;
BA_ "SPN" SG_ 3221225472 GeneratorPhaseAACFrequency 2437;
BA_ "SigType" SG_ 3221225472 GeneratorPhaseAACFrequency 1;
BA_ "SPN" SG_ 3221225472 GnrtrPhsALneNeutralACRMSVoltage 2445;
BA_ "SigType" SG_ 3221225472 GnrtrPhsALneNeutralACRMSVoltage 1;
BA_ "SPN" SG_ 3221225472 GnrtrPhseABLineLineACRMSVoltage 2441;
BA_ "SigType" SG_ 3221225472 GnrtrPhseABLineLineACRMSVoltage 1;
BA_ "SPN" SG_ 3221225472 GeneratorAverageACRMSCurrent 2448;
BA_ "SigType" SG_ 3221225472 GeneratorAverageACRMSCurrent 1;
BA_ "SPN" SG_ 3221225472 GeneratorAverageACFrequency 2436;
BA_ "SigType" SG_ 3221225472 GeneratorAverageACFrequency 1;
BA_ "SPN" SG_ 3221225472 GnrtrAvrgLneNeutralACRMSVoltage 2444;
BA_ "SigType" SG_ 3221225472 GnrtrAvrgLneNeutralACRMSVoltage 1;
BA_ "SPN" SG_ 3221225472 GnrtrAvrageLineLineACRMSVoltage 2440;
BA_ "SigType" SG_ 3221225472 GnrtrAvrageLineLineACRMSVoltage 1;
BA_ "SPN" SG_ 3221225472 Bus1_UtilityACPhaseDifference 2517;
BA_ "SigType" SG_ 3221225472 Bus1_UtilityACPhaseDifference 1;
BA_ "SPN" SG_ 3221225472 Bus1_UtilityInSync 2534;
BA_ "SigType" SG_ 3221225472 Bus1_UtilityInSync 4;
BA_ "SPN" SG_ 3221225472 Bus1_UtilityVoltageMatch 2532;
BA_ "SigType" SG_ 3221225472 Bus1_UtilityVoltageMatch 4;
BA_ "SPN" SG_ 3221225472 Bus1_UtilityFrequencyMatch 2533;
BA_ "SigType" SG_ 3221225472 Bus1_UtilityFrequencyMatch 4;
BA_ "SPN" SG_ 3221225472 Bus1_UtilityPhaseMatch 2531;
BA_ "SigType" SG_ 3221225472 Bus1_UtilityPhaseMatch 4;
BA_ "SPN" SG_ 3221225472 Bus1_UtilityDeadBus 2535;
BA_ "SigType" SG_ 3221225472 Bus1_UtilityDeadBus 4;
BA_ "SPN" SG_ 3221225472 Bus1PhaseCACFrequency 2507;
BA_ "SigType" SG_ 3221225472 Bus1PhaseCACFrequency 1;
BA_ "SPN" SG_ 3221225472 Bs1PhseCLineNeutralACRMSVoltage 2515;
BA_ "SigType" SG_ 3221225472 Bs1PhseCLineNeutralACRMSVoltage 1;
BA_ "SPN" SG_ 3221225472 Bus1PhaseCALineLineACRMSVoltage 2511;
BA_ "SigType" SG_ 3221225472 Bus1PhaseCALineLineACRMSVoltage 1;
BA_ "SPN" SG_ 3221225472 Bus1PhaseBACFrequency 2506;
BA_ "SigType" SG_ 3221225472 Bus1PhaseBACFrequency 1;
BA_ "SPN" SG_ 3221225472 Bs1PhseBLineNeutralACRMSVoltage 2514;
BA_ "SigType" SG_ 3221225472 Bs1PhseBLineNeutralACRMSVoltage 1;
BA_ "SPN" SG_ 3221225472 Bus1PhaseBCLineLineACRMSVoltage 2510;
BA_ "SigType" SG_ 3221225472 Bus1PhaseBCLineLineACRMSVoltage 1;
BA_ "SPN" SG_ 3221225472 Bus1PhaseAACFrequency 2505;
BA_ "SigType" SG_ 3221225472 Bus1PhaseAACFrequency 1;
BA_ "SPN" SG_ 3221225472 Bs1PhseALineNeutralACRMSVoltage 2513;
BA_ "SigType" SG_ 3221225472 Bs1PhseALineNeutralACRMSVoltage 1;
BA_ "SPN" SG_ 3221225472 Bus1PhaseABLineLineACRMSVoltage 2509;
BA_ "SigType" SG_ 3221225472 Bus1PhaseABLineLineACRMSVoltage 1;
BA_ "SPN" SG_ 3221225472 Bus1_GeneratorACPhaseDifference 2516;
BA_ "SigType" SG_ 3221225472 Bus1_GeneratorACPhaseDifference 1;
BA_ "SPN" SG_ 3221225472 Bus1_GeneratorInSync 2529;
BA_ "SigType" SG_ 3221225472 Bus1_GeneratorInSync 4;
BA_ "SPN" SG_ 3221225472 Bus1_GeneratorVoltageMatch 2527;
BA_ "SigType" SG_ 3221225472 Bus1_GeneratorVoltageMatch 4;
BA_ "SPN" SG_ 3221225472 Bus1_GeneratorFrequencyMatch 2528;
BA_ "SigType" SG_ 3221225472 Bus1_GeneratorFrequencyMatch 4;
BA_ "SPN" SG_ 3221225472 Bus1_GeneratorPhaseMatch 2526;
BA_ "SigType" SG_ 3221225472 Bus1_GeneratorPhaseMatch 4;
BA_ "SPN" SG_ 3221225472 Bus1_GeneratorDeadBus 2530;
BA_ "SigType" SG_ 3221225472 Bus1_GeneratorDeadBus 4;
BA_ "SPN" SG_ 3221225472 Bus1AverageACFrequency 2504;
BA_ "SigType" SG_ 3221225472 Bus1AverageACFrequency 1;
BA_ "SPN" SG_ 3221225472 Bs1AvrgeLineNeutralACRMSVoltage 2512;
BA_ "SigType" SG_ 3221225472 Bs1AvrgeLineNeutralACRMSVoltage 1;
BA_ "SPN" SG_ 3221225472 Bus1AverageLineLineACRMSVoltage 2508;
BA_ "SigType" SG_ 3221225472 Bus1AverageLineLineACRMSVoltage 1;
BA_ "SPN" SG_ 3221225472 AddressAssignment 2847;
BA_ "SPN" SG_ 3221225472 ShrtNameOfActualReportingDevice 2554;
BA_ "SigType" SG_ 3221225472 ShrtNameOfActualReportingDevice 4;
BA_ "SPN" SG_ 3221225472 LengthOfDataForTheReportedPGN 2553;
BA_ "SigType" SG_ 3221225472 LengthOfDataForTheReportedPGN 1;
BA_ "SPN" SG_ 3221225472 PGNofRequstedInformation 2552;
BA_ "SigType" SG_ 3221225472 PGNofRequstedInformation 6;
BA_ "SPN" SG_ 3221225472 SequenceNumber 2572;
BA_ "SPN" SG_ 3221225472 TotalNumberOfPacketsEoMA 2565;
BA_ "SPN" SG_ 3221225472 TotalMessageSizeEoMA 2564;
BA_ "SigType" SG_ 3221225472 TotalMessageSizeEoMA 1;
BA_ "SPN" SG_ 3221225472 TotalMessageSizeBAM 2567;
BA_ "SigType" SG_ 3221225472 TotalMessageSizeBAM 1;
BA_ "SPN" SG_ 3221225472 TotalNumberOfPacketsBAM 2568;
BA_ "SPN" SG_ 3221225472 ConnectionAbortReason 2570;
BA_ "SPN" SG_ 3221225472 NextPacketNumberToBeSent 2562;
BA_ "SPN" SG_ 3221225472 NumOfPacketsThatCanBeSent 2561;
BA_ "SPN" SG_ 3221225472 PGNumber 2560;
BA_ "SigType" SG_ 3221225472 PGNumber 6;
BA_ "SPN" SG_ 3221225472 MaximumNumberOfPackets 2559;
BA_ "SPN" SG_ 3221225472 TotalNumberOfPackets 2558;
BA_ "SPN" SG_ 3221225472 TotalMessageSize 2557;
BA_ "SigType" SG_ 3221225472 TotalMessageSize 1;
BA_ "SPN" SG_ 3221225472 ControlByte 2556;
BA_ "SPN" SG_ 3221225472 ParameterGroupNumber 2574;
BA_ "SigType" SG_ 3221225472 ParameterGroupNumber 6;
BA_ "SPN" SG_ 3221225472 UseTransferMode 2575;
BA_ "SigType" SG_ 3221225472 UseTransferMode 4;
BA_ "SPN" SG_ 3221225472 ParameterGroupNumber 2540;
BA_ "SigType" SG_ 3221225472 ParameterGroupNumber 6;
BA_ "SPN" SG_ 3221225472 AdditionalAxleGroupLocation 5935;
BA_ "SPN" SG_ 3221225472 AxleGroupWeight 409;
BA_ "SigType" SG_ 3221225472 AxleGroupWeight 1;
BA_ "SPN" SG_ 3221225472 AxleGroupLocation 4073;
BA_ "SPN" SG_ 3221225472 AdditionalAxleGroupLocation 5936;
BA_ "SPN" SG_ 3221225472 AxleGroupFullWeightCalib 407;
BA_ "SigType" SG_ 3221225472 AxleGroupFullWeightCalib 1;
BA_ "SPN" SG_ 3221225472 AxleGroupEmptyWeightCalib 408;
BA_ "SigType" SG_ 3221225472 AxleGroupEmptyWeightCalib 1;
BA_ "SPN" SG_ 3221225472 AxleGroupLocation 4074;
BA_ "SPN" SG_ 3221225472 EngChrgeAirCoolerBypassValve2Cmd 7422;
BA_ "SigType" SG_ 3221225472 EngChrgeAirCoolerBypassValve2Cmd 1;
BA_ "SPN" SG_ 3221225472 EngChrgeAirCoolerBypassValve1Cmd 7421;
BA_ "SigType" SG_ 3221225472 EngChrgeAirCoolerBypassValve1Cmd 1;
BA_ "SPN" SG_ 3221225472 DsrdAftrclrClntThermostatOpening 4200;
BA_ "SigType" SG_ 3221225472 DsrdAftrclrClntThermostatOpening 1;
BA_ "SPN" SG_ 3221225472 DsrdAftercoolerCoolantIntakeTemp 4199;
BA_ "SigType" SG_ 3221225472 DsrdAftercoolerCoolantIntakeTemp 1;
BA_ "SPN" SG_ 3221225472 AftercoolerCoolantThermostatMode 4198;
BA_ "SigType" SG_ 3221225472 AftercoolerCoolantThermostatMode 5;
BA_ "SPN" SG_ 3221225472 RarDriveAxleGroupWeightAvailable 5934;
BA_ "SigType" SG_ 3221225472 RarDriveAxleGroupWeightAvailable 5;
BA_ "SPN" SG_ 3221225472 RarSteerAxleGroupWeightAvailable 5933;
BA_ "SigType" SG_ 3221225472 RarSteerAxleGroupWeightAvailable 5;
BA_ "SPN" SG_ 3221225472 AddtnlTrlrAxlGrupWeightAvailable 4072;
BA_ "SigType" SG_ 3221225472 AddtnlTrlrAxlGrupWeightAvailable 5;
BA_ "SPN" SG_ 3221225472 TrailerHAxleGroupWeightAvailable 4071;
BA_ "SigType" SG_ 3221225472 TrailerHAxleGroupWeightAvailable 5;
BA_ "SPN" SG_ 3221225472 TrailerGAxleGroupWeightAvailable 4070;
BA_ "SigType" SG_ 3221225472 TrailerGAxleGroupWeightAvailable 5;
BA_ "SPN" SG_ 3221225472 TrailerFAxleGroupWeightAvailable 4069;
BA_ "SigType" SG_ 3221225472 TrailerFAxleGroupWeightAvailable 5;
BA_ "SPN" SG_ 3221225472 TrailerEAxleGroupWeightAvailable 4068;
BA_ "SigType" SG_ 3221225472 TrailerEAxleGroupWeightAvailable 5;
BA_ "SPN" SG_ 3221225472 TrailerDAxleGroupWeightAvailable 4067;
BA_ "SigType" SG_ 3221225472 TrailerDAxleGroupWeightAvailable 5;
BA_ "SPN" SG_ 3221225472 TrailerCAxleGroupWeightAvailable 4066;
BA_ "SigType" SG_ 3221225472 TrailerCAxleGroupWeightAvailable 5;
BA_ "SPN" SG_ 3221225472 TrailerBAxleGroupWeightAvailable 4065;
BA_ "SigType" SG_ 3221225472 TrailerBAxleGroupWeightAvailable 5;
BA_ "SPN" SG_ 3221225472 TrailerAAxleGroupWeightAvailable 4064;
BA_ "SigType" SG_ 3221225472 TrailerAAxleGroupWeightAvailable 5;
BA_ "SPN" SG_ 3221225472 AddtnlTrctrAxlGrpWeightAvailable 4063;
BA_ "SigType" SG_ 3221225472 AddtnlTrctrAxlGrpWeightAvailable 5;
BA_ "SPN" SG_ 3221225472 TagAxleGroupWeightAvailable 4062;
BA_ "SigType" SG_ 3221225472 TagAxleGroupWeightAvailable 5;
BA_ "SPN" SG_ 3221225472 DriveAxleGroupWeightAvailable 4061;
BA_ "SigType" SG_ 3221225472 DriveAxleGroupWeightAvailable 5;
BA_ "SPN" SG_ 3221225472 LiftAxleGroupWeightAvailable 4060;
BA_ "SigType" SG_ 3221225472 LiftAxleGroupWeightAvailable 5;
BA_ "SPN" SG_ 3221225472 SteerAxleGroupWeightAvailable 4059;
BA_ "SigType" SG_ 3221225472 SteerAxleGroupWeightAvailable 5;
BA_ "SPN" SG_ 3221225472 ZeroNetVehicleWeightChange 4075;
BA_ "SigType" SG_ 3221225472 ZeroNetVehicleWeightChange 5;
BA_ "SPN" SG_ 3221225472 EngExhaustGasTempAverageBank2 4152;
BA_ "SigType" SG_ 3221225472 EngExhaustGasTempAverageBank2 1;
BA_ "SPN" SG_ 3221225472 EngExhaustGasTempAverageBank1 4153;
BA_ "SigType" SG_ 3221225472 EngExhaustGasTempAverageBank1 1;
BA_ "SPN" SG_ 3221225472 EngExhaustGasTempAverage 4151;
BA_ "SigType" SG_ 3221225472 EngExhaustGasTempAverage 1;
BA_ "SigType" SG_ 3221225472 AETCTorqueValue14 1;
BA_ "SigType" SG_ 3221225472 AETCTorqueValue13 1;
BA_ "SigType" SG_ 3221225472 AETCTorqueValue12 1;
BA_ "SigType" SG_ 3221225472 AETCTorqueValue11 1;
BA_ "SigType" SG_ 3221225472 AETCTorqueValue10 1;
BA_ "SigType" SG_ 3221225472 AETCTorqueValue09 1;
BA_ "SigType" SG_ 3221225472 AETCTorqueValue08 1;
BA_ "SigType" SG_ 3221225472 AETCTorqueValue07 1;
BA_ "SigType" SG_ 3221225472 AETCTorqueValue06 1;
BA_ "SigType" SG_ 3221225472 AETCTorqueValue05 1;
BA_ "SigType" SG_ 3221225472 AETCTorqueValue04 1;
BA_ "SigType" SG_ 3221225472 AETCTorqueValue03 1;
BA_ "SigType" SG_ 3221225472 AETCTorqueValue02 1;
BA_ "SigType" SG_ 3221225472 AETCTorqueValue01 1;
BA_ "SigType" SG_ 3221225472 AETCSpeedValue14 1;
BA_ "SigType" SG_ 3221225472 AETCSpeedValue13 1;
BA_ "SigType" SG_ 3221225472 AETCSpeedValue12 1;
BA_ "SigType" SG_ 3221225472 AETCSpeedValue11 1;
BA_ "SigType" SG_ 3221225472 AETCSpeedValue10 1;
BA_ "SigType" SG_ 3221225472 AETCSpeedValue09 1;
BA_ "SigType" SG_ 3221225472 AETCSpeedValue08 1;
BA_ "SigType" SG_ 3221225472 AETCSpeedValue07 1;
BA_ "SigType" SG_ 3221225472 AETCSpeedValue06 1;
BA_ "SigType" SG_ 3221225472 AETCSpeedValue05 1;
BA_ "SigType" SG_ 3221225472 AETCSpeedValue04 1;
BA_ "SigType" SG_ 3221225472 AETCSpeedValue03 1;
BA_ "SigType" SG_ 3221225472 AETCSpeedValue02 1;
BA_ "SigType" SG_ 3221225472 AETCSpeedValue01 1;
BA_ "SigType" SG_ 3221225472 AETCTorqueValue00 1;
BA_ "SigType" SG_ 3221225472 AETCSpeedValue00 1;
BA_ "SPN" SG_ 3221225472 NumberOfAETCDataPoints 3559;
BA_ "GenSigStartValue" SG_ 3221225472 NumberOfAETCDataPoints 5;
BA_ "SPN" SG_ 3221225472 AETCDataCollectionStandard 3558;
BA_ "SPN" SG_ 3221225472 RightHeadlampLightDistribution 3694;
BA_ "SPN" SG_ 3221225472 LeftHeadlampLightDistribution 3693;
BA_ "SPN" SG_ 3221225472 RightHeadlampDynamicBendingLight 3692;
BA_ "SPN" SG_ 3221225472 LeftHeadlampDynamicBendingLight 3691;
BA_ "SPN" SG_ 3221225472 AuxI_OChannel2 1084;
BA_ "SigType" SG_ 3221225472 AuxI_OChannel2 1;
BA_ "SPN" SG_ 3221225472 AuxI_OChannel1 1083;
BA_ "SigType" SG_ 3221225472 AuxI_OChannel1 1;
BA_ "SPN" SG_ 3221225472 AuxI_O13 713;
BA_ "SigType" SG_ 3221225472 AuxI_O13 4;
BA_ "SPN" SG_ 3221225472 AuxI_O14 714;
BA_ "SigType" SG_ 3221225472 AuxI_O14 4;
BA_ "SPN" SG_ 3221225472 AuxI_O15 715;
BA_ "SigType" SG_ 3221225472 AuxI_O15 4;
BA_ "SPN" SG_ 3221225472 AuxI_O16 716;
BA_ "SigType" SG_ 3221225472 AuxI_O16 4;
BA_ "SPN" SG_ 3221225472 AuxI_O09 709;
BA_ "SigType" SG_ 3221225472 AuxI_O09 4;
BA_ "SPN" SG_ 3221225472 AuxI_O10 710;
BA_ "SigType" SG_ 3221225472 AuxI_O10 4;
BA_ "SPN" SG_ 3221225472 AuxI_O11 711;
BA_ "SigType" SG_ 3221225472 AuxI_O11 4;
BA_ "SPN" SG_ 3221225472 AuxI_O12 712;
BA_ "SigType" SG_ 3221225472 AuxI_O12 4;
BA_ "SPN" SG_ 3221225472 AuxI_O05 705;
BA_ "SigType" SG_ 3221225472 AuxI_O05 4;
BA_ "SPN" SG_ 3221225472 AuxI_O06 706;
BA_ "SigType" SG_ 3221225472 AuxI_O06 4;
BA_ "SPN" SG_ 3221225472 AuxI_O07 707;
BA_ "SigType" SG_ 3221225472 AuxI_O07 4;
BA_ "SPN" SG_ 3221225472 AuxI_O08 708;
BA_ "SigType" SG_ 3221225472 AuxI_O08 4;
BA_ "SPN" SG_ 3221225472 AuxI_O01 701;
BA_ "SigType" SG_ 3221225472 AuxI_O01 4;
BA_ "SPN" SG_ 3221225472 AuxI_O02 702;
BA_ "SigType" SG_ 3221225472 AuxI_O02 4;
BA_ "SPN" SG_ 3221225472 AuxI_O03 703;
BA_ "SigType" SG_ 3221225472 AuxI_O03 4;
BA_ "SPN" SG_ 3221225472 AuxI_O04 704;
BA_ "SigType" SG_ 3221225472 AuxI_O04 4;
BA_ "SPN" SG_ 3221225472 AuxI_O45 3868;
BA_ "SigType" SG_ 3221225472 AuxI_O45 4;
BA_ "SPN" SG_ 3221225472 AuxI_O46 3869;
BA_ "SigType" SG_ 3221225472 AuxI_O46 4;
BA_ "SPN" SG_ 3221225472 AuxI_O47 3870;
BA_ "SigType" SG_ 3221225472 AuxI_O47 4;
BA_ "SPN" SG_ 3221225472 AuxI_O48 3871;
BA_ "SigType" SG_ 3221225472 AuxI_O48 4;
BA_ "SPN" SG_ 3221225472 AuxI_O41 3864;
BA_ "SigType" SG_ 3221225472 AuxI_O41 4;
BA_ "SPN" SG_ 3221225472 AuxI_O42 3865;
BA_ "SigType" SG_ 3221225472 AuxI_O42 4;
BA_ "SPN" SG_ 3221225472 AuxI_O43 3866;
BA_ "SigType" SG_ 3221225472 AuxI_O43 4;
BA_ "SPN" SG_ 3221225472 AuxI_O44 3867;
BA_ "SigType" SG_ 3221225472 AuxI_O44 4;
BA_ "SPN" SG_ 3221225472 AuxI_O37 3860;
BA_ "SigType" SG_ 3221225472 AuxI_O37 4;
BA_ "SPN" SG_ 3221225472 AuxI_O38 3861;
BA_ "SigType" SG_ 3221225472 AuxI_O38 4;
BA_ "SPN" SG_ 3221225472 AuxI_O39 3862;
BA_ "SigType" SG_ 3221225472 AuxI_O39 4;
BA_ "SPN" SG_ 3221225472 AuxI_O40 3863;
BA_ "SigType" SG_ 3221225472 AuxI_O40 4;
BA_ "SPN" SG_ 3221225472 AuxI_O33 3856;
BA_ "SigType" SG_ 3221225472 AuxI_O33 4;
BA_ "SPN" SG_ 3221225472 AuxI_O34 3857;
BA_ "SigType" SG_ 3221225472 AuxI_O34 4;
BA_ "SPN" SG_ 3221225472 AuxI_O35 3858;
BA_ "SigType" SG_ 3221225472 AuxI_O35 4;
BA_ "SPN" SG_ 3221225472 AuxI_O36 3859;
BA_ "SigType" SG_ 3221225472 AuxI_O36 4;
BA_ "SPN" SG_ 3221225472 AuxI_O29 3852;
BA_ "SigType" SG_ 3221225472 AuxI_O29 4;
BA_ "SPN" SG_ 3221225472 AuxI_O30 3853;
BA_ "SigType" SG_ 3221225472 AuxI_O30 4;
BA_ "SPN" SG_ 3221225472 AuxI_O31 3854;
BA_ "SigType" SG_ 3221225472 AuxI_O31 4;
BA_ "SPN" SG_ 3221225472 AuxI_O32 3855;
BA_ "SigType" SG_ 3221225472 AuxI_O32 4;
BA_ "SPN" SG_ 3221225472 AuxI_O25 3848;
BA_ "SigType" SG_ 3221225472 AuxI_O25 4;
BA_ "SPN" SG_ 3221225472 AuxI_O26 3849;
BA_ "SigType" SG_ 3221225472 AuxI_O26 4;
BA_ "SPN" SG_ 3221225472 AuxI_O27 3850;
BA_ "SigType" SG_ 3221225472 AuxI_O27 4;
BA_ "SPN" SG_ 3221225472 AuxI_O28 3851;
BA_ "SigType" SG_ 3221225472 AuxI_O28 4;
BA_ "SPN" SG_ 3221225472 AuxI_O21 3844;
BA_ "SigType" SG_ 3221225472 AuxI_O21 4;
BA_ "SPN" SG_ 3221225472 AuxI_O22 3845;
BA_ "SigType" SG_ 3221225472 AuxI_O22 4;
BA_ "SPN" SG_ 3221225472 AuxI_O23 3846;
BA_ "SigType" SG_ 3221225472 AuxI_O23 4;
BA_ "SPN" SG_ 3221225472 AuxI_O24 3847;
BA_ "SigType" SG_ 3221225472 AuxI_O24 4;
BA_ "SPN" SG_ 3221225472 AuxI_O17 3840;
BA_ "SigType" SG_ 3221225472 AuxI_O17 4;
BA_ "SPN" SG_ 3221225472 AuxI_O18 3841;
BA_ "SigType" SG_ 3221225472 AuxI_O18 4;
BA_ "SPN" SG_ 3221225472 AuxI_O19 3842;
BA_ "SigType" SG_ 3221225472 AuxI_O19 4;
BA_ "SPN" SG_ 3221225472 AuxI_O20 3843;
BA_ "SigType" SG_ 3221225472 AuxI_O20 4;
BA_ "SPN" SG_ 3221225472 AuxI_O77 3900;
BA_ "SigType" SG_ 3221225472 AuxI_O77 4;
BA_ "SPN" SG_ 3221225472 AuxI_O78 3901;
BA_ "SigType" SG_ 3221225472 AuxI_O78 4;
BA_ "SPN" SG_ 3221225472 AuxI_O79 3902;
BA_ "SigType" SG_ 3221225472 AuxI_O79 4;
BA_ "SPN" SG_ 3221225472 AuxI_O80 3903;
BA_ "SigType" SG_ 3221225472 AuxI_O80 4;
BA_ "SPN" SG_ 3221225472 AuxI_O73 3896;
BA_ "SigType" SG_ 3221225472 AuxI_O73 4;
BA_ "SPN" SG_ 3221225472 AuxI_O74 3897;
BA_ "SigType" SG_ 3221225472 AuxI_O74 4;
BA_ "SPN" SG_ 3221225472 AuxI_O75 3898;
BA_ "SigType" SG_ 3221225472 AuxI_O75 4;
BA_ "SPN" SG_ 3221225472 AuxI_O76 3899;
BA_ "SigType" SG_ 3221225472 AuxI_O76 4;
BA_ "SPN" SG_ 3221225472 AuxI_O69 3892;
BA_ "SigType" SG_ 3221225472 AuxI_O69 4;
BA_ "SPN" SG_ 3221225472 AuxI_O70 3893;
BA_ "SigType" SG_ 3221225472 AuxI_O70 4;
BA_ "SPN" SG_ 3221225472 AuxI_O71 3894;
BA_ "SigType" SG_ 3221225472 AuxI_O71 4;
BA_ "SPN" SG_ 3221225472 AuxI_O72 3895;
BA_ "SigType" SG_ 3221225472 AuxI_O72 4;
BA_ "SPN" SG_ 3221225472 AuxI_O65 3888;
BA_ "SigType" SG_ 3221225472 AuxI_O65 4;
BA_ "SPN" SG_ 3221225472 AuxI_O66 3889;
BA_ "SigType" SG_ 3221225472 AuxI_O66 4;
BA_ "SPN" SG_ 3221225472 AuxI_O67 3890;
BA_ "SigType" SG_ 3221225472 AuxI_O67 4;
BA_ "SPN" SG_ 3221225472 AuxI_O68 3891;
BA_ "SigType" SG_ 3221225472 AuxI_O68 4;
BA_ "SPN" SG_ 3221225472 AuxI_O61 3884;
BA_ "SigType" SG_ 3221225472 AuxI_O61 4;
BA_ "SPN" SG_ 3221225472 AuxI_O62 3885;
BA_ "SigType" SG_ 3221225472 AuxI_O62 4;
BA_ "SPN" SG_ 3221225472 AuxI_O63 3886;
BA_ "SigType" SG_ 3221225472 AuxI_O63 4;
BA_ "SPN" SG_ 3221225472 AuxI_O64 3887;
BA_ "SigType" SG_ 3221225472 AuxI_O64 4;
BA_ "SPN" SG_ 3221225472 AuxI_O57 3880;
BA_ "SigType" SG_ 3221225472 AuxI_O57 4;
BA_ "SPN" SG_ 3221225472 AuxI_O58 3881;
BA_ "SigType" SG_ 3221225472 AuxI_O58 4;
BA_ "SPN" SG_ 3221225472 AuxI_O59 3882;
BA_ "SigType" SG_ 3221225472 AuxI_O59 4;
BA_ "SPN" SG_ 3221225472 AuxI_O60 3883;
BA_ "SigType" SG_ 3221225472 AuxI_O60 4;
BA_ "SPN" SG_ 3221225472 AuxI_O53 3876;
BA_ "SigType" SG_ 3221225472 AuxI_O53 4;
BA_ "SPN" SG_ 3221225472 AuxI_O54 3877;
BA_ "SigType" SG_ 3221225472 AuxI_O54 4;
BA_ "SPN" SG_ 3221225472 AuxI_O55 3878;
BA_ "SigType" SG_ 3221225472 AuxI_O55 4;
BA_ "SPN" SG_ 3221225472 AuxI_O56 3879;
BA_ "SigType" SG_ 3221225472 AuxI_O56 4;
BA_ "SPN" SG_ 3221225472 AuxI_O49 3872;
BA_ "SigType" SG_ 3221225472 AuxI_O49 4;
BA_ "SPN" SG_ 3221225472 AuxI_O50 3873;
BA_ "SigType" SG_ 3221225472 AuxI_O50 4;
BA_ "SPN" SG_ 3221225472 AuxI_O51 3874;
BA_ "SigType" SG_ 3221225472 AuxI_O51 4;
BA_ "SPN" SG_ 3221225472 AuxI_O52 3875;
BA_ "SigType" SG_ 3221225472 AuxI_O52 4;
BA_ "SPN" SG_ 3221225472 AuxI_O109 3932;
BA_ "SigType" SG_ 3221225472 AuxI_O109 4;
BA_ "SPN" SG_ 3221225472 AuxI_O110 3933;
BA_ "SigType" SG_ 3221225472 AuxI_O110 4;
BA_ "SPN" SG_ 3221225472 AuxI_O111 3934;
BA_ "SigType" SG_ 3221225472 AuxI_O111 4;
BA_ "SPN" SG_ 3221225472 AuxI_O112 3935;
BA_ "SigType" SG_ 3221225472 AuxI_O112 4;
BA_ "SPN" SG_ 3221225472 AuxI_O105 3928;
BA_ "SigType" SG_ 3221225472 AuxI_O105 4;
BA_ "SPN" SG_ 3221225472 AuxI_O106 3929;
BA_ "SigType" SG_ 3221225472 AuxI_O106 4;
BA_ "SPN" SG_ 3221225472 AuxI_O107 3930;
BA_ "SigType" SG_ 3221225472 AuxI_O107 4;
BA_ "SPN" SG_ 3221225472 AuxI_O108 3931;
BA_ "SigType" SG_ 3221225472 AuxI_O108 4;
BA_ "SPN" SG_ 3221225472 AuxI_O101 3924;
BA_ "SigType" SG_ 3221225472 AuxI_O101 4;
BA_ "SPN" SG_ 3221225472 AuxI_O102 3925;
BA_ "SigType" SG_ 3221225472 AuxI_O102 4;
BA_ "SPN" SG_ 3221225472 AuxI_O103 3926;
BA_ "SigType" SG_ 3221225472 AuxI_O103 4;
BA_ "SPN" SG_ 3221225472 AuxI_O104 3927;
BA_ "SigType" SG_ 3221225472 AuxI_O104 4;
BA_ "SPN" SG_ 3221225472 AuxI_O97 3920;
BA_ "SigType" SG_ 3221225472 AuxI_O97 4;
BA_ "SPN" SG_ 3221225472 AuxI_O98 3921;
BA_ "SigType" SG_ 3221225472 AuxI_O98 4;
BA_ "SPN" SG_ 3221225472 AuxI_O99 3922;
BA_ "SigType" SG_ 3221225472 AuxI_O99 4;
BA_ "SPN" SG_ 3221225472 AuxI_O100 3923;
BA_ "SigType" SG_ 3221225472 AuxI_O100 4;
BA_ "SPN" SG_ 3221225472 AuxI_O93 3916;
BA_ "SigType" SG_ 3221225472 AuxI_O93 4;
BA_ "SPN" SG_ 3221225472 AuxI_O94 3917;
BA_ "SigType" SG_ 3221225472 AuxI_O94 4;
BA_ "SPN" SG_ 3221225472 AuxI_O95 3918;
BA_ "SigType" SG_ 3221225472 AuxI_O95 4;
BA_ "SPN" SG_ 3221225472 AuxI_O96 3919;
BA_ "SigType" SG_ 3221225472 AuxI_O96 4;
BA_ "SPN" SG_ 3221225472 AuxI_O89 3912;
BA_ "SigType" SG_ 3221225472 AuxI_O89 4;
BA_ "SPN" SG_ 3221225472 AuxI_O90 3913;
BA_ "SigType" SG_ 3221225472 AuxI_O90 4;
BA_ "SPN" SG_ 3221225472 AuxI_O91 3914;
BA_ "SigType" SG_ 3221225472 AuxI_O91 4;
BA_ "SPN" SG_ 3221225472 AuxI_O92 3915;
BA_ "SigType" SG_ 3221225472 AuxI_O92 4;
BA_ "SPN" SG_ 3221225472 AuxI_O85 3908;
BA_ "SigType" SG_ 3221225472 AuxI_O85 4;
BA_ "SPN" SG_ 3221225472 AuxI_O86 3909;
BA_ "SigType" SG_ 3221225472 AuxI_O86 4;
BA_ "SPN" SG_ 3221225472 AuxI_O87 3910;
BA_ "SigType" SG_ 3221225472 AuxI_O87 4;
BA_ "SPN" SG_ 3221225472 AuxI_O88 3911;
BA_ "SigType" SG_ 3221225472 AuxI_O88 4;
BA_ "SPN" SG_ 3221225472 AuxI_O81 3904;
BA_ "SigType" SG_ 3221225472 AuxI_O81 4;
BA_ "SPN" SG_ 3221225472 AuxI_O82 3905;
BA_ "SigType" SG_ 3221225472 AuxI_O82 4;
BA_ "SPN" SG_ 3221225472 AuxI_O83 3906;
BA_ "SigType" SG_ 3221225472 AuxI_O83 4;
BA_ "SPN" SG_ 3221225472 AuxI_O84 3907;
BA_ "SigType" SG_ 3221225472 AuxI_O84 4;
BA_ "SPN" SG_ 3221225472 TrailerBrakeStrokeAxle5Right 3804;
BA_ "SPN" SG_ 3221225472 TrailerBrakeStrokeAxle5Left 3803;
BA_ "SPN" SG_ 3221225472 TrailerBrakeStrokeAxle4Right 3802;
BA_ "SPN" SG_ 3221225472 TrailerBrakeStrokeAxle4Left 3801;
BA_ "SPN" SG_ 3221225472 TrailerBrakeStrokeAxle3Right 3800;
BA_ "SPN" SG_ 3221225472 TrailerBrakeStrokeAxle3Left 3799;
BA_ "SPN" SG_ 3221225472 TrailerBrakeStrokeAxle2Right 3798;
BA_ "SPN" SG_ 3221225472 TrailerBrakeStrokeAxle2Left 3797;
BA_ "SPN" SG_ 3221225472 TrailerBrakeStrokeAxle1Right 3796;
BA_ "SPN" SG_ 3221225472 TrailerBrakeStrokeAxle1Left 3795;
BA_ "SPN" SG_ 3221225472 TractorBrakeStrokeAxle5Right 3794;
BA_ "SPN" SG_ 3221225472 TractorBrakeStrokeAxle5Left 3793;
BA_ "SPN" SG_ 3221225472 TractorBrakeStrokeAxle4Right 3792;
BA_ "SPN" SG_ 3221225472 TractorBrakeStrokeAxle4Left 3791;
BA_ "SPN" SG_ 3221225472 TractorBrakeStrokeAxle3Right 3790;
BA_ "SPN" SG_ 3221225472 TractorBrakeStrokeAxle3Left 3789;
BA_ "SPN" SG_ 3221225472 TractorBrakeStrokeAxle2Right 3788;
BA_ "SPN" SG_ 3221225472 TractorBrakeStrokeAxle2Left 3787;
BA_ "SPN" SG_ 3221225472 TractorBrakeStrokeAxle1Right 3786;
BA_ "SPN" SG_ 3221225472 TractorBrakeStrokeAxle1Left 3785;
BA_ "SPN" SG_ 3221225472 RoadSurfaceTemp 79;
BA_ "SigType" SG_ 3221225472 RoadSurfaceTemp 1;
BA_ "SPN" SG_ 3221225472 EngAirIntakeTemp 172;
BA_ "SigType" SG_ 3221225472 EngAirIntakeTemp 1;
BA_ "SPN" SG_ 3221225472 AmbientAirTemp 171;
BA_ "SigType" SG_ 3221225472 AmbientAirTemp 1;
BA_ "SPN" SG_ 3221225472 CabInteriorTemp 170;
BA_ "SigType" SG_ 3221225472 CabInteriorTemp 1;
BA_ "SPN" SG_ 3221225472 BarometricPress 108;
BA_ "SigType" SG_ 3221225472 BarometricPress 1;
BA_ "SPN" SG_ 3221225472 EngAirStopPress 6832;
BA_ "SigType" SG_ 3221225472 EngAirStopPress 1;
BA_ "SPN" SG_ 3221225472 EngAirStartPress6831 6831;
BA_ "SigType" SG_ 3221225472 EngAirStartPress6831 1;
BA_ "SPN" SG_ 3221225472 EngAirStartPress 82;
BA_ "SigType" SG_ 3221225472 EngAirStartPress 1;
BA_ "SPN" SG_ 3221225472 AirCompressorStatus 1351;
BA_ "SigType" SG_ 3221225472 AirCompressorStatus 4;
BA_ "SPN" SG_ 3221225472 AirSuspensionSupplyPress 1090;
BA_ "SigType" SG_ 3221225472 AirSuspensionSupplyPress 1;
BA_ "SPN" SG_ 3221225472 AuxEquipmentSupplyPress 1089;
BA_ "SigType" SG_ 3221225472 AuxEquipmentSupplyPress 1;
BA_ "SPN" SG_ 3221225472 PowertrainCircuitAirSupplyPress 6305;
BA_ "SigType" SG_ 3221225472 PowertrainCircuitAirSupplyPress 1;
BA_ "SPN" SG_ 3221225472 ServiceBrakeCircuit2AirPress 1088;
BA_ "SigType" SG_ 3221225472 ServiceBrakeCircuit2AirPress 1;
BA_ "SPN" SG_ 3221225472 ServiceBrakeCircuit1AirPress 1087;
BA_ "SigType" SG_ 3221225472 ServiceBrakeCircuit1AirPress 1;
BA_ "SPN" SG_ 3221225472 ParkingAnd_orTrailerAirPress 1086;
BA_ "SigType" SG_ 3221225472 ParkingAnd_orTrailerAirPress 1;
BA_ "SPN" SG_ 3221225472 PneumaticSupplyPress 46;
BA_ "SigType" SG_ 3221225472 PneumaticSupplyPress 1;
BA_ "SPN" SG_ 3221225472 SteerAxleLubePress 2614;
BA_ "SigType" SG_ 3221225472 SteerAxleLubePress 1;
BA_ "SPN" SG_ 3221225472 SteerAxleTemp 75;
BA_ "SigType" SG_ 3221225472 SteerAxleTemp 1;
BA_ "SPN" SG_ 3221225472 DriveAxleLubePress 2613;
BA_ "SigType" SG_ 3221225472 DriveAxleLubePress 1;
BA_ "SPN" SG_ 3221225472 DriveAxleTemp 578;
BA_ "SigType" SG_ 3221225472 DriveAxleTemp 1;
BA_ "SPN" SG_ 3221225472 DriveAxleLiftAirPress 579;
BA_ "SigType" SG_ 3221225472 DriveAxleLiftAirPress 1;
BA_ "SPN" SG_ 3221225472 DriveAxleLocation 930;
BA_ "SPN" SG_ 3221225472 EngGsMssFlwSnsrFuelingCorrection 1694;
BA_ "SigType" SG_ 3221225472 EngGsMssFlwSnsrFuelingCorrection 1;
BA_ "SPN" SG_ 3221225472 GsFlInjctonPulseCorrectionFactor 6649;
BA_ "GenSigStartValue" SG_ 3221225472 GsFlInjctonPulseCorrectionFactor 32128;
BA_ "SigType" SG_ 3221225472 GsFlInjctonPulseCorrectionFactor 1;
BA_ "SPN" SG_ 3221225472 EngTurboWastegateValvePos 1693;
BA_ "SigType" SG_ 3221225472 EngTurboWastegateValvePos 1;
BA_ "SPN" SG_ 3221225472 EngDesiredAbsIntakeManifoldPress 1692;
BA_ "SigType" SG_ 3221225472 EngDesiredAbsIntakeManifoldPress 1;
BA_ "SPN" SG_ 3221225472 EngGasFuelCorrectionFactor 1116;
BA_ "SigType" SG_ 3221225472 EngGasFuelCorrectionFactor 1;
BA_ "SPN" SG_ 3221225472 RequestedACCDistanceMode 1799;
BA_ "SPN" SG_ 3221225472 ACCUsageDemand 5023;
BA_ "SigType" SG_ 3221225472 ACCUsageDemand 5;
BA_ "SPN" SG_ 3221225472 ForwardCollisionWarning 5022;
BA_ "SigType" SG_ 3221225472 ForwardCollisionWarning 5;
BA_ "SPN" SG_ 3221225472 ACCDistanceAlertSignal 1796;
BA_ "SigType" SG_ 3221225472 ACCDistanceAlertSignal 5;
BA_ "SPN" SG_ 3221225472 ACCSystemShutoffWarning 1797;
BA_ "SigType" SG_ 3221225472 ACCSystemShutoffWarning 5;
BA_ "SPN" SG_ 3221225472 ACCTargetDetected 1798;
BA_ "SigType" SG_ 3221225472 ACCTargetDetected 5;
BA_ "SPN" SG_ 3221225472 AdptiveCruiseCtrlSetDistanceMode 1589;
BA_ "SPN" SG_ 3221225472 AdaptiveCruiseCtrlMode 1590;
BA_ "SPN" SG_ 3221225472 AdaptiveCruiseCtrlSetSpeed 1588;
BA_ "SigType" SG_ 3221225472 AdaptiveCruiseCtrlSetSpeed 1;
BA_ "SPN" SG_ 3221225472 DistanceToForwardVehicle 1587;
BA_ "SigType" SG_ 3221225472 DistanceToForwardVehicle 1;
BA_ "SPN" SG_ 3221225472 SpeedOfForwardVehicle 1586;
BA_ "SigType" SG_ 3221225472 SpeedOfForwardVehicle 1;
BA_ "SPN" SG_ 3221225472 ArticulationAngle 1120;
BA_ "SigType" SG_ 3221225472 ArticulationAngle 1;
BA_ "SPN" SG_ 3221225472 RelativeHumidity 354;
BA_ "SigType" SG_ 3221225472 RelativeHumidity 1;
BA_ "SPN" SG_ 3221225472 AuxLevel 3087;
BA_ "SigType" SG_ 3221225472 AuxLevel 1;
BA_ "SPN" SG_ 3221225472 AuxPress2 1388;
BA_ "SigType" SG_ 3221225472 AuxPress2 1;
BA_ "SPN" SG_ 3221225472 AuxPress1 1387;
BA_ "SigType" SG_ 3221225472 AuxPress1 1;
BA_ "SPN" SG_ 3221225472 AuxTemp2 442;
BA_ "SigType" SG_ 3221225472 AuxTemp2 1;
BA_ "SPN" SG_ 3221225472 AuxTemp1 441;
BA_ "SigType" SG_ 3221225472 AuxTemp1 1;
BA_ "SPN" SG_ 3221225472 LNGVaporizerCoolantOutletTemp 7020;
BA_ "SigType" SG_ 3221225472 LNGVaporizerCoolantOutletTemp 1;
BA_ "SPN" SG_ 3221225472 EngGasFuelVentPress 6814;
BA_ "SigType" SG_ 3221225472 EngGasFuelVentPress 1;
BA_ "SPN" SG_ 3221225472 EngBlowerBypassValvePos 72;
BA_ "SigType" SG_ 3221225472 EngBlowerBypassValvePos 1;
BA_ "SPN" SG_ 3221225472 EngGasSupplyPress 159;
BA_ "SigType" SG_ 3221225472 EngGasSupplyPress 1;
BA_ "SPN" SG_ 3221225472 AddressBusy 3293;
BA_ "SPN" SG_ 3221225472 ControlByte_ACKM 2541;
BA_ "SigType" SG_ 3221225472 ControlByte_ACKM 6;
BA_ "SPN" SG_ 3221225472 ParameterGroupNumber 2547;
BA_ "SigType" SG_ 3221225472 ParameterGroupNumber 6;
BA_ "SigType" SG_ 3221225472 GroupFunctionValue 1;
BA_ "SPN" SG_ 3221225472 AddressAccessDenied 3292;
BA_ "SPN" SG_ 3221225472 AddressNACK 3291;
BA_ "SPN" SG_ 3221225472 AddressAcknowledged 3290;
BA_ "SPN" SG_ 3221225472 Status2OfDoors 3411;
BA_ "SigType" SG_ 3221225472 Status2OfDoors 4;
BA_ "SPN" SG_ 3221225472 Ramp_WheelChairLiftPos 1820;
BA_ "SigType" SG_ 3221225472 Ramp_WheelChairLiftPos 4;
BA_ "SPN" SG_ 3221225472 PosOfDoors 1821;
BA_ "SPN" SG_ 3221225472 FifthWheelRollWarningIndicator 3317;
BA_ "SigType" SG_ 3221225472 FifthWheelRollWarningIndicator 5;
BA_ "SPN" SG_ 3221225472 FifthWheelRollMoment 3310;
BA_ "SigType" SG_ 3221225472 FifthWheelRollMoment 1;
BA_ "SPN" SG_ 3221225472 FifthWheelDrawbarForce 3309;
BA_ "SigType" SG_ 3221225472 FifthWheelDrawbarForce 1;
BA_ "SPN" SG_ 3221225472 FifthWheelVerticalForce 3308;
BA_ "SigType" SG_ 3221225472 FifthWheelVerticalForce 1;
BA_ "SPN" SG_ 3221225472 FifthWheelSliderLockIndicator 3316;
BA_ "SigType" SG_ 3221225472 FifthWheelSliderLockIndicator 4;
BA_ "SPN" SG_ 3221225472 FifthWheelSliderPos 3311;
BA_ "SigType" SG_ 3221225472 FifthWheelSliderPos 1;
BA_ "SPN" SG_ 3221225472 FfthWhlLockCoupleStatusIndicator 3313;
BA_ "SigType" SG_ 3221225472 FfthWhlLockCoupleStatusIndicator 5;
BA_ "SPN" SG_ 3221225472 FfthWhlLckReadyToCoupleIndicator 3312;
BA_ "SigType" SG_ 3221225472 FfthWhlLckReadyToCoupleIndicator 5;
BA_ "SPN" SG_ 3221225472 FifthWheelErrorStatus 3307;
BA_ "SPN" SG_ 3221225472 RollAndPitchMeasurementLatency 3327;
BA_ "SigType" SG_ 3221225472 RollAndPitchMeasurementLatency 1;
BA_ "SPN" SG_ 3221225472 PitchAndRollCompensated 3326;
BA_ "SigType" SG_ 3221225472 PitchAndRollCompensated 5;
BA_ "SPN" SG_ 3221225472 PitchRateFigureOfMerit 3325;
BA_ "SigType" SG_ 3221225472 PitchRateFigureOfMerit 5;
BA_ "SPN" SG_ 3221225472 RollAngleFigureOfMerit 3324;
BA_ "SigType" SG_ 3221225472 RollAngleFigureOfMerit 5;
BA_ "SPN" SG_ 3221225472 PitchAngleFigureOfMerit 3323;
BA_ "SigType" SG_ 3221225472 PitchAngleFigureOfMerit 5;
BA_ "SPN" SG_ 3221225472 PitchRate 3322;
BA_ "SigType" SG_ 3221225472 PitchRate 1;
BA_ "SPN" SG_ 3221225472 RollAngle 3319;
BA_ "SigType" SG_ 3221225472 RollAngle 1;
BA_ "SPN" SG_ 3221225472 PitchAngle 3318;
BA_ "SigType" SG_ 3221225472 PitchAngle 1;
BA_ "SPN" SG_ 3221225472 TransOilLevel1MeasurementStatus 3026;
BA_ "SPN" SG_ 3221225472 TransOilLevel1CountdownTimer 3028;
BA_ "SPN" SG_ 3221225472 TransOilLevel1High_Low 3027;
BA_ "SigType" SG_ 3221225472 TransOilLevel1High_Low 1;
BA_ "SPN" SG_ 3221225472 TransOilTemp1 177;
BA_ "SigType" SG_ 3221225472 TransOilTemp1 1;
BA_ "SPN" SG_ 3221225472 TransOilPress 127;
BA_ "SigType" SG_ 3221225472 TransOilPress 1;
BA_ "SPN" SG_ 3221225472 TransFilterDiffPress 126;
BA_ "SigType" SG_ 3221225472 TransFilterDiffPress 1;
BA_ "SPN" SG_ 3221225472 TransOilLevel1 124;
BA_ "SigType" SG_ 3221225472 TransOilLevel1 1;
BA_ "SPN" SG_ 3221225472 ClutchPress 123;
BA_ "SigType" SG_ 3221225472 ClutchPress 1;
BA_ "SPN" SG_ 3221225472 KeyswitchBatteryPotential 158;
BA_ "SigType" SG_ 3221225472 KeyswitchBatteryPotential 1;
BA_ "SPN" SG_ 3221225472 BatteryPotential_PowerInput1 168;
BA_ "SigType" SG_ 3221225472 BatteryPotential_PowerInput1 1;
BA_ "SPN" SG_ 3221225472 ChargingSystemPotential 167;
BA_ "SigType" SG_ 3221225472 ChargingSystemPotential 1;
BA_ "SPN" SG_ 3221225472 WrelessCommunicationNetworkType2 3446;
BA_ "SPN" SG_ 3221225472 NetworkSignalStrength2 3445;
BA_ "SigType" SG_ 3221225472 NetworkSignalStrength2 1;
BA_ "SPN" SG_ 3221225472 NetworkAntennaStatus2 3444;
BA_ "SPN" SG_ 3221225472 NetworkServiceStatus2 3443;
BA_ "SPN" SG_ 3221225472 NetworkTransceiverStatus2 3442;
BA_ "SPN" SG_ 3221225472 WrelessCommunicationNetworkType1 3372;
BA_ "SPN" SG_ 3221225472 NetworkSignalStrength1 3371;
BA_ "SigType" SG_ 3221225472 NetworkSignalStrength1 1;
BA_ "SPN" SG_ 3221225472 NetworkAntennaStatus1 3370;
BA_ "SPN" SG_ 3221225472 NetworkServiceStatus1 3369;
BA_ "SPN" SG_ 3221225472 NetworkTransceiverStatus1 3368;
BA_ "SPN" SG_ 3221225472 VoltageRegulatorEnabled 3379;
BA_ "SigType" SG_ 3221225472 VoltageRegulatorEnabled 5;
BA_ "SPN" SG_ 3221225472 VoltageRegulatorSoftStartState 3378;
BA_ "SigType" SG_ 3221225472 VoltageRegulatorSoftStartState 5;
BA_ "SPN" SG_ 3221225472 VltgRgltrUndrfrqncyCmpnstnEnbld 3377;
BA_ "SigType" SG_ 3221225472 VltgRgltrUndrfrqncyCmpnstnEnbld 5;
BA_ "SPN" SG_ 3221225472 VltgRgltrVAr_PwrFctrOprtingMode 3376;
BA_ "SPN" SG_ 3221225472 VltgRglatorLoadCompensationMode 3375;
BA_ "SPN" SG_ 3221225472 GnrtrOtputVoltageBiasPercentage 3382;
BA_ "SigType" SG_ 3221225472 GnrtrOtputVoltageBiasPercentage 1;
BA_ "SPN" SG_ 3221225472 GeneratorExcitationFieldCurrent 3381;
BA_ "SigType" SG_ 3221225472 GeneratorExcitationFieldCurrent 1;
BA_ "SPN" SG_ 3221225472 GeneratorExcitationFieldVoltage 3380;
BA_ "SigType" SG_ 3221225472 GeneratorExcitationFieldVoltage 1;
BA_ "SPN" SG_ 2566702846 EngOBDWarmUpSequence 5843;
BA_ "SigType" SG_ 2566702846 EngOBDWarmUpSequence 5;
BA_ "SPN" SG_ 2566703102 CertificationEngineFamilyName 5845;
BA_ "SPN" SG_ 2566703102 ModelYear 5844;
BA_ "SigType" SG_ 2566703102 ModelYear 3;
BA_ "SigType" SG_ 2566705918 DTC1 7;
BA_ "SPN" SG_ 2566705918 FlashProtectLamp 3041;
BA_ "SigType" SG_ 2566705918 FlashProtectLamp 5;
BA_ "SPN" SG_ 2566705918 FlashAmberWarningLamp 3040;
BA_ "SigType" SG_ 2566705918 FlashAmberWarningLamp 5;
BA_ "SPN" SG_ 2566705918 FlashRedStopLamp 3039;
BA_ "SigType" SG_ 2566705918 FlashRedStopLamp 5;
BA_ "SPN" SG_ 2566705918 FlashMalfuncIndicatorLamp 3038;
BA_ "SigType" SG_ 2566705918 FlashMalfuncIndicatorLamp 5;
BA_ "SPN" SG_ 2566705918 ProtectLampStatus 987;
BA_ "SigType" SG_ 2566705918 ProtectLampStatus 5;
BA_ "SPN" SG_ 2566705918 AmberWarningLampStatus 624;
BA_ "SigType" SG_ 2566705918 AmberWarningLampStatus 5;
BA_ "SPN" SG_ 2566705918 RedStopLampState 623;
BA_ "SigType" SG_ 2566705918 RedStopLampState 4;
BA_ "SPN" SG_ 2566705918 MalfunctionIndicatorLampStatus 1213;
BA_ "SigType" SG_ 2566705918 MalfunctionIndicatorLampStatus 5;
BA_ "SigType" SG_ 2566705918 DTC5 7;
BA_ "SigType" SG_ 2566705918 DTC4 7;
BA_ "SigType" SG_ 2566705918 DTC3 7;
BA_ "SigType" SG_ 2566705918 DTC2 7;
VAL_ 3221225472 GnrtorOverallPowerFactorLagging 3 "Not Available or Not Installed" 2 "Error" 1 "Lagging" 0 "Leading" ;
VAL_ 3221225472 GnratorPhaseCPowerFactorLagging 3 "Not Available or Not Installed" 2 "Error" 1 "Lagging" 0 "Leading" ;
VAL_ 3221225472 GnratorPhaseBPowerFactorLagging 3 "Not Available or Not Installed" 2 "Error" 1 "Lagging" 0 "Leading" ;
VAL_ 3221225472 GnratorPhaseAPowerFactorLagging 3 "Not Available or Not Installed" 2 "Error" 1 "Lagging" 0 "Leading" ;
VAL_ 3221225472 Bus1_UtilityInSync 3 "Not Available or Not Installed" 2 "Error" 1 "Synchronized" 0 "Not synchronized" ;
VAL_ 3221225472 Bus1_UtilityVoltageMatch 3 "Not Available or Not Installed" 2 "Error" 1 "Voltages match" 0 "Voltages do not match" ;
VAL_ 3221225472 Bus1_UtilityFrequencyMatch 3 "Not Available or Not Installed" 2 "Error" 1 "Frequencies match" 0 "Frequencies do not match" ;
VAL_ 3221225472 Bus1_UtilityPhaseMatch 3 "Not Available or Not Installed" 2 "Error" 1 "Phases match" 0 "Phases do not match" ;
VAL_ 3221225472 Bus1_UtilityDeadBus 3 "Not Available or Not Installed" 2 "Error" 1 "Bus is dead" 0 "Bus is not dead" ;
VAL_ 3221225472 Bus1_GeneratorInSync 3 "Not Available or Not Installed" 2 "Error" 1 "Synchronized" 0 "Not synchronized" ;
VAL_ 3221225472 Bus1_GeneratorVoltageMatch 3 "Not Available or Not Installed" 2 "Error" 1 "Voltages match" 0 "Voltages do not match" ;
VAL_ 3221225472 Bus1_GeneratorFrequencyMatch 3 "Not Available or Not Installed" 2 "Error" 1 "Frequencies match" 0 "Frequencies do not match" ;
VAL_ 3221225472 Bus1_GeneratorPhaseMatch 3 "Not Available or Not Installed" 2 "Error" 1 "Phases match" 0 "Phases do not match" ;
VAL_ 3221225472 Bus1_GeneratorDeadBus 3 "Not Available or Not Installed" 2 "Error" 1 "Bus is dead" 0 "Bus is not dead" ;
VAL_ 3221225472 PGNumber 0 "Zero" 255 "NotAvailable" 16646143 "Dummy" ;
VAL_ 3221225472 ControlByte 24 "EAbort" 23 "EEoMACK" 22 "EDPO" 21 "ECTS" 20 "ERTS" 255 "Abort" 32 "BAM" 19 "EoMA" 17 "CTS" 16 "RTS" ;
VAL_ 3221225472 UseTransferMode 3 "NA" 2 "Undefined" 1 "Yes" 0 "No" ;
VAL_ 3221225472 AdditionalAxleGroupLocation 2 "Rear Drive axle group" 1 "Rear Steer axle group" 0 "Reserved" ;
VAL_ 3221225472 AxleGroupLocation 15 "Reserved" 14 "Additional trailer axle group" 13 "Trailer H axle group" 12 "Trailer G axle group" 11 "Trailer F axle group" 10 "Trailer E axle group" 9 "Trailer D axle group" 8 "Trailer C axle group" 7 "Trailer B axle group" 6 "Trailer A axle group" 5 "Additional tractor axle group" 4 "Tag axle group" 3 "Sole or Forward-most Drive axle group" 2 "Lift axle group" 1 "Sole or Forward-most Steer axle group" 0 "Reserved" ;
VAL_ 3221225472 AdditionalAxleGroupLocation 2 "Rear Drive axle group" 1 "Rear Steer axle group" 0 "Reserved" ;
VAL_ 3221225472 AxleGroupLocation 15 "Reserved" 14 "Additional trailer axle group" 13 "Trailer H axle group" 12 "Trailer G axle group" 11 "Trailer F axle group" 10 "Trailer E axle group" 9 "Trailer D axle group" 8 "Trailer C axle group" 7 "Trailer B axle group" 6 "Trailer A axle group" 5 "Additional tractor axle group" 4 "Tag axle group" 3 "Sole or Forward-most Drive axle group" 2 "Lift axle group" 1 "Sole or Forward-most Steer axle group" 0 "Reserved" ;
VAL_ 3221225472 AftercoolerCoolantThermostatMode 3 "don't care/reserved" 2 "reserved" 1 "position control mode" 0 "temperature control mode" ;
VAL_ 3221225472 RarDriveAxleGroupWeightAvailable 3 "Not available / not applicable" 2 "Reserved" 1 "Rear drive axle group present" 0 "Rear drive axle group not present" ;
VAL_ 3221225472 RarSteerAxleGroupWeightAvailable 3 "Not available / not applicable" 2 "Reserved" 1 "Rear Steer axle group present" 0 "Rear Steer axle group not present" ;
VAL_ 3221225472 AddtnlTrlrAxlGrupWeightAvailable 3 "Not available / not applicable" 2 "Reserved" 1 "Additional trailer axle group present" 0 "Additional trailer axle group not present" ;
VAL_ 3221225472 TrailerHAxleGroupWeightAvailable 3 "Not available / not applicable" 2 "Reserved" 1 "Trailer H axle group present" 0 "Trailer H axle group not present" ;
VAL_ 3221225472 TrailerGAxleGroupWeightAvailable 3 "Not available / not applicable" 2 "Reserved" 1 "Trailer G axle group present" 0 "Trailer G axle group not present" ;
VAL_ 3221225472 TrailerFAxleGroupWeightAvailable 3 "Not available / not applicable" 2 "Reserved" 1 "Trailer F axle group present" 0 "Trailer F axle group not present" ;
VAL_ 3221225472 TrailerEAxleGroupWeightAvailable 3 "Not available / not applicable" 2 "Reserved" 1 "Trailer E axle group present" 0 "Trailer E axle group not present" ;
VAL_ 3221225472 TrailerDAxleGroupWeightAvailable 3 "Not available / not applicable" 2 "Reserved" 1 "Trailer D axle group present" 0 "Trailer D axle group not present" ;
VAL_ 3221225472 TrailerCAxleGroupWeightAvailable 3 "Not available / not applicable" 2 "Reserved" 1 "Trailer C axle group present" 0 "Trailer C axle group not present" ;
VAL_ 3221225472 TrailerBAxleGroupWeightAvailable 3 "Not available / not applicable" 2 "Reserved" 1 "Trailer B axle group present" 0 "Trailer B axle group not present" ;
VAL_ 3221225472 TrailerAAxleGroupWeightAvailable 3 "Not available / not applicable" 2 "Reserved" 1 "Trailer A axle group present" 0 "Trailer A axle group not present" ;
VAL_ 3221225472 AddtnlTrctrAxlGrpWeightAvailable 3 "Not available / not applicable" 2 "Reserved" 1 "Additional tractor axle group present" 0 "Additional tractor axle group not present" ;
VAL_ 3221225472 TagAxleGroupWeightAvailable 3 "Not available / not applicable" 2 "Reserved" 1 "Tag axle group present" 0 "Tag axle group not present" ;
VAL_ 3221225472 DriveAxleGroupWeightAvailable 3 "Not available / not applicable" 2 "Reserved" 1 "Drive axle group present" 0 "Drive axle group not present" ;
VAL_ 3221225472 LiftAxleGroupWeightAvailable 3 "Not available / not applicable" 2 "Reserved" 1 "Lift axle group present" 0 "Lift axle group not present" ;
VAL_ 3221225472 SteerAxleGroupWeightAvailable 3 "Not available / not applicable" 2 "Reserved" 1 "Steer axle group present" 0 "Steer axle group not present" ;
VAL_ 3221225472 ZeroNetVehicleWeightChange 3 "Not available / Not applicable" 2 "Reserved" 1 "Zero Net Vehicle Weight Change" 0 "No change to Net Vehicle Weight Change " ;
VAL_ 3221225472 AETCDataCollectionStandard 15 "Not Available" 0 "SAE J1995" ;
VAL_ 3221225472 RightHeadlampLightDistribution 15 "Not available" 7 "Different light distributions not available" 6 "Light distribution failure" 5 "Light distribution fail safe position" 4 "Light distribution adverse weather" 3 "Light distribution high beam" 2 "Light distribution motorway" 1 "Light distribution country" 0 "Light distribution town" ;
VAL_ 3221225472 LeftHeadlampLightDistribution 15 "Not available" 7 "Different light distributions not available" 6 "Light distribution failure" 5 "Light distribution fail safe position" 4 "Light distribution adverse weather" 3 "Light distribution high beam" 2 "Light distribution motorway" 1 "Light distribution country" 0 "Light distribution town" ;
VAL_ 3221225472 RightHeadlampDynamicBendingLight 7 "Not available" 3 "Dynamic bending light failure" 2 "Dynamic bending light fail safe position" 1 "Dynamic bending light is working properly" 0 "Dynamic bending light deactivated" ;
VAL_ 3221225472 LeftHeadlampDynamicBendingLight 7 "Not available" 3 "Dynamic bending light failure" 2 "Dynamic bending light fail safe position" 1 "Dynamic bending light is working properly" 0 "Dynamic bending light deactivated" ;
VAL_ 3221225472 AuxI_O13 3 "Not available" 2 "Error" 1 "Auxiliary channel on" 0 "Auxiliary channel off" ;
VAL_ 3221225472 AuxI_O14 3 "Not available" 2 "Error" 1 "Auxiliary channel on" 0 "Auxiliary channel off" ;
VAL_ 3221225472 AuxI_O15 3 "Not available" 2 "Error" 1 "Auxiliary channel on" 0 "Auxiliary channel off" ;
VAL_ 3221225472 AuxI_O16 3 "Not available" 2 "Error" 1 "Auxiliary channel on" 0 "Auxiliary channel off" ;
VAL_ 3221225472 AuxI_O09 3 "Not available" 2 "Error" 1 "Auxiliary channel on" 0 "Auxiliary channel off" ;
VAL_ 3221225472 AuxI_O10 3 "Not available" 2 "Error" 1 "Auxiliary channel on" 0 "Auxiliary channel off" ;
VAL_ 3221225472 AuxI_O11 3 "Not available" 2 "Error" 1 "Auxiliary channel on" 0 "Auxiliary channel off" ;
VAL_ 3221225472 AuxI_O12 3 "Not available" 2 "Error" 1 "Auxiliary channel on" 0 "Auxiliary channel off" ;
VAL_ 3221225472 AuxI_O05 3 "Not available" 2 "Error" 1 "Auxiliary channel on" 0 "Auxiliary channel off" ;
VAL_ 3221225472 AuxI_O06 2 "Error" 1 "Auxiliary channel on" 0 "Auxiliary channel off" 3 "Not available" ;
VAL_ 3221225472 AuxI_O07 3 "Not available" 2 "Error" 1 "Auxiliary channel on" 0 "Auxiliary channel off" ;
VAL_ 3221225472 AuxI_O08 3 "Not available" 2 "Error" 1 "Auxiliary channel on" 0 "Auxiliary channel off" ;
VAL_ 3221225472 AuxI_O01 3 "Not available" 2 "Error" 1 "Auxiliary channel on" 0 "Auxiliary channel off" ;
VAL_ 3221225472 AuxI_O02 3 "Not available" 2 "Error" 1 "Auxiliary channel on" 0 "Auxiliary channel off" ;
VAL_ 3221225472 AuxI_O03 3 "Not available" 2 "Error" 1 "Auxiliary channel on" 0 "Auxiliary channel off" ;
VAL_ 3221225472 AuxI_O04 3 "Not available" 2 "Error" 1 "Auxiliary channel on" 0 "Auxiliary channel off" ;
VAL_ 3221225472 AuxI_O45 3 "Not Available or Take No Action" 2 "Error Indicator or Not Used " 1 "Auxiliary channel on" 0 "Auxiliary channel off" ;
VAL_ 3221225472 AuxI_O46 3 "Not Available or Take No Action" 2 "Error Indicator or Not Used " 1 "Auxiliary channel on" 0 "Auxiliary channel off" ;
VAL_ 3221225472 AuxI_O47 3 "Not Available or Take No Action" 2 "Error Indicator or Not Used " 1 "Auxiliary channel on" 0 "Auxiliary channel off" ;
VAL_ 3221225472 AuxI_O48 3 "Not Available or Take No Action" 2 "Error Indicator or Not Used " 1 "Auxiliary channel on" 0 "Auxiliary channel off" ;
VAL_ 3221225472 AuxI_O41 3 "Not Available or Take No Action" 2 "Error Indicator or Not Used " 1 "Auxiliary channel on" 0 "Auxiliary channel off" ;
VAL_ 3221225472 AuxI_O42 3 "Not Available or Take No Action" 2 "Error Indicator or Not Used " 1 "Auxiliary channel on" 0 "Auxiliary channel off" ;
VAL_ 3221225472 AuxI_O43 3 "Not Available or Take No Action" 2 "Error Indicator or Not Used " 1 "Auxiliary channel on" 0 "Auxiliary channel off" ;
VAL_ 3221225472 AuxI_O44 3 "Not Available or Take No Action" 2 "Error Indicator or Not Used " 1 "Auxiliary channel on" 0 "Auxiliary channel off" ;
VAL_ 3221225472 AuxI_O37 3 "Not Available or Take No Action" 2 "Error Indicator or Not Used " 1 "Auxiliary channel on" 0 "Auxiliary channel off" ;
VAL_ 3221225472 AuxI_O38 3 "Not Available or Take No Action" 2 "Error Indicator or Not Used " 1 "Auxiliary channel on" 0 "Auxiliary channel off" ;
VAL_ 3221225472 AuxI_O39 3 "Not Available or Take No Action" 2 "Error Indicator or Not Used " 1 "Auxiliary channel on" 0 "Auxiliary channel off" ;
VAL_ 3221225472 AuxI_O40 3 "Not Available or Take No Action" 2 "Error Indicator or Not Used " 1 "Auxiliary channel on" 0 "Auxiliary channel off" ;
VAL_ 3221225472 AuxI_O33 3 "Not Available or Take No Action" 2 "Error Indicator or Not Used " 1 "Auxiliary channel on" 0 "Auxiliary channel off" ;
VAL_ 3221225472 AuxI_O34 3 "Not Available or Take No Action" 2 "Error Indicator or Not Used " 1 "Auxiliary channel on" 0 "Auxiliary channel off" ;
VAL_ 3221225472 AuxI_O35 3 "Not Available or Take No Action" 2 "Error Indicator or Not Used " 1 "Auxiliary channel on" 0 "Auxiliary channel off" ;
VAL_ 3221225472 AuxI_O36 3 "Not Available or Take No Action" 2 "Error Indicator or Not Used " 1 "Auxiliary channel on" 0 "Auxiliary channel off" ;
VAL_ 3221225472 AuxI_O29 3 "Not Available or Take No Action" 2 "Error Indicator or Not Used " 1 "Auxiliary channel on" 0 "Auxiliary channel off" ;
VAL_ 3221225472 AuxI_O30 3 "Not Available or Take No Action" 2 "Error Indicator or Not Used " 1 "Auxiliary channel on" 0 "Auxiliary channel off" ;
VAL_ 3221225472 AuxI_O31 3 "Not Available or Take No Action" 2 "Error Indicator or Not Used " 1 "Auxiliary channel on" 0 "Auxiliary channel off" ;
VAL_ 3221225472 AuxI_O32 3 "Not Available or Take No Action" 2 "Error Indicator or Not Used " 1 "Auxiliary channel on" 0 "Auxiliary channel off" ;
VAL_ 3221225472 AuxI_O25 3 "Not Available or Take No Action" 2 "Error Indicator or Not Used " 1 "Auxiliary channel on" 0 "Auxiliary channel off" ;
VAL_ 3221225472 AuxI_O26 3 "Not Available or Take No Action" 2 "Error Indicator or Not Used " 1 "Auxiliary channel on" 0 "Auxiliary channel off" ;
VAL_ 3221225472 AuxI_O27 0 "Auxiliary channel off" 3 "Not Available or Take No Action" 2 "Error Indicator or Not Used " 1 "Auxiliary channel on" ;
VAL_ 3221225472 AuxI_O28 3 "Not Available or Take No Action" 2 "Error Indicator or Not Used " 1 "Auxiliary channel on" 0 "Auxiliary channel off" ;
VAL_ 3221225472 AuxI_O21 3 "Not Available or Take No Action" 2 "Error Indicator or Not Used " 1 "Auxiliary channel on" 0 "Auxiliary channel off" ;
VAL_ 3221225472 AuxI_O22 3 "Not Available or Take No Action" 2 "Error Indicator or Not Used " 1 "Auxiliary channel on" 0 "Auxiliary channel off" ;
VAL_ 3221225472 AuxI_O23 3 "Not Available or Take No Action" 2 "Error Indicator or Not Used " 1 "Auxiliary channel on" 0 "Auxiliary channel off" ;
VAL_ 3221225472 AuxI_O24 3 "Not Available or Take No Action" 2 "Error Indicator or Not Used " 1 "Auxiliary channel on" 0 "Auxiliary channel off" ;
VAL_ 3221225472 AuxI_O17 3 "Not Available or Take No Action" 2 "Error Indicator or Not Used " 1 "Auxiliary channel on" 0 "Auxiliary channel off" ;
VAL_ 3221225472 AuxI_O18 3 "Not Available or Take No Action" 2 "Error Indicator or Not Used " 1 "Auxiliary channel on" 0 "Auxiliary channel off" ;
VAL_ 3221225472 AuxI_O19 3 "Not Available or Take No Action" 2 "Error Indicator or Not Used " 1 "Auxiliary channel on" 0 "Auxiliary channel off" ;
VAL_ 3221225472 AuxI_O20 3 "Not Available or Take No Action" 2 "Error Indicator or Not Used " 1 "Auxiliary channel on" 0 "Auxiliary channel off" ;
VAL_ 3221225472 AuxI_O77 3 "Not Available or Take No Action" 2 "Error Indicator or Not Used " 1 "Auxiliary channel on" 0 "Auxiliary channel off" ;
VAL_ 3221225472 AuxI_O78 3 "Not Available or Take No Action" 2 "Error Indicator or Not Used " 1 "Auxiliary channel on" 0 "Auxiliary channel off" ;
VAL_ 3221225472 AuxI_O79 3 "Not Available or Take No Action" 2 "Error Indicator or Not Used " 1 "Auxiliary channel on" 0 "Auxiliary channel off" ;
VAL_ 3221225472 AuxI_O80 3 "Not Available or Take No Action" 2 "Error Indicator or Not Used " 1 "Auxiliary channel on" 0 "Auxiliary channel off" ;
VAL_ 3221225472 AuxI_O73 3 "Not Available or Take No Action" 2 "Error Indicator or Not Used " 1 "Auxiliary channel on" 0 "Auxiliary channel off" ;
VAL_ 3221225472 AuxI_O74 3 "Not Available or Take No Action" 2 "Error Indicator or Not Used " 1 "Auxiliary channel on" 0 "Auxiliary channel off" ;
VAL_ 3221225472 AuxI_O75 3 "Not Available or Take No Action" 2 "Error Indicator or Not Used " 1 "Auxiliary channel on" 0 "Auxiliary channel off" ;
VAL_ 3221225472 AuxI_O76 3 "Not Available or Take No Action" 2 "Error Indicator or Not Used " 1 "Auxiliary channel on" 0 "Auxiliary channel off" ;
VAL_ 3221225472 AuxI_O69 3 "Not Available or Take No Action" 2 "Error Indicator or Not Used " 1 "Auxiliary channel on" 0 "Auxiliary channel off" ;
VAL_ 3221225472 AuxI_O70 3 "Not Available or Take No Action" 2 "Error Indicator or Not Used " 1 "Auxiliary channel on" 0 "Auxiliary channel off" ;
VAL_ 3221225472 AuxI_O71 3 "Not Available or Take No Action" 2 "Error Indicator or Not Used " 1 "Auxiliary channel on" 0 "Auxiliary channel off" ;
VAL_ 3221225472 AuxI_O72 3 "Not Available or Take No Action" 2 "Error Indicator or Not Used " 1 "Auxiliary channel on" 0 "Auxiliary channel off" ;
VAL_ 3221225472 AuxI_O65 3 "Not Available or Take No Action" 2 "Error Indicator or Not Used " 1 "Auxiliary channel on" 0 "Auxiliary channel off" ;
VAL_ 3221225472 AuxI_O66 3 "Not Available or Take No Action" 2 "Error Indicator or Not Used " 1 "Auxiliary channel on" 0 "Auxiliary channel off" ;
VAL_ 3221225472 AuxI_O67 3 "Not Available or Take No Action" 2 "Error Indicator or Not Used " 1 "Auxiliary channel on" 0 "Auxiliary channel off" ;
VAL_ 3221225472 AuxI_O68 3 "Not Available or Take No Action" 2 "Error Indicator or Not Used " 1 "Auxiliary channel on" 0 "Auxiliary channel off" ;
VAL_ 3221225472 AuxI_O61 3 "Not Available or Take No Action" 2 "Error Indicator or Not Used " 1 "Auxiliary channel on" 0 "Auxiliary channel off" ;
VAL_ 3221225472 AuxI_O62 3 "Not Available or Take No Action" 2 "Error Indicator or Not Used " 1 "Auxiliary channel on" 0 "Auxiliary channel off" ;
VAL_ 3221225472 AuxI_O63 3 "Not Available or Take No Action" 2 "Error Indicator or Not Used " 1 "Auxiliary channel on" 0 "Auxiliary channel off" ;
VAL_ 3221225472 AuxI_O64 3 "Not Available or Take No Action" 2 "Error Indicator or Not Used " 1 "Auxiliary channel on" 0 "Auxiliary channel off" ;
VAL_ 3221225472 AuxI_O57 3 "Not Available or Take No Action" 2 "Error Indicator or Not Used " 1 "Auxiliary channel on" 0 "Auxiliary channel off" ;
VAL_ 3221225472 AuxI_O58 3 "Not Available or Take No Action" 2 "Error Indicator or Not Used " 1 "Auxiliary channel on" 0 "Auxiliary channel off" ;
VAL_ 3221225472 AuxI_O59 3 "Not Available or Take No Action" 2 "Error Indicator or Not Used " 1 "Auxiliary channel on" 0 "Auxiliary channel off" ;
VAL_ 3221225472 AuxI_O60 3 "Not Available or Take No Action" 2 "Error Indicator or Not Used " 1 "Auxiliary channel on" 0 "Auxiliary channel off" ;
VAL_ 3221225472 AuxI_O53 3 "Not Available or Take No Action" 2 "Error Indicator or Not Used " 1 "Auxiliary channel on" 0 "Auxiliary channel off" ;
VAL_ 3221225472 AuxI_O54 3 "Not Available or Take No Action" 2 "Error Indicator or Not Used " 1 "Auxiliary channel on" 0 "Auxiliary channel off" ;
VAL_ 3221225472 AuxI_O55 3 "Not Available or Take No Action" 2 "Error Indicator or Not Used " 1 "Auxiliary channel on" 0 "Auxiliary channel off" ;
VAL_ 3221225472 AuxI_O56 3 "Not Available or Take No Action" 2 "Error Indicator or Not Used " 1 "Auxiliary channel on" 0 "Auxiliary channel off" ;
VAL_ 3221225472 AuxI_O49 3 "Not Available or Take No Action" 2 "Error Indicator or Not Used " 1 "Auxiliary channel on" 0 "Auxiliary channel off" ;
VAL_ 3221225472 AuxI_O50 3 "Not Available or Take No Action" 2 "Error Indicator or Not Used " 1 "Auxiliary channel on" 0 "Auxiliary channel off" ;
VAL_ 3221225472 AuxI_O51 3 "Not Available or Take No Action" 2 "Error Indicator or Not Used " 1 "Auxiliary channel on" 0 "Auxiliary channel off" ;
VAL_ 3221225472 AuxI_O52 3 "Not Available or Take No Action" 2 "Error Indicator or Not Used " 1 "Auxiliary channel on" 0 "Auxiliary channel off" ;
VAL_ 3221225472 AuxI_O109 3 "Not Available or Take No Action" 2 "Error Indicator or Not Used " 1 "Auxiliary channel on" 0 "Auxiliary channel off" ;
VAL_ 3221225472 AuxI_O110 3 "Not Available or Take No Action" 2 "Error Indicator or Not Used " 1 "Auxiliary channel on" 0 "Auxiliary channel off" ;
VAL_ 3221225472 AuxI_O111 3 "Not Available or Take No Action" 2 "Error Indicator or Not Used " 1 "Auxiliary channel on" 0 "Auxiliary channel off" ;
VAL_ 3221225472 AuxI_O112 3 "Not Available or Take No Action" 2 "Error Indicator or Not Used " 1 "Auxiliary channel on" 0 "Auxiliary channel off" ;
VAL_ 3221225472 AuxI_O105 3 "Not Available or Take No Action" 2 "Error Indicator or Not Used " 1 "Auxiliary channel on" 0 "Auxiliary channel off" ;
VAL_ 3221225472 AuxI_O106 3 "Not Available or Take No Action" 2 "Error Indicator or Not Used " 1 "Auxiliary channel on" 0 "Auxiliary channel off" ;
VAL_ 3221225472 AuxI_O107 3 "Not Available or Take No Action" 2 "Error Indicator or Not Used " 1 "Auxiliary channel on" 0 "Auxiliary channel off" ;
VAL_ 3221225472 AuxI_O108 3 "Not Available or Take No Action" 2 "Error Indicator or Not Used " 1 "Auxiliary channel on" 0 "Auxiliary channel off" ;
VAL_ 3221225472 AuxI_O101 3 "Not Available or Take No Action" 2 "Error Indicator or Not Used " 1 "Auxiliary channel on" 0 "Auxiliary channel off" ;
VAL_ 3221225472 AuxI_O102 3 "Not Available or Take No Action" 2 "Error Indicator or Not Used " 1 "Auxiliary channel on" 0 "Auxiliary channel off" ;
VAL_ 3221225472 AuxI_O103 3 "Not Available or Take No Action" 2 "Error Indicator or Not Used " 1 "Auxiliary channel on" 0 "Auxiliary channel off" ;
VAL_ 3221225472 AuxI_O104 3 "Not Available or Take No Action" 2 "Error Indicator or Not Used " 1 "Auxiliary channel on" 0 "Auxiliary channel off" ;
VAL_ 3221225472 AuxI_O97 3 "Not Available or Take No Action" 2 "Error Indicator or Not Used " 1 "Auxiliary channel on" 0 "Auxiliary channel off" ;
VAL_ 3221225472 AuxI_O98 3 "Not Available or Take No Action" 2 "Error Indicator or Not Used " 1 "Auxiliary channel on" 0 "Auxiliary channel off" ;
VAL_ 3221225472 AuxI_O99 3 "Not Available or Take No Action" 2 "Error Indicator or Not Used " 1 "Auxiliary channel on" 0 "Auxiliary channel off" ;
VAL_ 3221225472 AuxI_O100 3 "Not Available or Take No Action" 2 "Error Indicator or Not Used " 1 "Auxiliary channel on" 0 "Auxiliary channel off" ;
VAL_ 3221225472 AuxI_O93 3 "Not Available or Take No Action" 2 "Error Indicator or Not Used " 1 "Auxiliary channel on" 0 "Auxiliary channel off" ;
VAL_ 3221225472 AuxI_O94 3 "Not Available or Take No Action" 2 "Error Indicator or Not Used " 1 "Auxiliary channel on" 0 "Auxiliary channel off" ;
VAL_ 3221225472 AuxI_O95 0 "Auxiliary channel off" 3 "Not Available or Take No Action" 2 "Error Indicator or Not Used " 1 "Auxiliary channel on" ;
VAL_ 3221225472 AuxI_O96 3 "Not Available or Take No Action" 2 "Error Indicator or Not Used " 1 "Auxiliary channel on" 0 "Auxiliary channel off" ;
VAL_ 3221225472 AuxI_O89 3 "Not Available or Take No Action" 2 "Error Indicator or Not Used " 1 "Auxiliary channel on" 0 "Auxiliary channel off" ;
VAL_ 3221225472 AuxI_O90 3 "Not Available or Take No Action" 2 "Error Indicator or Not Used " 1 "Auxiliary channel on" 0 "Auxiliary channel off" ;
VAL_ 3221225472 AuxI_O91 3 "Not Available or Take No Action" 2 "Error Indicator or Not Used " 1 "Auxiliary channel on" 0 "Auxiliary channel off" ;
VAL_ 3221225472 AuxI_O92 3 "Not Available or Take No Action" 2 "Error Indicator or Not Used " 1 "Auxiliary channel on" 0 "Auxiliary channel off" ;
VAL_ 3221225472 AuxI_O85 3 "Not Available or Take No Action" 2 "Error Indicator or Not Used " 1 "Auxiliary channel on" 0 "Auxiliary channel off" ;
VAL_ 3221225472 AuxI_O86 3 "Not Available or Take No Action" 2 "Error Indicator or Not Used " 1 "Auxiliary channel on" 0 "Auxiliary channel off" ;
VAL_ 3221225472 AuxI_O87 3 "Not Available or Take No Action" 2 "Error Indicator or Not Used " 1 "Auxiliary channel on" 0 "Auxiliary channel off" ;
VAL_ 3221225472 AuxI_O88 3 "Not Available or Take No Action" 2 "Error Indicator or Not Used " 1 "Auxiliary channel on" 0 "Auxiliary channel off" ;
VAL_ 3221225472 AuxI_O81 3 "Not Available or Take No Action" 2 "Error Indicator or Not Used " 1 "Auxiliary channel on" 0 "Auxiliary channel off" ;
VAL_ 3221225472 AuxI_O82 3 "Not Available or Take No Action" 2 "Error Indicator or Not Used " 1 "Auxiliary channel on" 0 "Auxiliary channel off" ;
VAL_ 3221225472 AuxI_O83 3 "Not Available or Take No Action" 2 "Error Indicator or Not Used " 1 "Auxiliary channel on" 0 "Auxiliary channel off" ;
VAL_ 3221225472 AuxI_O84 3 "Not Available or Take No Action" 2 "Error Indicator or Not Used " 1 "Auxiliary channel on" 0 "Auxiliary channel off" ;
VAL_ 3221225472 TrailerBrakeStrokeAxle5Right 7 "Not available" 6 "Sensor error" 5 "Reserved" 4 "Reserved" 3 "Dragging brake" 2 "Overstroke" 1 "Non-functioning" 0 "OK" ;
VAL_ 3221225472 TrailerBrakeStrokeAxle5Left 7 "Not available" 6 "Sensor error" 5 "Reserved" 4 "Reserved" 3 "Dragging brake" 2 "Overstroke" 1 "Non-functioning" 0 "OK" ;
VAL_ 3221225472 TrailerBrakeStrokeAxle4Right 7 "Not available" 6 "Sensor error" 5 "Reserved" 4 "Reserved" 3 "Dragging brake" 2 "Overstroke" 1 "Non-functioning" 0 "OK" ;
VAL_ 3221225472 TrailerBrakeStrokeAxle4Left 7 "Not available" 6 "Sensor error" 5 "Reserved" 4 "Reserved" 3 "Dragging brake" 2 "Overstroke" 1 "Non-functioning" 0 "OK" ;
VAL_ 3221225472 TrailerBrakeStrokeAxle3Right 7 "Not available" 6 "Sensor error" 5 "Reserved" 4 "Reserved" 3 "Dragging brake" 2 "Overstroke" 1 "Non-functioning" 0 "OK" ;
VAL_ 3221225472 TrailerBrakeStrokeAxle3Left 7 "Not available" 6 "Sensor error" 5 "Reserved" 4 "Reserved" 3 "Dragging brake" 2 "Overstroke" 1 "Non-functioning" 0 "OK" ;
VAL_ 3221225472 TrailerBrakeStrokeAxle2Right 7 "Not available" 6 "Sensor error" 5 "Reserved" 4 "Reserved" 3 "Dragging brake" 2 "Overstroke" 1 "Non-functioning" 0 "OK" ;
VAL_ 3221225472 TrailerBrakeStrokeAxle2Left 7 "Not available" 6 "Sensor error" 5 "Reserved" 4 "Reserved" 3 "Dragging brake" 2 "Overstroke" 1 "Non-functioning" 0 "OK" ;
VAL_ 3221225472 TrailerBrakeStrokeAxle1Right 7 "Not available" 6 "Sensor error" 5 "Reserved" 4 "Reserved" 3 "Dragging brake" 2 "Overstroke" 1 "Non-functioning" 0 "OK" ;
VAL_ 3221225472 TrailerBrakeStrokeAxle1Left 7 "Not available" 6 "Sensor error" 5 "Reserved" 4 "Reserved" 3 "Dragging brake" 2 "Overstroke" 1 "Non-functioning" 0 "OK" ;
VAL_ 3221225472 TractorBrakeStrokeAxle5Right 7 "Not available" 6 "Sensor error" 5 "Reserved" 4 "Reserved" 3 "Dragging brake" 2 "Overstroke" 1 "Non-functioning" 0 "OK" ;
VAL_ 3221225472 TractorBrakeStrokeAxle5Left 7 "Not available" 6 "Sensor error" 5 "Reserved" 4 "Reserved" 3 "Dragging brake" 2 "Overstroke" 1 "Non-functioning" 0 "OK" ;
VAL_ 3221225472 TractorBrakeStrokeAxle4Right 7 "Not available" 6 "Sensor error" 5 "Reserved" 4 "Reserved" 3 "Dragging brake" 2 "Overstroke" 1 "Non-functioning" 0 "OK" ;
VAL_ 3221225472 TractorBrakeStrokeAxle4Left 7 "Not available" 6 "Sensor error" 5 "Reserved" 4 "Reserved" 3 "Dragging brake" 2 "Overstroke" 1 "Non-functioning" 0 "OK" ;
VAL_ 3221225472 TractorBrakeStrokeAxle3Right 0 "OK" 7 "Not available" 6 "Sensor error" 5 "Reserved" 4 "Reserved" 3 "Dragging brake" 2 "Overstroke" 1 "Non-functioning" ;
VAL_ 3221225472 TractorBrakeStrokeAxle3Left 7 "Not available" 6 "Sensor error" 5 "Reserved" 4 "Reserved" 3 "Dragging brake" 2 "Overstroke" 1 "Non-functioning" 0 "OK" ;
VAL_ 3221225472 TractorBrakeStrokeAxle2Right 7 "Not available" 6 "Sensor error" 5 "Reserved" 4 "Reserved" 3 "Dragging brake" 2 "Overstroke" 1 "Non-functioning" 0 "OK" ;
VAL_ 3221225472 TractorBrakeStrokeAxle2Left 7 "Not available" 6 "Sensor error" 5 "Reserved" 4 "Reserved" 3 "Dragging brake" 2 "Overstroke" 1 "Non-functioning" 0 "OK" ;
VAL_ 3221225472 TractorBrakeStrokeAxle1Right 7 "Not available" 6 "Sensor error" 5 "Reserved" 4 "Reserved" 3 "Dragging brake" 2 "Overstroke" 1 "Non-functioning" 0 "OK" ;
VAL_ 3221225472 TractorBrakeStrokeAxle1Left 7 "Not available" 6 "Sensor error" 5 "Reserved" 4 "Reserved" 3 "Dragging brake" 2 "Overstroke " 1 "Non-functioning" 0 "OK" ;
VAL_ 3221225472 AirCompressorStatus 3 "Not available" 2 "Error indicator" 1 "Compressor active" 0 "Compressor not active" ;
VAL_ 3221225472 RequestedACCDistanceMode 7 "not available" 6 "error condition" 5 "not defined" 4 "Requested ACC Distance Mode #5" 3 "Requested ACC Distance Mode #4" 2 "Requested ACC Distance Mode #3" 1 "Requested ACC Distance Mode #2" 0 "Requested ACC Distance Mode #1" ;
VAL_ 3221225472 ACCUsageDemand 3 "don't care" 2 "reserved" 1 "driver demand for using ACC distance keeping control" 0 "driver demand for not using ACC distance keeping control" ;
VAL_ 3221225472 ForwardCollisionWarning 3 "not available" 2 "Error indicator" 1 "Collision is imminent" 0 "No warning" ;
VAL_ 3221225472 ACCDistanceAlertSignal 3 "Take no action" 2 "Reserved" 1 "ACC DAS Active" 0 "ACC DAS Not Active" ;
VAL_ 3221225472 ACCSystemShutoffWarning 3 "Take no action" 2 "Reserved" 1 "ACC SSOW Active" 0 "ACC SSOW Not Active" ;
VAL_ 3221225472 ACCTargetDetected 3 "Take no action" 2 "Reserved" 1 "Target detected" 0 "No targets detected" ;
VAL_ 3221225472 AdptiveCruiseCtrlSetDistanceMode 7 "Not available/not valid" 6 "Error condition" 5 "Conventional cruise control mode" 4 "ACC Distance mode #5" 3 "ACC Distance mode #4" 2 "ACC Distance mode #3" 1 "ACC Distance mode #2" 0 "ACC Distance mode #1" ;
VAL_ 3221225472 AdaptiveCruiseCtrlMode 7 "Not available/not valid" 6 "Disabled or error condition" 5 "Finish mode" 4 "Hold mode" 3 "Overtake mode" 2 "Distance control active" 1 "Speed control active" 0 "Off" ;
VAL_ 3221225472 ControlByte_ACKM 3 "Cannot Respond" 2 "Access Denied" 1 "Negative Acknowledgment" 0 "Positive Acknowledgment" ;
VAL_ 3221225472 Status2OfDoors 3 "not available" 2 "error" 1 "at least 1 bus door enabled " 0 "all bus doors are disabled" ;
VAL_ 3221225472 Ramp_WheelChairLiftPos 3 "Not available" 2 "Error" 1 "Outside bus" 0 "Inside bus" ;
VAL_ 3221225472 PosOfDoors 15 "Not available" 14 "Error" 2 "All doors closed" 1 "Closing last door" 0 "At least 1 door is open" ;
VAL_ 3221225472 FifthWheelRollWarningIndicator 3 "Not Available" 2 "error" 1 "Limit exceeded" 0 "Limit not exceeded" ;
VAL_ 3221225472 FifthWheelSliderLockIndicator 3 "Not Available" 2 "Error" 1 "Locked" 0 "Not Locked" ;
VAL_ 3221225472 FfthWhlLockCoupleStatusIndicator 3 "Not Available" 2 "Error" 1 "Successful couple detected" 0 "Incomplete or bad couple" ;
VAL_ 3221225472 FfthWhlLckReadyToCoupleIndicator 3 "Not Available" 2 "Error" 1 "Lock open" 0 "Lock not open" ;
VAL_ 3221225472 FifthWheelErrorStatus 15 "15" 14 "14" 13 "13" 12 "12" 11 "11" 10 "10" 9 "9" 8 "8" 7 "7" 6 "6" 5 "5" 4 "4" 3 "3" 2 "2" 1 "1" 0 "0" ;
VAL_ 3221225472 PitchAndRollCompensated 3 "Not Available" 2 "Error" 1 "Compensation On" 0 "Compensation Off" ;
VAL_ 3221225472 PitchRateFigureOfMerit 3 "Not available" 2 "Error" 1 "Pitch rate degraded" 0 "Pitch rate fully functional" ;
VAL_ 3221225472 RollAngleFigureOfMerit 3 "Not available" 2 "Error" 1 "Roll angle degraded" 0 "Roll angle fully functional" ;
VAL_ 3221225472 PitchAngleFigureOfMerit 3 "Not available" 2 "Error" 1 "Pitch angle degraded" 0 "Pitch angle fully functional" ;
VAL_ 3221225472 TransOilLevel1MeasurementStatus 15 "Not available" 14 "Error" 13 "Conditions not valid, Other" 12 "Not defined" 11 "Not defined" 10 "Not defined" 9 "Conditions not valid, No request for reading" 8 "Conditions not valid, Engine speed too high" 7 "Conditions not valid, Engine speed too low" 6 "Conditions not valid, Vehicle not level" 5 "Conditions not valid, Vehicle moving" 4 "Conditions not valid, Transmission fluid temperature too high" 3 "Conditions not valid, Transmission fluid temperature too low" 2 "Conditions not valid, Transmission in gear" 1 "Conditions not valid, Settling timer still counting down" 0 "Conditions valid for transmission oil level measurement" ;
VAL_ 3221225472 TransOilLevel1CountdownTimer 15 "Not Available" 14 "Error" 13 "Thirteen minutes" 12 "Twelve minutes" 11 "Eleven minutes" 10 "Ten minutes" 9 "Nine minutes" 8 "Eight minutes" 7 "Seven minutes" 6 "Six minutes" 5 "Five minutes" 4 "Four minutes" 3 "Three minutes" 2 "Two minutes" 1 "One minute" 0 "less than 1 minute" ;
VAL_ 3221225472 WrelessCommunicationNetworkType2 255 "Not Available" 254 "Error" 4 "Satellite network" 3 "Wireless LAN #2" 2 "Wireless LAN #1" 1 "Cellular network #2" 0 "Cellular network #1" ;
VAL_ 3221225472 NetworkAntennaStatus2 255 "Not Available" 254 "Error" 1 "On" 0 "Off" ;
VAL_ 3221225472 NetworkServiceStatus2 255 "Not Available" 254 "Error" 3 "Not Authorized to Operate on Service" 2 "Service not available" 1 "Roaming Service" 0 "Local Service" ;
VAL_ 3221225472 NetworkTransceiverStatus2 255 "Not Available" 254 "Error" 2 "Not Authorized to Operate on Network" 1 "On" 0 "Off" ;
VAL_ 3221225472 WrelessCommunicationNetworkType1 255 "Not Available" 254 "Error" 4 "Satellite network" 3 "Wireless LAN #2" 2 "Wireless LAN #1" 1 "Cellular network #2" 0 "Cellular network #1" ;
VAL_ 3221225472 NetworkAntennaStatus1 255 "Not Available" 254 "Error" 1 "On" 0 "Off" ;
VAL_ 3221225472 NetworkServiceStatus1 255 "Not Available" 254 "Error" 3 "Not Authorized to Operate on Service" 2 "Service not available" 1 "Roaming Service" 0 "Local Service" ;
VAL_ 3221225472 NetworkTransceiverStatus1 255 "Not Available" 254 "Error" 2 "Not Authorized to Operate on Network" 1 "On" 0 "Off" ;
VAL_ 3221225472 VoltageRegulatorEnabled 3 "Not available" 2 "Reserved" 1 "Regulating voltage" 0 "Not regulating voltage" ;
VAL_ 3221225472 VoltageRegulatorSoftStartState 3 "Not available" 2 "Reserved" 1 "Soft start is active" 0 "Soft start is inactive" ;
VAL_ 3221225472 VltgRgltrUndrfrqncyCmpnstnEnbld 3 "Not available" 2 "Reserved" 1 "Underfrequency compensation enabled" 0 "Underfrequency compensation disabled" ;
VAL_ 3221225472 VltgRgltrVAr_PwrFctrOprtingMode 7 "Not available" 6 "Reserved" 5 "Reserved" 4 "Reserved" 3 "Reserved" 2 "VAr regulation enabled" 1 "Power factor regulation enabled" 0 "VAr/Power Factor regulation disabled" ;
VAL_ 3221225472 VltgRglatorLoadCompensationMode 7 "Not available" 6 "Reserved" 5 "Reserved" 4 "Reserved" 3 "Reserved" 2 "IR line drop compensation enabled" 1 "Voltage droop compensation enabled" 0 "load compensation disabled" ;
VAL_ 2566702846 EngOBDWarmUpSequence 3 "Not supported or not available" 2 "SAE reserved" 1 "A warm-up cycle has occurred on this engine start" 0 "A warm-up cycle has not occurred on this engine start" ;
VAL_ 2566705918 FlashProtectLamp 3 "Unavailable / Do Not Flash" 2 "Reserved" 1 "Fast Flash" 0 "Slow Flash" ;
VAL_ 2566705918 FlashAmberWarningLamp 3 "Unavailable / Do Not Flash" 2 "Reserved" 1 "Fast Flash" 0 "Slow Flash" ;
VAL_ 2566705918 FlashRedStopLamp 3 "Unavailable / Do Not Flash" 2 "Reserved" 1 "Fast Flash" 0 "Slow Flash" ;
VAL_ 2566705918 FlashMalfuncIndicatorLamp 3 "Unavailable / Do Not Flash" 2 "Class C DTC  " 1 "Fast Flash" 0 "Slow Flash" ;
VAL_ 2566705918 ProtectLampStatus 3 "Not available" 2 "Reserved" 1 "Lamp On" 0 "Lamp Off" ;
VAL_ 2566705918 AmberWarningLampStatus 3 "Not available" 2 "Reserved" 1 "Lamp On" 0 "Lamp Off" ;
VAL_ 2566705918 RedStopLampState 3 "Not available" 2 "Reserved" 1 "Lamp On" 0 "Lamp Off" ;
VAL_ 2566705918 MalfunctionIndicatorLampStatus 3 "Not available" 2 "Short MIL for WWH OBD" 1 "Lamp On" 0 "Lamp Off" ;
