VERSION ""

NS_ :

BS_:

BU_: PowertrainControlModule AtmosphericSensor SafetyRestraintSystem2 Aftertreatment_2_GasOutlet Aftertreatment_2_GasIntake DieselPartFilterControl Turbocharger SafetyRestraintSystem1 CabDisplay2 Aftertreatment_1_GasOutlet Aftertreatment_1_GasIntake OnBoardDataLogger OffBoardDiagnosticTool2 OffBoardDiagnosticTool1 FileServer ParkingBrakeController SeatController2 FanDriveController SteeringColumnUnit CommunicationUnitRadio CommunicationUnitSatellite CommunicationUnitCellular PropulsionBatteryCharger ChassisController2 ChassisController1 EngineValveControl AuxiliaryHeater2 AuxiliaryHeater1 ClutchUnit RampControl InformationSystem1 SuspensionSystemController2 OilSensor VehicleDynamicStability ExhaustEmissionController TransmissionDisplay2 TransmissionDisplay1 ClimateControl2 WaterPumpController RearAxleSteeringController LightingOperatorControl SeatController1 IgnitionController2 IgnitionController1 TirePressureController CabController2 CabController1 PneumaticSystemController SuspensionSystemController1 HydraulicPumpController EnduranceBrakingSystem RetarderExhaustEngine2 OnBoardDiagnosticUnit HeadwayController RetarderExhaustEngine1 CabDisplay1 ManagementComputer VirtualTerminal OffVehicleGateway PowerTakeOffFront HitchControl AuxiliaryValveControl BodyController TractorTrailerBridge1 StarterSystem ElectricalSystem VehicleSecurity VehicleNavigation AerodynamicControl ElectricalChargingSystem ClimateControl1 TripRecorder InstrumentCluster SuspensionDriveAxle2 SuspensionDriveAxle1 SuspensionSteerAxle SteeringController FuelSystem CruiseControl RetarderDriveline RetarderEngine BrakesDriveAxle2 BrakesDriveAxle1 BrakesSystemController BrakesSteerAxle AxleDrive2 AxleDrive1 AxleSteering PowerTakeOff ShiftConsoleSecondary ShiftConsolePrimary Transmission2 Transmission1 Engine2 Engine1

BO_ 3221225472 VECTOR__INDEPENDENT_SIG_MSG: 0 Vector__XXX
 SG_ EngExhaustDesiredNOx : 0|16@1+ (0.05,-200) [-200|3012.75] "ppm" Vector__XXX
 SG_ EngExhaustNOx : 0|16@1+ (0.05,-200) [-200|3012.75] "ppm" Vector__XXX
 SG_ GasFuelAccumulatorTemp : 0|8@1+ (1,-40) [-40|210] "°C" Vector__XXX
 SG_ EngFuelVaporizer1DischargeTemp : 0|8@1+ (1,-40) [-40|210] "°C" Vector__XXX
 SG_ EngGasFuelSupplyPress : 0|16@1+ (0.00390625,0) [0|250.996] "MPa" Vector__XXX
 SG_ ProductIdentificationModel : 0|8@1+ (1,0) [0|0] "" Vector__XXX
 SG_ ProductIdentificationBrand : 0|8@1+ (1,0) [0|0] "" Vector__XXX
 SG_ ProductIdentificationCode : 0|8@1+ (1,0) [0|0] "" Vector__XXX
 SG_ EngGsFlVlve20StartOfActuationCmd : 0|16@1+ (0.0078125,-400) [-400|101.99] "deg" Vector__XXX
 SG_ EngGsFlVlve19StartOfActuationCmd : 0|16@1+ (0.0078125,-400) [-400|101.99] "deg" Vector__XXX
 SG_ EngGsFlVlve18StartOfActuationCmd : 0|16@1+ (0.0078125,-400) [-400|101.99] "deg" Vector__XXX
 SG_ EngGsFlVlve17StartOfActuationCmd : 0|16@1+ (0.0078125,-400) [-400|101.99] "deg" Vector__XXX
 SG_ EngGsFlVlve16StartOfActuationCmd : 0|16@1+ (0.0078125,-400) [-400|101.99] "deg" Vector__XXX
 SG_ EngGsFlVlve15StartOfActuationCmd : 0|16@1+ (0.0078125,-400) [-400|101.99] "deg" Vector__XXX
 SG_ EngGsFlVlve14StartOfActuationCmd : 0|16@1+ (0.0078125,-400) [-400|101.99] "deg" Vector__XXX
 SG_ EngGsFlVlve13StartOfActuationCmd : 0|16@1+ (0.0078125,-400) [-400|101.99] "deg" Vector__XXX
 SG_ EngGsFlVlve12StartOfActuationCmd : 0|16@1+ (0.0078125,-400) [-400|101.99] "deg" Vector__XXX
 SG_ EngGsFlVlve11StartOfActuationCmd : 0|16@1+ (0.0078125,-400) [-400|101.99] "deg" Vector__XXX
 SG_ EngGsFlVlve10StartOfActuationCmd : 0|16@1+ (0.0078125,-400) [-400|101.99] "deg" Vector__XXX
 SG_ EngGsFlValve9StartOfActuationCmd : 0|16@1+ (0.0078125,-400) [-400|101.99] "deg" Vector__XXX
 SG_ EngGsFlValve8StartOfActuationCmd : 0|16@1+ (0.0078125,-400) [-400|101.99] "deg" Vector__XXX
 SG_ EngGsFlValve7StartOfActuationCmd : 0|16@1+ (0.0078125,-400) [-400|101.99] "deg" Vector__XXX
 SG_ EngGsFlValve6StartOfActuationCmd : 0|16@1+ (0.0078125,-400) [-400|101.99] "deg" Vector__XXX
 SG_ EngGsFlValve5StartOfActuationCmd : 0|16@1+ (0.0078125,-400) [-400|101.99] "deg" Vector__XXX
 SG_ EngGsFlValve4StartOfActuationCmd : 0|16@1+ (0.0078125,-400) [-400|101.99] "deg" Vector__XXX
 SG_ EngGsFlValve3StartOfActuationCmd : 0|16@1+ (0.0078125,-400) [-400|101.99] "deg" Vector__XXX
 SG_ EngGsFlValve2StartOfActuationCmd : 0|16@1+ (0.0078125,-400) [-400|101.99] "deg" Vector__XXX
 SG_ EngGsFlValve1StartOfActuationCmd : 0|16@1+ (0.0078125,-400) [-400|101.99] "deg" Vector__XXX
 SG_ EngGasFuelValve20DurationCmd : 0|16@1+ (2,0) [0|128510] "µs" Vector__XXX
 SG_ EngGasFuelValve19DurationCmd : 0|16@1+ (2,0) [0|128510] "µs" Vector__XXX
 SG_ EngGasFuelValve18DurationCmd : 0|16@1+ (2,0) [0|128510] "µs" Vector__XXX
 SG_ EngGasFuelValve17DurationCmd : 0|16@1+ (2,0) [0|128510] "µs" Vector__XXX
 SG_ EngGasFuelValve16DurationCmd : 0|16@1+ (2,0) [0|128510] "µs" Vector__XXX
 SG_ EngGasFuelValve15DurationCmd : 0|16@1+ (2,0) [0|128510] "µs" Vector__XXX
 SG_ EngGasFuelValve14DurationCmd : 0|16@1+ (2,0) [0|128510] "µs" Vector__XXX
 SG_ EngGasFuelValve13DurationCmd : 0|16@1+ (2,0) [0|128510] "µs" Vector__XXX
 SG_ EngGasFuelValve12DurationCmd : 0|16@1+ (2,0) [0|128510] "µs" Vector__XXX
 SG_ EngGasFuelValve11DurationCmd : 0|16@1+ (2,0) [0|128510] "µs" Vector__XXX
 SG_ EngGasFuelValve10DurationCmd : 0|16@1+ (2,0) [0|128510] "µs" Vector__XXX
 SG_ EngGasFuelValve9DurationCmd : 0|16@1+ (2,0) [0|128510] "µs" Vector__XXX
 SG_ EngGasFuelValve8DurationCmd : 0|16@1+ (2,0) [0|128510] "µs" Vector__XXX
 SG_ EngGasFuelValve7DurationCmd : 0|16@1+ (2,0) [0|128510] "µs" Vector__XXX
 SG_ EngGasFuelValve6DurationCmd : 0|16@1+ (2,0) [0|128510] "µs" Vector__XXX
 SG_ EngGasFuelValve5DurationCmd : 0|16@1+ (2,0) [0|128510] "µs" Vector__XXX
 SG_ EngGasFuelValve4DurationCmd : 0|16@1+ (2,0) [0|128510] "µs" Vector__XXX
 SG_ EngGasFuelValve3DurationCmd : 0|16@1+ (2,0) [0|128510] "µs" Vector__XXX
 SG_ EngGasFuelValve2DurationCmd : 0|16@1+ (2,0) [0|128510] "µs" Vector__XXX
 SG_ EngGasFuelValve1DurationCmd : 0|16@1+ (2,0) [0|128510] "µs" Vector__XXX
 SG_ EngGsFlVlvNmnlStrtOfActuationCmd : 0|16@1+ (0.0078125,-400) [-400|101.99] "deg" Vector__XXX
 SG_ EngGsFuelValveNominalDurationCmd : 0|16@1+ (2,0) [0|128510] "µs" Vector__XXX
 SG_ TransDirectionalOutputShaftSpeed : 0|16@1+ (1,-32127) [-32127|32128] "rpm" Vector__XXX
 SG_ TransHydrostaticLoop2Press : 0|16@1+ (1,0) [0|64255] "kPa" Vector__XXX
 SG_ TransHydrostaticLoop1Press : 0|16@1+ (1,0) [0|64255] "kPa" Vector__XXX
 SG_ EngCyl20AvrageCombustionDuration : 0|16@1+ (0.0078125,0) [0|501.99] "deg" Vector__XXX
 SG_ EngCyl20AvrgCntrOfCmbstionTiming : 0|16@1+ (0.0078125,-250) [-250|250.992] "deg" Vector__XXX
 SG_ EngCyl20AvrgStrtOfCmbstionTiming : 0|16@1+ (0.0078125,-250) [-250|250.992] "deg" Vector__XXX
 SG_ EngCyl20IndctdMeanEffectivePress : 0|16@1+ (0.0001220703125,-1) [-1|6.84362793] "MPa" Vector__XXX
 SG_ EngCyl19AvrageCombustionDuration : 0|16@1+ (0.0078125,0) [0|501.99] "deg" Vector__XXX
 SG_ EngCyl19AvrgCntrOfCmbstionTiming : 0|16@1+ (0.0078125,-250) [-250|250.992] "deg" Vector__XXX
 SG_ EngCyl19AvrgStrtOfCmbstionTiming : 0|16@1+ (0.0078125,-250) [-250|250.992] "deg" Vector__XXX
 SG_ EngCyl19IndctdMeanEffectivePress : 0|16@1+ (0.0001220703125,-1) [-1|6.84362793] "MPa" Vector__XXX
 SG_ EngCyl18AvrageCombustionDuration : 0|16@1+ (0.0078125,0) [0|501.99] "deg" Vector__XXX
 SG_ EngCyl18AvrgCntrOfCmbstionTiming : 0|16@1+ (0.0078125,-250) [-250|250.992] "deg" Vector__XXX
 SG_ EngCyl18AvrgStrtOfCmbstionTiming : 0|16@1+ (0.0078125,-250) [-250|250.992] "deg" Vector__XXX
 SG_ EngCyl18IndctdMeanEffectivePress : 0|16@1+ (0.0001220703125,-1) [-1|6.84362793] "MPa" Vector__XXX
 SG_ EngCyl17AvrageCombustionDuration : 0|16@1+ (0.0078125,0) [0|501.99] "deg" Vector__XXX
 SG_ EngCyl17AvrgCntrOfCmbstionTiming : 0|16@1+ (0.0078125,-250) [-250|250.992] "deg" Vector__XXX
 SG_ EngCyl17AvrgStrtOfCmbstionTiming : 0|16@1+ (0.0078125,-250) [-250|250.992] "deg" Vector__XXX
 SG_ EngCyl17IndctdMeanEffectivePress : 0|16@1+ (0.0001220703125,-1) [-1|6.84362793] "MPa" Vector__XXX
 SG_ EngCyl16AvrageCombustionDuration : 0|16@1+ (0.0078125,0) [0|501.99] "deg" Vector__XXX
 SG_ EngCyl16AvrgCntrOfCmbstionTiming : 0|16@1+ (0.0078125,-250) [-250|250.992] "deg" Vector__XXX
 SG_ EngCyl16AvrgStrtOfCmbstionTiming : 0|16@1+ (0.0078125,-250) [-250|250.992] "deg" Vector__XXX
 SG_ EngCyl16IndctdMeanEffectivePress : 0|16@1+ (0.0001220703125,-1) [-1|6.84362793] "MPa" Vector__XXX
 SG_ EngCyl15AvrageCombustionDuration : 0|16@1+ (0.0078125,0) [0|501.99] "deg" Vector__XXX
 SG_ EngCyl15AvrgCntrOfCmbstionTiming : 0|16@1+ (0.0078125,-250) [-250|250.992] "deg" Vector__XXX
 SG_ EngCyl15AvrgStrtOfCmbstionTiming : 0|16@1+ (0.0078125,-250) [-250|250.992] "deg" Vector__XXX
 SG_ EngCyl15IndctdMeanEffectivePress : 0|16@1+ (0.0001220703125,-1) [-1|6.84362793] "MPa" Vector__XXX
 SG_ EngCyl14AvrageCombustionDuration : 0|16@1+ (0.0078125,0) [0|501.99] "deg" Vector__XXX
 SG_ EngCyl14AvrgCntrOfCmbstionTiming : 0|16@1+ (0.0078125,-250) [-250|250.992] "deg" Vector__XXX
 SG_ EngCyl14AvrgStrtOfCmbstionTiming : 0|16@1+ (0.0078125,-250) [-250|250.992] "deg" Vector__XXX
 SG_ EngCyl14IndctdMeanEffectivePress : 0|16@1+ (0.0001220703125,-1) [-1|6.84362793] "MPa" Vector__XXX
 SG_ EngCyl13AvrageCombustionDuration : 0|16@1+ (0.0078125,0) [0|501.99] "deg" Vector__XXX
 SG_ EngCyl13AvrgCntrOfCmbstionTiming : 0|16@1+ (0.0078125,-250) [-250|250.992] "deg" Vector__XXX
 SG_ EngCyl13AvrgStrtOfCmbstionTiming : 0|16@1+ (0.0078125,-250) [-250|250.992] "deg" Vector__XXX
 SG_ EngCyl13IndctdMeanEffectivePress : 0|16@1+ (0.0001220703125,-1) [-1|6.84362793] "MPa" Vector__XXX
 SG_ EngCyl12AvrageCombustionDuration : 0|16@1+ (0.0078125,0) [0|501.99] "deg" Vector__XXX
 SG_ EngCyl12AvrgCntrOfCmbstionTiming : 0|16@1+ (0.0078125,-250) [-250|250.992] "deg" Vector__XXX
 SG_ EngCyl12AvrgStrtOfCmbstionTiming : 0|16@1+ (0.0078125,-250) [-250|250.992] "deg" Vector__XXX
 SG_ EngCyl12IndctdMeanEffectivePress : 0|16@1+ (0.0001220703125,-1) [-1|6.84362793] "MPa" Vector__XXX
 SG_ EngCyl11AvrageCombustionDuration : 0|16@1+ (0.0078125,0) [0|501.99] "deg" Vector__XXX
 SG_ EngCyl11AvrgCntrOfCmbstionTiming : 0|16@1+ (0.0078125,-250) [-250|250.992] "deg" Vector__XXX
 SG_ EngCyl11AvrgStrtOfCmbstionTiming : 0|16@1+ (0.0078125,-250) [-250|250.992] "deg" Vector__XXX
 SG_ EngCyl11IndctdMeanEffectivePress : 0|16@1+ (0.0001220703125,-1) [-1|6.84362793] "MPa" Vector__XXX
 SG_ EngCyl10AvrageCombustionDuration : 0|16@1+ (0.0078125,0) [0|501.99] "deg" Vector__XXX
 SG_ EngCyl10AvrgCntrOfCmbstionTiming : 0|16@1+ (0.0078125,-250) [-250|250.992] "deg" Vector__XXX
 SG_ EngCyl10AvrgStrtOfCmbstionTiming : 0|16@1+ (0.0078125,-250) [-250|250.992] "deg" Vector__XXX
 SG_ EngCyl10IndctdMeanEffectivePress : 0|16@1+ (0.0001220703125,-1) [-1|6.84362793] "MPa" Vector__XXX
 SG_ EngCyl9AverageCombustionDuration : 0|16@1+ (0.0078125,0) [0|501.99] "deg" Vector__XXX
 SG_ EngCyl9AvrgCntrOfCmbustionTiming : 0|16@1+ (0.0078125,-250) [-250|250.992] "deg" Vector__XXX
 SG_ EngCyl9AvrgStrtOfCmbustionTiming : 0|16@1+ (0.0078125,-250) [-250|250.992] "deg" Vector__XXX
 SG_ EngCyl9IndctedMeanEffectivePress : 0|16@1+ (0.0001220703125,-1) [-1|6.84362793] "MPa" Vector__XXX
 SG_ GenFrequencySelection : 0|4@1+ (1,0) [0|15] "" Vector__XXX
 SG_ GenGoverningSpeedCommand : 0|2@1+ (1,0) [0|3] "" Vector__XXX
 SG_ GenAlternatorEfficiency : 0|16@1+ (0.0025,0) [0|100] "%" Vector__XXX
 SG_ GenNotReadyToAutoParaState : 0|2@1+ (1,0) [0|3] "" Vector__XXX
 SG_ GenCtrlNotInAutoStartState : 0|2@1+ (1,0) [0|3] "" Vector__XXX
 SG_ RequestedEngineControlMode : 0|4@1+ (1,0) [0|15] "" Vector__XXX
 SG_ EngSpeedGovernorDroop : 0|8@1+ (0.04,0) [0|10] "%" Vector__XXX
 SG_ EngSpeedGovernorGainAdjust : 0|16@1+ (1,-32128) [-32128|32127] "" Vector__XXX
 SG_ StaticRollAngleStatus : 0|3@1+ (1,0) [0|7] "" Vector__XXX
 SG_ StaticRollAngle : 0|8@1+ (1,-125) [-90|90] "deg" Vector__XXX
 SG_ EngCyl2AverageCombustionDuration : 0|16@1+ (0.0078125,0) [0|501.99] "deg" Vector__XXX
 SG_ EngCyl2AvrgCntrOfCmbustionTiming : 0|16@1+ (0.0078125,-250) [-250|250.992] "deg" Vector__XXX
 SG_ EngCyl2AvrgStrtOfCmbustionTiming : 0|16@1+ (0.0078125,-250) [-250|250.992] "deg" Vector__XXX
 SG_ EngCyl2IndctedMeanEffectivePress : 0|16@1+ (0.0001220703125,-1) [-1|6.84362793] "MPa" Vector__XXX
 SG_ EngCyl1AverageCombustionDuration : 0|16@1+ (0.0078125,0) [0|501.99] "deg" Vector__XXX
 SG_ EngCyl1AvrgCntrOfCmbustionTiming : 0|16@1+ (0.0078125,-250) [-250|250.992] "deg" Vector__XXX
 SG_ EngCyl1AvrgStrtOfCmbustionTiming : 0|16@1+ (0.0078125,-250) [-250|250.992] "deg" Vector__XXX
 SG_ EngCyl1IndctedMeanEffectivePress : 0|16@1+ (0.0001220703125,-1) [-1|6.84362793] "MPa" Vector__XXX
 SG_ MaxPressIncreaseRate : 0|8@1+ (16,0) [0|4000] "kPa/deg crank angle" Vector__XXX
 SG_ LowFreqKnockLvl : 0|8@1+ (1,0) [0|250] "%" Vector__XXX
 SG_ EngCyl20PrssSensorPreliminaryFMI : 0|5@1+ (1,0) [0|31] "" Vector__XXX
 SG_ EngCyl20SynchronousKnockLevel : 0|8@1+ (1,0) [0|250] "%" Vector__XXX
 SG_ EngCyl20PeakPress : 0|16@1+ (0.0009765625,0) [0|62.74902344] "MPa" Vector__XXX
 SG_ EngCyl20HeatRelease : 0|16@1+ (0.0001220703125,-1) [-1|6.84362793] "kJ/l" Vector__XXX
 SG_ MaxPressIncreaseRate : 0|8@1+ (16,0) [0|4000] "kPa/deg crank angle" Vector__XXX
 SG_ LowFreqKnockLvl : 0|8@1+ (1,0) [0|250] "%" Vector__XXX
 SG_ EngCyl19PrssSensorPreliminaryFMI : 0|5@1+ (1,0) [0|31] "" Vector__XXX
 SG_ EngCyl19SynchronousKnockLevel : 0|8@1+ (1,0) [0|250] "%" Vector__XXX
 SG_ EngCyl19PeakPress : 0|16@1+ (0.0009765625,0) [0|62.74902344] "MPa" Vector__XXX
 SG_ EngCyl19HeatRelease : 0|16@1+ (0.0001220703125,-1) [-1|6.84362793] "kJ/l" Vector__XXX
 SG_ MaxPressIncreaseRate : 0|8@1+ (16,0) [0|4000] "kPa/deg crank angle" Vector__XXX
 SG_ LowFreqKnockLvl : 0|8@1+ (1,0) [0|250] "%" Vector__XXX
 SG_ EngCyl18PrssSensorPreliminaryFMI : 0|5@1+ (1,0) [0|31] "" Vector__XXX
 SG_ EngCyl18SynchronousKnockLevel : 0|8@1+ (1,0) [0|250] "%" Vector__XXX
 SG_ EngCyl18PeakPress : 0|16@1+ (0.0009765625,0) [0|62.74902344] "MPa" Vector__XXX
 SG_ EngCyl18HeatRelease : 0|16@1+ (0.0001220703125,-1) [-1|6.84362793] "kJ/l" Vector__XXX
 SG_ MaxPressIncreaseRate : 0|8@1+ (16,0) [0|4000] "kPa/deg crank angle" Vector__XXX
 SG_ LowFreqKnockLvl : 0|8@1+ (1,0) [0|250] "%" Vector__XXX
 SG_ EngCyl17PrssSensorPreliminaryFMI : 0|5@1+ (1,0) [0|31] "" Vector__XXX
 SG_ EngCyl17SynchronousKnockLevel : 0|8@1+ (1,0) [0|250] "%" Vector__XXX
 SG_ EngCyl17PeakPress : 0|16@1+ (0.0009765625,0) [0|62.74902344] "MPa" Vector__XXX
 SG_ EngCyl17HeatRelease : 0|16@1+ (0.0001220703125,-1) [-1|6.84362793] "kJ/l" Vector__XXX
 SG_ MaxPressIncreaseRate : 0|8@1+ (16,0) [0|4000] "kPa/deg crank angle" Vector__XXX
 SG_ LowFreqKnockLvl : 0|8@1+ (1,0) [0|250] "%" Vector__XXX
 SG_ EngCyl16PrssSensorPreliminaryFMI : 0|5@1+ (1,0) [0|31] "" Vector__XXX
 SG_ EngCyl16SynchronousKnockLevel : 0|8@1+ (1,0) [0|250] "%" Vector__XXX
 SG_ EngCyl16PeakPress : 0|16@1+ (0.0009765625,0) [0|62.74902344] "MPa" Vector__XXX
 SG_ EngCyl16HeatRelease : 0|16@1+ (0.0001220703125,-1) [-1|6.84362793] "kJ/l" Vector__XXX
 SG_ MaxPressIncreaseRate : 0|8@1+ (16,0) [0|4000] "kPa/deg crank angle" Vector__XXX
 SG_ LowFreqKnockLvl : 0|8@1+ (1,0) [0|250] "%" Vector__XXX
 SG_ EngCyl15PrssSensorPreliminaryFMI : 0|5@1+ (1,0) [0|31] "" Vector__XXX
 SG_ EngCyl15SynchronousKnockLevel : 0|8@1+ (1,0) [0|250] "%" Vector__XXX
 SG_ EngCyl15PeakPress : 0|16@1+ (0.0009765625,0) [0|62.74902344] "MPa" Vector__XXX
 SG_ EngCyl15HeatRelease : 0|16@1+ (0.0001220703125,-1) [-1|6.84362793] "kJ/l" Vector__XXX
 SG_ MaxPressIncreaseRate : 0|8@1+ (16,0) [0|4000] "kPa/deg crank angle" Vector__XXX
 SG_ LowFreqKnockLvl : 0|8@1+ (1,0) [0|250] "%" Vector__XXX
 SG_ EngCyl14PrssSensorPreliminaryFMI : 0|5@1+ (1,0) [0|31] "" Vector__XXX
 SG_ EngCyl14SynchronousKnockLevel : 0|8@1+ (1,0) [0|250] "%" Vector__XXX
 SG_ EngCyl14PeakPress : 0|16@1+ (0.0009765625,0) [0|62.74902344] "MPa" Vector__XXX
 SG_ EngCyl14HeatRelease : 0|16@1+ (0.0001220703125,-1) [-1|6.84362793] "kJ/l" Vector__XXX
 SG_ MaxPressIncreaseRate : 0|8@1+ (16,0) [0|4000] "kPa/deg crank angle" Vector__XXX
 SG_ LowFreqKnockLvl : 0|8@1+ (1,0) [0|250] "%" Vector__XXX
 SG_ EngCyl13PrssSensorPreliminaryFMI : 0|5@1+ (1,0) [0|31] "" Vector__XXX
 SG_ EngCyl13SynchronousKnockLevel : 0|8@1+ (1,0) [0|250] "%" Vector__XXX
 SG_ EngCyl13PeakPress : 0|16@1+ (0.0009765625,0) [0|62.74902344] "MPa" Vector__XXX
 SG_ EngCyl13HeatRelease : 0|16@1+ (0.0001220703125,-1) [-1|6.84362793] "kJ/l" Vector__XXX
 SG_ MaxPressIncreaseRate : 0|8@1+ (16,0) [0|4000] "kPa/deg crank angle" Vector__XXX
 SG_ LowFreqKnockLvl : 0|8@1+ (1,0) [0|250] "%" Vector__XXX
 SG_ EngCyl12PrssSensorPreliminaryFMI : 0|5@1+ (1,0) [0|31] "" Vector__XXX
 SG_ EngCyl12SynchronousKnockLevel : 0|8@1+ (1,0) [0|250] "%" Vector__XXX
 SG_ EngCyl12PeakPress : 0|16@1+ (0.0009765625,0) [0|62.74902344] "MPa" Vector__XXX
 SG_ EngCyl12HeatRelease : 0|16@1+ (0.0001220703125,-1) [-1|6.84362793] "kJ/l" Vector__XXX
 SG_ MaxPressIncreaseRate : 0|8@1+ (16,0) [0|4000] "kPa/deg crank angle" Vector__XXX
 SG_ LowFreqKnockLvl : 0|8@1+ (1,0) [0|250] "%" Vector__XXX
 SG_ EngCyl11PrssSensorPreliminaryFMI : 0|5@1+ (1,0) [0|31] "" Vector__XXX
 SG_ EngCyl11SynchronousKnockLevel : 0|8@1+ (1,0) [0|250] "%" Vector__XXX
 SG_ EngCyl11PeakPress : 0|16@1+ (0.0009765625,0) [0|62.74902344] "MPa" Vector__XXX
 SG_ EngCyl11HeatRelease : 0|16@1+ (0.0001220703125,-1) [-1|6.84362793] "kJ/l" Vector__XXX
 SG_ MaxPressIncreaseRate : 0|8@1+ (16,0) [0|4000] "kPa/deg crank angle" Vector__XXX
 SG_ LowFreqKnockLvl : 0|8@1+ (1,0) [0|250] "%" Vector__XXX
 SG_ EngCyl10PrssSensorPreliminaryFMI : 0|5@1+ (1,0) [0|31] "" Vector__XXX
 SG_ EngCyl10SynchronousKnockLevel : 0|8@1+ (1,0) [0|250] "%" Vector__XXX
 SG_ EngCyl10PeakPress : 0|16@1+ (0.0009765625,0) [0|62.74902344] "MPa" Vector__XXX
 SG_ EngCyl10HeatRelease : 0|16@1+ (0.0001220703125,-1) [-1|6.84362793] "kJ/l" Vector__XXX
 SG_ MaxPressIncreaseRate : 0|8@1+ (16,0) [0|4000] "kPa/deg crank angle" Vector__XXX
 SG_ LowFreqKnockLvl : 0|8@1+ (1,0) [0|250] "%" Vector__XXX
 SG_ EngCyl9PressSensorPreliminaryFMI : 0|5@1+ (1,0) [0|31] "" Vector__XXX
 SG_ EngCyl9SynchronousKnockLevel : 0|8@1+ (1,0) [0|250] "%" Vector__XXX
 SG_ EngCyl9PeakPress : 0|16@1+ (0.0009765625,0) [0|62.74902344] "MPa" Vector__XXX
 SG_ EngCyl9HeatRelease : 0|16@1+ (0.0001220703125,-1) [-1|6.84362793] "kJ/l" Vector__XXX
 SG_ MaxPressIncreaseRate : 0|8@1+ (16,0) [0|4000] "kPa/deg crank angle" Vector__XXX
 SG_ LowFreqKnockLvl : 0|8@1+ (1,0) [0|250] "%" Vector__XXX
 SG_ EngCyl8PressSensorPreliminaryFMI : 0|5@1+ (1,0) [0|31] "" Vector__XXX
 SG_ EngCyl8SynchronousKnockLevel : 0|8@1+ (1,0) [0|250] "%" Vector__XXX
 SG_ EngCyl8PeakPress : 0|16@1+ (0.0009765625,0) [0|62.74902344] "MPa" Vector__XXX
 SG_ EngCyl8HeatRelease : 0|16@1+ (0.0001220703125,-1) [-1|6.84362793] "kJ/l" Vector__XXX
 SG_ MaxPressIncreaseRate : 0|8@1+ (16,0) [0|4000] "kPa/deg crank angle" Vector__XXX
 SG_ LowFreqKnockLvl : 0|8@1+ (1,0) [0|250] "%" Vector__XXX
 SG_ EngCyl7PressSensorPreliminaryFMI : 0|5@1+ (1,0) [0|31] "" Vector__XXX
 SG_ EngCyl7SynchronousKnockLevel : 0|8@1+ (1,0) [0|250] "%" Vector__XXX
 SG_ EngCyl7PeakPress : 0|16@1+ (0.0009765625,0) [0|62.74902344] "MPa" Vector__XXX
 SG_ EngCyl7HeatRelease : 0|16@1+ (0.0001220703125,-1) [-1|6.84362793] "kJ/l" Vector__XXX
 SG_ MaxPressIncreaseRate : 0|8@1+ (16,0) [0|4000] "kPa/deg crank angle" Vector__XXX
 SG_ LowFreqKnockLvl : 0|8@1+ (1,0) [0|250] "%" Vector__XXX
 SG_ EngCyl6PressSensorPreliminaryFMI : 0|5@1+ (1,0) [0|31] "" Vector__XXX
 SG_ EngCyl6SynchronousKnockLevel : 0|8@1+ (1,0) [0|250] "%" Vector__XXX
 SG_ EngCyl6PeakPress : 0|16@1+ (0.0009765625,0) [0|62.74902344] "MPa" Vector__XXX
 SG_ EngCyl6HeatRelease : 0|16@1+ (0.0001220703125,-1) [-1|6.84362793] "kJ/l" Vector__XXX
 SG_ MaxPressIncreaseRate : 0|8@1+ (16,0) [0|4000] "kPa/deg crank angle" Vector__XXX
 SG_ LowFreqKnockLvl : 0|8@1+ (1,0) [0|250] "%" Vector__XXX
 SG_ EngCyl5PressSensorPreliminaryFMI : 0|5@1+ (1,0) [0|31] "" Vector__XXX
 SG_ EngCyl5SynchronousKnockLevel : 0|8@1+ (1,0) [0|250] "%" Vector__XXX
 SG_ EngCyl5PeakPress : 0|16@1+ (0.0009765625,0) [0|62.74902344] "MPa" Vector__XXX
 SG_ EngCyl5HeatRelease : 0|16@1+ (0.0001220703125,-1) [-1|6.84362793] "kJ/l" Vector__XXX
 SG_ MaxPressIncreaseRate : 0|8@1+ (16,0) [0|4000] "kPa/deg crank angle" Vector__XXX
 SG_ LowFreqKnockLvl : 0|8@1+ (1,0) [0|250] "%" Vector__XXX
 SG_ EngCyl4PressSensorPreliminaryFMI : 0|5@1+ (1,0) [0|31] "" Vector__XXX
 SG_ EngCyl4SynchronousKnockLevel : 0|8@1+ (1,0) [0|250] "%" Vector__XXX
 SG_ EngCyl4PeakPress : 0|16@1+ (0.0009765625,0) [0|62.74902344] "MPa" Vector__XXX
 SG_ EngCyl4HeatRelease : 0|16@1+ (0.0001220703125,-1) [-1|6.84362793] "kJ/l" Vector__XXX
 SG_ MaxPressIncreaseRate : 0|8@1+ (16,0) [0|4000] "kPa/deg crank angle" Vector__XXX
 SG_ LowFreqKnockLvl : 0|8@1+ (1,0) [0|250] "%" Vector__XXX
 SG_ EngCyl3PressSensorPreliminaryFMI : 0|5@1+ (1,0) [0|31] "" Vector__XXX
 SG_ EngCyl3SynchronousKnockLevel : 0|8@1+ (1,0) [0|250] "%" Vector__XXX
 SG_ EngCyl3PeakPress : 0|16@1+ (0.0009765625,0) [0|62.74902344] "MPa" Vector__XXX
 SG_ EngCyl3HeatRelease : 0|16@1+ (0.0001220703125,-1) [-1|6.84362793] "kJ/l" Vector__XXX
 SG_ MaxPressIncreaseRate : 0|8@1+ (16,0) [0|4000] "kPa/deg crank angle" Vector__XXX
 SG_ LowFreqKnockLvl : 0|8@1+ (1,0) [0|250] "%" Vector__XXX
 SG_ EngCyl2PressSensorPreliminaryFMI : 0|5@1+ (1,0) [0|31] "" Vector__XXX
 SG_ EngCyl2SynchronousKnockLevel : 0|8@1+ (1,0) [0|250] "%" Vector__XXX
 SG_ EngCyl2PeakPress : 0|16@1+ (0.0009765625,0) [0|62.74902344] "MPa" Vector__XXX
 SG_ EngCyl2HeatRelease : 0|16@1+ (0.0001220703125,-1) [-1|6.84362793] "kJ/l" Vector__XXX
 SG_ MaxPressIncreaseRate : 0|8@1+ (16,0) [0|4000] "kPa/deg crank angle" Vector__XXX
 SG_ LowFreqKnockLvl : 0|8@1+ (1,0) [0|250] "%" Vector__XXX
 SG_ EngCyl1PressSensorPreliminaryFMI : 0|5@1+ (1,0) [0|31] "" Vector__XXX
 SG_ EngCyl1SynchronousKnockLevel : 0|8@1+ (1,0) [0|100] "%" Vector__XXX
 SG_ EngCyl1PeakPress : 0|16@1+ (0.0009765625,0) [0|62.74902344] "MPa" Vector__XXX
 SG_ EngCyl1HeatRelease : 0|16@1+ (0.0001220703125,-1) [-1|6.84362793] "kJ/l" Vector__XXX
 SG_ EngTotalIntakeMassAirFlowRate : 0|16@1+ (0.0009765625,0) [0|62.74902344] "kg/s" Vector__XXX
 SG_ EngDesiredAirFuelRatio : 0|16@1+ (0.001,0) [0|64.255] "" Vector__XXX
 SG_ EngCylTorque : 0|16@1+ (1,0) [0|64255] "Nm" Vector__XXX
 SG_ EngCylDieselMassFlowRateCmd : 0|16@1+ (6.103515625E-005,0) [0|3.921813965] "kg/s" Vector__XXX
 SG_ EngCylGasMassFlowRateCmd : 0|16@1+ (6.103515625E-005,0) [0|3.921813965] "kg/s" Vector__XXX
 SG_ EngGasFuelPercentageCmd : 0|8@1+ (0.5,0) [0|100] "%" Vector__XXX
 SG_ EngDualFuelModeCmd : 0|2@1+ (1,0) [0|100] "" Vector__XXX
 SG_ EngTrbCmprssrBlwffActtr1OprtnStt : 0|4@1+ (1,0) [0|15] "" Vector__XXX
 SG_ EngTrbCmprssrBlowoffActuator1Pos : 0|8@1+ (0.4,0) [0|100] "%" Vector__XXX
 SG_ EngTrbCmprssrBlwffActtr1DsredPos : 0|8@1+ (0.4,0) [0|100] "%" Vector__XXX
 SG_ EngTrbCmprssrBlwoffActuator1Temp : 0|8@1+ (1,-40) [-40|210] "°C" Vector__XXX
 SG_ EngTrbCmprssrBlwffActtr1TmpSttus : 0|3@1+ (1,0) [0|7] "" Vector__XXX
 SG_ EngTrbCmprssrBlwffActtr1PrlmnryF : 0|5@1+ (1,0) [0|31] "" Vector__XXX
 SG_ PersistentLimitStatus : 0|3@1+ (1,0) [0|0] "" Vector__XXX
 SG_ MachineSelectedSpeedSource : 0|3@1+ (1,0) [0|0] "" Vector__XXX
 SG_ MachineSelectedDirection : 0|2@1+ (1,0) [0|0] "" Vector__XXX
 SG_ MachineSelectedDistance : 0|32@1+ (1,0) [0|0] "" Vector__XXX
 SG_ MachineSelectedSpeed : 0|16@1+ (1,0) [0|0] "" Vector__XXX
 SG_ GeneratorGoverningBias : 0|16@1+ (0.004,-125) [-125|125] "%" Vector__XXX
 SG_ AccelPedal2Channel3 : 0|8@1+ (0.4,0) [0|100] "%" Vector__XXX
 SG_ AccelPedal2Channel2 : 0|8@1+ (0.4,0) [0|100] "%" Vector__XXX
 SG_ AccelPedal1Channel3 : 0|8@1+ (0.4,0) [0|100] "%" Vector__XXX
 SG_ AccelPedal1Channel2 : 0|8@1+ (0.4,0) [0|100] "%" Vector__XXX
 SG_ DesiredEngFuelingState : 0|2@1+ (1,0) [0|3] "" Vector__XXX
 SG_ RequestedFuelType : 0|8@1+ (1,0) [0|255] "" Vector__XXX
 SG_ EngGasFuelSupplyDesiredPress : 0|16@1+ (0.5,0) [0|32127.5] "kPa" Vector__XXX
 SG_ EngGasFuelUsageInhibited : 0|2@1+ (1,0) [0|3] "" Vector__XXX
 SG_ AEBS2MessageChecksum : 0|4@1+ (1,0) [0|15] "" Vector__XXX
 SG_ AEBS2MessageCounter : 0|4@1+ (1,0) [0|15] "" Vector__XXX
 SG_ DrvrActvtnDmndFrAdvncdEmrgncyBrk : 0|2@1+ (1,0) [0|3] "" Vector__XXX
 SG_ ProcessVariableValue : 0|32@1+ (1,0) [0|0] "" Vector__XXX
 SG_ CountNumber : 0|8@1+ (1,0) [0|0] "" Vector__XXX
 SG_ ValveFailSafeMode : 0|2@1+ (1,0) [0|0] "" Vector__XXX
 SG_ ValveState : 0|4@1+ (1,0) [0|0] "" Vector__XXX
 SG_ RetractPortEstFlow : 0|8@1+ (1,0) [0|0] "" Vector__XXX
 SG_ ExtendPortEstFlow : 0|8@1+ (1,0) [0|0] "" Vector__XXX
 SG_ ReturnPortPress : 0|8@1+ (1,0) [0|0] "" Vector__XXX
 SG_ RetractPortPress : 0|16@1+ (1,0) [0|0] "" Vector__XXX
 SG_ ExtendPortPress : 0|16@1+ (1,0) [0|0] "" Vector__XXX
 SG_ RetractPortMeasuredFlow : 0|8@1+ (1,0) [0|0] "" Vector__XXX
 SG_ ExtendPortMeasuredFlow : 0|8@1+ (1,0) [0|0] "" Vector__XXX
 SG_ PortFlowCmd : 0|8@1+ (1,0) [0|0] "" Vector__XXX
 SG_ VehicleSystemQualifierFlag : 0|1@1+ (1,0) [0|1] "" Vector__XXX
 SG_ VehicleSystemInstanceQualifierFl : 0|1@1+ (1,0) [0|1] "" Vector__XXX
 SG_ NameChecksum : 0|8@1+ (1,0) [0|0] "" Vector__XXX
 SG_ NMControlModeIndicator : 0|4@1+ (1,0) [0|15] "" Vector__XXX
 SG_ ManufacturerCodeQualifierFlag : 0|1@1+ (1,0) [0|1] "" Vector__XXX
 SG_ IndustryGroupQualifierFlag : 0|1@1+ (1,0) [0|1] "" Vector__XXX
 SG_ FunctionQualifierFlag : 0|1@1+ (1,0) [0|1] "" Vector__XXX
 SG_ FunctionInstanceQualifierFlag : 0|1@1+ (1,0) [0|1] "" Vector__XXX
 SG_ ErrorCode : 0|8@1+ (1,0) [0|0] "" Vector__XXX
 SG_ ECUInstanceQualifierFlag : 0|1@1+ (1,0) [0|1] "" Vector__XXX
 SG_ CommandVehicleSystemInstance : 0|4@1+ (1,0) [0|15] "" Vector__XXX
 SG_ CommandVehicleSystem : 0|7@1+ (1,0) [0|127] "" Vector__XXX
 SG_ CommandManufacturerCode : 0|11@1+ (1,0) [0|2047] "" Vector__XXX
 SG_ CommandIndustryGroup : 0|3@1+ (1,0) [0|7] "" Vector__XXX
 SG_ CommandFunctionInstance : 0|5@1+ (1,0) [0|31] "" Vector__XXX
 SG_ CommandFunction : 0|8@1+ (1,0) [0|255] "" Vector__XXX
 SG_ CommandECUInstance : 0|3@1+ (1,0) [0|7] "" Vector__XXX
 SG_ CommandArbitraryAddressCapable : 0|1@1+ (1,0) [0|1] "" Vector__XXX
 SG_ ArbitraryAddressCapableQualifier : 0|1@1+ (1,0) [0|1] "" Vector__XXX
 SG_ SwitchedPowerOutput18Cmd : 0|2@1+ (1,0) [0|3] "" Vector__XXX
 SG_ SwitchedPowerOutput19Cmd : 0|2@1+ (1,0) [0|3] "" Vector__XXX
 SG_ SwitchedPowerOutput20Cmd : 0|2@1+ (1,0) [0|3] "" Vector__XXX
 SG_ SwitchedPowerOutput13Cmd : 0|2@1+ (1,0) [0|3] "" Vector__XXX
 SG_ SwitchedPowerOutput14Cmd : 0|2@1+ (1,0) [0|3] "" Vector__XXX
 SG_ SwitchedPowerOutput15Cmd : 0|2@1+ (1,0) [0|3] "" Vector__XXX
 SG_ SwitchedPowerOutput16Cmd : 0|2@1+ (1,0) [0|3] "" Vector__XXX
 SG_ SwitchedPowerOutput9Cmd : 0|2@1+ (1,0) [0|3] "" Vector__XXX
 SG_ SwitchedPowerOutput10Cmd : 0|2@1+ (1,0) [0|3] "" Vector__XXX
 SG_ SwitchedPowerOutput29Cmd : 0|2@1+ (1,0) [0|3] "" Vector__XXX
 SG_ SwitchedPowerOutput30Cmd : 0|2@1+ (1,0) [0|3] "" Vector__XXX
 SG_ SwitchedPowerOutput31Cmd : 0|2@1+ (1,0) [0|3] "" Vector__XXX
 SG_ SwitchedPowerOutput32Cmd : 0|2@1+ (1,0) [0|3] "" Vector__XXX
 SG_ SwitchedPowerOutput25Cmd : 0|2@1+ (1,0) [0|3] "" Vector__XXX
 SG_ SwitchedPowerOutput26Cmd : 0|2@1+ (1,0) [0|3] "" Vector__XXX
 SG_ SwitchedPowerOutput27Cmd : 0|2@1+ (1,0) [0|3] "" Vector__XXX
 SG_ SwitchedPowerOutput28Cmd : 0|2@1+ (1,0) [0|3] "" Vector__XXX
 SG_ SwitchedPowerOutput21Cmd : 0|2@1+ (1,0) [0|3] "" Vector__XXX
 SG_ SwitchedPowerOutput22Cmd : 0|2@1+ (1,0) [0|3] "" Vector__XXX
 SG_ SwitchedPowerOutput23Cmd : 0|2@1+ (1,0) [0|3] "" Vector__XXX
 SG_ SwitchedPowerOutput24Cmd : 0|2@1+ (1,0) [0|3] "" Vector__XXX
 SG_ SwitchedPowerOutput17Cmd : 0|2@1+ (1,0) [0|3] "" Vector__XXX
 SG_ SwitchedPowerOutput11Cmd : 0|2@1+ (1,0) [0|3] "" Vector__XXX
 SG_ SwitchedPowerOutput12Cmd : 0|2@1+ (1,0) [0|3] "" Vector__XXX
 SG_ SwitchedPowerOutput5Cmd : 0|2@1+ (1,0) [0|3] "" Vector__XXX
 SG_ SwitchedPowerOutput6Cmd : 0|2@1+ (1,0) [0|3] "" Vector__XXX
 SG_ SwitchedPowerOutput7Cmd : 0|2@1+ (1,0) [0|3] "" Vector__XXX
 SG_ SwitchedPowerOutput8Cmd : 0|2@1+ (1,0) [0|3] "" Vector__XXX
 SG_ SwitchedPowerOutput1Cmd : 0|2@1+ (1,0) [0|3] "" Vector__XXX
 SG_ SwitchedPowerOutput2Cmd : 0|2@1+ (1,0) [0|3] "" Vector__XXX
 SG_ SwitchedPowerOutput3Cmd : 0|2@1+ (1,0) [0|3] "" Vector__XXX
 SG_ SwitchedPowerOutput4Cmd : 0|2@1+ (1,0) [0|3] "" Vector__XXX
 SG_ TransMode10 : 0|2@1+ (1,0) [0|3] "" Vector__XXX
 SG_ TransMode9 : 0|2@1+ (1,0) [0|3] "" Vector__XXX
 SG_ AccelPedalPos3 : 0|8@1+ (0.4,0) [0|100] "%" Vector__XXX
 SG_ EngFuelIsolationCtrl : 0|2@1+ (1,0) [0|3] "" Vector__XXX
 SG_ FuelType : 0|8@1+ (1,0) [0|255] "" Vector__XXX
 SG_ EngFuelMassFlowRate : 0|16@1+ (0.005,0) [0|321.275] "g/s" Vector__XXX
 SG_ EngExhstGsRcrcltn1Valve2PosError : 0|16@1+ (0.004,-125) [-125|132.02] "%" Vector__XXX
 SG_ EngExhstGsRcrcltn1Valve1PosError : 0|16@1+ (0.004,-125) [-125|132.02] "%" Vector__XXX
 SG_ AFT1ParticulateSnsrCur : 0|16@1+ (0.00390625,0) [0|127] "µA" Vector__XXX
 SG_ AFT2ParticulateSnsr : 0|16@1+ (0.0125,0) [0|803.1875] "mg/m³" Vector__XXX
 SG_ AFT1ParticulateSnsr : 0|16@1+ (0.0125,0) [0|803.1875] "mg/m³" Vector__XXX
 SG_ AFT2InNOxSnsrSelfDiagTrigger : 0|4@1+ (1,0) [0|15] "" Vector__XXX
 SG_ AFT2OutNOxSnsrSelfDiagTrigger : 0|4@1+ (1,0) [0|15] "" Vector__XXX
 SG_ AFT1InNOxSnsrSelfDiagTrigger : 0|4@1+ (1,0) [0|15] "" Vector__XXX
 SG_ AFT1OutNOxSnsrSelfDiagTrigger : 0|4@1+ (1,0) [0|15] "" Vector__XXX
 SG_ AFT2OutGasSnsrPwrSupply : 0|2@1+ (1,0) [0|3] "" Vector__XXX
 SG_ AFT2InGasSnsrPwrSupply : 0|2@1+ (1,0) [0|3] "" Vector__XXX
 SG_ AFT1OutGasSnsrPwrSupply : 0|2@1+ (1,0) [0|3] "" Vector__XXX
 SG_ AFT1InGasSnsrPwrSupply : 0|2@1+ (1,0) [0|3] "" Vector__XXX
 SG_ EngExhstGsRcrcltn1Acttr2PrlmnryF : 0|5@1+ (1,0) [0|31] "" Vector__XXX
 SG_ EngExhstGsRcrcltn1Acttr2OprtnStt : 0|4@1+ (1,0) [0|15] "" Vector__XXX
 SG_ EngExhstGsRcrcltn1Acttr1OprtnStt : 0|4@1+ (1,0) [0|15] "" Vector__XXX
 SG_ EngExhstGsRcrcltn1Acttr2DsredPos : 0|8@1+ (0.4,0) [0|100] "%" Vector__XXX
 SG_ EngExhstGsRcrclton1Actuator2Temp : 0|8@1+ (1,-40) [-40|210] "°C" Vector__XXX
 SG_ EngExhstGsRcrcltn1Acttr2TmpSttus : 0|3@1+ (1,0) [0|7] "" Vector__XXX
 SG_ EngExhstGsRcrcltn1Acttr1DsredPos : 0|8@1+ (0.4,0) [0|100] "%" Vector__XXX
 SG_ EngExhstGsRcrclton1Actuator1Temp : 0|8@1+ (1,-40) [-40|210] "°C" Vector__XXX
 SG_ EngExhstGsRcrcltn1Acttr1TmpSttus : 0|3@1+ (1,0) [0|7] "" Vector__XXX
 SG_ EngExhstGsRcrcltn1Acttr1PrlmnryF : 0|5@1+ (1,0) [0|31] "" Vector__XXX
 SG_ EngExhstGsRcrcltn2Acttr2OprtnStt : 0|4@1+ (1,0) [0|15] "" Vector__XXX
 SG_ EngExhstGsRcrcltn2Acttr1OprtnStt : 0|4@1+ (1,0) [0|15] "" Vector__XXX
 SG_ EngExhstGsRcrcltn2Acttr2DsredPos : 0|8@1+ (0.4,0) [0|100] "%" Vector__XXX
 SG_ EngExhstGsRcrclton2Actuator2Temp : 0|8@1+ (1,-40) [-40|210] "°C" Vector__XXX
 SG_ EngExhstGsRcrcltn2Acttr2TmpSttus : 0|3@1+ (1,0) [0|7] "" Vector__XXX
 SG_ EngExhstGsRcrcltn2Acttr2PrlmnryF : 0|5@1+ (1,0) [0|31] "" Vector__XXX
 SG_ EngExhstGsRcrcltn2Acttr1DsredPos : 0|8@1+ (0.4,0) [0|100] "%" Vector__XXX
 SG_ EngExhstGsRcrclton2Actuator1Temp : 0|8@1+ (1,-40) [-40|210] "°C" Vector__XXX
 SG_ EngExhstGsRcrcltn2Acttr1TmpSttus : 0|3@1+ (1,0) [0|7] "" Vector__XXX
 SG_ EngExhstGsRcrcltn2Acttr1PrlmnryF : 0|5@1+ (1,0) [0|31] "" Vector__XXX
 SG_ EngFuelRackFuelSupplyTemp : 0|8@1+ (1,-40) [-40|210] "°C" Vector__XXX
 SG_ EngTurboWastegateActuator2Temp : 0|8@1+ (1,-40) [-40|210] "°C" Vector__XXX
 SG_ EngFuelValve2Temp : 0|8@1+ (1,-40) [-40|210] "°C" Vector__XXX
 SG_ EngFuelValve1Temp : 0|8@1+ (1,-40) [-40|210] "°C" Vector__XXX
 SG_ EngThrottleValve2Temp : 0|8@1+ (1,-40) [-40|210] "°C" Vector__XXX
 SG_ EngThrottleValve1Temp : 0|8@1+ (1,-40) [-40|210] "°C" Vector__XXX
 SG_ EngFuelingDesiredRqCount : 0|4@1+ (1,0) [0|15] "" Vector__XXX
 SG_ EngFuelingInhibitRqCount : 0|4@1+ (1,0) [0|15] "" Vector__XXX
 SG_ EngGasSubstitutionFuelPercentage : 0|8@1+ (0.5,0) [0|125] "%" Vector__XXX
 SG_ EngDualFuelMode : 0|2@1+ (1,0) [0|3] "" Vector__XXX
 SG_ SrcAddrssOfCntrllngDvcFrFlngStte : 0|8@1+ (1,0) [0|255] "" Vector__XXX
 SG_ EngFuelingInhibitPreventedReason : 0|4@1+ (1,0) [0|15] "" Vector__XXX
 SG_ EngFuelingInhibitAllowed : 0|2@1+ (1,0) [0|3] "" Vector__XXX
 SG_ FeedbackEngFuelingState : 0|2@1+ (1,0) [0|3] "" Vector__XXX
 SG_ IntmdTempPreliminaryFMI : 0|5@1+ (1,0) [0|31] "" Vector__XXX
 SG_ IntmdTemp : 0|16@1+ (0.03125,-273) [-273|1734.96875] "°C" Vector__XXX
 SG_ IntmdTempPreliminaryFMI : 0|5@1+ (1,0) [0|31] "" Vector__XXX
 SG_ IntmdTemp : 0|16@1+ (0.03125,-273) [-273|1734.96875] "°C" Vector__XXX
 SG_ SupplyGasMethanePercentage : 0|16@1+ (0.0025,0) [0|160.6375] "%" Vector__XXX
 SG_ EngAssistStatus : 0|2@1+ (1,0) [0|3] "" Vector__XXX
 SG_ HybrdSystmHghVltgExpsreIndicator : 0|2@1+ (1,0) [0|3] "" Vector__XXX
 SG_ HybrdSystmIntializationIndicator : 0|2@1+ (1,0) [0|3] "" Vector__XXX
 SG_ HybrdSystmRgnrtvBrakingIndicator : 0|2@1+ (1,0) [0|3] "" Vector__XXX
 SG_ HybridSystemElectricAltIndicator : 0|2@1+ (1,0) [0|3] "" Vector__XXX
 SG_ HybrdSystmMtrOvrspedAudibleAlarm : 0|2@1+ (1,0) [0|3] "" Vector__XXX
 SG_ HybrdSystmMtorOverspeedIndicator : 0|2@1+ (1,0) [0|3] "" Vector__XXX
 SG_ HybridSystemServiceIndicator : 0|2@1+ (1,0) [0|3] "" Vector__XXX
 SG_ PropulsionSystemActive : 0|2@1+ (1,0) [0|3] "" Vector__XXX
 SG_ HybridSystemOBDRelatedDTCStatus : 0|2@1+ (1,0) [0|3] "" Vector__XXX
 SG_ HybridSystemStopIndicator : 0|2@1+ (1,0) [0|3] "" Vector__XXX
 SG_ HybridSystemOverheatIndicator : 0|2@1+ (1,0) [0|3] "" Vector__XXX
 SG_ HybridSystemWarningIndicator : 0|2@1+ (1,0) [0|3] "" Vector__XXX
 SG_ IntmdNH3SnsrHtrCtrl : 0|2@1+ (1,0) [0|3] "" Vector__XXX
 SG_ IntmdNH3SnsrHtrPreliminaryFMI : 0|5@1+ (1,0) [0|31] "" Vector__XXX
 SG_ IntmdNH3SnsrAtTemp : 0|1@1+ (1,0) [0|1] "" Vector__XXX
 SG_ IntmdNH3SnsrPwrInRange : 0|2@1+ (1,0) [0|3] "" Vector__XXX
 SG_ IntmdNH3ReadingStable : 0|2@1+ (1,0) [0|3] "" Vector__XXX
 SG_ IntmdNH3SnsrPreliminaryFMI : 0|5@1+ (1,0) [0|31] "" Vector__XXX
 SG_ IntmdNH3 : 0|16@1+ (0.1,-200) [-200|6225.5] "ppm" Vector__XXX
 SG_ IntmdNH3SnsrHtrCtrl : 0|2@1+ (1,0) [0|3] "" Vector__XXX
 SG_ IntmdNH3SnsrHtrPreliminaryFMI : 0|5@1+ (1,0) [0|31] "" Vector__XXX
 SG_ IntmdNH3SnsrAtTemp : 0|2@1+ (1,0) [0|3] "" Vector__XXX
 SG_ IntmdNH3SnsrPwrInRange : 0|2@1+ (1,0) [0|3] "" Vector__XXX
 SG_ IntmdNH3ReadingStable : 0|2@1+ (1,0) [0|3] "" Vector__XXX
 SG_ IntmdNH3SnsrPreliminaryFMI : 0|5@1+ (1,0) [0|31] "" Vector__XXX
 SG_ IntmdNH3 : 0|16@1+ (0.1,-200) [-200|6225.5] "ppm" Vector__XXX
 SG_ LnrDsplcmntSnsrSnsrFigureOfMerit : 0|2@1+ (1,0) [0|3] "" Vector__XXX
 SG_ MeasuredLinearDisplacement : 0|16@1+ (0.1,0) [0|6425.5] "mm" Vector__XXX
 SG_ WandSensorFigureOfMerit : 0|2@1+ (1,0) [0|3] "" Vector__XXX
 SG_ WandAngle : 0|16@1+ (0.002,-64) [-64|64.51] "deg" Vector__XXX
 SG_ WirelessSignalStrength1 : 0|8@1+ (0.5,-125) [-125|0] "dBm" Vector__XXX
 SG_ TransmitterID1 : 0|24@1+ (1,0) [0|16449635] "" Vector__XXX
 SG_ TransmitterCmdState : 0|4@1+ (1,0) [0|15] "" Vector__XXX

CM_ SG_ 3221225472 EngExhaustDesiredNOx "Desired NOx concentration in the engine exhaust, prior to any aftertreatment of the exhaust.";
CM_ SG_ 3221225472 EngExhaustNOx "Calculated NOx concentration for the total engine exhaust, prior to any aftertreatment of the exhaust.  This parameter is primarily intended for engines that have separate NOx sensors in separate exhaust manifolds, but the engine does not have an ...";
CM_ SG_ 3221225472 GasFuelAccumulatorTemp "Gaseous fuel temperature at the outlet of the Gas Filter.";
CM_ SG_ 3221225472 EngFuelVaporizer1DischargeTemp "The temperature of the fuel in its gaseous state at the outlet of the first fuel vaporizer";
CM_ SG_ 3221225472 EngGasFuelSupplyPress "Pressure of gaseous fuel supply to fuel metering device in systems where the pressure range defined for SPN 159 is not sufficient.";
CM_ SG_ 3221225472 ProductIdentificationModel "The Product Identification Model specifies a unique product within a Brand.

Examples of Models are:
For Electronic components: SG2600, BT, ICC 230.
For Balers: Big Baler 230AB, XC 130 CV.
For Sprayers: 238i, 1962i, Explorer D.
Etc.";
CM_ SG_ 3221225472 ProductIdentificationBrand "The Product Identification Brand specifies the brand of a product.
 
The combination of the Product Identification Code and the Product Identification Brand shall make the product unique in the world.";
CM_ SG_ 3221225472 ProductIdentificationCode "The Product Identification Code as assigned by the manufacturer corresponds with the identification number on the type plate of a product. For vehicles this number may be the same as the VIN (Vehicle Identification Number) . For stand alone systems ...";
CM_ SG_ 3221225472 EngGsFlVlve20StartOfActuationCmd "The angle, relative to the TDC of cylinder 20, with 0 being the TDC before the power stroke commences, at the which gaseous fuel valve 20 is activated to open.
Timings after TDC are referred with positive values and timings before TDC are referred ...";
CM_ SG_ 3221225472 EngGsFlVlve19StartOfActuationCmd "The angle, relative to the TDC of cylinder 19, with 0 being the TDC before the power stroke commences, at the which gaseous fuel valve 19 is activated to open.
Timings after TDC are referred with positive values and timings before TDC are referred ...";
CM_ SG_ 3221225472 EngGsFlVlve18StartOfActuationCmd "The angle, relative to the TDC of cylinder 18, with 0 being the TDC before the power stroke commences, at the which gaseous fuel valve 18 is activated to open.
Timings after TDC are referred with positive values and timings before TDC are referred ...";
CM_ SG_ 3221225472 EngGsFlVlve17StartOfActuationCmd "The angle, relative to the TDC of cylinder 17, with 0 being the TDC before the power stroke commences, at the which gaseous fuel valve 17 is activated to open.
Timings after TDC are referred with positive values and timings before TDC are referred ...";
CM_ SG_ 3221225472 EngGsFlVlve16StartOfActuationCmd "The angle, relative to the TDC of cylinder 16, with 0 being the TDC before the power stroke commences, at the which gaseous fuel valve 16 is activated to open.
Timings after TDC are referred with positive values and timings before TDC are referred ...";
CM_ SG_ 3221225472 EngGsFlVlve15StartOfActuationCmd "The angle, relative to the TDC of cylinder 15, with 0 being the TDC before the power stroke commences, at the which gaseous fuel valve 15 is activated to open.
Timings after TDC are referred with positive values and timings before TDC are referred ...";
CM_ SG_ 3221225472 EngGsFlVlve14StartOfActuationCmd "The angle, relative to the TDC of cylinder 14, with 0 being the TDC before the power stroke commences, at the which gaseous fuel valve 14 is activated to open.
Timings after TDC are referred with positive values and timings before TDC are referred ...";
CM_ SG_ 3221225472 EngGsFlVlve13StartOfActuationCmd "The angle, relative to the TDC of cylinder 13, with 0 being the TDC before the power stroke commences, at the which gaseous fuel valve 13 is activated to open.
Timings after TDC are referred with positive values and timings before TDC are referred ...";
CM_ SG_ 3221225472 EngGsFlVlve12StartOfActuationCmd "The angle, relative to the TDC of cylinder 12, with 0 being the TDC before the power stroke commences, at the which gaseous fuel valve 12 is activated to open.
Timings after TDC are referred with positive values and timings before TDC are referred ...";
CM_ SG_ 3221225472 EngGsFlVlve11StartOfActuationCmd "The angle, relative to the TDC of cylinder 11, with 0 being the TDC before the power stroke commences, at the which gaseous fuel valve 11 is activated to open.
Timings after TDC are referred with positive values and timings before TDC are referred ...";
CM_ SG_ 3221225472 EngGsFlVlve10StartOfActuationCmd "The angle, relative to the TDC of cylinder 10, with 0 being the TDC before the power stroke commences, at the which gaseous fuel valve 10 is activated to open.
Timings after TDC are referred with positive values and timings before TDC are referred ...";
CM_ SG_ 3221225472 EngGsFlValve9StartOfActuationCmd "The angle, relative to the TDC of cylinder 9, with 0 being the TDC before the power stroke commences, at the which gaseous fuel valve 9 is activated to open.
Timings after TDC are referred with positive values and timings before TDC are referred ...";
CM_ SG_ 3221225472 EngGsFlValve8StartOfActuationCmd "The angle, relative to the TDC of cylinder 8, with 0 being the TDC before the power stroke commences, at the which gaseous fuel valve 8 is activated to open.
Timings after TDC are referred with positive values and timings before TDC are referred ...";
CM_ SG_ 3221225472 EngGsFlValve7StartOfActuationCmd "The angle, relative to the TDC of cylinder 7, with 0 being the TDC before the power stroke commences, at the which gaseous fuel valve 7 is activated to open.
Timings after TDC are referred with positive values and timings before TDC are referred ...";
CM_ SG_ 3221225472 EngGsFlValve6StartOfActuationCmd "The angle, relative to the TDC of cylinder 6, with 0 being the TDC before the power stroke commences, at the which gaseous fuel valve 6 is activated to open.
Timings after TDC are referred with positive values and timings before TDC are referred ...";
CM_ SG_ 3221225472 EngGsFlValve5StartOfActuationCmd "The angle, relative to the TDC of cylinder 5, with 0 being the TDC before the power stroke commences, at the which gaseous fuel valve 5 is activated to open.
Timings after TDC are referred with positive values and timings before TDC are referred ...";
CM_ SG_ 3221225472 EngGsFlValve4StartOfActuationCmd "The angle, relative to the TDC of cylinder 4, with 0 being the TDC before the power stroke commences, at the which gaseous fuel valve 4 is activated to open.
Timings after TDC are referred with positive values and timings before TDC are referred ...";
CM_ SG_ 3221225472 EngGsFlValve3StartOfActuationCmd "The angle, relative to the TDC of cylinder 3, with 0 being the TDC before the power stroke commences, at the which gaseous fuel valve 3 is activated to open.
Timings after TDC are referred with positive values and timings before TDC are referred ...";
CM_ SG_ 3221225472 EngGsFlValve2StartOfActuationCmd "The angle, relative to the TDC of cylinder 2, with 0 being the TDC before the power stroke commences, at the which gaseous fuel valve 2 is activated to open.
Timings after TDC are referred with positive values and timings before TDC are referred ...";
CM_ SG_ 3221225472 EngGsFlValve1StartOfActuationCmd "The angle, relative to the TDC of cylinder 1, with 0 being the TDC before the power stroke commences, at the which gaseous fuel valve 1 is activated to open.
Timings after TDC are referred with positive values and timings before TDC are referred ...";
CM_ SG_ 3221225472 EngGasFuelValve20DurationCmd "Amount of time the gaseous fuel valve 20 is activated.";
CM_ SG_ 3221225472 EngGasFuelValve19DurationCmd "Amount of time the gaseous fuel valve 19 is activated.";
CM_ SG_ 3221225472 EngGasFuelValve18DurationCmd "Amount of time the gaseous fuel valve 18 is activated.";
CM_ SG_ 3221225472 EngGasFuelValve17DurationCmd "Amount of time the gaseous fuel valve 17 is activated.";
CM_ SG_ 3221225472 EngGasFuelValve16DurationCmd "Amount of time the gaseous fuel valve 16 is activated.";
CM_ SG_ 3221225472 EngGasFuelValve15DurationCmd "Amount of time the gaseous fuel valve 15 is activated.";
CM_ SG_ 3221225472 EngGasFuelValve14DurationCmd "Amount of time the gaseous fuel valve 14 is activated.";
CM_ SG_ 3221225472 EngGasFuelValve13DurationCmd "Amount of time the gaseous fuel valve 13 is activated.";
CM_ SG_ 3221225472 EngGasFuelValve12DurationCmd "Amount of time the gaseous fuel valve 12 is activated.";
CM_ SG_ 3221225472 EngGasFuelValve11DurationCmd "Amount of time the gaseous fuel valve 11 is activated.";
CM_ SG_ 3221225472 EngGasFuelValve10DurationCmd "Amount of time the gaseous fuel valve 10 is activated.";
CM_ SG_ 3221225472 EngGasFuelValve9DurationCmd "Amount of time the gaseous fuel valve 9 is activated.";
CM_ SG_ 3221225472 EngGasFuelValve8DurationCmd "Amount of time the gaseous fuel valve 8 is activated.";
CM_ SG_ 3221225472 EngGasFuelValve7DurationCmd "Amount of time the gaseous fuel valve 7 is activated.";
CM_ SG_ 3221225472 EngGasFuelValve6DurationCmd "Amount of time the gaseous fuel valve 6 is activated.";
CM_ SG_ 3221225472 EngGasFuelValve5DurationCmd "Amount of time the gaseous fuel valve 5 is activated.";
CM_ SG_ 3221225472 EngGasFuelValve4DurationCmd "Amount of time the gaseous fuel valve 4 is activated.";
CM_ SG_ 3221225472 EngGasFuelValve3DurationCmd "Amount of time the gaseous fuel valve 3 is activated.";
CM_ SG_ 3221225472 EngGasFuelValve2DurationCmd "Amount of time the gaseous fuel valve 2 is activated.";
CM_ SG_ 3221225472 EngGasFuelValve1DurationCmd "Amount of time the gaseous fuel valve 1 is activated.";
CM_ SG_ 3221225472 EngGsFlVlvNmnlStrtOfActuationCmd "The angle, relative to the TDC of each cylinder, with 0 being the TDC before the power stroke commences, at the which gaseous fuel valves are activated to open.  It's a nominal value used for all the gaseous fuel valves in the engine.
Timings after ...";
CM_ SG_ 3221225472 EngGsFuelValveNominalDurationCmd "Amount of time the gaseous fuel valves are activated.  It's a nominal value used for all the gaseous fuel valves in the engine.

Note: Please see SPNs 6658 - 6677 for duration command for each gaseous fuel valves";
CM_ SG_ 3221225472 TransDirectionalOutputShaftSpeed "The rotational velocity and direction of the output shaft. Positive values are used for forward vehicle motion, negative values for reverse vehicle motion.

SPN 191 should be used when direction is not used.";
CM_ SG_ 3221225472 TransHydrostaticLoop2Press "Oil pressure in the transmission hydrostatic loop #2 between the pump and motor.";
CM_ SG_ 3221225472 TransHydrostaticLoop1Press "Oil pressure in the transmission hydrostatic loop #1 between the pump and motor.";
CM_ SG_ 3221225472 EngCyl20AvrageCombustionDuration "Average duration of combustion calculated over defined number of combustion cycles for engine cylinder 20 with reference to the crank angle.  Combustion duration is the difference between end of combustion and start of combustion expressed, in this ...";
CM_ SG_ 3221225472 EngCyl20AvrgCntrOfCmbstionTiming "Average timing calculated over defined number of combustion cycles for the center of combustion in engine cylinder 20 with reference to the crank angle.  Center of Combustion is used to indicate the combustion efficiency.  When the combustion ...";
CM_ SG_ 3221225472 EngCyl20AvrgStrtOfCmbstionTiming "Average start of combustion timing calculated over defined number of combustion cycles for engine cylinder 20 with reference to the crank angle.  When the combustion happens after the TDC (Top Dead Center) of this cylinder, the timing is referred in ...";
CM_ SG_ 3221225472 EngCyl20IndctdMeanEffectivePress "Average cylinder pressure calculated over defined number of combustion cycles for engine cylinder 20.  Negative range is to cover thermodynamic behavior during misfire.";
CM_ SG_ 3221225472 EngCyl19AvrageCombustionDuration "Average duration of combustion calculated over defined number of combustion cycles for engine cylinder 19 with reference to the crank angle.  Combustion duration is the difference between end of combustion and start of combustion expressed, in this ...";
CM_ SG_ 3221225472 EngCyl19AvrgCntrOfCmbstionTiming "Average timing calculated over defined number of combustion cycles for the center of combustion in engine cylinder 19 with reference to the crank angle.  Center of Combustion is used to indicate the combustion efficiency.  When the combustion ...";
CM_ SG_ 3221225472 EngCyl19AvrgStrtOfCmbstionTiming "Average start of combustion timing calculated over defined number of combustion cycles for engine cylinder 19 with reference to the crank angle.  When the combustion happens after the TDC (Top Dead Center) of this cylinder, the timing is referred in ...";
CM_ SG_ 3221225472 EngCyl19IndctdMeanEffectivePress "Average cylinder pressure calculated over defined number of combustion cycles for engine cylinder 19.  Negative range is to cover thermodynamic behavior during misfire.";
CM_ SG_ 3221225472 EngCyl18AvrageCombustionDuration "Average duration of combustion calculated over defined number of combustion cycles for engine cylinder 18 with reference to the crank angle.  Combustion duration is the difference between end of combustion and start of combustion expressed, in this ...";
CM_ SG_ 3221225472 EngCyl18AvrgCntrOfCmbstionTiming "Average timing calculated over defined number of combustion cycles for the center of combustion in engine cylinder 18 with reference to the crank angle.  Center of Combustion is used to indicate the combustion efficiency.  When the combustion ...";
CM_ SG_ 3221225472 EngCyl18AvrgStrtOfCmbstionTiming "Average start of combustion timing calculated over defined number of combustion cycles for engine cylinder 18 with reference to the crank angle.  When the combustion happens after the TDC (Top Dead Center) of this cylinder, the timing is referred in ...";
CM_ SG_ 3221225472 EngCyl18IndctdMeanEffectivePress "Average cylinder pressure calculated over defined number of combustion cycles for engine cylinder 18.  Negative range is to cover thermodynamic behavior during misfire.";
CM_ SG_ 3221225472 EngCyl17AvrageCombustionDuration "Average duration of combustion calculated over defined number of combustion cycles for engine cylinder 17 with reference to the crank angle.  Combustion duration is the difference between end of combustion and start of combustion expressed, in this ...";
CM_ SG_ 3221225472 EngCyl17AvrgCntrOfCmbstionTiming "Average timing calculated over defined number of combustion cycles for the center of combustion in engine cylinder 17 with reference to the crank angle.  Center of Combustion is used to indicate the combustion efficiency.  When the combustion ...";
CM_ SG_ 3221225472 EngCyl17AvrgStrtOfCmbstionTiming "Average start of combustion timing calculated over defined number of combustion cycles for engine cylinder 17 with reference to the crank angle.  When the combustion happens after the TDC (Top Dead Center) of this cylinder, the timing is referred in ...";
CM_ SG_ 3221225472 EngCyl17IndctdMeanEffectivePress "Average cylinder pressure calculated over defined number of combustion cycles for engine cylinder 17.  Negative range is to cover thermodynamic behavior during misfire.";
CM_ SG_ 3221225472 EngCyl16AvrageCombustionDuration "Average duration of combustion calculated over defined number of combustion cycles for engine cylinder 16 with reference to the crank angle.  Combustion duration is the difference between end of combustion and start of combustion expressed, in this ...";
CM_ SG_ 3221225472 EngCyl16AvrgCntrOfCmbstionTiming "Average timing calculated over defined number of combustion cycles for the center of combustion in engine cylinder 16 with reference to the crank angle.  Center of Combustion is used to indicate the combustion efficiency.  When the combustion ...";
CM_ SG_ 3221225472 EngCyl16AvrgStrtOfCmbstionTiming "Average start of combustion timing calculated over defined number of combustion cycles for engine cylinder 16 with reference to the crank angle.  When the combustion happens after the TDC (Top Dead Center) of this cylinder, the timing is referred in ...";
CM_ SG_ 3221225472 EngCyl16IndctdMeanEffectivePress "Average cylinder pressure calculated over defined number of combustion cycles for engine cylinder 16.  Negative range is to cover thermodynamic behavior during misfire.";
CM_ SG_ 3221225472 EngCyl15AvrageCombustionDuration "Average duration of combustion calculated over defined number of combustion cycles for engine cylinder 15 with reference to the crank angle.  Combustion duration is the difference between end of combustion and start of combustion expressed, in this ...";
CM_ SG_ 3221225472 EngCyl15AvrgCntrOfCmbstionTiming "Average timing calculated over defined number of combustion cycles for the center of combustion in engine cylinder 15 with reference to the crank angle.  Center of Combustion is used to indicate the combustion efficiency.  When the combustion ...";
CM_ SG_ 3221225472 EngCyl15AvrgStrtOfCmbstionTiming "Average start of combustion timing calculated over defined number of combustion cycles for engine cylinder 15 with reference to the crank angle.  When the combustion happens after the TDC (Top Dead Center) of this cylinder, the timing is referred in ...";
CM_ SG_ 3221225472 EngCyl15IndctdMeanEffectivePress "Average cylinder pressure calculated over defined number of combustion cycles for engine cylinder 15.  Negative range is to cover thermodynamic behavior during misfire.";
CM_ SG_ 3221225472 EngCyl14AvrageCombustionDuration "Average duration of combustion calculated over defined number of combustion cycles for engine cylinder 14 with reference to the crank angle.  Combustion duration is the difference between end of combustion and start of combustion expressed, in this ...";
CM_ SG_ 3221225472 EngCyl14AvrgCntrOfCmbstionTiming "Average timing calculated over defined number of combustion cycles for the center of combustion in engine cylinder 14 with reference to the crank angle.  Center of Combustion is used to indicate the combustion efficiency.  When the combustion ...";
CM_ SG_ 3221225472 EngCyl14AvrgStrtOfCmbstionTiming "Average start of combustion timing calculated over defined number of combustion cycles for engine cylinder 14 with reference to the crank angle.  When the combustion happens after the TDC (Top Dead Center) of this cylinder, the timing is referred in ...";
CM_ SG_ 3221225472 EngCyl14IndctdMeanEffectivePress "Average cylinder pressure calculated over defined number of combustion cycles for engine cylinder 14.  Negative range is to cover thermodynamic behavior during misfire.";
CM_ SG_ 3221225472 EngCyl13AvrageCombustionDuration "Average duration of combustion calculated over defined number of combustion cycles for engine cylinder 13 with reference to the crank angle.  Combustion duration is the difference between end of combustion and start of combustion expressed, in this ...";
CM_ SG_ 3221225472 EngCyl13AvrgCntrOfCmbstionTiming "Average timing calculated over defined number of combustion cycles for the center of combustion in engine cylinder 13 with reference to the crank angle.  Center of Combustion is used to indicate the combustion efficiency.  When the combustion ...";
CM_ SG_ 3221225472 EngCyl13AvrgStrtOfCmbstionTiming "Average start of combustion timing calculated over defined number of combustion cycles for engine cylinder 13 with reference to the crank angle.  When the combustion happens after the TDC (Top Dead Center) of this cylinder, the timing is referred in ...";
CM_ SG_ 3221225472 EngCyl13IndctdMeanEffectivePress "Average cylinder pressure calculated over defined number of combustion cycles for engine cylinder 13.  Negative range is to cover thermodynamic behavior during misfire.";
CM_ SG_ 3221225472 EngCyl12AvrageCombustionDuration "Average duration of combustion calculated over defined number of combustion cycles for engine cylinder 12 with reference to the crank angle.  Combustion duration is the difference between end of combustion and start of combustion expressed, in this ...";
CM_ SG_ 3221225472 EngCyl12AvrgCntrOfCmbstionTiming "Average timing calculated over defined number of combustion cycles for the center of combustion in engine cylinder 12 with reference to the crank angle.  Center of Combustion is used to indicate the combustion efficiency.  When the combustion ...";
CM_ SG_ 3221225472 EngCyl12AvrgStrtOfCmbstionTiming "Average start of combustion timing calculated over defined number of combustion cycles for engine cylinder 12 with reference to the crank angle.  When the combustion happens after the TDC (Top Dead Center) of this cylinder, the timing is referred in ...";
CM_ SG_ 3221225472 EngCyl12IndctdMeanEffectivePress "Average cylinder pressure calculated over defined number of combustion cycles for engine cylinder 12.  Negative range is to cover thermodynamic behavior during misfire.";
CM_ SG_ 3221225472 EngCyl11AvrageCombustionDuration "Average duration of combustion calculated over defined number of combustion cycles for engine cylinder 11 with reference to the crank angle.  Combustion duration is the difference between end of combustion and start of combustion expressed, in this ...";
CM_ SG_ 3221225472 EngCyl11AvrgCntrOfCmbstionTiming "Average timing calculated over defined number of combustion cycles for the center of combustion in engine cylinder 11 with reference to the crank angle.  Center of Combustion is used to indicate the combustion efficiency.  When the combustion ...";
CM_ SG_ 3221225472 EngCyl11AvrgStrtOfCmbstionTiming "Average start of combustion timing calculated over defined number of combustion cycles for engine cylinder 11 with reference to the crank angle.  When the combustion happens after the TDC (Top Dead Center) of this cylinder, the timing is referred in ...";
CM_ SG_ 3221225472 EngCyl11IndctdMeanEffectivePress "Average cylinder pressure calculated over defined number of combustion cycles for engine cylinder 11.  Negative range is to cover thermodynamic behavior during misfire.";
CM_ SG_ 3221225472 EngCyl10AvrageCombustionDuration "Average duration of combustion calculated over defined number of combustion cycles for engine cylinder 10 with reference to the crank angle.  Combustion duration is the difference between end of combustion and start of combustion expressed, in this ...";
CM_ SG_ 3221225472 EngCyl10AvrgCntrOfCmbstionTiming "Average timing calculated over defined number of combustion cycles for the center of combustion in engine cylinder 10 with reference to the crank angle.  Center of Combustion is used to indicate the combustion efficiency.  When the combustion ...";
CM_ SG_ 3221225472 EngCyl10AvrgStrtOfCmbstionTiming "Average start of combustion timing calculated over defined number of combustion cycles for engine cylinder 10 with reference to the crank angle.  When the combustion happens after the TDC (Top Dead Center) of this cylinder, the timing is referred in ...";
CM_ SG_ 3221225472 EngCyl10IndctdMeanEffectivePress "Average cylinder pressure calculated over defined number of combustion cycles for engine cylinder 10.  Negative range is to cover thermodynamic behavior during misfire.";
CM_ SG_ 3221225472 EngCyl9AverageCombustionDuration "Average duration of combustion calculated over defined number of combustion cycles for engine cylinder 9 with reference to the crank angle.  Combustion duration is the difference between end of combustion and start of combustion expressed, in this ...";
CM_ SG_ 3221225472 EngCyl9AvrgCntrOfCmbustionTiming "Average timing calculated over defined number of combustion cycles for the center of combustion in engine cylinder 9 with reference to the crank angle.  Center of Combustion is used to indicate the combustion efficiency.  When the combustion happens ...";
CM_ SG_ 3221225472 EngCyl9AvrgStrtOfCmbustionTiming "Average start of combustion timing calculated over defined number of combustion cycles for engine cylinder 9 with reference to the crank angle.  When the combustion happens after the TDC (Top Dead Center) of this cylinder, the timing is referred in ...";
CM_ SG_ 3221225472 EngCyl9IndctedMeanEffectivePress "Average cylinder pressure calculated over defined number of combustion cycles for engine cylinder 9.  Negative range is to cover thermodynamic behavior during misfire.";
CM_ SG_ 3221225472 GenFrequencySelection "Command from user and/or generator control system for the genset (engine) to target operations for 50 Hz, 60 Hz, or 400 Hz.

0000 = 50 Hz
0001 = 60 Hz
0010 = 400 Hz
0011 - 1101 = SAE Reserved
1110 = Unknown
1111= Don't care /take no action";
CM_ SG_ 3221225472 GenGoverningSpeedCommand "Command from user and/or generator control system for the genset (engine) to govern to low idle or rated base speed setpoints.  If this method of engine control is used, then the PGN 0 (TSC1) is not expected to be received by the engine controller ...";
CM_ SG_ 3221225472 GenAlternatorEfficiency "Measured, calculated, and/or estimated operating efficiency of the generator alternator.  Percentage reflects ratio of power output divided by power input, multiplied by 100.";
CM_ SG_ 3221225472 GenNotReadyToAutoParaState "This parameter indicates whether or not all systems required to start the engine and close to the bus are prepared to operate automatically. If not, the generator is not ready to automatically parallel, and the status parameter is in the ACTIVE ...";
CM_ SG_ 3221225472 GenCtrlNotInAutoStartState "This parameter indicates whether or not the generator set is in a condition to automatically start up and provide power. If not, this status parameter is in the ACTIVE state.
00 = inactive (ready to start automatically)
01 = active (not ready to ...";
CM_ SG_ 3221225472 RequestedEngineControlMode "This parameter is used to request a change to the engine control mode.  This is a status parameter.
Bit state 0000 = Normal Engine Shutdown
Bit state 0001 = Rapid Engine Shutdown
Bit state 0010 = Emergency Engine Shutdown
Bit state 0011 = Normal ...";
CM_ SG_ 3221225472 EngSpeedGovernorDroop "This is the percent speed droop adjustment relative to rated speed setpoint. The Engine Speed Droop is equal to the following equation:
100*[(Engine Speed at no load - Engine Speed at full rated load)/ (Engine Speed at full rated load)].
The ...";
CM_ SG_ 3221225472 EngSpeedGovernorGainAdjust "This parameter is used to adjust multiple gains at same time to attain engine stability across a broader range of applications.  

-32128 is least responsive
0 is normal
+32127 is most responsive";
CM_ SG_ 3221225472 StaticRollAngleStatus "Status of the transmitted roll angle data.

000 = Sensor Busy
001 = Sensor OK
010 = Sensor Defect
011 = Sensor Reboots
100 = Angle Data Invalid
101 = Reserved
110 = Error
111 = Not available";
CM_ SG_ 3221225472 StaticRollAngle "The measured static roll angle between the vehicle y-axis and the ground plane about the X-axis.  The sign of the roll angle is determined in accordance to the right-hand rule about the X-axis, as specified in SAE J670.  Roll angle is the same for ...";
CM_ SG_ 3221225472 EngCyl2AverageCombustionDuration "Average duration of combustion calculated over defined number of combustion cycles for engine cylinder 2 with reference to the crank angle.  Combustion duration is the difference between end of combustion and start of combustion expressed, in this ...";
CM_ SG_ 3221225472 EngCyl2AvrgCntrOfCmbustionTiming "Average timing calculated over defined number of combustion cycles for the center of combustion in engine cylinder 2 with reference to the crank angle.  Center of Combustion is used to indicate the combustion efficiency.  When the combustion happens ...";
CM_ SG_ 3221225472 EngCyl2AvrgStrtOfCmbustionTiming "Average start of combustion timing calculated over defined number of combustion cycles for engine cylinder 2 with reference to the crank angle.  When the combustion happens after the TDC (Top Dead Center) of this cylinder, the timing is referred in ...";
CM_ SG_ 3221225472 EngCyl2IndctedMeanEffectivePress "Average cylinder pressure calculated over defined number of combustion cycles for engine cylinder 2.  Negative range is to cover thermodynamic behavior during misfire.";
CM_ SG_ 3221225472 EngCyl1AverageCombustionDuration "Average duration of combustion calculated over defined number of combustion cycles for engine cylinder 1 with reference to the crank angle.  Combustion duration is the difference between end of combustion and start of combustion expressed, in this ...";
CM_ SG_ 3221225472 EngCyl1AvrgCntrOfCmbustionTiming "Average timing calculated over defined number of combustion cycles for the center of combustion in engine cylinder 1 with reference to the crank angle.  Center of Combustion is used to indicate the combustion efficiency.  When the combustion happens ...";
CM_ SG_ 3221225472 EngCyl1AvrgStrtOfCmbustionTiming "Average start of combustion timing calculated over defined number of combustion cycles for engine cylinder 1 with reference to the crank angle.  When the combustion happens after the TDC (Top Dead Center) of this cylinder, the timing is referred in ...";
CM_ SG_ 3221225472 EngCyl1IndctedMeanEffectivePress "Average cylinder pressure calculated over defined number of combustion cycles for engine cylinder 1.   Negative range is to cover thermodynamic behavior during misfire.";
CM_ SG_ 3221225472 MaxPressIncreaseRate "The maximum slope, in degrees of crank angle, of the pressure increase in engine cylinder 20 during the combustion cycle.";
CM_ SG_ 3221225472 LowFreqKnockLvl "Indicates the level of low frequency knock for engine cylinder 20. This knock occurs at frequencies below the typical knock level reported on SPNs 1371 & 6474.  The level of low frequency knock is reported using a relative scale where 0% is least ...";
CM_ SG_ 3221225472 EngCyl20PrssSensorPreliminaryFMI "Used to identify the applicable J1939-73 FMI detected in the engine cylinder 20 pressure sensor.  When there is no failure FMI 31 is sent. In the case of multiple failures the most severe is communicated.";
CM_ SG_ 3221225472 EngCyl20SynchronousKnockLevel "Used to indicate the level of knock for engine cylinder 20. The level of knock is reported using a relative scale where 0% is least level of knock, and increasing levels indicate more knock until 100% indicates the most severe level of knock allowed ...";
CM_ SG_ 3221225472 EngCyl20PeakPress "Peak pressure in engine cylinder 20 in combustion cycle.";
CM_ SG_ 3221225472 EngCyl20HeatRelease "The amount of heat produced during combustion in engine cylinder 20.  The negative range is to cover thermodynamic behavior during misfire.";
CM_ SG_ 3221225472 MaxPressIncreaseRate "The maximum slope, in degrees of crank angle, of the pressure increase in engine cylinder 19 during the combustion cycle.";
CM_ SG_ 3221225472 LowFreqKnockLvl "Indicates the level of low frequency knock for engine cylinder 19. This knock occurs at frequencies below the typical knock level reported on SPNs 1370 & 6470.  The level of low frequency knock is reported using a relative scale where 0% is least ...";
CM_ SG_ 3221225472 EngCyl19PrssSensorPreliminaryFMI "Used to identify the applicable J1939-73 FMI detected in the engine cylinder 19 pressure sensor.  When there is no failure FMI 31 is sent. In the case of multiple failures the most severe is communicated.";
CM_ SG_ 3221225472 EngCyl19SynchronousKnockLevel "Used to indicate the level of knock for engine cylinder 19. The level of knock is reported using a relative scale where 0% is least level of knock, and increasing levels indicate more knock until 100% indicates the most severe level of knock allowed ...";
CM_ SG_ 3221225472 EngCyl19PeakPress "Peak pressure in engine cylinder 19 in combustion cycle.";
CM_ SG_ 3221225472 EngCyl19HeatRelease "The amount of heat produced during combustion in engine cylinder 19.  The negative range is to cover thermodynamic behavior during misfire.";
CM_ SG_ 3221225472 MaxPressIncreaseRate "The maximum slope, in degrees of crank angle, of the pressure increase in engine cylinder 18 during the combustion cycle.";
CM_ SG_ 3221225472 LowFreqKnockLvl "Indicates the level of low frequency knock for engine cylinder 18. This knock occurs at frequencies below the typical knock level reported on SPNs 1369 & 6466.  The level of low frequency knock is reported using a relative scale where 0% is least ...";
CM_ SG_ 3221225472 EngCyl18PrssSensorPreliminaryFMI "Used to identify the applicable J1939-73 FMI detected in the engine cylinder 18 pressure sensor.  When there is no failure FMI 31 is sent. In the case of multiple failures the most severe is communicated.";
CM_ SG_ 3221225472 EngCyl18SynchronousKnockLevel "Used to indicate the level of knock for engine cylinder 18. The level of knock is reported using a relative scale where 0% is least level of knock, and increasing levels indicate more knock until 100% indicates the most severe level of knock allowed ...";
CM_ SG_ 3221225472 EngCyl18PeakPress "Peak pressure in engine cylinder 18 in combustion cycle.";
CM_ SG_ 3221225472 EngCyl18HeatRelease "The amount of heat produced during combustion in engine cylinder 18.  The negative range is to cover thermodynamic behavior during misfire.";
CM_ SG_ 3221225472 MaxPressIncreaseRate "The maximum slope, in degrees of crank angle, of the pressure increase in engine cylinder 17 during the combustion cycle.";
CM_ SG_ 3221225472 LowFreqKnockLvl "Indicates the level of low frequency knock for engine cylinder 17. This knock occurs at frequencies below the typical knock level reported on SPNs 1368 & 6462.  The level of low frequency knock is reported using a relative scale where 0% is least ...";
CM_ SG_ 3221225472 EngCyl17PrssSensorPreliminaryFMI "Used to identify the applicable J1939-73 FMI detected in the engine cylinder 17 pressure sensor.  When there is no failure FMI 31 is sent. In the case of multiple failures the most severe is communicated.";
CM_ SG_ 3221225472 EngCyl17SynchronousKnockLevel "Used to indicate the level of knock for engine cylinder 17. The level of knock is reported using a relative scale where 0% is least level of knock, and increasing levels indicate more knock until 100% indicates the most severe level of knock allowed ...";
CM_ SG_ 3221225472 EngCyl17PeakPress "Peak pressure in engine cylinder 17 in combustion cycle.";
CM_ SG_ 3221225472 EngCyl17HeatRelease "The amount of heat produced during combustion in engine cylinder 17.  The negative range is to cover thermodynamic behavior during misfire.";
CM_ SG_ 3221225472 MaxPressIncreaseRate "The maximum slope, in degrees of crank angle, of the pressure increase in engine cylinder 16 during the combustion cycle.";
CM_ SG_ 3221225472 LowFreqKnockLvl "Indicates the level of low frequency knock for engine cylinder 16. This knock occurs at frequencies below the typical knock level reported on SPNs 1367 & 6458.  The level of low frequency knock is reported using a relative scale where 0% is least ...";
CM_ SG_ 3221225472 EngCyl16PrssSensorPreliminaryFMI "Used to identify the applicable J1939-73 FMI detected in the engine cylinder 16 pressure sensor.  When there is no failure FMI 31 is sent. In the case of multiple failures the most severe is communicated.";
CM_ SG_ 3221225472 EngCyl16SynchronousKnockLevel "Used to indicate the level of knock for engine cylinder 16. The level of knock is reported using a relative scale where 0% is least level of knock, and increasing levels indicate more knock until 100% indicates the most severe level of knock allowed ...";
CM_ SG_ 3221225472 EngCyl16PeakPress "Peak pressure in engine cylinder 16 in combustion cycle.";
CM_ SG_ 3221225472 EngCyl16HeatRelease "The amount of heat produced during combustion in engine cylinder 16.  The negative range is to cover thermodynamic behavior during misfire.";
CM_ SG_ 3221225472 MaxPressIncreaseRate "The maximum slope, in degrees of crank angle, of the pressure increase in engine cylinder 15 during the combustion cycle.";
CM_ SG_ 3221225472 LowFreqKnockLvl "Indicates the level of low frequency knock for engine cylinder 15. This knock occurs at frequencies below the typical knock level reported on SPNs 1366 & 6454.  The level of low frequency knock is reported using a relative scale where 0% is least ...";
CM_ SG_ 3221225472 EngCyl15PrssSensorPreliminaryFMI "Used to identify the applicable J1939-73 FMI detected in the engine cylinder 15 pressure sensor.  When there is no failure FMI 31 is sent. In the case of multiple failures the most severe is communicated.";
CM_ SG_ 3221225472 EngCyl15SynchronousKnockLevel "Used to indicate the level of knock for engine cylinder 15. The level of knock is reported using a relative scale where 0% is least level of knock, and increasing levels indicate more knock until 100% indicates the most severe level of knock allowed ...";
CM_ SG_ 3221225472 EngCyl15PeakPress "Peak pressure in engine cylinder 15 in combustion cycle.";
CM_ SG_ 3221225472 EngCyl15HeatRelease "The amount of heat produced during combustion in engine cylinder 15.  The negative range is to cover thermodynamic behavior during misfire.";
CM_ SG_ 3221225472 MaxPressIncreaseRate "The maximum slope, in degrees of crank angle, of the pressure increase in engine cylinder 14 during the combustion cycle.";
CM_ SG_ 3221225472 LowFreqKnockLvl "Indicates the level of low frequency knock for engine cylinder 14. This knock occurs at frequencies below the typical knock level reported on SPNs 1365 & 6450.  The level of low frequency knock is reported using a relative scale where 0% is least ...";
CM_ SG_ 3221225472 EngCyl14PrssSensorPreliminaryFMI "Used to identify the applicable J1939-73 FMI detected in the engine cylinder 14 pressure sensor.  When there is no failure FMI 31 is sent. In the case of multiple failures the most severe is communicated.";
CM_ SG_ 3221225472 EngCyl14SynchronousKnockLevel "Used to indicate the level of knock for engine cylinder 14. The level of knock is reported using a relative scale where 0% is least level of knock, and increasing levels indicate more knock until 100% indicates the most severe level of knock allowed ...";
CM_ SG_ 3221225472 EngCyl14PeakPress "Peak pressure in engine cylinder 14 in combustion cycle.";
CM_ SG_ 3221225472 EngCyl14HeatRelease "The amount of heat produced during combustion in engine cylinder 14.  The negative range is to cover thermodynamic behavior during misfire.";
CM_ SG_ 3221225472 MaxPressIncreaseRate "The maximum slope, in degrees of crank angle, of the pressure increase in engine cylinder 13 during the combustion cycle.";
CM_ SG_ 3221225472 LowFreqKnockLvl "Indicates the level of low frequency knock for engine cylinder 13. This knock occurs at frequencies below the typical knock level reported on SPNs 1364 & 6446.  The level of low frequency knock is reported using a relative scale where 0% is least ...";
CM_ SG_ 3221225472 EngCyl13PrssSensorPreliminaryFMI "Used to identify the applicable J1939-73 FMI detected in the engine cylinder 13 pressure sensor.  When there is no failure FMI 31 is sent. In the case of multiple failures the most severe is communicated.";
CM_ SG_ 3221225472 EngCyl13SynchronousKnockLevel "Used to indicate the level of knock for engine cylinder 13. The level of knock is reported using a relative scale where 0% is least level of knock, and increasing levels indicate more knock until 100% indicates the most severe level of knock allowed ...";
CM_ SG_ 3221225472 EngCyl13PeakPress "Peak pressure in engine cylinder 13 in combustion cycle.";
CM_ SG_ 3221225472 EngCyl13HeatRelease "The amount of heat produced during combustion in engine cylinder 13.  The negative range is to cover thermodynamic behavior during misfire.";
CM_ SG_ 3221225472 MaxPressIncreaseRate "The maximum slope, in degrees of crank angle, of the pressure increase in engine cylinder 12 during the combustion cycle.";
CM_ SG_ 3221225472 LowFreqKnockLvl "Indicates the level of low frequency knock for engine cylinder 12. This knock occurs at frequencies below the typical knock level reported on SPNs 1363 & 6442.  The level of low frequency knock is reported using a relative scale where 0% is least ...";
CM_ SG_ 3221225472 EngCyl12PrssSensorPreliminaryFMI "Used to identify the applicable J1939-73 FMI detected in the engine cylinder 12 pressure sensor.  When there is no failure FMI 31 is sent. In the case of multiple failures the most severe is communicated.";
CM_ SG_ 3221225472 EngCyl12SynchronousKnockLevel "Used to indicate the level of knock for engine cylinder 12. The level of knock is reported using a relative scale where 0% is least level of knock, and increasing levels indicate more knock until 100% indicates the most severe level of knock allowed ...";
CM_ SG_ 3221225472 EngCyl12PeakPress "Peak pressure in engine cylinder 12 in combustion cycle.";
CM_ SG_ 3221225472 EngCyl12HeatRelease "The amount of heat produced during combustion in engine cylinder 12.  The negative range is to cover thermodynamic behavior during misfire.";
CM_ SG_ 3221225472 MaxPressIncreaseRate "The maximum slope, in degrees of crank angle, of the pressure increase in engine cylinder 11 during the combustion cycle.";
CM_ SG_ 3221225472 LowFreqKnockLvl "Indicates the level of low frequency knock for engine cylinder 11. This knock occurs at frequencies below the typical knock level reported on SPNs 1362 & 6438.  The level of low frequency knock is reported using a relative scale where 0% is least ...";
CM_ SG_ 3221225472 EngCyl11PrssSensorPreliminaryFMI "Used to identify the applicable J1939-73 FMI detected in the engine cylinder 11 pressure sensor.  When there is no failure FMI 31 is sent. In the case of multiple failures the most severe is communicated.";
CM_ SG_ 3221225472 EngCyl11SynchronousKnockLevel "Used to indicate the level of knock for engine cylinder 11. The level of knock is reported using a relative scale where 0% is least level of knock, and increasing levels indicate more knock until 100% indicates the most severe level of knock allowed ...";
CM_ SG_ 3221225472 EngCyl11PeakPress "Peak pressure in engine cylinder 11 in combustion cycle.";
CM_ SG_ 3221225472 EngCyl11HeatRelease "The amount of heat produced during combustion in engine cylinder 11.  The negative range is to cover thermodynamic behavior during misfire.";
CM_ SG_ 3221225472 MaxPressIncreaseRate "The maximum slope, in degrees of crank angle, of the pressure increase in engine cylinder 10 during the combustion cycle.";
CM_ SG_ 3221225472 LowFreqKnockLvl "Indicates the level of low frequency knock for engine cylinder 10. This knock occurs at frequencies below the typical knock level reported on SPNs 1361 & 6434.  The level of low frequency knock is reported using a relative scale where 0% is least ...";
CM_ SG_ 3221225472 EngCyl10PrssSensorPreliminaryFMI "Used to identify the applicable J1939-73 FMI detected in the engine cylinder 10 pressure sensor.  When there is no failure FMI 31 is sent. In the case of multiple failures the most severe is communicated.";
CM_ SG_ 3221225472 EngCyl10SynchronousKnockLevel "Used to indicate the level of knock for engine cylinder 10. The level of knock is reported using a relative scale where 0% is least level of knock, and increasing levels indicate more knock until 100% indicates the most severe level of knock allowed ...";
CM_ SG_ 3221225472 EngCyl10PeakPress "Peak pressure in engine cylinder 10 in combustion cycle.";
CM_ SG_ 3221225472 EngCyl10HeatRelease "The amount of heat produced during combustion in engine cylinder 10.  The negative range is to cover thermodynamic behavior during misfire.";
CM_ SG_ 3221225472 MaxPressIncreaseRate "The maximum slope, in degrees of crank angle, of the pressure increase in engine cylinder 9 during the combustion cycle.";
CM_ SG_ 3221225472 LowFreqKnockLvl "Indicates the level of low frequency knock for engine cylinder 9. This knock occurs at frequencies below the typical knock level reported on SPNs 1360 & 6430.  The level of low frequency knock is reported using a relative scale where 0% is least ...";
CM_ SG_ 3221225472 EngCyl9PressSensorPreliminaryFMI "Used to identify the applicable J1939-73 FMI detected in the engine cylinder 9 pressure sensor.  When there is no failure FMI 31 is sent. In the case of multiple failures the most severe is communicated.";
CM_ SG_ 3221225472 EngCyl9SynchronousKnockLevel "Used to indicate the level of knock for engine cylinder 9. The level of knock is reported using a relative scale where 0% is least level of knock, and increasing levels indicate more knock until 100% indicates the most severe level of knock allowed ...";
CM_ SG_ 3221225472 EngCyl9PeakPress "Peak pressure in engine cylinder 9 in combustion cycle.";
CM_ SG_ 3221225472 EngCyl9HeatRelease "The amount of heat produced during combustion in engine cylinder 9.  The negative range is to cover thermodynamic behavior during misfire.";
CM_ SG_ 3221225472 MaxPressIncreaseRate "The maximum slope, in degrees of crank angle, of the pressure increase in engine cylinder 8 during the combustion cycle.";
CM_ SG_ 3221225472 LowFreqKnockLvl "Indicates the level of low frequency knock for engine cylinder 8. This knock occurs at frequencies below the typical knock level reported on SPNs 1359 & 6426.  The level of low frequency knock is reported using a relative scale where 0% is least ...";
CM_ SG_ 3221225472 EngCyl8PressSensorPreliminaryFMI "Used to identify the applicable J1939-73 FMI detected in the engine cylinder 8 pressure sensor.  When there is no failure FMI 31 is sent. In the case of multiple failures the most severe is communicated.";
CM_ SG_ 3221225472 EngCyl8SynchronousKnockLevel "Used to indicate the level of knock for engine cylinder 8. The level of knock is reported using a relative scale where 0% is least level of knock, and increasing levels indicate more knock until 100% indicates the most severe level of knock allowed ...";
CM_ SG_ 3221225472 EngCyl8PeakPress "Peak pressure in engine cylinder 8 in combustion cycle.";
CM_ SG_ 3221225472 EngCyl8HeatRelease "The amount of heat produced during combustion in engine cylinder 8.  The negative range is to cover thermodynamic behavior during misfire.";
CM_ SG_ 3221225472 MaxPressIncreaseRate "The maximum slope, in degrees of crank angle, of the pressure increase in engine cylinder 7 during the combustion cycle.";
CM_ SG_ 3221225472 LowFreqKnockLvl "Indicates the level of low frequency knock for engine cylinder 7. This knock occurs at frequencies below the typical knock level reported on SPNs 1358 & 6422.  The level of low frequency knock is reported using a relative scale where 0% is least ...";
CM_ SG_ 3221225472 EngCyl7PressSensorPreliminaryFMI "Used to identify the applicable J1939-73 FMI detected in the engine cylinder 7 pressure sensor.  When there is no failure FMI 31 is sent. In the case of multiple failures the most severe is communicated.";
CM_ SG_ 3221225472 EngCyl7SynchronousKnockLevel "Used to indicate the level of knock for engine cylinder 7. The level of knock is reported using a relative scale where 0% is least level of knock, and increasing levels indicate more knock until 100% indicates the most severe level of knock allowed ...";
CM_ SG_ 3221225472 EngCyl7PeakPress "Peak pressure in engine cylinder 7 in combustion cycle.";
CM_ SG_ 3221225472 EngCyl7HeatRelease "The amount of heat produced during combustion in engine cylinder 7.  The negative range is to cover thermodynamic behavior during misfire.";
CM_ SG_ 3221225472 MaxPressIncreaseRate "The maximum slope, in degrees of crank angle, of the pressure increase in engine cylinder 6 during the combustion cycle.";
CM_ SG_ 3221225472 LowFreqKnockLvl "Indicates the level of low frequency knock for engine cylinder 6. This knock occurs at frequencies below the typical knock level reported on SPNs 1357 & 6418.  The level of low frequency knock is reported using a relative scale where 0% is least ...";
CM_ SG_ 3221225472 EngCyl6PressSensorPreliminaryFMI "Used to identify the applicable J1939-73 FMI detected in the engine cylinder 6 pressure sensor.  When there is no failure FMI 31 is sent. In the case of multiple failures the most severe is communicated.";
CM_ SG_ 3221225472 EngCyl6SynchronousKnockLevel "Used to indicate the level of knock for engine cylinder 6. The level of knock is reported using a relative scale where 0% is least level of knock, and increasing levels indicate more knock until 100% indicates the most severe level of knock allowed ...";
CM_ SG_ 3221225472 EngCyl6PeakPress "Peak pressure in engine cylinder 6 in combustion cycle.";
CM_ SG_ 3221225472 EngCyl6HeatRelease "The amount of heat produced during combustion in engine cylinder 6.  The negative range is to cover thermodynamic behavior during misfire.";
CM_ SG_ 3221225472 MaxPressIncreaseRate "The maximum slope, in degrees of crank angle, of the pressure increase in engine cylinder 5 during the combustion cycle.";
CM_ SG_ 3221225472 LowFreqKnockLvl "Indicates the level of low frequency knock for engine cylinder 5. This knock occurs at frequencies below the typical knock level reported on SPNs 1356 & 6414.  The level of low frequency knock is reported using a relative scale where 0% is least ...";
CM_ SG_ 3221225472 EngCyl5PressSensorPreliminaryFMI "Used to identify the applicable J1939-73 FMI detected in the engine cylinder 5 pressure sensor.  When there is no failure FMI 31 is sent. In the case of multiple failures the most severe is communicated.";
CM_ SG_ 3221225472 EngCyl5SynchronousKnockLevel "Used to indicate the level of knock for engine cylinder 6. The level of knock is reported using a relative scale where 0% is least level of knock, and increasing levels indicate more knock until 100% indicates the most severe level of knock allowed ...";
CM_ SG_ 3221225472 EngCyl5PeakPress "Peak pressure in engine cylinder 5 in combustion cycle.";
CM_ SG_ 3221225472 EngCyl5HeatRelease "The amount of heat produced during combustion in engine cylinder 5.  The negative range is to cover thermodynamic behavior during misfire.";
CM_ SG_ 3221225472 MaxPressIncreaseRate "The maximum slope, in degrees of crank angle, of the pressure increase in engine cylinder 4 during the combustion cycle.";
CM_ SG_ 3221225472 LowFreqKnockLvl "Indicates the level of low frequency knock for engine cylinder 4. This knock occurs at frequencies below the typical knock level reported on SPNs 1355 & 6410.  The level of low frequency knock is reported using a relative scale where 0% is least ...";
CM_ SG_ 3221225472 EngCyl4PressSensorPreliminaryFMI "Used to identify the applicable J1939-73 FMI detected in the engine cylinder 4 pressure sensor.  When there is no failure FMI 31 is sent. In the case of multiple failures the most severe is communicated.";
CM_ SG_ 3221225472 EngCyl4SynchronousKnockLevel "Used to indicate the level of knock for engine cylinder 4. The level of knock is reported using a relative scale where 0% is least level of knock, and increasing levels indicate more knock until 100% indicates the most severe level of knock allowed ...";
CM_ SG_ 3221225472 EngCyl4PeakPress "Peak pressure in engine cylinder 4 in combustion cycle.";
CM_ SG_ 3221225472 EngCyl4HeatRelease "The amount of heat produced during combustion in engine cylinder 4.  The negative range is to cover thermodynamic behavior during misfire.";
CM_ SG_ 3221225472 MaxPressIncreaseRate "The maximum slope, in degrees of crank angle, of the pressure increase in engine cylinder 3 during the combustion cycle.";
CM_ SG_ 3221225472 LowFreqKnockLvl "Indicates the level of low frequency knock for engine cylinder 3. This knock occurs at frequencies below the typical knock level reported on SPNs 1354 & 6406.  The level of low frequency knock is reported using a relative scale where 0% is least ...";
CM_ SG_ 3221225472 EngCyl3PressSensorPreliminaryFMI "Used to identify the applicable J1939-73 FMI detected in the engine cylinder 3 pressure sensor.  When there is no failure FMI 31 is sent. In the case of multiple failures the most severe is communicated.";
CM_ SG_ 3221225472 EngCyl3SynchronousKnockLevel "Used to indicate the level of knock for engine cylinder 3. The level of knock is reported using a relative scale where 0% is least level of knock, and increasing levels indicate more knock until 100% indicates the most severe level of knock allowed ...";
CM_ SG_ 3221225472 EngCyl3PeakPress "Peak pressure in engine cylinder 3 in combustion cycle.";
CM_ SG_ 3221225472 EngCyl3HeatRelease "The amount of heat produced during combustion in engine cylinder 3.  The negative range is to cover thermodynamic behavior during misfire.";
CM_ SG_ 3221225472 MaxPressIncreaseRate "The maximum slope, in degrees of crank angle, of the pressure increase in engine cylinder 2 during the combustion cycle.";
CM_ SG_ 3221225472 LowFreqKnockLvl "Indicates the level of low frequency knock for engine cylinder 2. This knock occurs at frequencies below the typical knock level reported on SPNs 1353 & 6402.  The level of low frequency knock is reported using a relative scale where 0% is least ...";
CM_ SG_ 3221225472 EngCyl2PressSensorPreliminaryFMI "Used to identify the applicable J1939-73 FMI detected in the engine cylinder 2 pressure sensor.  When there is no failure FMI 31 is sent. In the case of multiple failures the most severe is communicated.";
CM_ SG_ 3221225472 EngCyl2SynchronousKnockLevel "Used to indicate the level of knock for engine cylinder 2. The level of knock is reported using a relative scale where 0% is least level of knock, and increasing levels indicate more knock until 100% indicates the most severe level of knock allowed ...";
CM_ SG_ 3221225472 EngCyl2PeakPress "Peak pressure in engine cylinder 2 in combustion cycle.";
CM_ SG_ 3221225472 EngCyl2HeatRelease "The amount of heat produced during combustion in engine cylinder 2.  The negative range is to cover thermodynamic behavior during misfire.";
CM_ SG_ 3221225472 MaxPressIncreaseRate "The maximum slope, in degrees of crank angle, of the pressure increase in engine cylinder 1 during the combustion cycle.";
CM_ SG_ 3221225472 LowFreqKnockLvl "Indicates the level of low frequency knock for engine cylinder 1. This knock occurs at frequencies below the typical knock level reported on SPNs 1352 & 6398. The level of low frequency knock is reported using a relative scale where 0% is least ...";
CM_ SG_ 3221225472 EngCyl1PressSensorPreliminaryFMI "Used to identify the applicable J1939-73 FMI detected in the engine cylinder 1 pressure sensor.  When there is no failure FMI 31 is sent. In the case of multiple failures the most severe is communicated.";
CM_ SG_ 3221225472 EngCyl1SynchronousKnockLevel "Used to indicate the level of knock for engine cylinder 1. The level of knock is reported using a relative scale where 0% is least level of knock, and increasing levels indicate more knock until 100% indicates the most severe level of knock allowed ...";
CM_ SG_ 3221225472 EngCyl1PeakPress "Peak pressure in engine cylinder 1 in combustion cycle.";
CM_ SG_ 3221225472 EngCyl1HeatRelease "The amount of heat produced during combustion in Engine cylinder 1. The negative range is to cover thermodynamic behavior during misfire.";
CM_ SG_ 3221225472 EngTotalIntakeMassAirFlowRate "Mass Flow rate of air entering the engine. This also includes the amount of exhaust gas recirculated, if any.";
CM_ SG_ 3221225472 EngDesiredAirFuelRatio "Reports the desired Air Fuel ratio for the engine.

Air Fuel Ratio specifies the amount of air required to completely burn one unit of fuel in the engine to meet the required engine performance and emission standards.";
CM_ SG_ 3221225472 EngCylTorque "Calculated engine torque output per cylinder.";
CM_ SG_ 3221225472 EngCylDieselMassFlowRateCmd "Commanded Mass Flow rate of diesel fuel delivered to the engine normalized per cylinder.";
CM_ SG_ 3221225472 EngCylGasMassFlowRateCmd "Commanded Mass Flow rate of gaseous fuel delivered to the engine normalized per cylinder.";
CM_ SG_ 3221225472 EngGasFuelPercentageCmd "Percentage of Gaseous fuel used, in terms of % mass of fuel. 0% means no Gaseous fuel used and 100 % means completely gaseous fuel is used.
Gas substitution is the process for a dual fuel engine system of substituting gas, e.g. natural gas, for ...";
CM_ SG_ 3221225472 EngDualFuelModeCmd "Request to enable dual fuel mode.

00 = De-activate dual fuel mode
01 = Activate dual fuel mode
10 = Reserved
11 = Not available";
CM_ SG_ 3221225472 EngTrbCmprssrBlwffActtr1OprtnStt "Used to identify the status of Engine Turbocharger Compressor Blowoff Actuator 1.
0000 - Normal
0001 - Alarm (fully operational but needs service)
0010 - Alarm High Severity (functional but transient performance may be reduced)
0011 - Derate ...";
CM_ SG_ 3221225472 EngTrbCmprssrBlowoffActuator1Pos "Actual position of the turbocharger compressor blowoff actuator, where 0% represents fully closed and 100% represents fully open.";
CM_ SG_ 3221225472 EngTrbCmprssrBlwffActtr1DsredPos "The requested position of the Engine Turbocharger Compressor Blowoff actuator by the engine ECU, where 0% represents bypass fully closed and 100% represents fully open.  This is the position that the device is attempting to achieve.";
CM_ SG_ 3221225472 EngTrbCmprssrBlwoffActuator1Temp "Temperature of the Engine Turbocharger Compressor Bypass Actuator 1 drive circuitry. Temperature excursions may affect the torque output.";
CM_ SG_ 3221225472 EngTrbCmprssrBlwffActtr1TmpSttus "Used to identify the status of the Engine Turbocharger Compresssor Blowoff Actuator 1 drive circuitry temperature. Temperature excursions may affect the torque output.
000 - High Most severe
001 - High Least severe
010 - In Range
011 - Low Least ...";
CM_ SG_ 3221225472 EngTrbCmprssrBlwffActtr1PrlmnryF "Used to identify the applicable J1939-73 FMI detected in the Engine Turbocharger Blowoff Actuator 1 by the manufacturer's software. When there is no failure FMI 31 is transmitted. When there are multiple failures, the most severe is transmitted.";
CM_ SG_ 3221225472 PersistentLimitStatus "Reports the tractor ECU's present limit status associated with a parameter whose commands are presistent  (i.e. hitch position).
000 - Not limited
001 - Operator limited/controlled (Request cannot be implemented)
010 - Limited high (only lower ...";
CM_ SG_ 3221225472 MachineSelectedSpeedSource "Indicates the speed source that is currently being reported in the machine speed parameter.
000 - Wheel-based speed
001 - Ground-based speed
010 - Navigation-based speed
011 - 'Blended' speed
100 - 'Simulated' speed
101 - 110 - Reserved
111 - ...";
CM_ SG_ 3221225472 MachineSelectedDirection "Indicates the current direction of travel of the machine.

00 - Reverse
01 - Forward
10 - Error indication
11 - Not available";
CM_ SG_ 3221225472 MachineSelectedDistance "Actual distance traveled by the machine based on the value of selected machine speed.  When distance exceeds 4211081.215 m, the value should be reset to zero and incremented as additional distance accrues.";
CM_ SG_ 3221225472 MachineSelectedSpeed "Reports the value of one of the currently available machine speeds (wheel, ground, or navigational-based) which the machine has determined to best represent the machine's speed.";
CM_ SG_ 3221225472 GeneratorGoverningBias "Control signal used to govern the genset's speed or load (depending on isochronous or utility parallel operation, respectively)
NOTE:  If this method of engine control is used, the PGN 0 (TSC1) is not expected to be received by the engine ...";
CM_ SG_ 3221225472 AccelPedal2Channel3 "Sensor output 3 for the accelerator pedal #2 position when using a redundant-style sensor.  The ratio of actual accelerator pedal position to maximum pedal position. This is for the second occurrence of the accelerator pedal. Although it is used as ...";
CM_ SG_ 3221225472 AccelPedal2Channel2 "Sensor output 2 for the accelerator pedal #2 position when using a redundant-style sensor.  The ratio of actual accelerator pedal position to maximum pedal position. This is for the second occurrence of the accelerator pedal. Although it is used as ...";
CM_ SG_ 3221225472 AccelPedal1Channel3 "Sensor output 3 for the accelerator pedal #1 position when using a redundant-style sensor.  The ratio of actual accelerator pedal position to maximum pedal position. This is for the first occurrence of the accelerator pedal. Although it is used as ...";
CM_ SG_ 3221225472 AccelPedal1Channel2 "Sensor output 2 for the accelerator pedal #1 position when using a redundant-style sensor.  The ratio of actual accelerator pedal position to maximum pedal position. This is for the first occurrence of the accelerator pedal. Although it is used as ...";
CM_ SG_ 3221225472 DesiredEngFuelingState "Devices send this request to the engine controller to:
(a) Shut off engine fueling, but remain prepared to re-start quickly by not shutting down the control system, or
(b) Keep the engine running.
00 Fueling not desired (shut off engine fueling)
 ...";
CM_ SG_ 3221225472 RequestedFuelType "Engine controller receives this request from another control module to select the type of fuel to be used for engine operation.
0x00 - Not available - NONE
0x01 - Gasoline/petrol - GAS
0x02 - Methanol - METH
0x03 - Ethanol - ETH
0x04 - Diesel - ...";
CM_ SG_ 3221225472 EngGasFuelSupplyDesiredPress "Desired gage pressure of gaseous fuel supply to the engine.";
CM_ SG_ 3221225472 EngGasFuelUsageInhibited "Used to request that the engine should not be allowed to use gaseous fuel for engine cylinder combustion. This state is relevant for dual fuel systems and would be used when conditions are detected that make it unsafe or not appropriate to use ...";
CM_ SG_ 3221225472 AEBS2MessageChecksum "Used to check the message checksum of the transmitting (HMI) unit within the AEBS2 system.
Checksum = (Byte1 + Byte2 + Byte3 + Byte4 + Byte5 + Byte6 + Byte7 + (message counter & 0x0F) + message ID low byte + message ID mid low byte + message ID mid ...";
CM_ SG_ 3221225472 AEBS2MessageCounter "The message counter is increased with every transmitted AEBS2 message.  After reaching a value of 0xF the next value will be 0.";
CM_ SG_ 3221225472 DrvrActvtnDmndFrAdvncdEmrgncyBrk "According to the Vienna world convention on road traffic the driver must be provided with means to deactivate an Advanced Emergency Braking System. This command is to be transmitted from the respective HMI unit to the AEBS unit.
00 - the driver ...";
CM_ SG_ 3221225472 ProcessVariableValue "This 4 byte parameter contains the actual data  for the Process Data Message.";
CM_ SG_ 3221225472 CountNumber "This parameter indicates which member of the set of possible entities is being referenced. The means of generating this Count Number is explained in the following clause.";
CM_ SG_ 3221225472 ValveFailSafeMode "Command for setting the fail safe mode of a general purpose valve.

00 Block
01 Float
10 Reserved
11 Don't Care";
CM_ SG_ 3221225472 ValveState "The measured state of the general purpose valve.   With float enabled, hydraulic fluid may flow to or from the tractor as driven by the implement.
0000            Blocked
0001            Extend
0010            Retract
0011            Floating
 ...";
CM_ SG_ 3221225472 RetractPortEstFlow "The value reported by the controller of flow through the extend port of an auxiliary valve of a tractor";
CM_ SG_ 3221225472 ExtendPortEstFlow "The value reported by the controller of flow through the extend port of an auxiliary valve of a tractor";
CM_ SG_ 3221225472 ReturnPortPress "The measured nominal pressure at the return port of an auxiliary valve of a tractor";
CM_ SG_ 3221225472 RetractPortPress "The measured nominal pressure at the retract port of an auxiliary valve of a tractor";
CM_ SG_ 3221225472 ExtendPortPress "The measured nominal pressure at the extend port of an auxiliary valve of a tractor";
CM_ SG_ 3221225472 RetractPortMeasuredFlow "The measured flow through the retract port of an auxiliary valve of a tractor";
CM_ SG_ 3221225472 ExtendPortMeasuredFlow "The measured flow through the extend port of an auxiliary valve of a tractor";
CM_ SG_ 3221225472 PortFlowCmd "The command to set the flow through the extend or retract port of an auxiliary valve of a tractor";
CM_ SG_ 3221225472 SwitchedPowerOutput18Cmd "Desired state of Switched Power Output #18. Used to set the desired state.

00 - Output off
01 - Output on
10 - Reserved
11 - Take no action";
CM_ SG_ 3221225472 SwitchedPowerOutput19Cmd "Desired state of Switched Power Output #19. Used to set the desired state.

00 - Output off
01 - Output on
10 - Reserved
11 - Take no action";
CM_ SG_ 3221225472 SwitchedPowerOutput20Cmd "Desired state of Switched Power Output #20. Used to set the desired state.

00 - Output off
01 - Output on
10 - Reserved
11 - Take no action";
CM_ SG_ 3221225472 SwitchedPowerOutput13Cmd "Desired state of Switched Power Output #13. Used to set the desired state.

00 - Output off
01 - Output on
10 - Reserved
11 - Take no action";
CM_ SG_ 3221225472 SwitchedPowerOutput14Cmd "Desired state of Switched Power Output #14. Used to set the desired state.

00 - Output off
01 - Output on
10 - Reserved
11 - Take no action";
CM_ SG_ 3221225472 SwitchedPowerOutput15Cmd "Desired state of Switched Power Output #15. Used to set the desired state.

00 - Output off
01 - Output on
10 - Reserved
11 - Take no action";
CM_ SG_ 3221225472 SwitchedPowerOutput16Cmd "Desired state of Switched Power Output #16. Used to set the desired state.

00 - Output off
01 - Output on
10 - Reserved
11 - Take no action";
CM_ SG_ 3221225472 SwitchedPowerOutput9Cmd "Desired state of Switched Power Output #9. Used to set the desired state.

00 - Output off
01 - Output on
10 - Reserved
11 - Take no action";
CM_ SG_ 3221225472 SwitchedPowerOutput10Cmd "Desired state of Switched Power Output #10. Used to set the desired state.

00 - Output off
01 - Output on
10 - Reserved
11 - Take no action";
CM_ SG_ 3221225472 SwitchedPowerOutput29Cmd "Desired state of Switched Power Output #29. Used to set the desired state.

00 - Output off
01 - Output on
10 - Reserved
11 - Take no action";
CM_ SG_ 3221225472 SwitchedPowerOutput30Cmd "Desired state of Switched Power Output #30. Used to set the desired state.

00 - Output off
01 - Output on
10 - Reserved
11 - Take no action";
CM_ SG_ 3221225472 SwitchedPowerOutput31Cmd "Desired state of Switched Power Output #31. Used to set the desired state.

00 - Output off
01 - Output on
10 - Reserved
11 - Take no action";
CM_ SG_ 3221225472 SwitchedPowerOutput32Cmd "Desired state of Switched Power Output #32. Used to set the desired state.

00 - Output off
01 - Output on
10 - Reserved
11 - Take no action";
CM_ SG_ 3221225472 SwitchedPowerOutput25Cmd "Desired state of Switched Power Output #25. Used to set the desired state.

00 - Output off
01 - Output on
10 - Reserved
11 - Take no action";
CM_ SG_ 3221225472 SwitchedPowerOutput26Cmd "Desired state of Switched Power Output #26. Used to set the desired state.

00 - Output off
01 - Output on
10 - Reserved
11 - Take no action";
CM_ SG_ 3221225472 SwitchedPowerOutput27Cmd "Desired state of Switched Power Output #27. Used to set the desired state.

00 - Output off
01 - Output on
10 - Reserved
11 - Take no action";
CM_ SG_ 3221225472 SwitchedPowerOutput28Cmd "Desired state of Switched Power Output #28. Used to set the desired state.

00 - Output off
01 - Output on
10 - Reserved
11 - Take no action";
CM_ SG_ 3221225472 SwitchedPowerOutput21Cmd "Desired state of Switched Power Output #21. Used to set the desired state.

00 - Output off
01 - Output on
10 - Reserved
11 - Take no action";
CM_ SG_ 3221225472 SwitchedPowerOutput22Cmd "Desired state of Switched Power Output #22. Used to set the desired state.

00 - Output off
01 - Output on
10 - Reserved
11 - Take no action";
CM_ SG_ 3221225472 SwitchedPowerOutput23Cmd "Desired state of Switched Power Output #23. Used to set the desired state.

00 - Output off
01 - Output on
10 - Reserved
11 - Take no action";
CM_ SG_ 3221225472 SwitchedPowerOutput24Cmd "Desired state of Switched Power Output #24. Used to set the desired state.

00 - Output off
01 - Output on
10 - Reserved
11 - Take no action";
CM_ SG_ 3221225472 SwitchedPowerOutput17Cmd "Desired state of Switched Power Output #17. Used to set the desired state.

00 - Output off
01 - Output on
10 - Reserved
11 - Take no action";
CM_ SG_ 3221225472 SwitchedPowerOutput11Cmd "Desired state of Switched Power Output #11. Used to set the desired state.

00 - Output off
01 - Output on
10 - Reserved
11 - Take no action";
CM_ SG_ 3221225472 SwitchedPowerOutput12Cmd "Desired state of Switched Power Output #12. Used to set the desired state.

00 - Output off
01 - Output on
10 - Reserved
11 - Take no action";
CM_ SG_ 3221225472 SwitchedPowerOutput5Cmd "Desired state of Switched Power Output #5. Used to set the desired state.

00 - Output off
01 - Output on
10 - Reserved
11 - Take no action";
CM_ SG_ 3221225472 SwitchedPowerOutput6Cmd "Desired state of Switched Power Output #6. Used to set the desired state.

00 - Output off
01 - Output on
10 - Reserved
11 - Take no action";
CM_ SG_ 3221225472 SwitchedPowerOutput7Cmd "Desired state of Switched Power Output #7. Used to set the desired state.

00 - Output off
01 - Output on
10 - Reserved
11 - Take no action";
CM_ SG_ 3221225472 SwitchedPowerOutput8Cmd "Desired state of Switched Power Output #8. Used to set the desired state.

00 - Output off
01 - Output on
10 - Reserved
11 - Take no action";
CM_ SG_ 3221225472 SwitchedPowerOutput1Cmd "Desired state of Switched Power Output #1. Used to set the desired state.

00 - Output off
01 - Output on
10 - Reserved
11 - Take no action";
CM_ SG_ 3221225472 SwitchedPowerOutput2Cmd "Desired state of Switched Power Output #2. Used to set the desired state.

00 - Output off
01 - Output on
10 - Reserved
11 - Take no action";
CM_ SG_ 3221225472 SwitchedPowerOutput3Cmd "Desired state of Switched Power Output #3. Used to set the desired state.

00 - Output off
01 - Output on
10 - Reserved
11 - Take no action";
CM_ SG_ 3221225472 SwitchedPowerOutput4Cmd "Desired state of Switched Power Output #4. Used to set the desired state.

00 - Output off
01 - Output on
10 - Reserved
11 - Take no action";
CM_ SG_ 3221225472 TransMode10 "Indicates whether transmission mode 10 is enabled. Modes are manufacturer specific and are not necessarily mutually exclusive. See also SPN 6568. 

00 Disable
01 Enable
10 Reserved
11 Take no action";
CM_ SG_ 3221225472 TransMode9 "Indicates whether transmission mode 9 is enabled. Modes are manufacturer specific and are not necessarily mutually exclusive. See also SPN 6567. 

00 Disable
01 Enable
10 Reserved
11 Take no action";
CM_ SG_ 3221225472 AccelPedalPos3 "The ratio of actual position of the third analog engine speed/torque request input device (such as an accelerator pedal or throttle lever) to the maximum position of the input device.  This parameter is intended for the third accelerator control in ...";
CM_ SG_ 3221225472 EngFuelIsolationCtrl "Control setting for fuel isolation. In a single injector dual fuel system when using just diesel fuel, diesel must not be allowed to migrate into the gaseous fuel system. When the fuel isolation valve is closed the engine uses dual fuel by allowing ...";
CM_ SG_ 3221225472 FuelType "Type of fuel currently being utilized by the vehicle
Data Byte - Scaling - External Display
0x00 - Not available - NONE
0x01 - Gasoline/petrol - GAS
0x02 - Methanol - METH
0x03 - Ethanol - ETH
0x04 - Diesel - DSL
0x05 - Liquefied Petroleum ...";
CM_ SG_ 3221225472 EngFuelMassFlowRate "Mass of liquid fuel consumed by engine per unit of time.";
CM_ SG_ 3221225472 EngExhstGsRcrcltn1Valve2PosError "The position error of the Exhaust Gas Recirculation 1 valve 2, determined as the actual position (SPN 3821) minus the commanded position (SPN 3822).";
CM_ SG_ 3221225472 EngExhstGsRcrcltn1Valve1PosError "The position error of the Exhaust Gas Recirculation 1 valve, determined as the actual position (SPN 27) minus the commanded position (SPN 2791).";
CM_ SG_ 3221225472 AFT1ParticulateSnsrCur "Raw aftertreatment 1 PM sensor electical current reading.";
CM_ SG_ 3221225472 AFT2ParticulateSnsr "The particulate sensor measures the mass concentration of particulate matter in the exhaust downstream of the DPF in exhaust bank 2.";
CM_ SG_ 3221225472 AFT1ParticulateSnsr "The particulate sensor measures the mass concentration of particulate matter in the exhaust downstream of the DPF in exhaust bank 1.";
CM_ SG_ 3221225472 AFT2InNOxSnsrSelfDiagTrigger "Signal to trigger the self-diagnosis of NOx sensor ATI2 (Aftertreatment Intake Bank 2)
0000 Diagnostic mode disabled
0001 NOx Sensor ATI2 Self Diagnosis Request at Lambda=1.0
0010 NOx Sensor ATI2 Self Diagnosis Request at partial load
0011 NOx ...";
CM_ SG_ 3221225472 AFT2OutNOxSnsrSelfDiagTrigger "Signal to trigger the self-diagnosis of NOx sensor ATO2 (Aftertreatment Outlet Bank 2)
0000 Diagnostic mode disabled
0001 NOx Sensor ATO2 Self Diagnosis Request at Lambda=1.0
0010 NOx Sensor ATO2 Self Diagnosis Request at partial load
0011 NOx ...";
CM_ SG_ 3221225472 AFT1InNOxSnsrSelfDiagTrigger "Signal to trigger the self-diagnosis of NOx sensor ATI1 (Aftertreatment Intake Bank 1)
0000 Diagnostic mode disabled
0001 NOx Sensor ATI1 Self Diagnosis Request at Lambda=1.0
0010 NOx Sensor ATI1 Self Diagnosis Request at partial load
0011 NOx ...";
CM_ SG_ 3221225472 AFT1OutNOxSnsrSelfDiagTrigger "Signal to trigger the self-diagnosis of NOx sensor ATO1 (Aftertreatment Outlet Bank 1)
0000 Diagnostic mode disabled
0001 NOx Sensor ATO1 Self Diagnosis Request at Lambda=1.0
0010 NOx Sensor ATO1 Self Diagnosis Request at partial load
0011 NOx ...";
CM_ SG_ 3221225472 AFT2OutGasSnsrPwrSupply "State signal which indicates when the Aftertreatment 2 Outlet Gas Sensor driver output is being driven.  On means the ECU is powering the Aftertreatment 2 Intake Gas Sensor.  Note that the ECU is external to the sensor.
00 - Off
01 - On: The ECU ...";
CM_ SG_ 3221225472 AFT2InGasSnsrPwrSupply "State signal which indicates when the Aftertreatment 2 Intake Gas Sensor driver output is being driven.  On means the ECU is powering the Aftertreatment 2 Intake Gas Sensor.  Note that the ECU is external to the sensor.
00 - Off
01 - On: The ECU ...";
CM_ SG_ 3221225472 AFT1OutGasSnsrPwrSupply "State signal which indicates when the Aftertreatment 1 Outlet Gas Sensor driver output is being driven.  On means the ECU is powering the Aftertreatment 1 Intake Gas Sensor.  Note that the ECU is external to the sensor.
00 - Off
01 - On: The ECU ...";
CM_ SG_ 3221225472 AFT1InGasSnsrPwrSupply "State signal which indicates when the Aftertreatment 1 Intake Gas Sensor driver output is being driven.  On means the ECU is powering the Aftertreatment 1 Intake Gas Sensor.  Note that the ECU is external to the sensor.
00 - Off
01 - On: The ECU ...";
CM_ SG_ 3221225472 EngExhstGsRcrcltn1Acttr2PrlmnryF "Used to identify the applicable J1939-73 FMI detected in the Engine Exhaust Gas Recirculation 1 Actuator 2 by the manufacturer's software. When there is no failure FMI 31 is transmitted. When there are multiple failures, the most severe is ...";
CM_ SG_ 3221225472 EngExhstGsRcrcltn1Acttr2OprtnStt "Used to identify the status of Exhaust Gas Recirculation 1 Actuator 2
0000 - Normal
0001 - Alarm (fully operational but needs service)
0010 - Alarm High Severity (functional but transient performance may be reduced)
0011 - Derate Active (torque ...";
CM_ SG_ 3221225472 EngExhstGsRcrcltn1Acttr1OprtnStt "Used to identify the status of Exhaust Gas Recirculation 1 Actuator 1
0000 - Normal
0001 - Alarm (fully operational but needs service)
0010 - Alarm High Severity (functional but transient performance may be reduced)
0011 - Derate Active (torque ...";
CM_ SG_ 3221225472 EngExhstGsRcrcltn1Acttr2DsredPos "The requested position of the Engine Exhaust Gas Recirculation 1 Actuator 2 by the engine ECU, where 0% represents fully closed and 100% represents fully open.

This is the position that the device is attempting to achieve.";
CM_ SG_ 3221225472 EngExhstGsRcrclton1Actuator2Temp "Temperature of the Engine Exhaust Gas Recirculation 1 Actuator 2 drive circuitry.  Temperature excursions may affect the torque output.";
CM_ SG_ 3221225472 EngExhstGsRcrcltn1Acttr2TmpSttus "Used to identify the status of the Engine Exhaust Gas Recirculation 1 Actuator 2 drive circuitry temperature.  Temperature excursions may affect the torque output.
000 - High Most severe
001 - High Least severe
010 - In Range
011 - Low Least ...";
CM_ SG_ 3221225472 EngExhstGsRcrcltn1Acttr1DsredPos "The requested position of the Engine Exhaust Gas Recirculation 1 Actuator 1 by the engine ECU, where 0% represents fully closed and 100% represents fully open.

This is the position that the device is attempting to achieve.";
CM_ SG_ 3221225472 EngExhstGsRcrclton1Actuator1Temp "Temperature of the Engine Exhaust Gas Recirculation 1 Actuator 1 drive circuitry.  Temperature excursions may affect the torque output.";
CM_ SG_ 3221225472 EngExhstGsRcrcltn1Acttr1TmpSttus "Used to identify the status of the Engine Exhaust Gas Recirculation 1 Actuator 1 drive circuitry temperature.  Temperature excursions may affect the torque output.
000 - High Most severe
001 - High Least severe
010 - In Range
011 - Low Least ...";
CM_ SG_ 3221225472 EngExhstGsRcrcltn1Acttr1PrlmnryF "Used to identify the applicable J1939-73 FMI detected in the Engine Exhaust Gas Recirculation 1 Actuator 1 by the manufacturer's software. When there is no failure FMI 31 is transmitted. When there are multiple failures, the most severe is ...";
CM_ SG_ 3221225472 EngExhstGsRcrcltn2Acttr2OprtnStt "Used to identify the status of Exhaust Gas Recirculation 2 Actuator 2
0000 - Normal
0001 - Alarm (fully operational but needs service)
0010 - Alarm High Severity (functional but transient performance may be reduced)
0011 - Derate Active (torque ...";
CM_ SG_ 3221225472 EngExhstGsRcrcltn2Acttr1OprtnStt "Used to identify the status of Exhaust Gas Recirculation 2 Actuator 1
0000 - Normal
0001 - Alarm (fully operational but needs service)
0010 - Alarm High Severity (functional but transient performance may be reduced)
0011 - Derate Active (torque ...";
CM_ SG_ 3221225472 EngExhstGsRcrcltn2Acttr2DsredPos "The requested position of the Engine Exhaust Gas Recirculation 2 Actuator 2 by the engine ECU, where 0% represents fully closed and 100% represents fully open.

This is the position that the device is attempting to achieve.";
CM_ SG_ 3221225472 EngExhstGsRcrclton2Actuator2Temp "Temperature of the Engine Exhaust Gas Recirculation 2 Actuator 2 drive circuitry.  Temperature excursions may affect the torque output.";
CM_ SG_ 3221225472 EngExhstGsRcrcltn2Acttr2TmpSttus "Used to identify the status of the Engine Exhaust Gas Recirculation 2 Actuator 2 drive circuitry temperature.  Temperature excursions may affect the torque output.
000 - High Most severe
001 - High Least severe
010 - In Range
011 - Low Least ...";
CM_ SG_ 3221225472 EngExhstGsRcrcltn2Acttr2PrlmnryF "Used to identify the applicable J1939-73 FMI detected in the Engine Exhaust Gas Recirculation 2 Actuator 2 by the manufacturer's software. When there is no failure FMI 31 is transmitted. When there are multiple failures, the most severe is ...";
CM_ SG_ 3221225472 EngExhstGsRcrcltn2Acttr1DsredPos "The requested position of the Engine Exhaust Gas Recirculation 2 Actuator 1 by the engine ECU, where 0% represents fully closed and 100% represents fully open.

This is the position that the device is attempting to achieve.";
CM_ SG_ 3221225472 EngExhstGsRcrclton2Actuator1Temp "Temperature of the Engine Exhaust Gas Recirculation 2 Actuator 1 drive circuitry.  Temperature excursions may affect the torque output.";
CM_ SG_ 3221225472 EngExhstGsRcrcltn2Acttr1TmpSttus "Used to identify the status of the Engine Exhaust Gas Recirculation 2 Actuator 1 drive circuitry temperature.  Temperature excursions may affect the torque output.
000 - High Most severe
001 - High Least severe
010 - In Range
011 - Low Least ...";
CM_ SG_ 3221225472 EngExhstGsRcrcltn2Acttr1PrlmnryF "Used to identify the applicable J1939-73 FMI detected in the Engine Exhaust Gas Recirculation 2 Actuator 1 by the manufacturer's software. When there is no failure FMI 31 is transmitted. When there are multiple failures, the most severe is ...";
CM_ SG_ 3221225472 EngFuelRackFuelSupplyTemp "Temperature of fuel in the engine fuel rack.";
CM_ SG_ 3221225472 EngTurboWastegateActuator2Temp "Temperature of the Engine Turbocharger Wastegate Actuator 2 drive circuitry.  Temperature excursions may affect the torque output.";
CM_ SG_ 3221225472 EngFuelValve2Temp "Temperature of the Engine Fuel Valve 2 drive circuitry. Temperature excursions may affect the torque output.";
CM_ SG_ 3221225472 EngFuelValve1Temp "Temperature of the Engine Fuel Valve 1 drive circuitry. Temperature excursions may affect the torque output.";
CM_ SG_ 3221225472 EngThrottleValve2Temp "Temperature of the engine throttle valve 2 drive circuitry (SPN 3673).  Temperature excursions may affect the torque output.";
CM_ SG_ 3221225472 EngThrottleValve1Temp "Temperature of the engine throttle valve 1 drive circuitry (SPN 51).  Temperature excursions may affect the torque output.";
CM_ SG_ 3221225472 EngFuelingDesiredRqCount "A signal issued by the engine control system indicating the number of devices from which the engine control system has received a 'fueling desired' request. Requests included in this count are either from an external device via SPN 5793 Desired ...";
CM_ SG_ 3221225472 EngFuelingInhibitRqCount "A signal issued by the engine control system indicating the number of devices from which the engine control system has received a 'fueling not desired' request. Requests included in this count are either from an external device via SPN 5793 Desired ...";
CM_ SG_ 3221225472 EngGasSubstitutionFuelPercentage "Percentage of Gaseous fuel used. 0% means no Gaseous fuel used and 100% means completely gaseous fuel is used.
Gas substitution is the process for a dual fuel engine system of substituting gas, e.g. natural gas, for some fraction of the primary ...";
CM_ SG_ 3221225472 EngDualFuelMode "Actual dual fuel mode, off or on.

00 = Actual dual fuel mode off
01 = Actual dual fuel mode on
10 = Reserved
11 = Not available";
CM_ SG_ 3221225472 SrcAddrssOfCntrllngDvcFrFlngStte "The J1939 source address of the device currently controlling the fueling state via SPN 5793.
254 (0xFE) is used to indicate that the Source Address of Controlling Device for Fueling State parameter is supported, but no device is currently ...";
CM_ SG_ 3221225472 EngFuelingInhibitPreventedReason "If Engine Fueling Inhibit Allowed (SPN 5795) indicates that the engine will not inhibit fueling, then this parameter will indicate the reason.
If more than one reason exists at the same time, then it is up to the manufacturer to decide which one to ...";
CM_ SG_ 3221225472 EngFuelingInhibitAllowed "This parameter is broadcast by the engine control system, and indicates to other devices on the network whether or not it will respond to requests to inhibit engine fueling via SPN 5793 Desired Engine Fueling State. With this information, devices ...";
CM_ SG_ 3221225472 FeedbackEngFuelingState "This parameter provides feedback to the network that SPN 5793 Desired Engine Fueling State was honored. SPN 5795 Engine Fueling Inhibit Allowed indicates the engine's current ability to honor requests via SPN 5793 Desired Engine Fueling State.
00 = ...";
CM_ SG_ 3221225472 IntmdTempPreliminaryFMI "Used to identify the applicable J1939-73 FMI detected in the aftertreatment SCR intermediate temperature sensor by the manufacturer's sensor control software in exhaust bank 1. When there is no failure FMI 31 is sent. In the case of multiple ...";
CM_ SG_ 3221225472 IntmdTemp "Temperature of engine combustion byproducts at an intermediate point in the SCR component in exhaust bank 1.";
CM_ SG_ 3221225472 IntmdTempPreliminaryFMI "Used to identify the applicable J1939-73 FMI detected in the aftertreatment SCR intermediate temperature sensor by the manufacturer's sensor control software in exhaust bank 2. When there is no failure FMI 31 is sent. In the case of multiple ...";
CM_ SG_ 3221225472 IntmdTemp "Temperature of engine combustion byproducts at an intermediate point in the SCR component in exhaust bank 2.";
CM_ SG_ 3221225472 SupplyGasMethanePercentage "The percentage of methane in the gas supplied to the engine.";
CM_ SG_ 3221225472 EngAssistStatus "Provides the engine an indication of when the hybrid system is not mechanically assisting rotation (i.e. not motoring) the engine. When this parameter is in state 00, the engine can perform operations while free of potential hybrid system ...";
CM_ SG_ 3221225472 HybrdSystmHghVltgExpsreIndicator "This signal indicates the condition and state of the hybrid system high voltage exposure detection system (e.g. High
Voltage Interlock Loop [HVIL]). The high voltage exposure detection system is used to detect situations on a hybrid
vehicle where ...";
CM_ SG_ 3221225472 HybrdSystmIntializationIndicator "Signal from the hybrid system that indicates when it is initialized and ready to start the engine or other power source (e.g. fuel cell). The intent is that this would drive an indicator for the vehicle operator. If the operator attempts to start ...";
CM_ SG_ 3221225472 HybrdSystmRgnrtvBrakingIndicator "Signal from the hybrid system indicating when regenerative braking is active.

00 - Regenerative braking is inactive
01 - Regenerative braking is active
10 - Regenerative braking is disabled or faulted 
11 - Not Available";
CM_ SG_ 3221225472 HybridSystemElectricAltIndicator "Signal from the hybrid system indicating that the electric alternator is failed or needs servicing.  The alternator Indicator (e.g. dash lamp) is to be activated.
00 - Alternator Indicator is off
01 - Alternator Indicator is on
10 - Alternator ...";
CM_ SG_ 3221225472 HybrdSystmMtrOvrspedAudibleAlarm "Signal from the hybrid system indicating that the overspeed audible alarm should be activated.

00 - Motor Overspeed Audible Alarm is off
01 - Motor Overspeed Audible Alarm is on
10 - Error
11 - Not Available";
CM_ SG_ 3221225472 HybrdSystmMtorOverspeedIndicator "Signal from the hybrid system indicating that the hybrid system motor is exceeding maximum speed limit.
00 - Hybrid System Motor Overspeed Indicator is off
01 - Hybrid System Motor Overspeed Indicator is on continously
10 - Hybrid System Motor ...";
CM_ SG_ 3221225472 HybridSystemServiceIndicator "Signal from the hybrid system indicating that the hybrid system or one of its components requires servicing (e.g. oil change, coolant change).
00 - Hybrid Service Indicator is off
01 - Hybrid Service Indicator is on continously
10 - Hybrid ...";
CM_ SG_ 3221225472 PropulsionSystemActive "Indicates when the hybrid system is ready to provide or is actively providing propulsion as defined in ARB regulation 13CCR1971.1, which includes the amendments up to the Board hearing date of August 2012. This parameter is called out by the 1971.1 ...";
CM_ SG_ 3221225472 HybridSystemOBDRelatedDTCStatus "Signal from hybrid system indicating the status of OBD related DTCs
00 - Hybrid System does not have an active OBD related DTC
01 - Hybrid System has an active OBD related DTC
10 - SAE Reserved
11 - Not available
See 'SPN 6810' in the ...";
CM_ SG_ 3221225472 HybridSystemStopIndicator "Signal from a hybrid system indicating that some aspect of its operation is not functioning correctly, and as a result, the vehicle must be stopped. The indicator is typically a lamp. Distinctions in meaning between the continuous and flashing ...";
CM_ SG_ 3221225472 HybridSystemOverheatIndicator "Signal from a hybrid system indicating that at least one of its monitored temperatures is above normal acceptable limits, and as a result, hybrid system operation may be altered or restricted. The indicator is typically a lamp. Distinctions in ...";
CM_ SG_ 3221225472 HybridSystemWarningIndicator "Signal from a hybrid system indicating that some aspect of its operation is not functioning correctly, and as a result, hybrid system operation may be altered or restricted. The indicator is typically a lamp. Distinctions in meaning between the ...";
CM_ SG_ 3221225472 IntmdNH3SnsrHtrCtrl "Indicates the heater status in the warm-up process. Upon receiving a power-up command, the NH3 sensor ramps up according to a manufacturer defined profile. The Preheat 1, Preheat 2, and Automatic messages are regions within this profile in exhaust ...";
CM_ SG_ 3221225472 IntmdNH3SnsrHtrPreliminaryFMI "Used to identify the applicable J1939-73 FMI detected in the heater of the SCR intermediate NH3 exhaust sensor by the manufacturer's sensor control software in exhaust bank 2. When there is no failure FMI 31 is sent. In the case of multiple failures ...";
CM_ SG_ 3221225472 IntmdNH3SnsrAtTemp "Indicates that the heater element of the aftertreatment SCR intermediate NH3 sensor is within the manufacturer's specified range for accurate measurements in exhaust bank 2.
00 - Heater element is not in range
01 - Heater element is in range
10 - ...";
CM_ SG_ 3221225472 IntmdNH3SnsrPwrInRange "Indicates that the power supplied to the aftertreatment SCR intermediate NH3 sensor is within the manufacturer's specification in exhaust bank 2.

00 - Heater element is not in range
01 - Heater element is in range
10 - Error
11 - Not available";
CM_ SG_ 3221225472 IntmdNH3ReadingStable "Indicates that the NH3 reading of the aftertreatment SCR intermediate NH3 sensor is stable as determined by the manufacturer's control software in exhaust bank 2.

00 - Reading is not stable
01 - Reading is stable
10 - Error
11 - Not available";
CM_ SG_ 3221225472 IntmdNH3SnsrPreliminaryFMI "Used to identify the applicable J1939-73 FMI detected in the aftertreatment SCR intermediate NH3 sensor by the manufacturer's sensor control software in exhaust bank 2. When there is no failure FMI 31 is sent. In the case of multiple failures the ...";
CM_ SG_ 3221225472 IntmdNH3 "The amount of NH3 in the exhaust aftertreatment system measured by a NH3 sensor at an intermediate point in the SCR system, represented in NH3 molecule parts per million non-NH3 molecules in exhaust bank 2.";
CM_ SG_ 3221225472 IntmdNH3SnsrHtrCtrl "Indicates the heater status in the warm-up process. Upon receiving a power-up command, the NH3 sensor ramps up according to a manufacturer defined profile. The Preheat 1, Preheat 2, and Automatic messages are regions within this profile in exhaust ...";
CM_ SG_ 3221225472 IntmdNH3SnsrHtrPreliminaryFMI "Used to identify the applicable J1939-73 FMI detected in the heater of the outlet NH3 exhaust sensor by the manufacturer's sensor control software in exhaust bank 1. When there is no failure FMI 31 is sent. In the case of multiple failures the most ...";
CM_ SG_ 3221225472 IntmdNH3SnsrAtTemp "Indicates that the heater element of the aftertreatment SCR intermediate NH3 sensor is within the manufacturer's specified range for accurate measurements in exhaust bank 1.
00 - Heater element is not in range
01 - Heater element is in range
10 - ...";
CM_ SG_ 3221225472 IntmdNH3SnsrPwrInRange "Indicates that the power supplied to the aftertreatment SCR intermediate NH3 sensor is within the manufacturer's specification in exhaust bank 1.

00 - Power is not in range
01 - Power is in range
10 - Error
11 - Not available";
CM_ SG_ 3221225472 IntmdNH3ReadingStable "Indicates that the NH3 reading of the aftertreatment SCR intermediate NH3 sensor is stable as determined by the manufacturer's control software in exhaust bank 1.

00 - Reading is not stable
01 - Reading is stable
10 - Error
11 - Not available";
CM_ SG_ 3221225472 IntmdNH3SnsrPreliminaryFMI "Used to identify the applicable J1939-73 FMI detected in the aftertreatment SCR intermediate NH3 sensor by the manufacturer's sensor control software in exhaust bank 1. When there is no failure FMI 31 is sent. In the case of multiple failures the ...";
CM_ SG_ 3221225472 IntmdNH3 "The amount of NH3 in the exhaust aftertreatment system measured by a NH3 sensor at an intermediate point in the SCR system, represented in NH3 molecule parts per million non-NH3 molecules in exhaust bank 1.";
CM_ SG_ 3221225472 LnrDsplcmntSnsrSnsrFigureOfMerit "Figure of Merit sensor status of Linear Displacement Sensor.

00    Sensor fully functional
01    Sensor degraded
10    Sensor failed
11    Sensor not available";
CM_ SG_ 3221225472 MeasuredLinearDisplacement "Distance to target as measured by the Linear Displacement Sensor.";
CM_ SG_ 3221225472 WandSensorFigureOfMerit "Figure of Merit sensor status for a wand sensor.

00    Sensor fully functional
01    Sensor degraded
10    Sensor failed
11    Sensor not available";
CM_ SG_ 3221225472 WandAngle "A wand sensor measures the angle of deflection of a wand from its null position. This parameter reports the measured angle of a wand sensor.";
CM_ SG_ 3221225472 WirelessSignalStrength1 "The absolute received signal strength of the signal received from the off-board transmitter. The signal strength is reported as a Received Signal Strength Indicator (RSSI) value calculated in dBm.";
CM_ SG_ 3221225472 TransmitterID1 "The ID of the off-board transmitter that sent the incoming message received by the wireless transceiver.";
CM_ SG_ 3221225472 TransmitterCmdState "The command contained in the signal received by the wireless transceiver from an off-board transmitter.
0000b - Stop
0001b - Clear
0010b - Field Test
0011b - Transmitter Test
0100b - Standby
0101b to 1101b - Reserved
1110b - Error
1111b - ...";
BA_DEF_ SG_  "SigType" ENUM  "Default","Range","RangeSigned","ASCII","Discrete","Control","ReferencePGN","DTC","StringDelimiter","StringLength","StringLengthControl","MessageCounter","MessageChecksum";
BA_DEF_ SG_  "GenSigStartValue" INT 0 2147483647;
BA_DEF_ SG_  "GenSigSendType" ENUM  "Cyclic","OnWrite","OnWriteWithRepetition","OnChange","OnChangeWithRepetition","IfActive","IfActiveWithRepetition","NoSigSendType";
BA_DEF_ SG_  "GenSigILSupport" ENUM  "No","Yes";
BA_DEF_ SG_  "GenSigEVName" STRING ;
BA_DEF_ SG_  "SPN" INT 0 524287;
BA_DEF_ BO_  "TpJ1939VarDlc" ENUM  "No","Yes";
BA_DEF_ BO_  "GenMsgILSupport" ENUM  "No","Yes";
BA_DEF_ BO_  "GenMsgRequestable" INT 0 1;
BA_DEF_ BO_  "GenMsgSendType" ENUM  "cyclic","NotUsed","NotUsed","NotUsed","NotUsed","NotUsed","NotUsed","IfActive","noMsgSendType";
BA_DEF_ BO_  "VFrameFormat" ENUM  "StandardCAN","ExtendedCAN","reserved","J1939PG";
BA_DEF_ SG_  "SystemSignalLongSymbol" STRING ;
BA_DEF_DEF_  "SigType" "Default";
BA_DEF_DEF_  "GenSigStartValue" 0;
BA_DEF_DEF_  "GenSigSendType" "NoSigSendType";
BA_DEF_DEF_  "GenSigILSupport" "Yes";
BA_DEF_DEF_  "GenSigEVName" "Env@Nodename_@Signame";
BA_DEF_DEF_  "SPN" 0;
BA_DEF_DEF_  "TpJ1939VarDlc" "No";
BA_DEF_DEF_  "GenMsgILSupport" "Yes";
BA_DEF_DEF_  "GenMsgRequestable" 1;
BA_DEF_DEF_  "GenMsgSendType" "noMsgSendType";
BA_DEF_DEF_  "VFrameFormat" "J1939PG";
BA_DEF_DEF_  "SystemSignalLongSymbol" "";
BA_ "SPN" SG_ 3221225472 EngExhaustDesiredNOx 6580;
BA_ "SigType" SG_ 3221225472 EngExhaustDesiredNOx 1;
BA_ "SPN" SG_ 3221225472 EngExhaustNOx 6579;
BA_ "SigType" SG_ 3221225472 EngExhaustNOx 1;
BA_ "SPN" SG_ 3221225472 GasFuelAccumulatorTemp 6815;
BA_ "SigType" SG_ 3221225472 GasFuelAccumulatorTemp 1;
BA_ "SPN" SG_ 3221225472 EngFuelVaporizer1DischargeTemp 6610;
BA_ "SigType" SG_ 3221225472 EngFuelVaporizer1DischargeTemp 1;
BA_ "SPN" SG_ 3221225472 EngGasFuelSupplyPress 6646;
BA_ "SigType" SG_ 3221225472 EngGasFuelSupplyPress 1;
BA_ "SPN" SG_ 3221225472 ProductIdentificationModel 6701;
BA_ "SigType" SG_ 3221225472 ProductIdentificationModel 8;
BA_ "SPN" SG_ 3221225472 ProductIdentificationBrand 6700;
BA_ "SigType" SG_ 3221225472 ProductIdentificationBrand 8;
BA_ "SPN" SG_ 3221225472 ProductIdentificationCode 6699;
BA_ "SigType" SG_ 3221225472 ProductIdentificationCode 8;
BA_ "SPN" SG_ 3221225472 EngGsFlVlve20StartOfActuationCmd 6697;
BA_ "SigType" SG_ 3221225472 EngGsFlVlve20StartOfActuationCmd 1;
BA_ "SPN" SG_ 3221225472 EngGsFlVlve19StartOfActuationCmd 6696;
BA_ "SigType" SG_ 3221225472 EngGsFlVlve19StartOfActuationCmd 1;
BA_ "SPN" SG_ 3221225472 EngGsFlVlve18StartOfActuationCmd 6695;
BA_ "SigType" SG_ 3221225472 EngGsFlVlve18StartOfActuationCmd 1;
BA_ "SPN" SG_ 3221225472 EngGsFlVlve17StartOfActuationCmd 6694;
BA_ "SigType" SG_ 3221225472 EngGsFlVlve17StartOfActuationCmd 1;
BA_ "SPN" SG_ 3221225472 EngGsFlVlve16StartOfActuationCmd 6693;
BA_ "SigType" SG_ 3221225472 EngGsFlVlve16StartOfActuationCmd 1;
BA_ "SPN" SG_ 3221225472 EngGsFlVlve15StartOfActuationCmd 6692;
BA_ "SigType" SG_ 3221225472 EngGsFlVlve15StartOfActuationCmd 1;
BA_ "SPN" SG_ 3221225472 EngGsFlVlve14StartOfActuationCmd 6691;
BA_ "SigType" SG_ 3221225472 EngGsFlVlve14StartOfActuationCmd 1;
BA_ "SPN" SG_ 3221225472 EngGsFlVlve13StartOfActuationCmd 6690;
BA_ "SigType" SG_ 3221225472 EngGsFlVlve13StartOfActuationCmd 1;
BA_ "SPN" SG_ 3221225472 EngGsFlVlve12StartOfActuationCmd 6689;
BA_ "SigType" SG_ 3221225472 EngGsFlVlve12StartOfActuationCmd 1;
BA_ "SPN" SG_ 3221225472 EngGsFlVlve11StartOfActuationCmd 6688;
BA_ "SigType" SG_ 3221225472 EngGsFlVlve11StartOfActuationCmd 1;
BA_ "SPN" SG_ 3221225472 EngGsFlVlve10StartOfActuationCmd 6687;
BA_ "SigType" SG_ 3221225472 EngGsFlVlve10StartOfActuationCmd 1;
BA_ "SPN" SG_ 3221225472 EngGsFlValve9StartOfActuationCmd 6686;
BA_ "SigType" SG_ 3221225472 EngGsFlValve9StartOfActuationCmd 1;
BA_ "SPN" SG_ 3221225472 EngGsFlValve8StartOfActuationCmd 6685;
BA_ "SigType" SG_ 3221225472 EngGsFlValve8StartOfActuationCmd 1;
BA_ "SPN" SG_ 3221225472 EngGsFlValve7StartOfActuationCmd 6684;
BA_ "SigType" SG_ 3221225472 EngGsFlValve7StartOfActuationCmd 1;
BA_ "SPN" SG_ 3221225472 EngGsFlValve6StartOfActuationCmd 6683;
BA_ "SigType" SG_ 3221225472 EngGsFlValve6StartOfActuationCmd 1;
BA_ "SPN" SG_ 3221225472 EngGsFlValve5StartOfActuationCmd 6682;
BA_ "SigType" SG_ 3221225472 EngGsFlValve5StartOfActuationCmd 1;
BA_ "SPN" SG_ 3221225472 EngGsFlValve4StartOfActuationCmd 6681;
BA_ "SigType" SG_ 3221225472 EngGsFlValve4StartOfActuationCmd 1;
BA_ "SPN" SG_ 3221225472 EngGsFlValve3StartOfActuationCmd 6680;
BA_ "SigType" SG_ 3221225472 EngGsFlValve3StartOfActuationCmd 1;
BA_ "SPN" SG_ 3221225472 EngGsFlValve2StartOfActuationCmd 6679;
BA_ "SigType" SG_ 3221225472 EngGsFlValve2StartOfActuationCmd 1;
BA_ "SPN" SG_ 3221225472 EngGsFlValve1StartOfActuationCmd 6678;
BA_ "SigType" SG_ 3221225472 EngGsFlValve1StartOfActuationCmd 1;
BA_ "SPN" SG_ 3221225472 EngGasFuelValve20DurationCmd 6677;
BA_ "SigType" SG_ 3221225472 EngGasFuelValve20DurationCmd 1;
BA_ "SPN" SG_ 3221225472 EngGasFuelValve19DurationCmd 6676;
BA_ "SigType" SG_ 3221225472 EngGasFuelValve19DurationCmd 1;
BA_ "SPN" SG_ 3221225472 EngGasFuelValve18DurationCmd 6675;
BA_ "SigType" SG_ 3221225472 EngGasFuelValve18DurationCmd 1;
BA_ "SPN" SG_ 3221225472 EngGasFuelValve17DurationCmd 6674;
BA_ "SigType" SG_ 3221225472 EngGasFuelValve17DurationCmd 1;
BA_ "SPN" SG_ 3221225472 EngGasFuelValve16DurationCmd 6673;
BA_ "SigType" SG_ 3221225472 EngGasFuelValve16DurationCmd 1;
BA_ "SPN" SG_ 3221225472 EngGasFuelValve15DurationCmd 6672;
BA_ "SigType" SG_ 3221225472 EngGasFuelValve15DurationCmd 1;
BA_ "SPN" SG_ 3221225472 EngGasFuelValve14DurationCmd 6671;
BA_ "SigType" SG_ 3221225472 EngGasFuelValve14DurationCmd 1;
BA_ "SPN" SG_ 3221225472 EngGasFuelValve13DurationCmd 6670;
BA_ "SigType" SG_ 3221225472 EngGasFuelValve13DurationCmd 1;
BA_ "SPN" SG_ 3221225472 EngGasFuelValve12DurationCmd 6669;
BA_ "SigType" SG_ 3221225472 EngGasFuelValve12DurationCmd 1;
BA_ "SPN" SG_ 3221225472 EngGasFuelValve11DurationCmd 6668;
BA_ "SigType" SG_ 3221225472 EngGasFuelValve11DurationCmd 1;
BA_ "SPN" SG_ 3221225472 EngGasFuelValve10DurationCmd 6667;
BA_ "SigType" SG_ 3221225472 EngGasFuelValve10DurationCmd 1;
BA_ "SPN" SG_ 3221225472 EngGasFuelValve9DurationCmd 6666;
BA_ "SigType" SG_ 3221225472 EngGasFuelValve9DurationCmd 1;
BA_ "SPN" SG_ 3221225472 EngGasFuelValve8DurationCmd 6665;
BA_ "SigType" SG_ 3221225472 EngGasFuelValve8DurationCmd 1;
BA_ "SPN" SG_ 3221225472 EngGasFuelValve7DurationCmd 6664;
BA_ "SigType" SG_ 3221225472 EngGasFuelValve7DurationCmd 1;
BA_ "SPN" SG_ 3221225472 EngGasFuelValve6DurationCmd 6663;
BA_ "SigType" SG_ 3221225472 EngGasFuelValve6DurationCmd 1;
BA_ "SPN" SG_ 3221225472 EngGasFuelValve5DurationCmd 6662;
BA_ "SigType" SG_ 3221225472 EngGasFuelValve5DurationCmd 1;
BA_ "SPN" SG_ 3221225472 EngGasFuelValve4DurationCmd 6661;
BA_ "SigType" SG_ 3221225472 EngGasFuelValve4DurationCmd 1;
BA_ "SPN" SG_ 3221225472 EngGasFuelValve3DurationCmd 6660;
BA_ "SigType" SG_ 3221225472 EngGasFuelValve3DurationCmd 1;
BA_ "SPN" SG_ 3221225472 EngGasFuelValve2DurationCmd 6659;
BA_ "SigType" SG_ 3221225472 EngGasFuelValve2DurationCmd 1;
BA_ "SPN" SG_ 3221225472 EngGasFuelValve1DurationCmd 6658;
BA_ "SigType" SG_ 3221225472 EngGasFuelValve1DurationCmd 1;
BA_ "SPN" SG_ 3221225472 EngGsFlVlvNmnlStrtOfActuationCmd 6657;
BA_ "SigType" SG_ 3221225472 EngGsFlVlvNmnlStrtOfActuationCmd 1;
BA_ "SPN" SG_ 3221225472 EngGsFuelValveNominalDurationCmd 6656;
BA_ "SigType" SG_ 3221225472 EngGsFuelValveNominalDurationCmd 1;
BA_ "SPN" SG_ 3221225472 TransDirectionalOutputShaftSpeed 6585;
BA_ "SigType" SG_ 3221225472 TransDirectionalOutputShaftSpeed 1;
BA_ "SPN" SG_ 3221225472 TransHydrostaticLoop2Press 6584;
BA_ "SigType" SG_ 3221225472 TransHydrostaticLoop2Press 1;
BA_ "SPN" SG_ 3221225472 TransHydrostaticLoop1Press 6583;
BA_ "SigType" SG_ 3221225472 TransHydrostaticLoop1Press 1;
BA_ "SPN" SG_ 3221225472 EngCyl20AvrageCombustionDuration 6562;
BA_ "SigType" SG_ 3221225472 EngCyl20AvrageCombustionDuration 1;
BA_ "SPN" SG_ 3221225472 EngCyl20AvrgCntrOfCmbstionTiming 6561;
BA_ "SigType" SG_ 3221225472 EngCyl20AvrgCntrOfCmbstionTiming 1;
BA_ "SPN" SG_ 3221225472 EngCyl20AvrgStrtOfCmbstionTiming 6560;
BA_ "SigType" SG_ 3221225472 EngCyl20AvrgStrtOfCmbstionTiming 1;
BA_ "SPN" SG_ 3221225472 EngCyl20IndctdMeanEffectivePress 6559;
BA_ "SigType" SG_ 3221225472 EngCyl20IndctdMeanEffectivePress 1;
BA_ "SPN" SG_ 3221225472 EngCyl19AvrageCombustionDuration 6558;
BA_ "SigType" SG_ 3221225472 EngCyl19AvrageCombustionDuration 1;
BA_ "SPN" SG_ 3221225472 EngCyl19AvrgCntrOfCmbstionTiming 6557;
BA_ "SigType" SG_ 3221225472 EngCyl19AvrgCntrOfCmbstionTiming 1;
BA_ "SPN" SG_ 3221225472 EngCyl19AvrgStrtOfCmbstionTiming 6556;
BA_ "SigType" SG_ 3221225472 EngCyl19AvrgStrtOfCmbstionTiming 1;
BA_ "SPN" SG_ 3221225472 EngCyl19IndctdMeanEffectivePress 6555;
BA_ "SigType" SG_ 3221225472 EngCyl19IndctdMeanEffectivePress 1;
BA_ "SPN" SG_ 3221225472 EngCyl18AvrageCombustionDuration 6554;
BA_ "SigType" SG_ 3221225472 EngCyl18AvrageCombustionDuration 1;
BA_ "SPN" SG_ 3221225472 EngCyl18AvrgCntrOfCmbstionTiming 6553;
BA_ "SigType" SG_ 3221225472 EngCyl18AvrgCntrOfCmbstionTiming 1;
BA_ "SPN" SG_ 3221225472 EngCyl18AvrgStrtOfCmbstionTiming 6552;
BA_ "SigType" SG_ 3221225472 EngCyl18AvrgStrtOfCmbstionTiming 1;
BA_ "SPN" SG_ 3221225472 EngCyl18IndctdMeanEffectivePress 6551;
BA_ "SigType" SG_ 3221225472 EngCyl18IndctdMeanEffectivePress 1;
BA_ "SPN" SG_ 3221225472 EngCyl17AvrageCombustionDuration 6550;
BA_ "SigType" SG_ 3221225472 EngCyl17AvrageCombustionDuration 1;
BA_ "SPN" SG_ 3221225472 EngCyl17AvrgCntrOfCmbstionTiming 6549;
BA_ "SigType" SG_ 3221225472 EngCyl17AvrgCntrOfCmbstionTiming 1;
BA_ "SPN" SG_ 3221225472 EngCyl17AvrgStrtOfCmbstionTiming 6548;
BA_ "SigType" SG_ 3221225472 EngCyl17AvrgStrtOfCmbstionTiming 1;
BA_ "SPN" SG_ 3221225472 EngCyl17IndctdMeanEffectivePress 6547;
BA_ "SigType" SG_ 3221225472 EngCyl17IndctdMeanEffectivePress 1;
BA_ "SPN" SG_ 3221225472 EngCyl16AvrageCombustionDuration 6546;
BA_ "SigType" SG_ 3221225472 EngCyl16AvrageCombustionDuration 1;
BA_ "SPN" SG_ 3221225472 EngCyl16AvrgCntrOfCmbstionTiming 6545;
BA_ "SigType" SG_ 3221225472 EngCyl16AvrgCntrOfCmbstionTiming 1;
BA_ "SPN" SG_ 3221225472 EngCyl16AvrgStrtOfCmbstionTiming 6544;
BA_ "SigType" SG_ 3221225472 EngCyl16AvrgStrtOfCmbstionTiming 1;
BA_ "SPN" SG_ 3221225472 EngCyl16IndctdMeanEffectivePress 6543;
BA_ "SigType" SG_ 3221225472 EngCyl16IndctdMeanEffectivePress 1;
BA_ "SPN" SG_ 3221225472 EngCyl15AvrageCombustionDuration 6542;
BA_ "SigType" SG_ 3221225472 EngCyl15AvrageCombustionDuration 1;
BA_ "SPN" SG_ 3221225472 EngCyl15AvrgCntrOfCmbstionTiming 6541;
BA_ "SigType" SG_ 3221225472 EngCyl15AvrgCntrOfCmbstionTiming 1;
BA_ "SPN" SG_ 3221225472 EngCyl15AvrgStrtOfCmbstionTiming 6540;
BA_ "SigType" SG_ 3221225472 EngCyl15AvrgStrtOfCmbstionTiming 1;
BA_ "SPN" SG_ 3221225472 EngCyl15IndctdMeanEffectivePress 6539;
BA_ "SigType" SG_ 3221225472 EngCyl15IndctdMeanEffectivePress 1;
BA_ "SPN" SG_ 3221225472 EngCyl14AvrageCombustionDuration 6538;
BA_ "SigType" SG_ 3221225472 EngCyl14AvrageCombustionDuration 1;
BA_ "SPN" SG_ 3221225472 EngCyl14AvrgCntrOfCmbstionTiming 6537;
BA_ "SigType" SG_ 3221225472 EngCyl14AvrgCntrOfCmbstionTiming 1;
BA_ "SPN" SG_ 3221225472 EngCyl14AvrgStrtOfCmbstionTiming 6536;
BA_ "SigType" SG_ 3221225472 EngCyl14AvrgStrtOfCmbstionTiming 1;
BA_ "SPN" SG_ 3221225472 EngCyl14IndctdMeanEffectivePress 6535;
BA_ "SigType" SG_ 3221225472 EngCyl14IndctdMeanEffectivePress 1;
BA_ "SPN" SG_ 3221225472 EngCyl13AvrageCombustionDuration 6534;
BA_ "SigType" SG_ 3221225472 EngCyl13AvrageCombustionDuration 1;
BA_ "SPN" SG_ 3221225472 EngCyl13AvrgCntrOfCmbstionTiming 6533;
BA_ "SigType" SG_ 3221225472 EngCyl13AvrgCntrOfCmbstionTiming 1;
BA_ "SPN" SG_ 3221225472 EngCyl13AvrgStrtOfCmbstionTiming 6532;
BA_ "SigType" SG_ 3221225472 EngCyl13AvrgStrtOfCmbstionTiming 1;
BA_ "SPN" SG_ 3221225472 EngCyl13IndctdMeanEffectivePress 6531;
BA_ "SigType" SG_ 3221225472 EngCyl13IndctdMeanEffectivePress 1;
BA_ "SPN" SG_ 3221225472 EngCyl12AvrageCombustionDuration 6530;
BA_ "SigType" SG_ 3221225472 EngCyl12AvrageCombustionDuration 1;
BA_ "SPN" SG_ 3221225472 EngCyl12AvrgCntrOfCmbstionTiming 6529;
BA_ "SigType" SG_ 3221225472 EngCyl12AvrgCntrOfCmbstionTiming 1;
BA_ "SPN" SG_ 3221225472 EngCyl12AvrgStrtOfCmbstionTiming 6528;
BA_ "SigType" SG_ 3221225472 EngCyl12AvrgStrtOfCmbstionTiming 1;
BA_ "SPN" SG_ 3221225472 EngCyl12IndctdMeanEffectivePress 6527;
BA_ "SigType" SG_ 3221225472 EngCyl12IndctdMeanEffectivePress 1;
BA_ "SPN" SG_ 3221225472 EngCyl11AvrageCombustionDuration 6526;
BA_ "SigType" SG_ 3221225472 EngCyl11AvrageCombustionDuration 1;
BA_ "SPN" SG_ 3221225472 EngCyl11AvrgCntrOfCmbstionTiming 6525;
BA_ "SigType" SG_ 3221225472 EngCyl11AvrgCntrOfCmbstionTiming 1;
BA_ "SPN" SG_ 3221225472 EngCyl11AvrgStrtOfCmbstionTiming 6524;
BA_ "SigType" SG_ 3221225472 EngCyl11AvrgStrtOfCmbstionTiming 1;
BA_ "SPN" SG_ 3221225472 EngCyl11IndctdMeanEffectivePress 6523;
BA_ "SigType" SG_ 3221225472 EngCyl11IndctdMeanEffectivePress 1;
BA_ "SPN" SG_ 3221225472 EngCyl10AvrageCombustionDuration 6522;
BA_ "SigType" SG_ 3221225472 EngCyl10AvrageCombustionDuration 1;
BA_ "SPN" SG_ 3221225472 EngCyl10AvrgCntrOfCmbstionTiming 6521;
BA_ "SigType" SG_ 3221225472 EngCyl10AvrgCntrOfCmbstionTiming 1;
BA_ "SPN" SG_ 3221225472 EngCyl10AvrgStrtOfCmbstionTiming 6520;
BA_ "SigType" SG_ 3221225472 EngCyl10AvrgStrtOfCmbstionTiming 1;
BA_ "SPN" SG_ 3221225472 EngCyl10IndctdMeanEffectivePress 6519;
BA_ "SigType" SG_ 3221225472 EngCyl10IndctdMeanEffectivePress 1;
BA_ "SPN" SG_ 3221225472 EngCyl9AverageCombustionDuration 6518;
BA_ "SigType" SG_ 3221225472 EngCyl9AverageCombustionDuration 1;
BA_ "SPN" SG_ 3221225472 EngCyl9AvrgCntrOfCmbustionTiming 6517;
BA_ "SigType" SG_ 3221225472 EngCyl9AvrgCntrOfCmbustionTiming 1;
BA_ "SPN" SG_ 3221225472 EngCyl9AvrgStrtOfCmbustionTiming 6516;
BA_ "SigType" SG_ 3221225472 EngCyl9AvrgStrtOfCmbustionTiming 1;
BA_ "SPN" SG_ 3221225472 EngCyl9IndctedMeanEffectivePress 6515;
BA_ "SigType" SG_ 3221225472 EngCyl9IndctedMeanEffectivePress 1;
BA_ "SPN" SG_ 3221225472 GenFrequencySelection 4080;
BA_ "SPN" SG_ 3221225472 GenGoverningSpeedCommand 4079;
BA_ "SigType" SG_ 3221225472 GenGoverningSpeedCommand 5;
BA_ "SPN" SG_ 3221225472 GenAlternatorEfficiency 4078;
BA_ "SigType" SG_ 3221225472 GenAlternatorEfficiency 1;
BA_ "SPN" SG_ 3221225472 GenNotReadyToAutoParaState 3568;
BA_ "SigType" SG_ 3221225472 GenNotReadyToAutoParaState 5;
BA_ "SPN" SG_ 3221225472 GenCtrlNotInAutoStartState 3567;
BA_ "SigType" SG_ 3221225472 GenCtrlNotInAutoStartState 5;
BA_ "SPN" SG_ 3221225472 RequestedEngineControlMode 3542;
BA_ "SigType" SG_ 3221225472 RequestedEngineControlMode 4;
BA_ "SPN" SG_ 3221225472 EngSpeedGovernorDroop 5568;
BA_ "SigType" SG_ 3221225472 EngSpeedGovernorDroop 1;
BA_ "SPN" SG_ 3221225472 EngSpeedGovernorGainAdjust 5567;
BA_ "SigType" SG_ 3221225472 EngSpeedGovernorGainAdjust 1;
BA_ "SPN" SG_ 3221225472 StaticRollAngleStatus 5583;
BA_ "SPN" SG_ 3221225472 StaticRollAngle 5582;
BA_ "GenSigStartValue" SG_ 3221225472 StaticRollAngle 35;
BA_ "SigType" SG_ 3221225472 StaticRollAngle 1;
BA_ "SPN" SG_ 3221225472 EngCyl2AverageCombustionDuration 6490;
BA_ "SigType" SG_ 3221225472 EngCyl2AverageCombustionDuration 1;
BA_ "SPN" SG_ 3221225472 EngCyl2AvrgCntrOfCmbustionTiming 6489;
BA_ "SigType" SG_ 3221225472 EngCyl2AvrgCntrOfCmbustionTiming 1;
BA_ "SPN" SG_ 3221225472 EngCyl2AvrgStrtOfCmbustionTiming 6488;
BA_ "SigType" SG_ 3221225472 EngCyl2AvrgStrtOfCmbustionTiming 1;
BA_ "SPN" SG_ 3221225472 EngCyl2IndctedMeanEffectivePress 6487;
BA_ "SigType" SG_ 3221225472 EngCyl2IndctedMeanEffectivePress 1;
BA_ "SPN" SG_ 3221225472 EngCyl1AverageCombustionDuration 6486;
BA_ "SigType" SG_ 3221225472 EngCyl1AverageCombustionDuration 1;
BA_ "SPN" SG_ 3221225472 EngCyl1AvrgCntrOfCmbustionTiming 6485;
BA_ "SigType" SG_ 3221225472 EngCyl1AvrgCntrOfCmbustionTiming 1;
BA_ "SPN" SG_ 3221225472 EngCyl1AvrgStrtOfCmbustionTiming 6484;
BA_ "SigType" SG_ 3221225472 EngCyl1AvrgStrtOfCmbustionTiming 1;
BA_ "SPN" SG_ 3221225472 EngCyl1IndctedMeanEffectivePress 6483;
BA_ "SigType" SG_ 3221225472 EngCyl1IndctedMeanEffectivePress 1;
BA_ "SPN" SG_ 3221225472 MaxPressIncreaseRate 7648;
BA_ "SigType" SG_ 3221225472 MaxPressIncreaseRate 1;
BA_ "SPN" SG_ 3221225472 LowFreqKnockLvl 7628;
BA_ "SigType" SG_ 3221225472 LowFreqKnockLvl 1;
BA_ "SPN" SG_ 3221225472 EngCyl20PrssSensorPreliminaryFMI 6475;
BA_ "SPN" SG_ 3221225472 EngCyl20SynchronousKnockLevel 6474;
BA_ "SigType" SG_ 3221225472 EngCyl20SynchronousKnockLevel 1;
BA_ "SPN" SG_ 3221225472 EngCyl20PeakPress 6473;
BA_ "SigType" SG_ 3221225472 EngCyl20PeakPress 1;
BA_ "SPN" SG_ 3221225472 EngCyl20HeatRelease 6472;
BA_ "SigType" SG_ 3221225472 EngCyl20HeatRelease 1;
BA_ "SPN" SG_ 3221225472 MaxPressIncreaseRate 7647;
BA_ "SigType" SG_ 3221225472 MaxPressIncreaseRate 1;
BA_ "SPN" SG_ 3221225472 LowFreqKnockLvl 7627;
BA_ "SigType" SG_ 3221225472 LowFreqKnockLvl 1;
BA_ "SPN" SG_ 3221225472 EngCyl19PrssSensorPreliminaryFMI 6471;
BA_ "SPN" SG_ 3221225472 EngCyl19SynchronousKnockLevel 6470;
BA_ "SigType" SG_ 3221225472 EngCyl19SynchronousKnockLevel 1;
BA_ "SPN" SG_ 3221225472 EngCyl19PeakPress 6469;
BA_ "SigType" SG_ 3221225472 EngCyl19PeakPress 1;
BA_ "SPN" SG_ 3221225472 EngCyl19HeatRelease 6468;
BA_ "SigType" SG_ 3221225472 EngCyl19HeatRelease 1;
BA_ "SPN" SG_ 3221225472 MaxPressIncreaseRate 7646;
BA_ "SigType" SG_ 3221225472 MaxPressIncreaseRate 1;
BA_ "SPN" SG_ 3221225472 LowFreqKnockLvl 7626;
BA_ "SigType" SG_ 3221225472 LowFreqKnockLvl 1;
BA_ "SPN" SG_ 3221225472 EngCyl18PrssSensorPreliminaryFMI 6467;
BA_ "SPN" SG_ 3221225472 EngCyl18SynchronousKnockLevel 6466;
BA_ "SigType" SG_ 3221225472 EngCyl18SynchronousKnockLevel 1;
BA_ "SPN" SG_ 3221225472 EngCyl18PeakPress 6465;
BA_ "SigType" SG_ 3221225472 EngCyl18PeakPress 1;
BA_ "SPN" SG_ 3221225472 EngCyl18HeatRelease 6464;
BA_ "SigType" SG_ 3221225472 EngCyl18HeatRelease 1;
BA_ "SPN" SG_ 3221225472 MaxPressIncreaseRate 7645;
BA_ "SigType" SG_ 3221225472 MaxPressIncreaseRate 1;
BA_ "SPN" SG_ 3221225472 LowFreqKnockLvl 7625;
BA_ "SigType" SG_ 3221225472 LowFreqKnockLvl 1;
BA_ "SPN" SG_ 3221225472 EngCyl17PrssSensorPreliminaryFMI 6463;
BA_ "SPN" SG_ 3221225472 EngCyl17SynchronousKnockLevel 6462;
BA_ "SigType" SG_ 3221225472 EngCyl17SynchronousKnockLevel 1;
BA_ "SPN" SG_ 3221225472 EngCyl17PeakPress 6461;
BA_ "SigType" SG_ 3221225472 EngCyl17PeakPress 1;
BA_ "SPN" SG_ 3221225472 EngCyl17HeatRelease 6460;
BA_ "SigType" SG_ 3221225472 EngCyl17HeatRelease 1;
BA_ "SPN" SG_ 3221225472 MaxPressIncreaseRate 7644;
BA_ "SigType" SG_ 3221225472 MaxPressIncreaseRate 1;
BA_ "SPN" SG_ 3221225472 LowFreqKnockLvl 7624;
BA_ "SigType" SG_ 3221225472 LowFreqKnockLvl 1;
BA_ "SPN" SG_ 3221225472 EngCyl16PrssSensorPreliminaryFMI 6459;
BA_ "SPN" SG_ 3221225472 EngCyl16SynchronousKnockLevel 6458;
BA_ "SigType" SG_ 3221225472 EngCyl16SynchronousKnockLevel 1;
BA_ "SPN" SG_ 3221225472 EngCyl16PeakPress 6457;
BA_ "SigType" SG_ 3221225472 EngCyl16PeakPress 1;
BA_ "SPN" SG_ 3221225472 EngCyl16HeatRelease 6456;
BA_ "SigType" SG_ 3221225472 EngCyl16HeatRelease 1;
BA_ "SPN" SG_ 3221225472 MaxPressIncreaseRate 7643;
BA_ "SigType" SG_ 3221225472 MaxPressIncreaseRate 1;
BA_ "SPN" SG_ 3221225472 LowFreqKnockLvl 7623;
BA_ "SigType" SG_ 3221225472 LowFreqKnockLvl 1;
BA_ "SPN" SG_ 3221225472 EngCyl15PrssSensorPreliminaryFMI 6455;
BA_ "SPN" SG_ 3221225472 EngCyl15SynchronousKnockLevel 6454;
BA_ "SigType" SG_ 3221225472 EngCyl15SynchronousKnockLevel 1;
BA_ "SPN" SG_ 3221225472 EngCyl15PeakPress 6453;
BA_ "SigType" SG_ 3221225472 EngCyl15PeakPress 1;
BA_ "SPN" SG_ 3221225472 EngCyl15HeatRelease 6452;
BA_ "SigType" SG_ 3221225472 EngCyl15HeatRelease 1;
BA_ "SPN" SG_ 3221225472 MaxPressIncreaseRate 7642;
BA_ "SigType" SG_ 3221225472 MaxPressIncreaseRate 1;
BA_ "SPN" SG_ 3221225472 LowFreqKnockLvl 7622;
BA_ "SigType" SG_ 3221225472 LowFreqKnockLvl 1;
BA_ "SPN" SG_ 3221225472 EngCyl14PrssSensorPreliminaryFMI 6451;
BA_ "SPN" SG_ 3221225472 EngCyl14SynchronousKnockLevel 6450;
BA_ "SigType" SG_ 3221225472 EngCyl14SynchronousKnockLevel 1;
BA_ "SPN" SG_ 3221225472 EngCyl14PeakPress 6449;
BA_ "SigType" SG_ 3221225472 EngCyl14PeakPress 1;
BA_ "SPN" SG_ 3221225472 EngCyl14HeatRelease 6448;
BA_ "SigType" SG_ 3221225472 EngCyl14HeatRelease 1;
BA_ "SPN" SG_ 3221225472 MaxPressIncreaseRate 7641;
BA_ "SigType" SG_ 3221225472 MaxPressIncreaseRate 1;
BA_ "SPN" SG_ 3221225472 LowFreqKnockLvl 7621;
BA_ "SigType" SG_ 3221225472 LowFreqKnockLvl 1;
BA_ "SPN" SG_ 3221225472 EngCyl13PrssSensorPreliminaryFMI 6447;
BA_ "SPN" SG_ 3221225472 EngCyl13SynchronousKnockLevel 6446;
BA_ "SigType" SG_ 3221225472 EngCyl13SynchronousKnockLevel 1;
BA_ "SPN" SG_ 3221225472 EngCyl13PeakPress 6445;
BA_ "SigType" SG_ 3221225472 EngCyl13PeakPress 1;
BA_ "SPN" SG_ 3221225472 EngCyl13HeatRelease 6444;
BA_ "SigType" SG_ 3221225472 EngCyl13HeatRelease 1;
BA_ "SPN" SG_ 3221225472 MaxPressIncreaseRate 7640;
BA_ "SigType" SG_ 3221225472 MaxPressIncreaseRate 1;
BA_ "SPN" SG_ 3221225472 LowFreqKnockLvl 7620;
BA_ "SigType" SG_ 3221225472 LowFreqKnockLvl 1;
BA_ "SPN" SG_ 3221225472 EngCyl12PrssSensorPreliminaryFMI 6443;
BA_ "SPN" SG_ 3221225472 EngCyl12SynchronousKnockLevel 6442;
BA_ "SigType" SG_ 3221225472 EngCyl12SynchronousKnockLevel 1;
BA_ "SPN" SG_ 3221225472 EngCyl12PeakPress 6441;
BA_ "SigType" SG_ 3221225472 EngCyl12PeakPress 1;
BA_ "SPN" SG_ 3221225472 EngCyl12HeatRelease 6440;
BA_ "SigType" SG_ 3221225472 EngCyl12HeatRelease 1;
BA_ "SPN" SG_ 3221225472 MaxPressIncreaseRate 7639;
BA_ "SigType" SG_ 3221225472 MaxPressIncreaseRate 1;
BA_ "SPN" SG_ 3221225472 LowFreqKnockLvl 7619;
BA_ "SigType" SG_ 3221225472 LowFreqKnockLvl 1;
BA_ "SPN" SG_ 3221225472 EngCyl11PrssSensorPreliminaryFMI 6439;
BA_ "SPN" SG_ 3221225472 EngCyl11SynchronousKnockLevel 6438;
BA_ "SigType" SG_ 3221225472 EngCyl11SynchronousKnockLevel 1;
BA_ "SPN" SG_ 3221225472 EngCyl11PeakPress 6437;
BA_ "SigType" SG_ 3221225472 EngCyl11PeakPress 1;
BA_ "SPN" SG_ 3221225472 EngCyl11HeatRelease 6436;
BA_ "SigType" SG_ 3221225472 EngCyl11HeatRelease 1;
BA_ "SPN" SG_ 3221225472 MaxPressIncreaseRate 7638;
BA_ "SigType" SG_ 3221225472 MaxPressIncreaseRate 1;
BA_ "SPN" SG_ 3221225472 LowFreqKnockLvl 7618;
BA_ "SigType" SG_ 3221225472 LowFreqKnockLvl 1;
BA_ "SPN" SG_ 3221225472 EngCyl10PrssSensorPreliminaryFMI 6435;
BA_ "SPN" SG_ 3221225472 EngCyl10SynchronousKnockLevel 6434;
BA_ "SigType" SG_ 3221225472 EngCyl10SynchronousKnockLevel 1;
BA_ "SPN" SG_ 3221225472 EngCyl10PeakPress 6433;
BA_ "SigType" SG_ 3221225472 EngCyl10PeakPress 1;
BA_ "SPN" SG_ 3221225472 EngCyl10HeatRelease 6432;
BA_ "SigType" SG_ 3221225472 EngCyl10HeatRelease 1;
BA_ "SPN" SG_ 3221225472 MaxPressIncreaseRate 7637;
BA_ "SigType" SG_ 3221225472 MaxPressIncreaseRate 1;
BA_ "SPN" SG_ 3221225472 LowFreqKnockLvl 7617;
BA_ "SigType" SG_ 3221225472 LowFreqKnockLvl 1;
BA_ "SPN" SG_ 3221225472 EngCyl9PressSensorPreliminaryFMI 6431;
BA_ "SPN" SG_ 3221225472 EngCyl9SynchronousKnockLevel 6430;
BA_ "SigType" SG_ 3221225472 EngCyl9SynchronousKnockLevel 1;
BA_ "SPN" SG_ 3221225472 EngCyl9PeakPress 6429;
BA_ "SigType" SG_ 3221225472 EngCyl9PeakPress 1;
BA_ "SPN" SG_ 3221225472 EngCyl9HeatRelease 6428;
BA_ "SigType" SG_ 3221225472 EngCyl9HeatRelease 1;
BA_ "SPN" SG_ 3221225472 MaxPressIncreaseRate 7636;
BA_ "SigType" SG_ 3221225472 MaxPressIncreaseRate 1;
BA_ "SPN" SG_ 3221225472 LowFreqKnockLvl 7616;
BA_ "SigType" SG_ 3221225472 LowFreqKnockLvl 1;
BA_ "SPN" SG_ 3221225472 EngCyl8PressSensorPreliminaryFMI 6427;
BA_ "SPN" SG_ 3221225472 EngCyl8SynchronousKnockLevel 6426;
BA_ "SigType" SG_ 3221225472 EngCyl8SynchronousKnockLevel 1;
BA_ "SPN" SG_ 3221225472 EngCyl8PeakPress 6425;
BA_ "SigType" SG_ 3221225472 EngCyl8PeakPress 1;
BA_ "SPN" SG_ 3221225472 EngCyl8HeatRelease 6424;
BA_ "SigType" SG_ 3221225472 EngCyl8HeatRelease 1;
BA_ "SPN" SG_ 3221225472 MaxPressIncreaseRate 7635;
BA_ "SigType" SG_ 3221225472 MaxPressIncreaseRate 1;
BA_ "SPN" SG_ 3221225472 LowFreqKnockLvl 7615;
BA_ "SigType" SG_ 3221225472 LowFreqKnockLvl 1;
BA_ "SPN" SG_ 3221225472 EngCyl7PressSensorPreliminaryFMI 6423;
BA_ "SPN" SG_ 3221225472 EngCyl7SynchronousKnockLevel 6422;
BA_ "SigType" SG_ 3221225472 EngCyl7SynchronousKnockLevel 1;
BA_ "SPN" SG_ 3221225472 EngCyl7PeakPress 6421;
BA_ "SigType" SG_ 3221225472 EngCyl7PeakPress 1;
BA_ "SPN" SG_ 3221225472 EngCyl7HeatRelease 6420;
BA_ "SigType" SG_ 3221225472 EngCyl7HeatRelease 1;
BA_ "SPN" SG_ 3221225472 MaxPressIncreaseRate 7634;
BA_ "SigType" SG_ 3221225472 MaxPressIncreaseRate 1;
BA_ "SPN" SG_ 3221225472 LowFreqKnockLvl 7614;
BA_ "SigType" SG_ 3221225472 LowFreqKnockLvl 1;
BA_ "SPN" SG_ 3221225472 EngCyl6PressSensorPreliminaryFMI 6419;
BA_ "SPN" SG_ 3221225472 EngCyl6SynchronousKnockLevel 6418;
BA_ "SigType" SG_ 3221225472 EngCyl6SynchronousKnockLevel 1;
BA_ "SPN" SG_ 3221225472 EngCyl6PeakPress 6417;
BA_ "SigType" SG_ 3221225472 EngCyl6PeakPress 1;
BA_ "SPN" SG_ 3221225472 EngCyl6HeatRelease 6416;
BA_ "SigType" SG_ 3221225472 EngCyl6HeatRelease 1;
BA_ "SPN" SG_ 3221225472 MaxPressIncreaseRate 7633;
BA_ "SigType" SG_ 3221225472 MaxPressIncreaseRate 1;
BA_ "SPN" SG_ 3221225472 LowFreqKnockLvl 7613;
BA_ "SigType" SG_ 3221225472 LowFreqKnockLvl 1;
BA_ "SPN" SG_ 3221225472 EngCyl5PressSensorPreliminaryFMI 6415;
BA_ "SPN" SG_ 3221225472 EngCyl5SynchronousKnockLevel 6414;
BA_ "SigType" SG_ 3221225472 EngCyl5SynchronousKnockLevel 1;
BA_ "SPN" SG_ 3221225472 EngCyl5PeakPress 6413;
BA_ "SigType" SG_ 3221225472 EngCyl5PeakPress 1;
BA_ "SPN" SG_ 3221225472 EngCyl5HeatRelease 6412;
BA_ "SigType" SG_ 3221225472 EngCyl5HeatRelease 1;
BA_ "SPN" SG_ 3221225472 MaxPressIncreaseRate 7632;
BA_ "SigType" SG_ 3221225472 MaxPressIncreaseRate 1;
BA_ "SPN" SG_ 3221225472 LowFreqKnockLvl 7612;
BA_ "SigType" SG_ 3221225472 LowFreqKnockLvl 1;
BA_ "SPN" SG_ 3221225472 EngCyl4PressSensorPreliminaryFMI 6411;
BA_ "SPN" SG_ 3221225472 EngCyl4SynchronousKnockLevel 6410;
BA_ "SigType" SG_ 3221225472 EngCyl4SynchronousKnockLevel 1;
BA_ "SPN" SG_ 3221225472 EngCyl4PeakPress 6409;
BA_ "SigType" SG_ 3221225472 EngCyl4PeakPress 1;
BA_ "SPN" SG_ 3221225472 EngCyl4HeatRelease 6408;
BA_ "SigType" SG_ 3221225472 EngCyl4HeatRelease 1;
BA_ "SPN" SG_ 3221225472 MaxPressIncreaseRate 7631;
BA_ "SigType" SG_ 3221225472 MaxPressIncreaseRate 1;
BA_ "SPN" SG_ 3221225472 LowFreqKnockLvl 7611;
BA_ "SigType" SG_ 3221225472 LowFreqKnockLvl 1;
BA_ "SPN" SG_ 3221225472 EngCyl3PressSensorPreliminaryFMI 6407;
BA_ "SPN" SG_ 3221225472 EngCyl3SynchronousKnockLevel 6406;
BA_ "SigType" SG_ 3221225472 EngCyl3SynchronousKnockLevel 1;
BA_ "SPN" SG_ 3221225472 EngCyl3PeakPress 6405;
BA_ "SigType" SG_ 3221225472 EngCyl3PeakPress 1;
BA_ "SPN" SG_ 3221225472 EngCyl3HeatRelease 6404;
BA_ "SigType" SG_ 3221225472 EngCyl3HeatRelease 1;
BA_ "SPN" SG_ 3221225472 MaxPressIncreaseRate 7630;
BA_ "SigType" SG_ 3221225472 MaxPressIncreaseRate 1;
BA_ "SPN" SG_ 3221225472 LowFreqKnockLvl 7610;
BA_ "SigType" SG_ 3221225472 LowFreqKnockLvl 1;
BA_ "SPN" SG_ 3221225472 EngCyl2PressSensorPreliminaryFMI 6403;
BA_ "SPN" SG_ 3221225472 EngCyl2SynchronousKnockLevel 6402;
BA_ "SigType" SG_ 3221225472 EngCyl2SynchronousKnockLevel 1;
BA_ "SPN" SG_ 3221225472 EngCyl2PeakPress 6401;
BA_ "SigType" SG_ 3221225472 EngCyl2PeakPress 1;
BA_ "SPN" SG_ 3221225472 EngCyl2HeatRelease 6400;
BA_ "SigType" SG_ 3221225472 EngCyl2HeatRelease 1;
BA_ "SPN" SG_ 3221225472 MaxPressIncreaseRate 7629;
BA_ "SigType" SG_ 3221225472 MaxPressIncreaseRate 1;
BA_ "SPN" SG_ 3221225472 LowFreqKnockLvl 7609;
BA_ "SigType" SG_ 3221225472 LowFreqKnockLvl 1;
BA_ "SPN" SG_ 3221225472 EngCyl1PressSensorPreliminaryFMI 6399;
BA_ "SPN" SG_ 3221225472 EngCyl1SynchronousKnockLevel 6398;
BA_ "SigType" SG_ 3221225472 EngCyl1SynchronousKnockLevel 1;
BA_ "SPN" SG_ 3221225472 EngCyl1PeakPress 6397;
BA_ "SigType" SG_ 3221225472 EngCyl1PeakPress 1;
BA_ "SPN" SG_ 3221225472 EngCyl1HeatRelease 6396;
BA_ "SigType" SG_ 3221225472 EngCyl1HeatRelease 1;
BA_ "SPN" SG_ 3221225472 EngTotalIntakeMassAirFlowRate 6393;
BA_ "SigType" SG_ 3221225472 EngTotalIntakeMassAirFlowRate 1;
BA_ "SPN" SG_ 3221225472 EngDesiredAirFuelRatio 6392;
BA_ "SigType" SG_ 3221225472 EngDesiredAirFuelRatio 1;
BA_ "SPN" SG_ 3221225472 EngCylTorque 6389;
BA_ "SigType" SG_ 3221225472 EngCylTorque 1;
BA_ "SPN" SG_ 3221225472 EngCylDieselMassFlowRateCmd 6388;
BA_ "SigType" SG_ 3221225472 EngCylDieselMassFlowRateCmd 1;
BA_ "SPN" SG_ 3221225472 EngCylGasMassFlowRateCmd 6387;
BA_ "SigType" SG_ 3221225472 EngCylGasMassFlowRateCmd 1;
BA_ "SPN" SG_ 3221225472 EngGasFuelPercentageCmd 6386;
BA_ "SigType" SG_ 3221225472 EngGasFuelPercentageCmd 1;
BA_ "SPN" SG_ 3221225472 EngDualFuelModeCmd 6792;
BA_ "SigType" SG_ 3221225472 EngDualFuelModeCmd 5;
BA_ "SPN" SG_ 3221225472 EngTrbCmprssrBlwffActtr1OprtnStt 6316;
BA_ "SPN" SG_ 3221225472 EngTrbCmprssrBlowoffActuator1Pos 6315;
BA_ "SigType" SG_ 3221225472 EngTrbCmprssrBlowoffActuator1Pos 1;
BA_ "SPN" SG_ 3221225472 EngTrbCmprssrBlwffActtr1DsredPos 6314;
BA_ "SigType" SG_ 3221225472 EngTrbCmprssrBlwffActtr1DsredPos 1;
BA_ "SPN" SG_ 3221225472 EngTrbCmprssrBlwoffActuator1Temp 6313;
BA_ "SigType" SG_ 3221225472 EngTrbCmprssrBlwoffActuator1Temp 1;
BA_ "SPN" SG_ 3221225472 EngTrbCmprssrBlwffActtr1TmpSttus 6312;
BA_ "SPN" SG_ 3221225472 EngTrbCmprssrBlwffActtr1PrlmnryF 6311;
BA_ "SPN" SG_ 3221225472 PersistentLimitStatus 4307;
BA_ "SPN" SG_ 3221225472 MachineSelectedSpeedSource 4308;
BA_ "SPN" SG_ 3221225472 MachineSelectedDirection 4309;
BA_ "SigType" SG_ 3221225472 MachineSelectedDirection 4;
BA_ "SPN" SG_ 3221225472 MachineSelectedDistance 4306;
BA_ "SPN" SG_ 3221225472 MachineSelectedSpeed 4305;
BA_ "SPN" SG_ 3221225472 GeneratorGoverningBias 3938;
BA_ "SigType" SG_ 3221225472 GeneratorGoverningBias 1;
BA_ "SPN" SG_ 3221225472 AccelPedal2Channel3 2626;
BA_ "SigType" SG_ 3221225472 AccelPedal2Channel3 1;
BA_ "SPN" SG_ 3221225472 AccelPedal2Channel2 2625;
BA_ "SigType" SG_ 3221225472 AccelPedal2Channel2 1;
BA_ "SPN" SG_ 3221225472 AccelPedal1Channel3 2624;
BA_ "SigType" SG_ 3221225472 AccelPedal1Channel3 1;
BA_ "SPN" SG_ 3221225472 AccelPedal1Channel2 2623;
BA_ "SigType" SG_ 3221225472 AccelPedal1Channel2 1;
BA_ "SPN" SG_ 3221225472 DesiredEngFuelingState 5793;
BA_ "SigType" SG_ 3221225472 DesiredEngFuelingState 5;
BA_ "SPN" SG_ 3221225472 RequestedFuelType 6317;
BA_ "SPN" SG_ 3221225472 EngGasFuelSupplyDesiredPress 6715;
BA_ "SigType" SG_ 3221225472 EngGasFuelSupplyDesiredPress 1;
BA_ "SPN" SG_ 3221225472 EngGasFuelUsageInhibited 6833;
BA_ "SigType" SG_ 3221225472 EngGasFuelUsageInhibited 4;
BA_ "SPN" SG_ 3221225472 AEBS2MessageChecksum 5683;
BA_ "SigType" SG_ 3221225472 AEBS2MessageChecksum 12;
BA_ "SPN" SG_ 3221225472 AEBS2MessageCounter 5682;
BA_ "SigType" SG_ 3221225472 AEBS2MessageCounter 11;
BA_ "SPN" SG_ 3221225472 DrvrActvtnDmndFrAdvncdEmrgncyBrk 5681;
BA_ "SigType" SG_ 3221225472 DrvrActvtnDmndFrAdvncdEmrgncyBrk 5;
BA_ "SPN" SG_ 3221225472 ProcessVariableValue 2429;
BA_ "SPN" SG_ 3221225472 CountNumber 2422;
BA_ "SPN" SG_ 3221225472 ValveFailSafeMode 2934;
BA_ "SigType" SG_ 3221225472 ValveFailSafeMode 4;
BA_ "SPN" SG_ 3221225472 ValveState 2932;
BA_ "SPN" SG_ 3221225472 RetractPortEstFlow 2940;
BA_ "SPN" SG_ 3221225472 ExtendPortEstFlow 2939;
BA_ "SPN" SG_ 3221225472 ReturnPortPress 2943;
BA_ "SPN" SG_ 3221225472 RetractPortPress 2942;
BA_ "SPN" SG_ 3221225472 ExtendPortPress 2941;
BA_ "SPN" SG_ 3221225472 RetractPortMeasuredFlow 2938;
BA_ "SPN" SG_ 3221225472 ExtendPortMeasuredFlow 2937;
BA_ "SPN" SG_ 3221225472 PortFlowCmd 2944;
BA_ "SystemSignalLongSymbol" SG_ 3221225472 VehicleSystemInstanceQualifierFl "VehicleSystemInstanceQualifierFlag";
BA_ "SystemSignalLongSymbol" SG_ 3221225472 ArbitraryAddressCapableQualifier "ArbitraryAddressCapableQualifierFlag";
BA_ "SPN" SG_ 3221225472 SwitchedPowerOutput18Cmd 6002;
BA_ "SigType" SG_ 3221225472 SwitchedPowerOutput18Cmd 5;
BA_ "SPN" SG_ 3221225472 SwitchedPowerOutput19Cmd 6001;
BA_ "SigType" SG_ 3221225472 SwitchedPowerOutput19Cmd 5;
BA_ "SPN" SG_ 3221225472 SwitchedPowerOutput20Cmd 6000;
BA_ "SigType" SG_ 3221225472 SwitchedPowerOutput20Cmd 5;
BA_ "SPN" SG_ 3221225472 SwitchedPowerOutput13Cmd 5999;
BA_ "SigType" SG_ 3221225472 SwitchedPowerOutput13Cmd 5;
BA_ "SPN" SG_ 3221225472 SwitchedPowerOutput14Cmd 5998;
BA_ "SigType" SG_ 3221225472 SwitchedPowerOutput14Cmd 5;
BA_ "SPN" SG_ 3221225472 SwitchedPowerOutput15Cmd 5997;
BA_ "SigType" SG_ 3221225472 SwitchedPowerOutput15Cmd 5;
BA_ "SPN" SG_ 3221225472 SwitchedPowerOutput16Cmd 5996;
BA_ "SigType" SG_ 3221225472 SwitchedPowerOutput16Cmd 5;
BA_ "SPN" SG_ 3221225472 SwitchedPowerOutput9Cmd 5995;
BA_ "SigType" SG_ 3221225472 SwitchedPowerOutput9Cmd 5;
BA_ "SPN" SG_ 3221225472 SwitchedPowerOutput10Cmd 5994;
BA_ "SigType" SG_ 3221225472 SwitchedPowerOutput10Cmd 5;
BA_ "SPN" SG_ 3221225472 SwitchedPowerOutput29Cmd 6015;
BA_ "SigType" SG_ 3221225472 SwitchedPowerOutput29Cmd 5;
BA_ "SPN" SG_ 3221225472 SwitchedPowerOutput30Cmd 6014;
BA_ "SigType" SG_ 3221225472 SwitchedPowerOutput30Cmd 5;
BA_ "SPN" SG_ 3221225472 SwitchedPowerOutput31Cmd 6013;
BA_ "SigType" SG_ 3221225472 SwitchedPowerOutput31Cmd 5;
BA_ "SPN" SG_ 3221225472 SwitchedPowerOutput32Cmd 6012;
BA_ "SigType" SG_ 3221225472 SwitchedPowerOutput32Cmd 5;
BA_ "SPN" SG_ 3221225472 SwitchedPowerOutput25Cmd 6011;
BA_ "SigType" SG_ 3221225472 SwitchedPowerOutput25Cmd 5;
BA_ "SPN" SG_ 3221225472 SwitchedPowerOutput26Cmd 6010;
BA_ "SigType" SG_ 3221225472 SwitchedPowerOutput26Cmd 5;
BA_ "SPN" SG_ 3221225472 SwitchedPowerOutput27Cmd 6009;
BA_ "SigType" SG_ 3221225472 SwitchedPowerOutput27Cmd 5;
BA_ "SPN" SG_ 3221225472 SwitchedPowerOutput28Cmd 6008;
BA_ "SigType" SG_ 3221225472 SwitchedPowerOutput28Cmd 5;
BA_ "SPN" SG_ 3221225472 SwitchedPowerOutput21Cmd 6007;
BA_ "SigType" SG_ 3221225472 SwitchedPowerOutput21Cmd 5;
BA_ "SPN" SG_ 3221225472 SwitchedPowerOutput22Cmd 6006;
BA_ "SigType" SG_ 3221225472 SwitchedPowerOutput22Cmd 5;
BA_ "SPN" SG_ 3221225472 SwitchedPowerOutput23Cmd 6005;
BA_ "SigType" SG_ 3221225472 SwitchedPowerOutput23Cmd 5;
BA_ "SPN" SG_ 3221225472 SwitchedPowerOutput24Cmd 6004;
BA_ "SigType" SG_ 3221225472 SwitchedPowerOutput24Cmd 5;
BA_ "SPN" SG_ 3221225472 SwitchedPowerOutput17Cmd 6003;
BA_ "SigType" SG_ 3221225472 SwitchedPowerOutput17Cmd 5;
BA_ "SPN" SG_ 3221225472 SwitchedPowerOutput11Cmd 5993;
BA_ "SigType" SG_ 3221225472 SwitchedPowerOutput11Cmd 5;
BA_ "SPN" SG_ 3221225472 SwitchedPowerOutput12Cmd 5992;
BA_ "SigType" SG_ 3221225472 SwitchedPowerOutput12Cmd 5;
BA_ "SPN" SG_ 3221225472 SwitchedPowerOutput5Cmd 5991;
BA_ "SigType" SG_ 3221225472 SwitchedPowerOutput5Cmd 5;
BA_ "SPN" SG_ 3221225472 SwitchedPowerOutput6Cmd 5990;
BA_ "SigType" SG_ 3221225472 SwitchedPowerOutput6Cmd 5;
BA_ "SPN" SG_ 3221225472 SwitchedPowerOutput7Cmd 5989;
BA_ "SigType" SG_ 3221225472 SwitchedPowerOutput7Cmd 5;
BA_ "SPN" SG_ 3221225472 SwitchedPowerOutput8Cmd 5988;
BA_ "SigType" SG_ 3221225472 SwitchedPowerOutput8Cmd 5;
BA_ "SPN" SG_ 3221225472 SwitchedPowerOutput1Cmd 5987;
BA_ "SigType" SG_ 3221225472 SwitchedPowerOutput1Cmd 5;
BA_ "SPN" SG_ 3221225472 SwitchedPowerOutput2Cmd 5986;
BA_ "SigType" SG_ 3221225472 SwitchedPowerOutput2Cmd 5;
BA_ "SPN" SG_ 3221225472 SwitchedPowerOutput3Cmd 5985;
BA_ "SigType" SG_ 3221225472 SwitchedPowerOutput3Cmd 5;
BA_ "SPN" SG_ 3221225472 SwitchedPowerOutput4Cmd 5984;
BA_ "SigType" SG_ 3221225472 SwitchedPowerOutput4Cmd 5;
BA_ "SPN" SG_ 3221225472 TransMode10 6570;
BA_ "SigType" SG_ 3221225472 TransMode10 5;
BA_ "SPN" SG_ 3221225472 TransMode9 6569;
BA_ "SigType" SG_ 3221225472 TransMode9 5;
BA_ "SPN" SG_ 3221225472 AccelPedalPos3 28;
BA_ "SigType" SG_ 3221225472 AccelPedalPos3 1;
BA_ "SPN" SG_ 3221225472 EngFuelIsolationCtrl 7394;
BA_ "SigType" SG_ 3221225472 EngFuelIsolationCtrl 5;
BA_ "SPN" SG_ 3221225472 FuelType 5837;
BA_ "SPN" SG_ 3221225472 EngFuelMassFlowRate 5833;
BA_ "SigType" SG_ 3221225472 EngFuelMassFlowRate 1;
BA_ "SPN" SG_ 3221225472 EngExhstGsRcrcltn1Valve2PosError 5830;
BA_ "SigType" SG_ 3221225472 EngExhstGsRcrcltn1Valve2PosError 1;
BA_ "SPN" SG_ 3221225472 EngExhstGsRcrcltn1Valve1PosError 5829;
BA_ "SigType" SG_ 3221225472 EngExhstGsRcrcltn1Valve1PosError 1;
BA_ "SPN" SG_ 3221225472 AFT1ParticulateSnsrCur 7393;
BA_ "SigType" SG_ 3221225472 AFT1ParticulateSnsrCur 1;
BA_ "SPN" SG_ 3221225472 AFT2ParticulateSnsr 5836;
BA_ "SigType" SG_ 3221225472 AFT2ParticulateSnsr 1;
BA_ "SPN" SG_ 3221225472 AFT1ParticulateSnsr 5835;
BA_ "SigType" SG_ 3221225472 AFT1ParticulateSnsr 1;
BA_ "SPN" SG_ 3221225472 AFT2InNOxSnsrSelfDiagTrigger 5712;
BA_ "SPN" SG_ 3221225472 AFT2OutNOxSnsrSelfDiagTrigger 5711;
BA_ "SPN" SG_ 3221225472 AFT1InNOxSnsrSelfDiagTrigger 5710;
BA_ "SPN" SG_ 3221225472 AFT1OutNOxSnsrSelfDiagTrigger 5709;
BA_ "SPN" SG_ 3221225472 AFT2OutGasSnsrPwrSupply 5761;
BA_ "SigType" SG_ 3221225472 AFT2OutGasSnsrPwrSupply 5;
BA_ "SPN" SG_ 3221225472 AFT2InGasSnsrPwrSupply 5760;
BA_ "SigType" SG_ 3221225472 AFT2InGasSnsrPwrSupply 5;
BA_ "SPN" SG_ 3221225472 AFT1OutGasSnsrPwrSupply 5759;
BA_ "SigType" SG_ 3221225472 AFT1OutGasSnsrPwrSupply 5;
BA_ "SPN" SG_ 3221225472 AFT1InGasSnsrPwrSupply 5758;
BA_ "SigType" SG_ 3221225472 AFT1InGasSnsrPwrSupply 5;
BA_ "SPN" SG_ 3221225472 EngExhstGsRcrcltn1Acttr2PrlmnryF 5767;
BA_ "SPN" SG_ 3221225472 EngExhstGsRcrcltn1Acttr2OprtnStt 5772;
BA_ "SPN" SG_ 3221225472 EngExhstGsRcrcltn1Acttr1OprtnStt 5771;
BA_ "SPN" SG_ 3221225472 EngExhstGsRcrcltn1Acttr2DsredPos 5770;
BA_ "SigType" SG_ 3221225472 EngExhstGsRcrcltn1Acttr2DsredPos 1;
BA_ "SPN" SG_ 3221225472 EngExhstGsRcrclton1Actuator2Temp 5769;
BA_ "SigType" SG_ 3221225472 EngExhstGsRcrclton1Actuator2Temp 1;
BA_ "SPN" SG_ 3221225472 EngExhstGsRcrcltn1Acttr2TmpSttus 5768;
BA_ "SPN" SG_ 3221225472 EngExhstGsRcrcltn1Acttr1DsredPos 5766;
BA_ "SigType" SG_ 3221225472 EngExhstGsRcrcltn1Acttr1DsredPos 1;
BA_ "SPN" SG_ 3221225472 EngExhstGsRcrclton1Actuator1Temp 5765;
BA_ "SigType" SG_ 3221225472 EngExhstGsRcrclton1Actuator1Temp 1;
BA_ "SPN" SG_ 3221225472 EngExhstGsRcrcltn1Acttr1TmpSttus 5764;
BA_ "SPN" SG_ 3221225472 EngExhstGsRcrcltn1Acttr1PrlmnryF 5763;
BA_ "SPN" SG_ 3221225472 EngExhstGsRcrcltn2Acttr2OprtnStt 5782;
BA_ "SPN" SG_ 3221225472 EngExhstGsRcrcltn2Acttr1OprtnStt 5781;
BA_ "SPN" SG_ 3221225472 EngExhstGsRcrcltn2Acttr2DsredPos 5780;
BA_ "SigType" SG_ 3221225472 EngExhstGsRcrcltn2Acttr2DsredPos 1;
BA_ "SPN" SG_ 3221225472 EngExhstGsRcrclton2Actuator2Temp 5779;
BA_ "SigType" SG_ 3221225472 EngExhstGsRcrclton2Actuator2Temp 1;
BA_ "SPN" SG_ 3221225472 EngExhstGsRcrcltn2Acttr2TmpSttus 5778;
BA_ "SPN" SG_ 3221225472 EngExhstGsRcrcltn2Acttr2PrlmnryF 5777;
BA_ "SPN" SG_ 3221225472 EngExhstGsRcrcltn2Acttr1DsredPos 5776;
BA_ "SigType" SG_ 3221225472 EngExhstGsRcrcltn2Acttr1DsredPos 1;
BA_ "SPN" SG_ 3221225472 EngExhstGsRcrclton2Actuator1Temp 5775;
BA_ "SigType" SG_ 3221225472 EngExhstGsRcrclton2Actuator1Temp 1;
BA_ "SPN" SG_ 3221225472 EngExhstGsRcrcltn2Acttr1TmpSttus 5774;
BA_ "SPN" SG_ 3221225472 EngExhstGsRcrcltn2Acttr1PrlmnryF 5773;
BA_ "SPN" SG_ 3221225472 EngFuelRackFuelSupplyTemp 7314;
BA_ "SigType" SG_ 3221225472 EngFuelRackFuelSupplyTemp 1;
BA_ "SPN" SG_ 3221225472 EngTurboWastegateActuator2Temp 5787;
BA_ "SigType" SG_ 3221225472 EngTurboWastegateActuator2Temp 1;
BA_ "SPN" SG_ 3221225472 EngFuelValve2Temp 5786;
BA_ "SigType" SG_ 3221225472 EngFuelValve2Temp 1;
BA_ "SPN" SG_ 3221225472 EngFuelValve1Temp 5785;
BA_ "SigType" SG_ 3221225472 EngFuelValve1Temp 1;
BA_ "SPN" SG_ 3221225472 EngThrottleValve2Temp 5784;
BA_ "SigType" SG_ 3221225472 EngThrottleValve2Temp 1;
BA_ "SPN" SG_ 3221225472 EngThrottleValve1Temp 5783;
BA_ "SigType" SG_ 3221225472 EngThrottleValve1Temp 1;
BA_ "SPN" SG_ 3221225472 EngFuelingDesiredRqCount 6897;
BA_ "SPN" SG_ 3221225472 EngFuelingInhibitRqCount 6896;
BA_ "SPN" SG_ 3221225472 EngGasSubstitutionFuelPercentage 6333;
BA_ "SigType" SG_ 3221225472 EngGasSubstitutionFuelPercentage 1;
BA_ "SPN" SG_ 3221225472 EngDualFuelMode 6791;
BA_ "SigType" SG_ 3221225472 EngDualFuelMode 5;
BA_ "SPN" SG_ 3221225472 SrcAddrssOfCntrllngDvcFrFlngStte 6307;
BA_ "SPN" SG_ 3221225472 EngFuelingInhibitPreventedReason 5866;
BA_ "SPN" SG_ 3221225472 EngFuelingInhibitAllowed 5795;
BA_ "SigType" SG_ 3221225472 EngFuelingInhibitAllowed 5;
BA_ "SPN" SG_ 3221225472 FeedbackEngFuelingState 5794;
BA_ "SigType" SG_ 3221225472 FeedbackEngFuelingState 5;
BA_ "SPN" SG_ 3221225472 IntmdTempPreliminaryFMI 5863;
BA_ "SPN" SG_ 3221225472 IntmdTemp 5862;
BA_ "SigType" SG_ 3221225472 IntmdTemp 1;
BA_ "SPN" SG_ 3221225472 IntmdTempPreliminaryFMI 5865;
BA_ "SPN" SG_ 3221225472 IntmdTemp 5864;
BA_ "SigType" SG_ 3221225472 IntmdTemp 1;
BA_ "SPN" SG_ 3221225472 SupplyGasMethanePercentage 5867;
BA_ "SigType" SG_ 3221225472 SupplyGasMethanePercentage 1;
BA_ "SPN" SG_ 3221225472 EngAssistStatus 7418;
BA_ "SigType" SG_ 3221225472 EngAssistStatus 5;
BA_ "SPN" SG_ 3221225472 HybrdSystmHghVltgExpsreIndicator 7454;
BA_ "SigType" SG_ 3221225472 HybrdSystmHghVltgExpsreIndicator 5;
BA_ "SPN" SG_ 3221225472 HybrdSystmIntializationIndicator 7453;
BA_ "SigType" SG_ 3221225472 HybrdSystmIntializationIndicator 5;
BA_ "SPN" SG_ 3221225472 HybrdSystmRgnrtvBrakingIndicator 7452;
BA_ "SigType" SG_ 3221225472 HybrdSystmRgnrtvBrakingIndicator 5;
BA_ "SPN" SG_ 3221225472 HybridSystemElectricAltIndicator 7451;
BA_ "SigType" SG_ 3221225472 HybridSystemElectricAltIndicator 5;
BA_ "SPN" SG_ 3221225472 HybrdSystmMtrOvrspedAudibleAlarm 7450;
BA_ "SigType" SG_ 3221225472 HybrdSystmMtrOvrspedAudibleAlarm 5;
BA_ "SPN" SG_ 3221225472 HybrdSystmMtorOverspeedIndicator 7449;
BA_ "SigType" SG_ 3221225472 HybrdSystmMtorOverspeedIndicator 5;
BA_ "SPN" SG_ 3221225472 HybridSystemServiceIndicator 7448;
BA_ "SigType" SG_ 3221225472 HybridSystemServiceIndicator 5;
BA_ "SPN" SG_ 3221225472 PropulsionSystemActive 7315;
BA_ "SigType" SG_ 3221225472 PropulsionSystemActive 5;
BA_ "SPN" SG_ 3221225472 HybridSystemOBDRelatedDTCStatus 6810;
BA_ "SigType" SG_ 3221225472 HybridSystemOBDRelatedDTCStatus 5;
BA_ "SPN" SG_ 3221225472 HybridSystemStopIndicator 5874;
BA_ "SigType" SG_ 3221225472 HybridSystemStopIndicator 5;
BA_ "SPN" SG_ 3221225472 HybridSystemOverheatIndicator 5873;
BA_ "SigType" SG_ 3221225472 HybridSystemOverheatIndicator 5;
BA_ "SPN" SG_ 3221225472 HybridSystemWarningIndicator 5872;
BA_ "SigType" SG_ 3221225472 HybridSystemWarningIndicator 5;
BA_ "SPN" SG_ 3221225472 IntmdNH3SnsrHtrCtrl 5861;
BA_ "SigType" SG_ 3221225472 IntmdNH3SnsrHtrCtrl 5;
BA_ "SPN" SG_ 3221225472 IntmdNH3SnsrHtrPreliminaryFMI 5860;
BA_ "SPN" SG_ 3221225472 IntmdNH3SnsrAtTemp 5859;
BA_ "SPN" SG_ 3221225472 IntmdNH3SnsrPwrInRange 5858;
BA_ "SigType" SG_ 3221225472 IntmdNH3SnsrPwrInRange 5;
BA_ "SPN" SG_ 3221225472 IntmdNH3ReadingStable 5857;
BA_ "SigType" SG_ 3221225472 IntmdNH3ReadingStable 5;
BA_ "SPN" SG_ 3221225472 IntmdNH3SnsrPreliminaryFMI 5856;
BA_ "SPN" SG_ 3221225472 IntmdNH3 5855;
BA_ "SigType" SG_ 3221225472 IntmdNH3 1;
BA_ "SPN" SG_ 3221225472 IntmdNH3SnsrHtrCtrl 5854;
BA_ "SigType" SG_ 3221225472 IntmdNH3SnsrHtrCtrl 5;
BA_ "SPN" SG_ 3221225472 IntmdNH3SnsrHtrPreliminaryFMI 5853;
BA_ "SPN" SG_ 3221225472 IntmdNH3SnsrAtTemp 5852;
BA_ "SigType" SG_ 3221225472 IntmdNH3SnsrAtTemp 5;
BA_ "SPN" SG_ 3221225472 IntmdNH3SnsrPwrInRange 5851;
BA_ "SigType" SG_ 3221225472 IntmdNH3SnsrPwrInRange 5;
BA_ "SPN" SG_ 3221225472 IntmdNH3ReadingStable 5850;
BA_ "SigType" SG_ 3221225472 IntmdNH3ReadingStable 5;
BA_ "SPN" SG_ 3221225472 IntmdNH3SnsrPreliminaryFMI 5849;
BA_ "SPN" SG_ 3221225472 IntmdNH3 5848;
BA_ "SigType" SG_ 3221225472 IntmdNH3 1;
BA_ "SPN" SG_ 3221225472 LnrDsplcmntSnsrSnsrFigureOfMerit 5824;
BA_ "SigType" SG_ 3221225472 LnrDsplcmntSnsrSnsrFigureOfMerit 5;
BA_ "SPN" SG_ 3221225472 MeasuredLinearDisplacement 5823;
BA_ "SigType" SG_ 3221225472 MeasuredLinearDisplacement 1;
BA_ "SPN" SG_ 3221225472 WandSensorFigureOfMerit 5822;
BA_ "SigType" SG_ 3221225472 WandSensorFigureOfMerit 5;
BA_ "SPN" SG_ 3221225472 WandAngle 5821;
BA_ "SigType" SG_ 3221225472 WandAngle 1;
BA_ "SPN" SG_ 3221225472 WirelessSignalStrength1 5753;
BA_ "SigType" SG_ 3221225472 WirelessSignalStrength1 1;
BA_ "SPN" SG_ 3221225472 TransmitterID1 5752;
BA_ "SPN" SG_ 3221225472 TransmitterCmdState 5751;
VAL_ 3221225472 GenFrequencySelection 14 "Unknown" 2 "400 Hz" 1 "60 Hz" 0 "50 Hz" ;
VAL_ 3221225472 GenGoverningSpeedCommand 3 "Don't care / take no action" 2 "Reserved" 1 "Low Idle Speed" 0 "Rated Speed" ;
VAL_ 3221225472 GenNotReadyToAutoParaState 3 "not available" 2 "error" 1 "active" 0 "inactive" ;
VAL_ 3221225472 GenCtrlNotInAutoStartState 3 "not available" 2 "error" 1 "active" 0 "inactive" ;
VAL_ 3221225472 StaticRollAngleStatus 7 "Not available" 6 "Error" 5 "Reserved" 4 "Angle Data Invalid" 3 "Sensor Reboots" 2 "Sensor Defect" 1 "Sensor OK" 0 "Sensor Busy" ;
VAL_ 3221225472 EngDualFuelModeCmd 3 "Not available" 2 "Reserved" 1 "Activate dual fuel mode" 0 "De-activate dual fuel mode" ;
VAL_ 3221225472 EngTrbCmprssrBlwffActtr1OprtnStt 15 "Not available" 14 "Error" 6 "Calibration in Progress" 5 "Uncontrolled Shutdown Active" 4 "Controlled Shutdown Active" 3 "Derate Active" 2 "Alarm High Severity" 1 "Alarm" 0 "Normal" ;
VAL_ 3221225472 EngTrbCmprssrBlwffActtr1TmpSttus 7 "Not available" 6 "Error" 5 "Not Defined" 4 "Low Most severe" 3 "Low Least severe" 2 "In Range" 1 "High Least severe" 0 "High Most severe" ;
VAL_ 3221225472 PersistentLimitStatus 7 "Not available" 6 "Non-recoverable fault" 3 "Limited low" 2 "Limited high" 1 "Operator limited/controlled" 0 "Not limited" ;
VAL_ 3221225472 MachineSelectedSpeedSource 7 "Not available" 4 "'Simulated' speed" 3 "'Blended' speed" 2 "Navigation-based speed" 1 "Ground-based speed" 0 "Wheel-based speed" ;
VAL_ 3221225472 MachineSelectedDirection 2 "Error indication" 1 "Forward" 0 "Reverse" 3 "Not available" ;
VAL_ 3221225472 DesiredEngFuelingState 3 "Don't care / Take no action" 2 "Parameter supported" 1 "Fueling desired" 0 "Fueling not desired" ;
VAL_ 3221225472 RequestedFuelType 255 "Not supported" 254 "Reserved for use in SPN 5837" 24 "Reserved for use in SPN 5837" 23 "Natural Gas" 7 "Propane" 6 "Compressed Natural Gas" 5 "Liquefied Petroleum Gas" 4 "Diesel" 3 "Ethanol" 2 "Methanol" 1 "Gasoline/petrol" 0 "Not available" ;
VAL_ 3221225472 EngGasFuelUsageInhibited 3 "Not available" 2 "Error" 1 "Gaseous Fuel Usage Inhibited" 0 "Gaseous Fuel Usage Not Inhibited" ;
VAL_ 3221225472 DrvrActvtnDmndFrAdvncdEmrgncyBrk 3 "don't' care / take no action" 2 "reserved" 1 "the driver wants the Advanced Emergency Braking System to warn or intervene if necessary" 0 "the driver does not want the Advanced Emergency Braking System to warn or intervene at any time" ;
VAL_ 3221225472 ValveFailSafeMode 3 "Don't Care" 2 "Reserved" 1 "Float" 0 "Block" ;
VAL_ 3221225472 ValveState 15 "Don't Care" 3 "Floating" 2 "Retract" 1 "Extend" 0 "Blocked" ;
VAL_ 3221225472 NMControlModeIndicator 0 "SetPendingName" 1 "PendingName" 2 "CurrentName" 3 "NameACK" 4 "NameNACK" 5 "ReqPendingName" 6 "ReqCurrentName" 7 "AdoptPendingName" 8 "ReqNameAddressClaim" ;
VAL_ 3221225472 ErrorCode 0 "Security not satisfied" 1 "Item(s) not allowed to change" 2 "Item conflict" 3 "Checksum does not match" 4 "Pending Name not set" 255 "Not Available" 5 "Other" ;
VAL_ 3221225472 SwitchedPowerOutput18Cmd 3 "Take no action" 2 "Reserved" 1 "Output on" 0 "Output off" ;
VAL_ 3221225472 SwitchedPowerOutput19Cmd 3 "Take no action" 2 "Reserved" 1 "Output on" 0 "Output off" ;
VAL_ 3221225472 SwitchedPowerOutput20Cmd 3 "Take no action" 2 "Reserved" 1 "Output on" 0 "Output off" ;
VAL_ 3221225472 SwitchedPowerOutput13Cmd 3 "Take no action" 2 "Reserved" 1 "Output on" 0 "Output off" ;
VAL_ 3221225472 SwitchedPowerOutput14Cmd 3 "Take no action" 2 "Reserved" 1 "Output on" 0 "Output off" ;
VAL_ 3221225472 SwitchedPowerOutput15Cmd 3 "Take no action" 2 "Reserved" 1 "Output on" 0 "Output off" ;
VAL_ 3221225472 SwitchedPowerOutput16Cmd 3 "Take no action" 2 "Reserved" 1 "Output on" 0 "Output off" ;
VAL_ 3221225472 SwitchedPowerOutput9Cmd 3 "Take no action" 2 "Reserved" 1 "Output on" 0 "Output off" ;
VAL_ 3221225472 SwitchedPowerOutput10Cmd 3 "Take no action" 2 "Reserved" 1 "Output on" 0 "Output off" ;
VAL_ 3221225472 SwitchedPowerOutput29Cmd 3 "Take no action" 2 "Reserved" 1 "Output on" 0 "Output off" ;
VAL_ 3221225472 SwitchedPowerOutput30Cmd 3 "Take no action" 2 "Reserved" 1 "Output on" 0 "Output off" ;
VAL_ 3221225472 SwitchedPowerOutput31Cmd 3 "Take no action" 2 "Reserved" 1 "Output on" 0 "Output off" ;
VAL_ 3221225472 SwitchedPowerOutput32Cmd 3 "Take no action" 2 "Reserved" 1 "Output on" 0 "Output off" ;
VAL_ 3221225472 SwitchedPowerOutput25Cmd 3 "Take no action" 2 "Reserved" 1 "Output on" 0 "Output off" ;
VAL_ 3221225472 SwitchedPowerOutput26Cmd 3 "Take no action" 2 "Reserved" 1 "Output on" 0 "Output off" ;
VAL_ 3221225472 SwitchedPowerOutput27Cmd 3 "Take no action" 2 "Reserved" 1 "Output on" 0 "Output off" ;
VAL_ 3221225472 SwitchedPowerOutput28Cmd 3 "Take no action" 2 "Reserved" 1 "Output on" 0 "Output off" ;
VAL_ 3221225472 SwitchedPowerOutput21Cmd 3 "Take no action" 2 "Reserved" 1 "Output on" 0 "Output off" ;
VAL_ 3221225472 SwitchedPowerOutput22Cmd 3 "Take no action" 2 "Reserved" 1 "Output on" 0 "Output off" ;
VAL_ 3221225472 SwitchedPowerOutput23Cmd 3 "Take no action" 2 "Reserved" 1 "Output on" 0 "Output off" ;
VAL_ 3221225472 SwitchedPowerOutput24Cmd 3 "Take no action" 2 "Reserved" 1 "Output on" 0 "Output off" ;
VAL_ 3221225472 SwitchedPowerOutput17Cmd 3 "Take no action" 2 "Reserved" 1 "Output on" 0 "Output off" ;
VAL_ 3221225472 SwitchedPowerOutput11Cmd 3 "Take no action" 2 "Reserved" 1 "Output on" 0 "Output off" ;
VAL_ 3221225472 SwitchedPowerOutput12Cmd 3 "Take no action" 2 "Reserved" 1 "Output on" 0 "Output off" ;
VAL_ 3221225472 SwitchedPowerOutput5Cmd 3 "Take no action" 2 "Reserved" 1 "Output on" 0 "Output off" ;
VAL_ 3221225472 SwitchedPowerOutput6Cmd 3 "Take no action" 2 "Reserved" 1 "Output on" 0 "Output off" ;
VAL_ 3221225472 SwitchedPowerOutput7Cmd 3 "Take no action" 2 "Reserved" 1 "Output on" 0 "Output off" ;
VAL_ 3221225472 SwitchedPowerOutput8Cmd 3 "Take no action" 2 "Reserved" 1 "Output on" 0 "Output off" ;
VAL_ 3221225472 SwitchedPowerOutput1Cmd 3 "Take no action" 2 "Reserved" 1 "Output on" 0 "Output off" ;
VAL_ 3221225472 SwitchedPowerOutput2Cmd 3 "Take no action" 2 "Reserved" 1 "Output on" 0 "Output off" ;
VAL_ 3221225472 SwitchedPowerOutput3Cmd 3 "Take no action" 2 "Reserved" 1 "Output on" 0 "Output off" ;
VAL_ 3221225472 SwitchedPowerOutput4Cmd 3 "Take no action" 2 "Reserved" 1 "Output on" 0 "Output off" ;
VAL_ 3221225472 TransMode10 3 "Take no action" 2 "Reserved" 1 "Enable" 0 "Disable" ;
VAL_ 3221225472 TransMode9 3 "Take no action" 2 "Reserved" 1 "Enable" 0 "Disable" ;
VAL_ 3221225472 EngFuelIsolationCtrl 3 "Don't care / take no action" 2 "Reserved" 1 "Gaseous Fuel is Used" 0 "Gaseous Fuel Migration is Prevented" ;
VAL_ 3221225472 FuelType 255 "Not available, Parameter not supported)" 254 "Error" 28 "Dual Fuel, Diesel and LNG" 27 "Dual Fuel, Diesel and CNG" 26 "Natural Gas, Compressed or Liquefied Natural Gas)" 25 "Bi-fuel using diesel" 24 "Bi-fuel vehicle using NG" 23 "Natural Gas, NG)" 22 "Hybrid vehicle in regeneration mode" 21 "Hybrid vehicle using battery and combustion engine" 20 "Hybrid vehicle using battery" 19 "Hybrid vehicle using diesel engine" 18 "Hybrid vehicle using gasoline engine on ethanol" 17 "Hybrid vehicle using gasoline engine" 16 "Bi-fuel vehicle using battery and combustion engine" 15 "Bi-fuel vehicle using battery" 14 "Bi-fuel vehicle using propane" 13 "Bi-fuel vehicle using CNG" 12 "Bi-fuel vehicle using LPG" 11 "Bi-fuel vehicle using ethanol" 10 "Bi-fuel vehicle using methanol" 9 "Bi-fuel vehicle using gasoline" 8 "Battery/electric" 7 "Propane" 6 "Compressed Natural Gas" 5 "Liquefied Petroleum Gas" 4 "Diesel" 3 "Ethanol" 2 "Methanol" 1 "Gasoline/petrol" 0 "Not available, NONE" ;
VAL_ 3221225472 AFT2InNOxSnsrSelfDiagTrigger 15 "Not supported" 4 "NOx Sensor ATI2 Self Diagnosis Request at After Run" 3 "NOx Sensor ATI2 Self Diagnosis Request at fuel cut" 2 "NOx Sensor ATI2 Self Diagnosis Request at partial load" 1 "NOx Sensor ATI2 Self Diagnosis Request at Lambda=1.0" 0 "Diagnostic mode disabled" ;
VAL_ 3221225472 AFT2OutNOxSnsrSelfDiagTrigger 15 "Not supported" 4 "NOx Sensor ATO2 Self Diagnosis Request at After Run" 3 "NOx Sensor ATO2 Self Diagnosis Request at fuel cut" 2 "NOx Sensor ATO2 Self Diagnosis Request at partial load" 1 "NOx Sensor ATO2 Self Diagnosis Request at Lambda=1.0" 0 "Diagnostic mode disabled" ;
VAL_ 3221225472 AFT1InNOxSnsrSelfDiagTrigger 2 "NOx Sensor ATI1 Self Diagnosis Request at partial load" 1 "NOx Sensor ATI1 Self Diagnosis Request at Lambda=1.0" 0 "Diagnostic mode disabled" 15 "Not supported" 4 "NOx Sensor ATI1 Self Diagnosis Request at After Run" 3 "NOx Sensor ATI1 Self Diagnosis Request at fuel cut" ;
VAL_ 3221225472 AFT1OutNOxSnsrSelfDiagTrigger 15 "Not supported" 4 "NOx Sensor ATO1 Self Diagnosis Request at After Run" 3 "NOx Sensor ATO1 Self Diagnosis Request at fuel cut" 2 "NOx Sensor ATO1 Self Diagnosis Request at partial load" 1 "NOx Sensor ATO1 Self Diagnosis Request at Lambda=1.0" 0 "Diagnostic mode disabled" ;
VAL_ 3221225472 AFT2OutGasSnsrPwrSupply 3 "Unavailable" 2 "Error" 1 "On: The ECU is powering the Aftertreatment 2 Outlet Gas Sensor" 0 "Off" ;
VAL_ 3221225472 AFT2InGasSnsrPwrSupply 3 "Unavailable" 2 "Error" 1 "On: The ECU is powering the Aftertreatment 2 Intake Gas Sensor" 0 "Off" ;
VAL_ 3221225472 AFT1OutGasSnsrPwrSupply 3 "Unavailable" 2 "Error" 1 "On: The ECU is powering the Aftertreatment 1 Outlet Gas Sensor" 0 "Off" ;
VAL_ 3221225472 AFT1InGasSnsrPwrSupply 3 "Unavailable" 2 "Error" 1 "On: The ECU is powering the Aftertreatment 1 Intake Gas Sensor" 0 "Off" ;
VAL_ 3221225472 EngExhstGsRcrcltn1Acttr2OprtnStt 15 "Not available" 14 "Error" 5 "Uncontrolled Shutdown Active" 4 "Controlled Shutdown Active" 3 "Derate Active" 2 "Alarm High Severity" 1 "Alarm" 0 "Normal" ;
VAL_ 3221225472 EngExhstGsRcrcltn1Acttr1OprtnStt 15 "Not available" 14 "Error" 5 "Uncontrolled Shutdown Active" 4 "Controlled Shutdown Active" 3 "Derate Active" 2 "Alarm High Severity" 1 "Alarm" 0 "Normal" ;
VAL_ 3221225472 EngExhstGsRcrcltn1Acttr2TmpSttus 7 "Not available" 6 "Error" 5 "Not Defined" 4 "Low Most severe" 3 "Low Least severe" 2 "In Range " 1 "High Least severe" 0 "High Most severe" ;
VAL_ 3221225472 EngExhstGsRcrcltn1Acttr1TmpSttus 7 "Not available" 6 "Error" 5 "Not Defined" 4 "Low Most severe" 3 "Low Least severe" 2 "In Range " 1 "High Least severe" 0 "High Most severe" ;
VAL_ 3221225472 EngExhstGsRcrcltn2Acttr2OprtnStt 15 "Not available" 14 "Error" 5 "Uncontrolled Shutdown Active" 4 "Controlled Shutdown Active" 3 "Derate Active" 2 "Alarm High Severity" 1 "Alarm" 0 "Normal" ;
VAL_ 3221225472 EngExhstGsRcrcltn2Acttr1OprtnStt 15 "Not available" 14 "Error" 5 "Uncontrolled Shutdown Active" 4 "Controlled Shutdown Active" 3 "Derate Active" 2 "Alarm High Severity" 1 "Alarm" 0 "Normal" ;
VAL_ 3221225472 EngExhstGsRcrcltn2Acttr2TmpSttus 7 "Not available" 6 "Error" 5 "Not Defined" 4 "Low Most severe" 3 "Low Least severe" 2 "In Range " 1 "High Least severe" 0 "High Most severe" ;
VAL_ 3221225472 EngExhstGsRcrcltn2Acttr1TmpSttus 7 "Not available" 6 "Error" 5 "Not Defined" 4 "Low Most severe" 3 "Low Least severe" 2 "In Range " 1 "High Least severe" 0 "High Most severe" ;
VAL_ 3221225472 EngFuelingDesiredRqCount 3 "More than 10 active fueling desired requests" ;
VAL_ 3221225472 EngFuelingInhibitRqCount 3 "More than 10 active fueling inhibit requests" ;
VAL_ 3221225472 EngDualFuelMode 3 "Not available" 2 "Reserved" 1 "Actual dual fuel mode on" 0 "Actual dual fuel mode off" ;
VAL_ 3221225472 EngFuelingInhibitPreventedReason 15 "Not Supported" 12 "Low idle governor operation required" 11 "Engine driven fan request" 10 "Maximum number of engine fuelling inhibit requests" 9 "Insufficient SLI battery charge" 8 "Engine protection" 7 "Engine load too high" 6 "Aftertreatment Protection" 5 "Aftertreatment system is cold" 4 "Service Override" 3 "Engine is cold" 2 "Oil Distribution in engine is incomplete" 1 "Aftertreatment regeneration is active or preparing to be active" 0 "Fueling inhibit allowed" ;
VAL_ 3221225472 EngFuelingInhibitAllowed 3 "Not Supported" 2 "SAE Reserved" 1 "Engine will stop fueling in response to SPN 5793 Desired Engine Fueling State" 0 "Engine currently will not stop fueling in response to SPN 5793 Desired Engine Fueling State" ;
VAL_ 3221225472 FeedbackEngFuelingState 3 "Not Supported" 2 "No active request per SPN 5793 Desired Engine Fueling State or SPN 5795 Engine Fueling Inhibit Allowed = 00" 1 "Engine will be kept running" 0 "Fueling is or will be inhibited" ;
VAL_ 3221225472 EngAssistStatus 3 "Not Available" 2 "Error" 1 "Hybrid system may or may not mechanically assist engine rotation" 0 "Hybrid system is not mechanically assisting engine rotation" ;
VAL_ 3221225472 HybrdSystmHghVltgExpsreIndicator 3 "Not Available" 2 "Error" 1 "System is operational and has detected a compromise" 0 "System is operational and intact" ;
VAL_ 3221225472 HybrdSystmIntializationIndicator 3 "Not Available" 2 "Error" 1 "Hybrid System Initialization Indicator is active" 0 "Hybrid System Initialization Indicator is not active" ;
VAL_ 3221225472 HybrdSystmRgnrtvBrakingIndicator 3 "Not Available" 2 "Regenerative braking is disabled or faulted " 1 "Regenerative braking is active" 0 "Regenerative braking is inactive" ;
VAL_ 3221225472 HybridSystemElectricAltIndicator 3 "Not Available" 2 "Alternator Indicator is flashing" 1 "Alternator Indicator is on" 0 "Alternator Indicator is off" ;
VAL_ 3221225472 HybrdSystmMtrOvrspedAudibleAlarm 3 "Not Available" 2 "Error" 1 "Motor Overspeed Audible Alarm is on" 0 "Motor Overspeed Audible Alarm is off" ;
VAL_ 3221225472 HybrdSystmMtorOverspeedIndicator 3 "Not Available" 2 "Hybrid System Motor Overspeed Indicator is flashing" 1 "Hybrid System Motor Overspeed Indicator is on continously" 0 "Hybrid System Motor Overspeed Indicator is off" ;
VAL_ 3221225472 HybridSystemServiceIndicator 3 "Not Available" 2 "Hybrid Service Indicator is flashing" 1 "Hybrid Service Indicator is on continously" 0 "Hybrid Service Indicator is off" ;
VAL_ 3221225472 PropulsionSystemActive 3 "Not Available" 2 "SAE Reserved" 1 "Propulsion System is ready to move" 0 "Propulsion System is not ready to move vehicle if commanded by operator" ;
VAL_ 3221225472 HybridSystemOBDRelatedDTCStatus 3 "Not available" 2 "SAE Reserved" 1 "Hybrid System has an active OBD related DTC" 0 "Hybrid System does not have an active OBD related DTC" ;
VAL_ 3221225472 HybridSystemStopIndicator 3 "Not available" 2 "Hybrid System Stop Indicator is flashing" 1 "Hybrid System Stop Indicator is on continuously" 0 "Hybrid System Stop Indicator is off" ;
VAL_ 3221225472 HybridSystemOverheatIndicator 3 "Not available" 2 "Hybrid System Temperature Indicator is flashing" 1 "Hybrid System Temperature Indicator is on continuously" 0 "Hybrid System Temperature Indicator is off" ;
VAL_ 3221225472 HybridSystemWarningIndicator 3 "Not available" 2 "Hybrid System Warning Indicator is flashing" 1 "Hybrid System Warning Indicator is on continuously" 0 "Hybrid System Warning Indicator is off" ;
VAL_ 3221225472 IntmdNH3SnsrHtrCtrl 3 "Heater off or Not available" 2 "Preheat 1 " 1 "Preheat 2 " 0 "Automatic " ;
VAL_ 3221225472 IntmdNH3SnsrAtTemp 3 "Not available" 2 "Error" 1 "Heater element is in range" 0 "Heater element is not in range" ;
VAL_ 3221225472 IntmdNH3SnsrPwrInRange 3 "Not available" 2 "Error" 1 "Heater element is in range" 0 "Heater element is not in range" ;
VAL_ 3221225472 IntmdNH3ReadingStable 3 "Not available" 2 "Error" 1 "Reading is stable" 0 "Reading is not stable" ;
VAL_ 3221225472 IntmdNH3SnsrHtrCtrl 3 "Heater off or not available" 2 "Preheat 1 " 1 "Preheat 2 " 0 "Automatic " ;
VAL_ 3221225472 IntmdNH3SnsrAtTemp 3 "Not available" 2 "Error" 1 "Heater element is in range" 0 "Heater element is not in range" ;
VAL_ 3221225472 IntmdNH3SnsrPwrInRange 3 "Not available" 2 "Error" 1 "Power is in range" 0 "Power is not in range" ;
VAL_ 3221225472 IntmdNH3ReadingStable 3 "Not available" 2 "Error" 1 "Reading is stable" 0 "Reading is not stable" ;
VAL_ 3221225472 LnrDsplcmntSnsrSnsrFigureOfMerit 3 "Sensor not available" 2 "Sensor failed" 1 "Sensor degraded" 0 "Sensor fully functional" ;
VAL_ 3221225472 WandSensorFigureOfMerit 3 "Sensor not available" 2 "Sensor failed" 1 "Sensor degraded" 0 "Sensor fully functional" ;
VAL_ 3221225472 TransmitterCmdState 15 "Don't Care" 14 "Error" 4 "Standby" 3 "Transmitter Test" 2 "Field Test" 1 "Clear" 0 "Stop" ;
