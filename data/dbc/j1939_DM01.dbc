VERSION ""

NS_ :

BS_:

BU_: PowertrainControlModule AtmosphericSensor SafetyRestraintSystem2 Aftertreatment_2_GasOutlet Aftertreatment_2_GasIntake DieselPartFilterControl Turbocharger SafetyRestraintSystem1 CabDisplay2 Aftertreatment_1_GasOutlet Aftertreatment_1_GasIntake OnBoardDataLogger OffBoardDiagnosticTool2 OffBoardDiagnosticTool1 FileServer ParkingBrakeController SeatController2 FanDriveController SteeringColumnUnit CommunicationUnitRadio CommunicationUnitSatellite CommunicationUnitCellular PropulsionBatteryCharger ChassisController2 ChassisController1 EngineValveControl AuxiliaryHeater2 AuxiliaryHeater1 ClutchUnit RampControl InformationSystem1 SuspensionSystemController2 OilSensor VehicleDynamicStability ExhaustEmissionController TransmissionDisplay2 TransmissionDisplay1 ClimateControl2 WaterPumpController RearAxleSteeringController LightingOperatorControl SeatController1 IgnitionController2 IgnitionController1 TirePressureController CabController2 CabController1 PneumaticSystemController SuspensionSystemController1 HydraulicPumpController EnduranceBrakingSystem RetarderExhaustEngine2 OnBoardDiagnosticUnit HeadwayController RetarderExhaustEngine1 CabDisplay1 ManagementComputer VirtualTerminal OffVehicleGateway PowerTakeOffFront HitchControl AuxiliaryValveControl BodyController TractorTrailerBridge1 StarterSystem ElectricalSystem VehicleSecurity VehicleNavigation AerodynamicControl ElectricalChargingSystem ClimateControl1 TripRecorder InstrumentCluster SuspensionDriveAxle2 SuspensionDriveAxle1 SuspensionSteerAxle SteeringController FuelSystem CruiseControl RetarderDriveline RetarderEngine BrakesDriveAxle2 BrakesDriveAxle1 BrakesSystemController BrakesSteerAxle AxleDrive2 AxleDrive1 AxleSteering PowerTakeOff ShiftConsoleSecondary ShiftConsolePrimary Transmission2 Transmission1 Engine2 Engine1

BO_ 3221225472 VECTOR__INDEPENDENT_SIG_MSG: 0 Vector__XXX
 SG_ Joystick7Button12PressedStatus : 0|2@1+ (1,0) [0|3] "" Vector__XXX
 SG_ Joystick7Button5PressedStatus : 0|2@1+ (1,0) [0|3] "" Vector__XXX
 SG_ Joystick7Button6PressedStatus : 0|2@1+ (1,0) [0|3] "" Vector__XXX
 SG_ Joystick7Button7PressedStatus : 0|2@1+ (1,0) [0|3] "" Vector__XXX
 SG_ Joystick7Button8PressedStatus : 0|2@1+ (1,0) [0|3] "" Vector__XXX
 SG_ Joystick7Button1PressedStatus : 0|2@1+ (1,0) [0|3] "" Vector__XXX
 SG_ Joystick7Button2PressedStatus : 0|2@1+ (1,0) [0|3] "" Vector__XXX
 SG_ Joystick7Button3PressedStatus : 0|2@1+ (1,0) [0|3] "" Vector__XXX
 SG_ Joystick7Button4PressedStatus : 0|2@1+ (1,0) [0|3] "" Vector__XXX
 SG_ Joystick7XAxisDetentPosStatus : 0|2@1+ (1,0) [0|3] "" Vector__XXX
 SG_ Joystick7YAxisDetentPosStatus : 0|2@1+ (1,0) [0|3] "" Vector__XXX
 SG_ Joystick7YAxisPos : 0|10@1+ (0.1,0) [0|102] "%" Vector__XXX
 SG_ Jystck7YAxsLvrFrwrdPstvPosStatus : 0|2@1+ (1,0) [0|3] "" Vector__XXX
 SG_ Jystck7YAxsLvrBckNgtivePosStatus : 0|2@1+ (1,0) [0|3] "" Vector__XXX
 SG_ Joystick7YAxisNeutralPosStatus : 0|2@1+ (1,0) [0|3] "" Vector__XXX
 SG_ Joystick7XAxisPos : 0|10@1+ (0.1,0) [0|102] "%" Vector__XXX
 SG_ Jystck7XAxsLvrRghtPstvePosStatus : 0|2@1+ (1,0) [0|3] "" Vector__XXX
 SG_ Jystck7XAxsLvrLftNgtivePosStatus : 0|2@1+ (1,0) [0|3] "" Vector__XXX
 SG_ Joystick7XAxisNeutralPosStatus : 0|2@1+ (1,0) [0|3] "" Vector__XXX
 SG_ Joystick6Button9PressedStatus : 0|2@1+ (1,0) [0|3] "" Vector__XXX
 SG_ Joystick6Button10PressedStatus : 0|2@1+ (1,0) [0|3] "" Vector__XXX
 SG_ Joystick6Button11PressedStatus : 0|2@1+ (1,0) [0|3] "" Vector__XXX
 SG_ Joystick6Button12PressedStatus : 0|2@1+ (1,0) [0|3] "" Vector__XXX
 SG_ Joystick6Button5PressedStatus : 0|2@1+ (1,0) [0|3] "" Vector__XXX
 SG_ Joystick6Button6PressedStatus : 0|2@1+ (1,0) [0|3] "" Vector__XXX
 SG_ Joystick6Button7PressedStatus : 0|2@1+ (1,0) [0|3] "" Vector__XXX
 SG_ Joystick6Button8PressedStatus : 0|2@1+ (1,0) [0|3] "" Vector__XXX
 SG_ Joystick6Button1PressedStatus : 0|2@1+ (1,0) [0|3] "" Vector__XXX
 SG_ Joystick6Button2PressedStatus : 0|2@1+ (1,0) [0|3] "" Vector__XXX
 SG_ Joystick6Button3PressedStatus : 0|2@1+ (1,0) [0|3] "" Vector__XXX
 SG_ Joystick6Button4PressedStatus : 0|2@1+ (1,0) [0|3] "" Vector__XXX
 SG_ Joystick6XAxisDetentPosStatus : 0|2@1+ (1,0) [0|3] "" Vector__XXX
 SG_ Joystick6YAxisDetentPosStatus : 0|2@1+ (1,0) [0|3] "" Vector__XXX
 SG_ Joystick6YAxisPos : 0|10@1+ (0.1,0) [0|102] "%" Vector__XXX
 SG_ Jystck6YAxsLvrFrwrdPstvPosStatus : 0|2@1+ (1,0) [0|3] "" Vector__XXX
 SG_ Jystck6YAxsLvrBckNgtivePosStatus : 0|2@1+ (1,0) [0|3] "" Vector__XXX
 SG_ Joystick6YAxisNeutralPosStatus : 0|2@1+ (1,0) [0|3] "" Vector__XXX
 SG_ Joystick6XAxisPos : 0|10@1+ (0.1,0) [0|102] "%" Vector__XXX
 SG_ Jystck6XAxsLvrRghtPstvePosStatus : 0|2@1+ (1,0) [0|3] "" Vector__XXX
 SG_ Jystck6XAxsLvrLftNgtivePosStatus : 0|2@1+ (1,0) [0|3] "" Vector__XXX
 SG_ Joystick6XAxisNeutralPosStatus : 0|2@1+ (1,0) [0|3] "" Vector__XXX
 SG_ Joystick5Button9PressedStatus : 0|2@1+ (1,0) [0|3] "" Vector__XXX
 SG_ Joystick5Button10PressedStatus : 0|2@1+ (1,0) [0|3] "" Vector__XXX
 SG_ Joystick5Button11PressedStatus : 0|2@1+ (1,0) [0|3] "" Vector__XXX
 SG_ Joystick5Button12PressedStatus : 0|2@1+ (1,0) [0|3] "" Vector__XXX
 SG_ Joystick5Button5PressedStatus : 0|2@1+ (1,0) [0|3] "" Vector__XXX
 SG_ Joystick5Button6PressedStatus : 0|2@1+ (1,0) [0|3] "" Vector__XXX
 SG_ Joystick5Button7PressedStatus : 0|2@1+ (1,0) [0|3] "" Vector__XXX
 SG_ Joystick5Button8PressedStatus : 0|2@1+ (1,0) [0|3] "" Vector__XXX
 SG_ Joystick5Button1PressedStatus : 0|2@1+ (1,0) [0|3] "" Vector__XXX
 SG_ Joystick5Button2PressedStatus : 0|2@1+ (1,0) [0|3] "" Vector__XXX
 SG_ Joystick5Button3PressedStatus : 0|2@1+ (1,0) [0|3] "" Vector__XXX
 SG_ Joystick5Button4PressedStatus : 0|2@1+ (1,0) [0|3] "" Vector__XXX
 SG_ Joystick5XAxisDetentPosStatus : 0|2@1+ (1,0) [0|3] "" Vector__XXX
 SG_ Joystick5YAxisDetentPosStatus : 0|2@1+ (1,0) [0|3] "" Vector__XXX
 SG_ Joystick5YAxisPos : 0|10@1+ (0.1,0) [0|102] "%" Vector__XXX
 SG_ Jystck5YAxsLvrFrwrdPstvPosStatus : 0|2@1+ (1,0) [0|3] "" Vector__XXX
 SG_ Jystck5YAxsLvrBckNgtivePosStatus : 0|2@1+ (1,0) [0|3] "" Vector__XXX
 SG_ Joystick5YAxisNeutralPosStatus : 0|2@1+ (1,0) [0|3] "" Vector__XXX
 SG_ Joystick5XAxisPos : 0|10@1+ (0.1,0) [0|102] "%" Vector__XXX
 SG_ Jystck5XAxsLvrRghtPstvePosStatus : 0|2@1+ (1,0) [0|3] "" Vector__XXX
 SG_ Jystck5XAxsLvrLftNgtivePosStatus : 0|2@1+ (1,0) [0|3] "" Vector__XXX
 SG_ Joystick5XAxisNeutralPosStatus : 0|2@1+ (1,0) [0|3] "" Vector__XXX
 SG_ Joystick4Button9PressedStatus : 0|2@1+ (1,0) [0|3] "" Vector__XXX
 SG_ Joystick4Button10PressedStatus : 0|2@1+ (1,0) [0|3] "" Vector__XXX
 SG_ Joystick4Button11PressedStatus : 0|2@1+ (1,0) [0|3] "" Vector__XXX
 SG_ Joystick4Button12PressedStatus : 0|2@1+ (1,0) [0|3] "" Vector__XXX
 SG_ Joystick4Button5PressedStatus : 0|2@1+ (1,0) [0|3] "" Vector__XXX
 SG_ Joystick4Button6PressedStatus : 0|2@1+ (1,0) [0|3] "" Vector__XXX
 SG_ Joystick4Button7PressedStatus : 0|2@1+ (1,0) [0|3] "" Vector__XXX
 SG_ Joystick4Button8PressedStatus : 0|2@1+ (1,0) [0|3] "" Vector__XXX
 SG_ Joystick4Button1PressedStatus : 0|2@1+ (1,0) [0|3] "" Vector__XXX
 SG_ Joystick4Button2PressedStatus : 0|2@1+ (1,0) [0|3] "" Vector__XXX
 SG_ Joystick4Button3PressedStatus : 0|2@1+ (1,0) [0|3] "" Vector__XXX
 SG_ Joystick4Button4PressedStatus : 0|2@1+ (1,0) [0|3] "" Vector__XXX
 SG_ Joystick4XAxisDetentPosStatus : 0|2@1+ (1,0) [0|3] "" Vector__XXX
 SG_ Joystick4YAxisDetentPosStatus : 0|2@1+ (1,0) [0|3] "" Vector__XXX
 SG_ Joystick4YAxisPos : 0|10@1+ (0.1,0) [0|102] "%" Vector__XXX
 SG_ Jystck4YAxsLvrFrwrdPstvPosStatus : 0|2@1+ (1,0) [0|3] "" Vector__XXX
 SG_ Jystck4YAxsLvrBckNgtivePosStatus : 0|2@1+ (1,0) [0|3] "" Vector__XXX
 SG_ Joystick4YAxisNeutralPosStatus : 0|2@1+ (1,0) [0|3] "" Vector__XXX
 SG_ Joystick4XAxisPos : 0|10@1+ (0.1,0) [0|102] "%" Vector__XXX
 SG_ Jystck4XAxsLvrRghtPstvePosStatus : 0|2@1+ (1,0) [0|3] "" Vector__XXX
 SG_ Jystck4XAxsLvrLftNgtivePosStatus : 0|2@1+ (1,0) [0|3] "" Vector__XXX
 SG_ Joystick4XAxisNeutralPosStatus : 0|2@1+ (1,0) [0|3] "" Vector__XXX
 SG_ Joystick10Button9PressedStatus : 0|2@1+ (1,0) [0|3] "" Vector__XXX
 SG_ Joystick10Button10PressedStatus : 0|2@1+ (1,0) [0|3] "" Vector__XXX
 SG_ Joystick10Button11PressedStatus : 0|2@1+ (1,0) [0|3] "" Vector__XXX
 SG_ Joystick10Button12PressedStatus : 0|2@1+ (1,0) [0|3] "" Vector__XXX
 SG_ Joystick10Button5PressedStatus : 0|2@1+ (1,0) [0|3] "" Vector__XXX
 SG_ Joystick10Button6PressedStatus : 0|2@1+ (1,0) [0|3] "" Vector__XXX
 SG_ Joystick10Button7PressedStatus : 0|2@1+ (1,0) [0|3] "" Vector__XXX
 SG_ Joystick10Button8PressedStatus : 0|2@1+ (1,0) [0|3] "" Vector__XXX
 SG_ Joystick10Button1PressedStatus : 0|2@1+ (1,0) [0|3] "" Vector__XXX
 SG_ Joystick10Button2PressedStatus : 0|2@1+ (1,0) [0|3] "" Vector__XXX
 SG_ Joystick10Button3PressedStatus : 0|2@1+ (1,0) [0|3] "" Vector__XXX
 SG_ Joystick10Button4PressedStatus : 0|2@1+ (1,0) [0|3] "" Vector__XXX
 SG_ Joystick10XAxisDetentPosStatus : 0|2@1+ (1,0) [0|3] "" Vector__XXX
 SG_ Joystick10YAxisDetentPosStatus : 0|2@1+ (1,0) [0|3] "" Vector__XXX
 SG_ Joystick10YAxisPos : 0|10@1+ (0.1,0) [0|102] "%" Vector__XXX
 SG_ Jystck10YAxsLvrFrwrdPstvPsStatus : 0|2@1+ (1,0) [0|3] "" Vector__XXX
 SG_ Jystck10YAxsLvrBckNgtvePosStatus : 0|2@1+ (1,0) [0|3] "" Vector__XXX
 SG_ Joystick10YAxisNeutralPosStatus : 0|2@1+ (1,0) [0|3] "" Vector__XXX
 SG_ Joystick10XAxisPos : 0|10@1+ (0.1,0) [0|102] "%" Vector__XXX
 SG_ Jystck10XAxsLvrRghtPstvPosStatus : 0|2@1+ (1,0) [0|3] "" Vector__XXX
 SG_ Jystck10XAxsLvrLftNgtvePosStatus : 0|2@1+ (1,0) [0|3] "" Vector__XXX
 SG_ Joystick10XAxisNeutralPosStatus : 0|2@1+ (1,0) [0|3] "" Vector__XXX
 SG_ PssngrArbgDctivationSwitchStatus : 0|2@1+ (1,0) [0|3] "" Vector__XXX
 SG_ Beltlock10Status : 0|2@1+ (1,0) [0|3] "" Vector__XXX
 SG_ Beltlock9Status : 0|2@1+ (1,0) [0|3] "" Vector__XXX
 SG_ Beltlock8Status : 0|2@1+ (1,0) [0|3] "" Vector__XXX
 SG_ Beltlock7Status : 0|2@1+ (1,0) [0|3] "" Vector__XXX
 SG_ Beltlock6Status : 0|2@1+ (1,0) [0|3] "" Vector__XXX
 SG_ Beltlock5Status : 0|2@1+ (1,0) [0|3] "" Vector__XXX
 SG_ Beltlock4Status : 0|2@1+ (1,0) [0|3] "" Vector__XXX
 SG_ Beltlock3Status : 0|2@1+ (1,0) [0|3] "" Vector__XXX
 SG_ PassengerBeltlockStatus : 0|2@1+ (1,0) [0|3] "" Vector__XXX
 SG_ DriverBeltlockStatus : 0|2@1+ (1,0) [0|3] "" Vector__XXX
 SG_ BatteryCharger2OutputCurrent : 0|16@1+ (0.05,-1600) [-1600|1612.75] "A" Vector__XXX
 SG_ BatteryCharger2OutputVoltage : 0|16@1+ (0.05,0) [0|3212.75] "V" Vector__XXX
 SG_ BatteryCharger2PowerLineState : 0|2@1+ (1,0) [0|3] "" Vector__XXX
 SG_ BatteryCharger2State : 0|4@1+ (1,0) [0|15] "" Vector__XXX
 SG_ BatteryCharger1OutputCurrent : 0|16@1+ (0.05,-1600) [-1600|1612.75] "A" Vector__XXX
 SG_ BatteryCharger1OutputVoltage : 0|16@1+ (0.05,0) [0|3212.75] "V" Vector__XXX
 SG_ BatteryCharger1PowerLineState : 0|2@1+ (1,0) [0|3] "" Vector__XXX
 SG_ BatteryCharger1State : 0|4@1+ (1,0) [0|15] "" Vector__XXX
 SG_ TwoTWCDiffTemp : 0|16@1+ (0.03125,-273) [-273|1734.96875] "°C" Vector__XXX
 SG_ OneTWCDiffTemp : 0|16@1+ (0.03125,-273) [-273|1734.96875] "°C" Vector__XXX
 SG_ TwoGOCDiffTemp : 0|16@1+ (0.03125,-273) [-273|1734.96875] "°C" Vector__XXX
 SG_ OneGOCDiffTemp : 0|16@1+ (0.03125,-273) [-273|1734.96875] "°C" Vector__XXX
 SG_ OutTemp : 0|16@1+ (0.03125,-273) [-273|1734.96875] "°C" Vector__XXX
 SG_ InTemp : 0|16@1+ (0.03125,-273) [-273|1734.96875] "°C" Vector__XXX
 SG_ DiffPressPreliminaryFMI : 0|5@1+ (1,0) [0|31] "" Vector__XXX
 SG_ OutTempPreliminaryFMI : 0|5@1+ (1,0) [0|31] "" Vector__XXX
 SG_ InTempPreliminaryFMI : 0|5@1+ (1,0) [0|31] "" Vector__XXX
 SG_ DiffPress : 0|16@1+ (0.1,0) [0|6425.5] "kPa" Vector__XXX
 SG_ OutTemp : 0|16@1+ (0.03125,-273) [-273|1734.96875] "°C" Vector__XXX
 SG_ InTemp : 0|16@1+ (0.03125,-273) [-273|1734.96875] "°C" Vector__XXX
 SG_ CorrectedNOx : 0|16@1+ (0.05,-200) [-200|3012.75] "ppm" Vector__XXX
 SG_ NOxSnsrSelfDiagFinalResult : 0|8@1+ (1,0) [0|250] "" Vector__XXX
 SG_ NOxSnsrNH3Correction : 0|8@1+ (0.5,0) [0|125] "%" Vector__XXX
 SG_ NOxSnsrNO2Correction : 0|8@1+ (0.5,0) [0|125] "%" Vector__XXX
 SG_ NOxSnsrNOxPressCorrection : 0|8@1+ (0.5,0) [0|125] "%/bar" Vector__XXX
 SG_ NOxSnsrO2PressCorrection : 0|8@1+ (0.5,0) [0|125] "%/bar" Vector__XXX
 SG_ NOxSnsrOpHours : 0|16@1+ (1,0) [0|64255] "h" Vector__XXX
 SG_ NOxSnsrNewPartDeviationNOxOffset : 0|8@1+ (1,-125) [-125|125] "ppm" Vector__XXX
 SG_ NOxSnsrNewPartDeviationNOxGain : 0|16@1+ (0.1,-100) [-100|100] "%" Vector__XXX
 SG_ NOxSnsrHtrRatio : 0|16@1+ (0.001,0) [0|64.255] "" Vector__XXX
 SG_ SCRInCorrectedNOx : 0|16@1+ (0.05,-200) [-200|3012.75] "ppm" Vector__XXX
 SG_ NOxSnsrSelfDiagFinalResult : 0|8@1+ (1,0) [0|250] "" Vector__XXX
 SG_ NOxSnsrNH3Correction : 0|8@1+ (0.5,0) [0|125] "%" Vector__XXX
 SG_ NOxSnsrNO2Correction : 0|8@1+ (0.5,0) [0|125] "%" Vector__XXX
 SG_ NOxSnsrNOxPressCorrection : 0|8@1+ (0.5,0) [0|125] "%/bar" Vector__XXX
 SG_ NOxSnsrO2PressCorrection : 0|8@1+ (0.5,0) [0|125] "%/bar" Vector__XXX
 SG_ NOxSnsrOpHours : 0|16@1+ (1,0) [0|64255] "h" Vector__XXX
 SG_ NOxSnsrNewPartDeviationNOxOffset : 0|8@1+ (1,-125) [-125|125] "ppm" Vector__XXX
 SG_ NOxSnsrNewPartDeviationNOxGain : 0|16@1+ (0.1,-100) [-100|100] "%" Vector__XXX
 SG_ NOxSnsrHtrRatio : 0|16@1+ (0.001,0) [0|64.255] "" Vector__XXX
 SG_ Press2Ctrl : 0|16@1+ (0.0025,0) [0|160.6375] "%" Vector__XXX
 SG_ FlowDiverterVlvCtrl : 0|2@1+ (1,0) [0|3] "" Vector__XXX
 SG_ PumpRelayCtrl : 0|2@1+ (1,0) [0|3] "" Vector__XXX
 SG_ Press2 : 0|16@1+ (0.1,0) [0|6425.5] "kPa" Vector__XXX
 SG_ StdDeviationCalOffset : 0|16@1+ (0.0025,0) [0|160.6375] "%" Vector__XXX
 SG_ MeanCalOffset : 0|16@1+ (0.0025,0) [0|160.6375] "%" Vector__XXX
 SG_ OutTemp : 0|16@1+ (0.03125,-273) [-273|1734.96875] "°C" Vector__XXX
 SG_ InTemp : 0|16@1+ (0.03125,-273) [-273|1734.96875] "°C" Vector__XXX
 SG_ DiffPressPreliminaryFMI : 0|5@1+ (1,0) [0|31] "" Vector__XXX
 SG_ OutTempPreliminaryFMI : 0|5@1+ (1,0) [0|31] "" Vector__XXX
 SG_ InTempPreliminaryFMI : 0|5@1+ (1,0) [0|31] "" Vector__XXX
 SG_ DiffPress : 0|16@1+ (0.1,0) [0|6425.5] "kPa" Vector__XXX
 SG_ OutTemp : 0|16@1+ (0.03125,-273) [-273|1734.96875] "°C" Vector__XXX
 SG_ InTemp : 0|16@1+ (0.03125,-273) [-273|1734.96875] "°C" Vector__XXX
 SG_ HtrPreliminaryFMI : 0|5@1+ (1,0) [0|31] "" Vector__XXX
 SG_ SCROpIndSev : 0|3@1+ (1,0) [0|7] "" Vector__XXX
 SG_ TempPreliminaryFMI : 0|5@1+ (1,0) [0|31] "" Vector__XXX
 SG_ DEFTankLowLvlInd : 0|3@1+ (1,0) [0|7] "" Vector__XXX
 SG_ LvlVolPreliminaryFMI : 0|5@1+ (1,0) [0|31] "" Vector__XXX
 SG_ Lvl : 0|16@1+ (0.1,0) [0|6425.5] "mm" Vector__XXX
 SG_ Temp1 : 0|8@1+ (1,-40) [-40|210] "°C" Vector__XXX
 SG_ Volume : 0|8@1+ (0.4,0) [0|100] "%" Vector__XXX
 SG_ CorrectedNOx : 0|16@1+ (0.05,-200) [-200|3012.75] "ppm" Vector__XXX
 SG_ NOxSnsrSelfDiagFinalResult : 0|8@1+ (1,0) [0|250] "" Vector__XXX
 SG_ NOxSnsrNH3Correction : 0|8@1+ (0.5,0) [0|125] "%" Vector__XXX
 SG_ NOxSnsrNO2Correction : 0|8@1+ (0.5,0) [0|125] "%" Vector__XXX
 SG_ NOxSnsrNOxPressCorrection : 0|8@1+ (0.5,0) [0|125] "%/bar" Vector__XXX
 SG_ NOxSnsrO2PressCorrection : 0|8@1+ (0.5,0) [0|125] "%/bar" Vector__XXX
 SG_ NOxSnsrOpHours : 0|16@1+ (1,0) [0|64255] "h" Vector__XXX
 SG_ NOxSnsrNewPartDeviationNOxOffset : 0|8@1+ (1,-125) [-125|125] "ppm" Vector__XXX
 SG_ NOxSnsrNewPartDeviationNOxGain : 0|16@1+ (0.1,-100) [-100|100] "%" Vector__XXX
 SG_ NOxSnsrHtrRatio : 0|16@1+ (0.001,0) [0|64.255] "" Vector__XXX
 SG_ SCRInCorrectedNOx : 0|16@1+ (0.05,-200) [-200|3012.75] "ppm" Vector__XXX
 SG_ NOxSnsrSelfDiagFinalResult : 0|8@1+ (1,0) [0|250] "" Vector__XXX
 SG_ NOxSnsrNH3Correction : 0|8@1+ (0.5,0) [0|125] "%" Vector__XXX
 SG_ NOxSnsrNO2Correction : 0|8@1+ (0.5,0) [0|125] "%" Vector__XXX
 SG_ NOxSnsrNOxPressCorrection : 0|8@1+ (0.5,0) [0|125] "%/bar" Vector__XXX
 SG_ NOxSnsrO2PressCorrection : 0|8@1+ (0.5,0) [0|125] "%/bar" Vector__XXX
 SG_ NOxSnsrOpHours : 0|16@1+ (1,0) [0|64255] "h" Vector__XXX
 SG_ NOxSnsrNewPartDeviationNOxOffset : 0|8@1+ (1,-125) [-125|125] "ppm" Vector__XXX
 SG_ NOxSnsrNewPartDeviationNOxGain : 0|16@1+ (0.1,-100) [-100|100] "%" Vector__XXX
 SG_ NOxSnsrHtrRatio : 0|16@1+ (0.001,0) [0|64.255] "" Vector__XXX
 SG_ StdDeviationCalOffset : 0|16@1+ (0.0025,0) [0|160.6375] "%" Vector__XXX
 SG_ MeanCalOffset : 0|16@1+ (0.0025,0) [0|160.6375] "%" Vector__XXX
 SG_ Armrest2Switch2 : 0|2@1+ (1,0) [0|3] "" Vector__XXX
 SG_ Armrest2Switch1 : 0|2@1+ (1,0) [0|3] "" Vector__XXX
 SG_ Armrest1Switch2 : 0|2@1+ (1,0) [0|3] "" Vector__XXX
 SG_ Armrest1Switch1 : 0|2@1+ (1,0) [0|3] "" Vector__XXX
 SG_ AngularRateMeasurementLatency : 0|8@1+ (0.5,0) [0|125] "ms" Vector__XXX
 SG_ YawRateExRangeFigureOfMerit : 0|2@1+ (1,0) [0|3] "" Vector__XXX
 SG_ RollRateExRangeFigureOfMerit : 0|2@1+ (1,0) [0|3] "" Vector__XXX
 SG_ PitchRateExRangeFigureOfMerit : 0|2@1+ (1,0) [0|3] "" Vector__XXX
 SG_ YawRateExRange : 0|16@1+ (0.0078125,-250) [-250|250.992] "deg/s" Vector__XXX
 SG_ RollRateExRange : 0|16@1+ (0.0078125,-250) [-250|250.992] "deg/s" Vector__XXX
 SG_ PitchRateExRange : 0|16@1+ (0.0078125,-250) [-250|250.992] "deg/s" Vector__XXX
 SG_ DesulfationStatus : 0|2@1+ (1,0) [0|3] "" Vector__XXX
 SG_ DesulfationStatus : 0|2@1+ (1,0) [0|3] "" Vector__XXX
 SG_ DEFQuickThawHtrPreliminaryFMI : 0|5@1+ (1,0) [0|31] "" Vector__XXX
 SG_ DEFQuickThawHtr : 0|8@1+ (0.4,0) [0|100] "%" Vector__XXX
 SG_ DEFQuickThawTempPreliminaryFMI : 0|5@1+ (1,0) [0|31] "" Vector__XXX
 SG_ DEFQuickThawLvlPreliminaryFMI : 0|5@1+ (1,0) [0|31] "" Vector__XXX
 SG_ DEFQuickThawTankLvl : 0|16@1+ (0.1,0) [0|6425.5] "mm" Vector__XXX
 SG_ DEFQuickThawTemp : 0|8@1+ (1,-40) [-40|210] "°C" Vector__XXX
 SG_ DEFQuickThawTankVolume : 0|8@1+ (0.4,0) [0|100] "%" Vector__XXX
 SG_ HtrPreliminaryFMI : 0|5@1+ (1,0) [0|31] "" Vector__XXX
 SG_ TempPreliminaryFMI : 0|5@1+ (1,0) [0|31] "" Vector__XXX
 SG_ LvlVolPreliminaryFMI : 0|5@1+ (1,0) [0|31] "" Vector__XXX
 SG_ Lvl : 0|16@1+ (0.1,0) [0|6425.5] "mm" Vector__XXX
 SG_ Temp1 : 0|8@1+ (1,-40) [-40|210] "°C" Vector__XXX
 SG_ Volume : 0|8@1+ (0.4,0) [0|100] "%" Vector__XXX
 SG_ DosingUnit2DiverterVlv : 0|8@1+ (0.4,0) [0|100] "%" Vector__XXX
 SG_ TankDrainVlvCmd : 0|8@1+ (0.4,0) [0|100] "%" Vector__XXX
 SG_ PumpSt : 0|2@1+ (1,0) [0|3] "" Vector__XXX
 SG_ TankFillVlvCmd : 0|8@1+ (0.4,0) [0|100] "%" Vector__XXX
 SG_ DosingUnit1DiverterVlv : 0|8@1+ (0.4,0) [0|100] "%" Vector__XXX
 SG_ PumpDrivePercentage : 0|8@1+ (0.4,0) [0|100] "%" Vector__XXX
 SG_ Pump1MotorSpd : 0|16@1+ (0.5,0) [0|32127.5] "rpm" Vector__XXX
 SG_ TypeProperty : 0|4@1+ (1,0) [0|15] "" Vector__XXX
 SG_ OutTempPreliminaryFMI : 0|5@1+ (1,0) [0|31] "" Vector__XXX
 SG_ OutTemp : 0|16@1+ (0.03125,-273) [-273|1734.96875] "°C" Vector__XXX
 SG_ InTempPreliminaryFMI : 0|5@1+ (1,0) [0|31] "" Vector__XXX
 SG_ InTemp : 0|16@1+ (0.03125,-273) [-273|1734.96875] "°C" Vector__XXX
 SG_ InAbsPress : 0|16@1+ (0.1,0) [0|6425.5] "kPa" Vector__XXX
 SG_ InPress : 0|16@1+ (0.1,-3212.7) [-3212.7|3212.8] "kPa" Vector__XXX
 SG_ DiffPressPreliminaryFMI : 0|5@1+ (1,0) [0|31] "" Vector__XXX
 SG_ DiffPress : 0|16@1+ (0.1,0) [0|6425.5] "kPa" Vector__XXX
 SG_ DEFLineHtr10 : 0|2@1+ (1,0) [0|3] "" Vector__XXX
 SG_ DEFLineHtr9 : 0|2@1+ (1,0) [0|3] "" Vector__XXX
 SG_ DEFLineHtr8 : 0|2@1+ (1,0) [0|3] "" Vector__XXX
 SG_ DEFLineHtr7 : 0|2@1+ (1,0) [0|3] "" Vector__XXX
 SG_ DEFLineHtr6 : 0|2@1+ (1,0) [0|3] "" Vector__XXX
 SG_ DEFLineHtr5 : 0|2@1+ (1,0) [0|3] "" Vector__XXX
 SG_ DEFLineHtrRelay3 : 0|2@1+ (1,0) [0|3] "" Vector__XXX
 SG_ DEFLineHtrRelay2 : 0|2@1+ (1,0) [0|3] "" Vector__XXX
 SG_ DEFLineHtrRelay1 : 0|2@1+ (1,0) [0|3] "" Vector__XXX
 SG_ DEFQuickThawHtrCmd : 0|8@1+ (0.4,0) [0|100] "%" Vector__XXX
 SG_ DEFTankHtrCmd : 0|8@1+ (0.4,0) [0|100] "%" Vector__XXX
 SG_ DEFLineHtr4 : 0|2@1+ (1,0) [0|3] "" Vector__XXX
 SG_ DEFLineHtr3 : 0|2@1+ (1,0) [0|3] "" Vector__XXX
 SG_ DEFLineHtr2 : 0|2@1+ (1,0) [0|3] "" Vector__XXX
 SG_ DEFLineHtr1 : 0|2@1+ (1,0) [0|3] "" Vector__XXX
 SG_ DEFDoserHeatingModeReq : 0|3@1+ (1,0) [0|7] "" Vector__XXX
 SG_ DEFDoserFaultSuppressionReq : 0|2@1+ (1,0) [0|3] "" Vector__XXX
 SG_ DEFReqQuantityOfIntegrator : 0|16@1+ (0.1,0) [0|6425.5] "g" Vector__XXX
 SG_ DEFDosingReqQuantity6594 : 0|16@1+ (0.05,0) [0|3212.75] "g/min" Vector__XXX
 SG_ DEFPumpHtrCmd : 0|8@1+ (0.4,0) [0|100] "%" Vector__XXX
 SG_ DEFDosingTestInjPermStatus : 0|2@1+ (1,0) [0|3] "" Vector__XXX
 SG_ DEFHydStiffnessCheckPermStatus : 0|2@1+ (1,0) [0|3] "" Vector__XXX
 SG_ SysReqSt : 0|4@1+ (1,0) [0|15] "" Vector__XXX
 SG_ DEFDosingReqQuantity : 0|16@1+ (0.3,0) [0|19276.5] "g/h" Vector__XXX
 SG_ DEFLineHtr4PreliminaryFMI : 0|5@1+ (1,0) [0|31] "" Vector__XXX
 SG_ DEFLineHtr4St : 0|2@1+ (1,0) [0|3] "" Vector__XXX
 SG_ DEFLineHtr3PreliminaryFMI : 0|5@1+ (1,0) [0|31] "" Vector__XXX
 SG_ DEFLineHtr3St : 0|2@1+ (1,0) [0|3] "" Vector__XXX
 SG_ DEFLineHtr2PreliminaryFMI : 0|5@1+ (1,0) [0|31] "" Vector__XXX
 SG_ DEFLineHtr2St : 0|2@1+ (1,0) [0|3] "" Vector__XXX
 SG_ DEFLineHtr1PreliminaryFMI : 0|5@1+ (1,0) [0|31] "" Vector__XXX
 SG_ DEFLineHtr1St : 0|2@1+ (1,0) [0|3] "" Vector__XXX
 SG_ FeedbackCtrlStatus : 0|3@1+ (1,0) [0|7] "" Vector__XXX
 SG_ VlvExhTempReductionReq : 0|3@1+ (1,0) [0|7] "" Vector__XXX
 SG_ DEFDoser1Temp : 0|8@1+ (1,-40) [-40|210] "°C" Vector__XXX
 SG_ AirAssistVlv : 0|8@1+ (0.4,0) [0|100] "%" Vector__XXX
 SG_ AirAssistAbsPress : 0|8@1+ (8,0) [0|2000] "kPa" Vector__XXX
 SG_ DEFActualDosingQuantity6596 : 0|16@1+ (0.05,0) [0|3212.75] "g/min" Vector__XXX
 SG_ Sys2St : 0|4@1+ (1,0) [0|15] "" Vector__XXX
 SG_ DEFDoser1AbsPress : 0|8@1+ (8,0) [0|2000] "kPa" Vector__XXX
 SG_ DEFActualQuantityOfIntegrator : 0|16@1+ (0.1,0) [0|6425.5] "g" Vector__XXX
 SG_ Sys1St : 0|4@1+ (1,0) [0|15] "" Vector__XXX
 SG_ DEFActualDosingQuantity : 0|16@1+ (0.3,0) [0|19276.5] "g/h" Vector__XXX
 SG_ OutNH3GasSnsrHtrCtrl : 0|2@1+ (1,0) [0|3] "" Vector__XXX
 SG_ OutNH3GasSnsrHtrPreliminaryFMI : 0|5@1+ (1,0) [0|31] "" Vector__XXX
 SG_ OutNH3GasSnsrAtTemp : 0|2@1+ (1,0) [0|3] "" Vector__XXX
 SG_ OutNH3GasSnsrPwrInRange : 0|2@1+ (1,0) [0|3] "" Vector__XXX
 SG_ OutNH3ReadingStable : 0|2@1+ (1,0) [0|3] "" Vector__XXX
 SG_ OutNH3SnsrPreliminaryFMI : 0|5@1+ (1,0) [0|31] "" Vector__XXX
 SG_ OutNH3 : 0|16@1+ (0.05,-200) [-200|3012.75] "ppm" Vector__XXX
 SG_ DiffPressPreliminaryFMI : 0|5@1+ (1,0) [0|31] "" Vector__XXX
 SG_ OutTempPreliminaryFMI : 0|5@1+ (1,0) [0|31] "" Vector__XXX
 SG_ InTempPreliminaryFMI : 0|5@1+ (1,0) [0|31] "" Vector__XXX
 SG_ DiffPress : 0|16@1+ (0.1,0) [0|6425.5] "kPa" Vector__XXX
 SG_ OutTemp : 0|16@1+ (0.03125,-273) [-273|1734.96875] "°C" Vector__XXX
 SG_ InTemp : 0|16@1+ (0.03125,-273) [-273|1734.96875] "°C" Vector__XXX
 SG_ DiffPressPreliminaryFMI : 0|5@1+ (1,0) [0|31] "" Vector__XXX
 SG_ OutTempPreliminaryFMI : 0|5@1+ (1,0) [0|31] "" Vector__XXX
 SG_ InTempPreliminaryFMI : 0|5@1+ (1,0) [0|31] "" Vector__XXX
 SG_ DiffPress : 0|16@1+ (0.5,0) [0|32127.5] "kPa" Vector__XXX
 SG_ OutTemp : 0|16@1+ (0.03125,-273) [-273|1734.96875] "°C" Vector__XXX
 SG_ InTemp : 0|16@1+ (0.03125,-273) [-273|1734.96875] "°C" Vector__XXX
 SG_ DEFQuickThawHtrPreliminaryFMI : 0|5@1+ (1,0) [0|31] "" Vector__XXX
 SG_ DEFQuickThawHtr : 0|8@1+ (0.4,0) [0|100] "%" Vector__XXX
 SG_ DEFQuickThawTempPreliminaryFMI : 0|5@1+ (1,0) [0|31] "" Vector__XXX
 SG_ DEFQuickThawLvlVolPreliminaryFMI : 0|5@1+ (1,0) [0|31] "" Vector__XXX
 SG_ DEFQuickThawTankLvl : 0|16@1+ (0.1,0) [0|6425.5] "mm" Vector__XXX
 SG_ DEFQuickThawTemp : 0|8@1+ (1,-40) [-40|210] "°C" Vector__XXX
 SG_ DEFQuickThawTankVolume : 0|8@1+ (0.4,0) [0|100] "%" Vector__XXX
 SG_ DosingUnit2DiverterVlv : 0|8@1+ (0.4,0) [0|100] "%" Vector__XXX
 SG_ Pump : 0|2@1+ (1,0) [0|3] "" Vector__XXX
 SG_ PumpPwrRelay : 0|2@1+ (1,0) [0|3] "" Vector__XXX
 SG_ TankDrainVlvCmd : 0|8@1+ (0.4,0) [0|100] "%" Vector__XXX
 SG_ PumpSt : 0|2@1+ (1,0) [0|3] "" Vector__XXX
 SG_ TankFillVlvCmd : 0|8@1+ (0.4,0) [0|100] "%" Vector__XXX
 SG_ DosingUnit1DiverterVlv : 0|8@1+ (0.4,0) [0|100] "%" Vector__XXX
 SG_ PumpDrivePercentage : 0|8@1+ (0.4,0) [0|100] "%" Vector__XXX
 SG_ Pump1MotorSpd : 0|16@1+ (0.5,0) [0|32127.5] "rpm" Vector__XXX
 SG_ OutTempPreliminaryFMI : 0|5@1+ (1,0) [0|31] "" Vector__XXX
 SG_ OutTemp : 0|16@1+ (0.03125,-273) [-273|1734.96875] "°C" Vector__XXX
 SG_ InTempPreliminaryFMI : 0|5@1+ (1,0) [0|31] "" Vector__XXX
 SG_ InTemp : 0|16@1+ (0.03125,-273) [-273|1734.96875] "°C" Vector__XXX
 SG_ InAbsPress : 0|16@1+ (0.1,0) [0|6425.5] "kPa" Vector__XXX
 SG_ InPress : 0|16@1+ (0.1,-3212.7) [-3212.7|3212.8] "kPa" Vector__XXX
 SG_ DiffPressPreliminaryFMI : 0|5@1+ (1,0) [0|31] "" Vector__XXX
 SG_ DiffPress : 0|16@1+ (0.1,0) [0|6425.5] "kPa" Vector__XXX
 SG_ DEFLineHtr10 : 0|2@1+ (1,0) [0|3] "" Vector__XXX
 SG_ DEFLineHtr9 : 0|2@1+ (1,0) [0|3] "" Vector__XXX
 SG_ DEFLineHtr8 : 0|2@1+ (1,0) [0|3] "" Vector__XXX
 SG_ DEFLineHtr7 : 0|2@1+ (1,0) [0|3] "" Vector__XXX
 SG_ DEFLineHtr6 : 0|2@1+ (1,0) [0|3] "" Vector__XXX
 SG_ DEFLineHtr5 : 0|2@1+ (1,0) [0|3] "" Vector__XXX
 SG_ DEFLineHtrRelay3 : 0|2@1+ (1,0) [0|3] "" Vector__XXX
 SG_ DEFLineHtrRelay2 : 0|2@1+ (1,0) [0|3] "" Vector__XXX
 SG_ DEFLineHtrRelay1 : 0|2@1+ (1,0) [0|3] "" Vector__XXX
 SG_ DEFPumpHtrCmd : 0|8@1+ (0.4,0) [0|100] "%" Vector__XXX
 SG_ DEFQuickThawHtrCmd : 0|8@1+ (0.4,0) [0|100] "%" Vector__XXX
 SG_ DEFTankHtrCmd : 0|8@1+ (0.4,0) [0|100] "%" Vector__XXX
 SG_ DEFLineHtr4 : 0|2@1+ (1,0) [0|3] "" Vector__XXX
 SG_ DEFLineHtr3 : 0|2@1+ (1,0) [0|3] "" Vector__XXX
 SG_ DEFLineHtr2 : 0|2@1+ (1,0) [0|3] "" Vector__XXX
 SG_ DEFLineHtr1 : 0|2@1+ (1,0) [0|3] "" Vector__XXX
 SG_ DEFDoserHeatingModeReq : 0|3@1+ (1,0) [0|7] "" Vector__XXX
 SG_ DEFDoserFaultSuppressionReq : 0|2@1+ (1,0) [0|3] "" Vector__XXX
 SG_ DEFDosingReqQuantity6593 : 0|16@1+ (0.05,0) [0|3212.75] "g/min" Vector__XXX
 SG_ DEFDosingTestInjPermStatus : 0|2@1+ (1,0) [0|3] "" Vector__XXX
 SG_ DEFHydStiffnessCheckPermStatus : 0|2@1+ (1,0) [0|3] "" Vector__XXX
 SG_ DEFReqQuantityOfIntegrator : 0|16@1+ (0.1,0) [0|6425.5] "g" Vector__XXX
 SG_ SysReqSt : 0|4@1+ (1,0) [0|15] "" Vector__XXX
 SG_ DEFDosingReqQuantity : 0|16@1+ (0.3,0) [0|19276.5] "g/h" Vector__XXX
 SG_ DEFLineHtr4PreliminaryFMI : 0|5@1+ (1,0) [0|31] "" Vector__XXX
 SG_ DEFLineHtr4St : 0|2@1+ (1,0) [0|3] "" Vector__XXX
 SG_ DEFLineHtr3PreliminaryFMI : 0|5@1+ (1,0) [0|31] "" Vector__XXX
 SG_ DEFLineHtr3St : 0|2@1+ (1,0) [0|3] "" Vector__XXX
 SG_ DEFLineHtr2PreliminaryFMI : 0|5@1+ (1,0) [0|31] "" Vector__XXX
 SG_ DEFLineHtr2St : 0|2@1+ (1,0) [0|3] "" Vector__XXX
 SG_ DEFLineHtr1PreliminaryFMI : 0|5@1+ (1,0) [0|31] "" Vector__XXX
 SG_ DEFLineHtr1St : 0|2@1+ (1,0) [0|3] "" Vector__XXX
 SG_ FeedbackCtrlStatus : 0|3@1+ (1,0) [0|7] "" Vector__XXX
 SG_ VlvExhTempReductionReq : 0|3@1+ (1,0) [0|7] "" Vector__XXX
 SG_ DEFDoser1Temp : 0|8@1+ (1,-40) [-40|210] "°C" Vector__XXX
 SG_ AirAssistVlv : 0|8@1+ (0.4,0) [0|100] "%" Vector__XXX
 SG_ AirAssistAbsPress : 0|8@1+ (8,0) [0|2000] "kPa" Vector__XXX
 SG_ DEFDoser1AbsPress : 0|8@1+ (8,0) [0|2000] "kPa" Vector__XXX
 SG_ DEFActualDosingQuantity6595 : 0|16@1+ (0.05,0) [0|3212.75] "g/min" Vector__XXX
 SG_ DEFActualQuantityOfIntegrator : 0|16@1+ (0.1,0) [0|6425.5] "g" Vector__XXX
 SG_ Sys2St : 0|4@1+ (1,0) [0|15] "" Vector__XXX
 SG_ Sys1St : 0|4@1+ (1,0) [0|15] "" Vector__XXX
 SG_ DEFActualDosingQuantity : 0|16@1+ (0.3,0) [0|19276.5] "g/h" Vector__XXX
 SG_ OutNH3GasSnsrHtrCtrl : 0|2@1+ (1,0) [0|3] "" Vector__XXX
 SG_ OutNH3GasSnsrHtrPreliminaryFMI : 0|5@1+ (1,0) [0|31] "" Vector__XXX
 SG_ OutNH3GasSnsrAtTemp : 0|2@1+ (1,0) [0|3] "" Vector__XXX
 SG_ OutNH3GasSnsrPwrInRange : 0|2@1+ (1,0) [0|3] "" Vector__XXX
 SG_ OutNH3ReadingStable : 0|2@1+ (1,0) [0|3] "" Vector__XXX
 SG_ OutNH3SnsrPreliminaryFMI : 0|5@1+ (1,0) [0|31] "" Vector__XXX
 SG_ OutNH3 : 0|16@1+ (0.05,-200) [-200|3012.75] "ppm" Vector__XXX
 SG_ DiffPressPreliminaryFMI : 0|5@1+ (1,0) [0|31] "" Vector__XXX
 SG_ OutTempPreliminaryFMI : 0|5@1+ (1,0) [0|31] "" Vector__XXX
 SG_ InTempPreliminaryFMI : 0|5@1+ (1,0) [0|31] "" Vector__XXX
 SG_ DiffPress : 0|16@1+ (0.1,0) [0|6425.5] "kPa" Vector__XXX
 SG_ OutTemp : 0|16@1+ (0.03125,-273) [-273|1734.96875] "°C" Vector__XXX
 SG_ InTemp : 0|16@1+ (0.03125,-273) [-273|1734.96875] "°C" Vector__XXX
 SG_ BatteryMainSwitchHoldState : 0|2@1+ (1,0) [0|3] "" Vector__XXX
 SG_ Joystick3XAxisDetentPosStatus : 0|2@1+ (1,0) [0|3] "" Vector__XXX
 SG_ Joystick3Button9PressedStatus : 0|2@1+ (1,0) [0|3] "" Vector__XXX
 SG_ Joystick3Button10PressedStatus : 0|2@1+ (1,0) [0|3] "" Vector__XXX
 SG_ Joystick3Button11PressedStatus : 0|2@1+ (1,0) [0|3] "" Vector__XXX
 SG_ Joystick3Button12PressedStatus : 0|2@1+ (1,0) [0|3] "" Vector__XXX
 SG_ Joystick3YAxisDetentPosStatus : 0|2@1+ (1,0) [0|3] "" Vector__XXX
 SG_ DiffPressPreliminaryFMI : 0|5@1+ (1,0) [0|31] "" Vector__XXX
 SG_ OutTempPreliminaryFMI : 0|5@1+ (1,0) [0|31] "" Vector__XXX
 SG_ InTempPreliminaryFMI : 0|5@1+ (1,0) [0|31] "" Vector__XXX
 SG_ DiffPress : 0|16@1+ (0.1,0) [0|6425.5] "kPa" Vector__XXX
 SG_ OutTemp : 0|16@1+ (0.03125,-273) [-273|1734.96875] "°C" Vector__XXX
 SG_ InTemp : 0|16@1+ (0.03125,-273) [-273|1734.96875] "°C" Vector__XXX
 SG_ FlowDiverterVlvCtrl : 0|2@1+ (1,0) [0|3] "" Vector__XXX
 SG_ PumpRelayCtrl : 0|2@1+ (1,0) [0|3] "" Vector__XXX
 SG_ Press2 : 0|16@1+ (0.1,0) [0|6425.5] "kPa" Vector__XXX

CM_ SG_ 3221225472 Joystick7Button12PressedStatus "Reports when the joystick button has been pressed.

00 Button not pressed
01 Button pressed
10 Error Indicator
11 Not Available";
CM_ SG_ 3221225472 Joystick7Button5PressedStatus "Reports when the joystick button has been pressed.

00 Button not pressed
01 Button pressed
10 Error Indicator
11 Not Available";
CM_ SG_ 3221225472 Joystick7Button6PressedStatus "Reports when the joystick button has been pressed.

00 Button not pressed
01 Button pressed
10 Error Indicator
11 Not Available";
CM_ SG_ 3221225472 Joystick7Button7PressedStatus "Reports when the joystick button has been pressed.

00 Button not pressed
01 Button pressed
10 Error Indicator
11 Not Available";
CM_ SG_ 3221225472 Joystick7Button8PressedStatus "Reports when the joystick button has been pressed.

00 Button not pressed
01 Button pressed
10 Error Indicator
11 Not Available";
CM_ SG_ 3221225472 Joystick7Button1PressedStatus "Reports when the joystick button has been pressed.

00 Button not pressed
01 Button pressed
10 Error Indicator
11 Not Available";
CM_ SG_ 3221225472 Joystick7Button2PressedStatus "Reports when the joystick button has been pressed.

00 Button not pressed
01 Button pressed
10 Error Indicator
11 Not Available";
CM_ SG_ 3221225472 Joystick7Button3PressedStatus "Reports when the joystick button has been pressed.

00 Button not pressed
01 Button pressed
10 Error Indicator
11 Not Available";
CM_ SG_ 3221225472 Joystick7Button4PressedStatus "Reports when the joystick button has been pressed.

00 Button not pressed
01 Button pressed
10 Error Indicator
11 Not Available";
CM_ SG_ 3221225472 Joystick7XAxisDetentPosStatus "Reports when the current joystick position is in the detent position for that axis of travel.

00 Not in the Detent Position
01 In the Detent Position
10 Error Indicator
11 Not Available";
CM_ SG_ 3221225472 Joystick7YAxisDetentPosStatus "Reports when the current joystick position is in the detent position for that axis of travel.

00 Not in the Detent Position
01 In the Detent Position
10 Error Indicator
11 Not Available";
CM_ SG_ 3221225472 Joystick7YAxisPos "The position of the joystick in the relative motion of travel from the neutral position.  Position value of 0 is Neutral and position value 1000 (100%) is the end of linear zone.  Value of 1022 indicates an error has occurred.";
CM_ SG_ 3221225472 Jystck7YAxsLvrFrwrdPstvPosStatus "Reports when the current joystick position is on the positive travel side (forward, right, clockwise, up) relative to the neutral position for that axis of travel.
00 Not on Positive side of Neutral
01 On positive side of Neutral
10 Error ...";
CM_ SG_ 3221225472 Jystck7YAxsLvrBckNgtivePosStatus "Reports when the current joystick position is on the negative travel side (back, left, counterclockwise, down) relative to the neutral position for that axis of travel.
00 Not on negative side of Neutral
01 On negative side of Neutral
10 Error ...";
CM_ SG_ 3221225472 Joystick7YAxisNeutralPosStatus "Reports when the current joystick position is in the neutral position for that axis of travel.  The neutral position measurement must be determined from some mechanism other than the axis position measurement device.
00 Not in Neutral Position
01 ...";
CM_ SG_ 3221225472 Joystick7XAxisPos "The position of the joystick in the relative motion of travel from the neutral position.  Position value of 0 is Neutral and position value 1000 (100%) is the end of linear zone.  Value of 1022 indicates an error has occurred.";
CM_ SG_ 3221225472 Jystck7XAxsLvrRghtPstvePosStatus "Reports when the current joystick position is on the positive travel side (forward, right, clockwise, up) relative to the neutral position for that axis of travel.
00 Not on Positive side of Neutral
01 On positive side of Neutral
10 Error ...";
CM_ SG_ 3221225472 Jystck7XAxsLvrLftNgtivePosStatus "Reports when the current joystick position is on the negative travel side (back, left, counterclockwise, down) relative to the neutral position for that axis of travel.
00 Not on negative side of Neutral
01 On negative side of Neutral
10 Error ...";
CM_ SG_ 3221225472 Joystick7XAxisNeutralPosStatus "Reports when the current joystick position is in the neutral position for that axis of travel.  The neutral position measurement must be determined from some mechanism other than the axis position measurement device.
00 Not in Neutral Position
01 ...";
CM_ SG_ 3221225472 Joystick6Button9PressedStatus "Reports when the joystick button has been pressed.

00 Button not pressed
01 Button pressed
10 Error Indicator
11 Not Available";
CM_ SG_ 3221225472 Joystick6Button10PressedStatus "Reports when the joystick button has been pressed.

00 Button not pressed
01 Button pressed
10 Error Indicator
11 Not Available";
CM_ SG_ 3221225472 Joystick6Button11PressedStatus "Reports when the joystick button has been pressed.

00 Button not pressed
01 Button pressed
10 Error Indicator
11 Not Available";
CM_ SG_ 3221225472 Joystick6Button12PressedStatus "Reports when the joystick button has been pressed.

00 Button not pressed
01 Button pressed
10 Error Indicator
11 Not Available";
CM_ SG_ 3221225472 Joystick6Button5PressedStatus "Reports when the joystick button has been pressed.

00 Button not pressed
01 Button pressed
10 Error Indicator
11 Not Available";
CM_ SG_ 3221225472 Joystick6Button6PressedStatus "Reports when the joystick button has been pressed.

00 Button not pressed
01 Button pressed
10 Error Indicator
11 Not Available";
CM_ SG_ 3221225472 Joystick6Button7PressedStatus "Reports when the joystick button has been pressed.

00 Button not pressed
01 Button pressed
10 Error Indicator
11 Not Available";
CM_ SG_ 3221225472 Joystick6Button8PressedStatus "Reports when the joystick button has been pressed.

00 Button not pressed
01 Button pressed
10 Error Indicator
11 Not Available";
CM_ SG_ 3221225472 Joystick6Button1PressedStatus "Reports when the joystick button has been pressed.

00 Button not pressed
01 Button pressed
10 Error Indicator
11 Not Available";
CM_ SG_ 3221225472 Joystick6Button2PressedStatus "Reports when the joystick button has been pressed.

00 Button not pressed
01 Button pressed
10 Error Indicator
11 Not Available";
CM_ SG_ 3221225472 Joystick6Button3PressedStatus "Reports when the joystick button has been pressed.

00 Button not pressed
01 Button pressed
10 Error Indicator
11 Not Available";
CM_ SG_ 3221225472 Joystick6Button4PressedStatus "Reports when the joystick button has been pressed.

00 Button not pressed
01 Button pressed
10 Error Indicator
11 Not Available";
CM_ SG_ 3221225472 Joystick6XAxisDetentPosStatus "Reports when the current joystick position is in the detent position for that axis of travel.

00 Not in the Detent Position
01 In the Detent Position
10 Error Indicator
11 Not Available";
CM_ SG_ 3221225472 Joystick6YAxisDetentPosStatus "Reports when the current joystick position is in the detent position for that axis of travel.

00 Not in the Detent Position
01 In the Detent Position
10 Error Indicator
11 Not Available";
CM_ SG_ 3221225472 Joystick6YAxisPos "The position of the joystick in the relative motion of travel from the neutral position.  Position value of 0 is Neutral and position value 1000 (100%) is the end of linear zone.  Value of 1022 indicates an error has occurred.";
CM_ SG_ 3221225472 Jystck6YAxsLvrFrwrdPstvPosStatus "Reports when the current joystick position is on the positive travel side (forward, right, clockwise, up) relative to the neutral position for that axis of travel.
00 Not on Positive side of Neutral
01 On positive side of Neutral
10 Error ...";
CM_ SG_ 3221225472 Jystck6YAxsLvrBckNgtivePosStatus "Reports when the current joystick position is on the negative travel side (back, left, counterclockwise, down) relative to the neutral position for that axis of travel.
00 Not on negative side of Neutral
01 On negative side of Neutral
10 Error ...";
CM_ SG_ 3221225472 Joystick6YAxisNeutralPosStatus "Reports when the current joystick position is in the neutral position for that axis of travel.  The neutral position measurement must be determined from some mechanism other than the axis position measurement device.
00 Not in Neutral Position
01 ...";
CM_ SG_ 3221225472 Joystick6XAxisPos "The position of the joystick in the relative motion of travel from the neutral position.  Position value of 0 is Neutral and position value 1000 (100%) is the end of linear zone.  Value of 1022 indicates an error has occurred.";
CM_ SG_ 3221225472 Jystck6XAxsLvrRghtPstvePosStatus "Reports when the current joystick position is on the positive travel side (forward, right, clockwise, up) relative to the neutral position for that axis of travel.
00 Not on Positive side of Neutral
01 On positive side of Neutral
10 Error ...";
CM_ SG_ 3221225472 Jystck6XAxsLvrLftNgtivePosStatus "Reports when the current joystick position is on the negative travel side (back, left, counterclockwise, down) relative to the neutral position for that axis of travel.
00 Not on negative side of Neutral
01 On negative side of Neutral
10 Error ...";
CM_ SG_ 3221225472 Joystick6XAxisNeutralPosStatus "Reports when the current joystick position is in the neutral position for that axis of travel.  The neutral position measurement must be determined from some mechanism other than the axis position measurement device.
00 Not in Neutral Position
01 ...";
CM_ SG_ 3221225472 Joystick5Button9PressedStatus "Reports when the joystick button has been pressed.

00 Button not pressed
01 Button pressed
10 Error Indicator
11 Not Available";
CM_ SG_ 3221225472 Joystick5Button10PressedStatus "Reports when the joystick button has been pressed.

00 Button not pressed
01 Button pressed
10 Error Indicator
11 Not Available";
CM_ SG_ 3221225472 Joystick5Button11PressedStatus "Reports when the joystick button has been pressed.

00 Button not pressed
01 Button pressed
10 Error Indicator
11 Not Available";
CM_ SG_ 3221225472 Joystick5Button12PressedStatus "Reports when the joystick button has been pressed.

00 Button not pressed
01 Button pressed
10 Error Indicator
11 Not Available";
CM_ SG_ 3221225472 Joystick5Button5PressedStatus "Reports when the joystick button has been pressed.

00 Button not pressed
01 Button pressed
10 Error Indicator
11 Not Available";
CM_ SG_ 3221225472 Joystick5Button6PressedStatus "Reports when the joystick button has been pressed.

00 Button not pressed
01 Button pressed
10 Error Indicator
11 Not Available";
CM_ SG_ 3221225472 Joystick5Button7PressedStatus "Reports when the joystick button has been pressed.

00 Button not pressed
01 Button pressed
10 Error Indicator
11 Not Available";
CM_ SG_ 3221225472 Joystick5Button8PressedStatus "Reports when the joystick button has been pressed.

00 Button not pressed
01 Button pressed
10 Error Indicator
11 Not Available";
CM_ SG_ 3221225472 Joystick5Button1PressedStatus "Reports when the joystick button has been pressed.

00 Button not pressed
01 Button pressed
10 Error Indicator
11 Not Available";
CM_ SG_ 3221225472 Joystick5Button2PressedStatus "Reports when the joystick button has been pressed.

00 Button not pressed
01 Button pressed
10 Error Indicator
11 Not Available";
CM_ SG_ 3221225472 Joystick5Button3PressedStatus "Reports when the joystick button has been pressed.

00 Button not pressed
01 Button pressed
10 Error Indicator
11 Not Available";
CM_ SG_ 3221225472 Joystick5Button4PressedStatus "Reports when the joystick button has been pressed.

00 Button not pressed
01 Button pressed
10 Error Indicator
11 Not Available";
CM_ SG_ 3221225472 Joystick5XAxisDetentPosStatus "Reports when the current joystick position is in the detent position for that axis of travel.

00 Not in the Detent Position
01 In the Detent Position
10 Error Indicator
11 Not Available";
CM_ SG_ 3221225472 Joystick5YAxisDetentPosStatus "Reports when the current joystick position is in the detent position for that axis of travel.

00 Not in the Detent Position
01 In the Detent Position
10 Error Indicator
11 Not Available";
CM_ SG_ 3221225472 Joystick5YAxisPos "The position of the joystick in the relative motion of travel from the neutral position.  Position value of 0 is Neutral and position value 1000 (100%) is the end of linear zone.  Value of 1022 indicates an error has occurred.";
CM_ SG_ 3221225472 Jystck5YAxsLvrFrwrdPstvPosStatus "Reports when the current joystick position is on the positive travel side (forward, right, clockwise, up) relative to the neutral position for that axis of travel.
00 Not on Positive side of Neutral
01 On positive side of Neutral
10 Error ...";
CM_ SG_ 3221225472 Jystck5YAxsLvrBckNgtivePosStatus "Reports when the current joystick position is on the negative travel side (back, left, counterclockwise, down) relative to the neutral position for that axis of travel.
00 Not on negative side of Neutral
01 On negative side of Neutral
10 Error ...";
CM_ SG_ 3221225472 Joystick5YAxisNeutralPosStatus "Reports when the current joystick position is in the neutral position for that axis of travel.  The neutral position measurement must be determined from some mechanism other than the axis position measurement device.
00 Not in Neutral Position
01 ...";
CM_ SG_ 3221225472 Joystick5XAxisPos "The position of the joystick in the relative motion of travel from the neutral position.  Position value of 0 is Neutral and position value 1000 (100%) is the end of linear zone.  Value of 1022 indicates an error has occurred.";
CM_ SG_ 3221225472 Jystck5XAxsLvrRghtPstvePosStatus "Reports when the current joystick position is on the positive travel side (forward, right, clockwise, up) relative to the neutral position for that axis of travel.
00 Not on Positive side of Neutral
01 On positive side of Neutral
10 Error ...";
CM_ SG_ 3221225472 Jystck5XAxsLvrLftNgtivePosStatus "Reports when the current joystick position is on the negative travel side (back, left, counterclockwise, down) relative to the neutral position for that axis of travel.
00 Not on negative side of Neutral
01 On negative side of Neutral
10 Error ...";
CM_ SG_ 3221225472 Joystick5XAxisNeutralPosStatus "Reports when the current joystick position is in the neutral position for that axis of travel.  The neutral position measurement must be determined from some mechanism other than the axis position measurement device.
00 Not in Neutral Position
01 ...";
CM_ SG_ 3221225472 Joystick4Button9PressedStatus "Reports when the joystick button has been pressed.

00 Button not pressed
01 Button pressed
10 Error Indicator
11 Not Available";
CM_ SG_ 3221225472 Joystick4Button10PressedStatus "Reports when the joystick button has been pressed.

00 Button not pressed
01 Button pressed
10 Error Indicator
11 Not Available";
CM_ SG_ 3221225472 Joystick4Button11PressedStatus "Reports when the joystick button has been pressed.

00 Button not pressed
01 Button pressed
10 Error Indicator
11 Not Available";
CM_ SG_ 3221225472 Joystick4Button12PressedStatus "Reports when the joystick button has been pressed.

00 Button not pressed
01 Button pressed
10 Error Indicator
11 Not Available";
CM_ SG_ 3221225472 Joystick4Button5PressedStatus "Reports when the joystick button has been pressed.

00 Button not pressed
01 Button pressed
10 Error Indicator
11 Not Available";
CM_ SG_ 3221225472 Joystick4Button6PressedStatus "Reports when the joystick button has been pressed.

00 Button not pressed
01 Button pressed
10 Error Indicator
11 Not Available";
CM_ SG_ 3221225472 Joystick4Button7PressedStatus "Reports when the joystick button has been pressed.

00 Button not pressed
01 Button pressed
10 Error Indicator
11 Not Available";
CM_ SG_ 3221225472 Joystick4Button8PressedStatus "Reports when the joystick button has been pressed.

00 Button not pressed
01 Button pressed
10 Error Indicator
11 Not Available";
CM_ SG_ 3221225472 Joystick4Button1PressedStatus "Reports when the joystick button has been pressed.

00 Button not pressed
01 Button pressed
10 Error Indicator
11 Not Available";
CM_ SG_ 3221225472 Joystick4Button2PressedStatus "Reports when the joystick button has been pressed.

00 Button not pressed
01 Button pressed
10 Error Indicator
11 Not Available";
CM_ SG_ 3221225472 Joystick4Button3PressedStatus "Reports when the joystick button has been pressed.

00 Button not pressed
01 Button pressed
10 Error Indicator
11 Not Available";
CM_ SG_ 3221225472 Joystick4Button4PressedStatus "Reports when the joystick button has been pressed.

00 Button not pressed
01 Button pressed
10 Error Indicator
11 Not Available";
CM_ SG_ 3221225472 Joystick4XAxisDetentPosStatus "Reports when the current joystick position is in the detent position for that axis of travel.

00 Not in the Detent Position
01 In the Detent Position
10 Error Indicator
11 Not Available";
CM_ SG_ 3221225472 Joystick4YAxisDetentPosStatus "Reports when the current joystick position is in the detent position for that axis of travel.

00 Not in the Detent Position
01 In the Detent Position
10 Error Indicator
11 Not Available";
CM_ SG_ 3221225472 Joystick4YAxisPos "The position of the joystick in the relative motion of travel from the neutral position.  Position value of 0 is Neutral and position value 1000 (100%) is the end of linear zone.  Value of 1022 indicates an error has occurred.";
CM_ SG_ 3221225472 Jystck4YAxsLvrFrwrdPstvPosStatus "Reports when the current joystick position is on the positive travel side (forward, right, clockwise, up) relative to the neutral position for that axis of travel.
00 Not on Positive side of Neutral
01 On positive side of Neutral
10 Error ...";
CM_ SG_ 3221225472 Jystck4YAxsLvrBckNgtivePosStatus "Reports when the current joystick position is on the negative travel side (back, left, counterclockwise, down) relative to the neutral position for that axis of travel.
00 Not on negative side of Neutral
01 On negative side of Neutral
10 Error ...";
CM_ SG_ 3221225472 Joystick4YAxisNeutralPosStatus "Reports when the current joystick position is in the neutral position for that axis of travel.  The neutral position measurement must be determined from some mechanism other than the axis position measurement device.
00 Not in Neutral Position
01 ...";
CM_ SG_ 3221225472 Joystick4XAxisPos "The position of the joystick in the relative motion of travel from the neutral position.  Position value of 0 is Neutral and position value 1000 (100%) is the end of linear zone.  Value of 1022 indicates an error has occurred.";
CM_ SG_ 3221225472 Jystck4XAxsLvrRghtPstvePosStatus "Reports when the current joystick position is on the positive travel side (forward, right, clockwise, up) relative to the neutral position for that axis of travel.
00 Not on Positive side of Neutral
01 On positive side of Neutral
10 Error ...";
CM_ SG_ 3221225472 Jystck4XAxsLvrLftNgtivePosStatus "Reports when the current joystick position is on the negative travel side (back, left, counterclockwise, down) relative to the neutral position for that axis of travel.
00 Not on negative side of Neutral
01 On negative side of Neutral
10 Error ...";
CM_ SG_ 3221225472 Joystick4XAxisNeutralPosStatus "Reports when the current joystick position is in the neutral position for that axis of travel.  The neutral position measurement must be determined from some mechanism other than the axis position measurement device.
00 Not in Neutral Position
01 ...";
CM_ SG_ 3221225472 Joystick10Button9PressedStatus "Reports when the joystick button has been pressed.

00 Button not pressed
01 Button pressed
10 Error Indicator
11 Not Available";
CM_ SG_ 3221225472 Joystick10Button10PressedStatus "Reports when the joystick button has been pressed.

00 Button not pressed
01 Button pressed
10 Error Indicator
11 Not Available";
CM_ SG_ 3221225472 Joystick10Button11PressedStatus "Reports when the joystick button has been pressed.

00 Button not pressed
01 Button pressed
10 Error Indicator
11 Not Available";
CM_ SG_ 3221225472 Joystick10Button12PressedStatus "Reports when the joystick button has been pressed.

00 Button not pressed
01 Button pressed
10 Error Indicator
11 Not Available";
CM_ SG_ 3221225472 Joystick10Button5PressedStatus "Reports when the joystick button has been pressed.

00 Button not pressed
01 Button pressed
10 Error Indicator
11 Not Available";
CM_ SG_ 3221225472 Joystick10Button6PressedStatus "Reports when the joystick button has been pressed.

00 Button not pressed
01 Button pressed
10 Error Indicator
11 Not Available";
CM_ SG_ 3221225472 Joystick10Button7PressedStatus "Reports when the joystick button has been pressed.

00 Button not pressed
01 Button pressed
10 Error Indicator
11 Not Available";
CM_ SG_ 3221225472 Joystick10Button8PressedStatus "Reports when the joystick button has been pressed.

00 Button not pressed
01 Button pressed
10 Error Indicator
11 Not Available";
CM_ SG_ 3221225472 Joystick10Button1PressedStatus "Reports when the joystick button has been pressed.

00 Button not pressed
01 Button pressed
10 Error Indicator
11 Not Available";
CM_ SG_ 3221225472 Joystick10Button2PressedStatus "Reports when the joystick button has been pressed.

00 Button not pressed
01 Button pressed
10 Error Indicator
11 Not Available";
CM_ SG_ 3221225472 Joystick10Button3PressedStatus "Reports when the joystick button has been pressed.

00 Button not pressed
01 Button pressed
10 Error Indicator
11 Not Available";
CM_ SG_ 3221225472 Joystick10Button4PressedStatus "Reports when the joystick button has been pressed.

00 Button not pressed
01 Button pressed
10 Error Indicator
11 Not Available";
CM_ SG_ 3221225472 Joystick10XAxisDetentPosStatus "Reports when the current joystick position is in the detent position for that axis of travel.

00 Not in the Detent Position
01 In the Detent Position
10 Error Indicator
11 Not Available";
CM_ SG_ 3221225472 Joystick10YAxisDetentPosStatus "Reports when the current joystick position is in the detent position for that axis of travel.

00 Not in the Detent Position
01 In the Detent Position
10 Error Indicator
11 Not Available";
CM_ SG_ 3221225472 Joystick10YAxisPos "The position of the joystick in the relative motion of travel from the neutral position.  Position value of 0 is Neutral and position value 1000 (100%) is the end of linear zone.  Value of 1022 indicates an error has occurred.";
CM_ SG_ 3221225472 Jystck10YAxsLvrFrwrdPstvPsStatus "Reports when the current joystick position is on the positive travel side (forward, right, clockwise, up) relative to the neutral position for that axis of travel.
00 Not on Positive side of Neutral
01 On positive side of Neutral
10 Error ...";
CM_ SG_ 3221225472 Jystck10YAxsLvrBckNgtvePosStatus "Reports when the current joystick position is on the negative travel side (back, left, counterclockwise, down) relative to the neutral position for that axis of travel.
00 Not on negative side of Neutral
01 On negative side of Neutral
10 Error ...";
CM_ SG_ 3221225472 Joystick10YAxisNeutralPosStatus "Reports when the current joystick position is in the neutral position for that axis of travel.  The neutral position measurement must be determined from some mechanism other than the axis position measurement device.
00 Not in Neutral Position
01 ...";
CM_ SG_ 3221225472 Joystick10XAxisPos "The position of the joystick in the relative motion of travel from the neutral position.  Position value of 0 is Neutral and position value 1000 (100%) is the end of linear zone.  Value of 1022 indicates an error has occurred.";
CM_ SG_ 3221225472 Jystck10XAxsLvrRghtPstvPosStatus "Reports when the current joystick position is on the positive travel side (forward, right, clockwise, up) relative to the neutral position for that axis of travel.
00 Not on Positive side of Neutral
01 On positive side of Neutral
10 Error ...";
CM_ SG_ 3221225472 Jystck10XAxsLvrLftNgtvePosStatus "Reports when the current joystick position is on the negative travel side (back, left, counterclockwise, down) relative to the neutral position for that axis of travel.
00 Not on negative side of Neutral
01 On negative side of Neutral
10 Error ...";
CM_ SG_ 3221225472 Joystick10XAxisNeutralPosStatus "Reports when the current joystick position is in the neutral position for that axis of travel.  The neutral position measurement must be determined from some mechanism other than the axis position measurement device.
00 Not in Neutral Position
01 ...";
CM_ SG_ 3221225472 PssngrArbgDctivationSwitchStatus "State of switch used to deactivate Passenger Airbag manually.

00 = passenger airbag activated
01 = passenger airbag deactivated
10 = Error - State of deactivation switch cannot be determined
11 = not available";
CM_ SG_ 3221225472 Beltlock10Status "State of switch used to determine if Beltlock 10 is buckled.

00 = unlocked
01 = locked
10 = Error - Beltlock state cannot be determined
11 = not available";
CM_ SG_ 3221225472 Beltlock9Status "State of switch used to determine if Beltlock 9 is buckled.

00 = unlocked
01 = locked
10 = Error - Beltlock state cannot be determined
11 = not available";
CM_ SG_ 3221225472 Beltlock8Status "State of switch used to determine if Beltlock 8 is buckled.

00 = unlocked
01 = locked
10 = Error - Beltlock state cannot be determined
11 = not available";
CM_ SG_ 3221225472 Beltlock7Status "State of switch used to determine if Beltlock 7 is buckled.

00 = unlocked
01 = locked
10 = Error - Beltlock state cannot be determined
11 = not available";
CM_ SG_ 3221225472 Beltlock6Status "State of switch used to determine if Beltlock 6 is buckled.

00 = unlocked
01 = locked
10 = Error - Beltlock state cannot be determined
11 = not available";
CM_ SG_ 3221225472 Beltlock5Status "State of switch used to determine if Beltlock 5 is buckled.

00 = unlocked
01 = locked
10 = Error - Beltlock state cannot be determined
11 = not available";
CM_ SG_ 3221225472 Beltlock4Status "State of switch used to determine if Beltlock 4 is buckled.

00 = unlocked
01 = locked
10 = Error - Beltlock state cannot be determined
11 = not available";
CM_ SG_ 3221225472 Beltlock3Status "State of switch used to determine if Beltlock 3 is buckled.

00 = unlocked
01 = locked
10 = Error - Beltlock state cannot be determined
11 = not available";
CM_ SG_ 3221225472 PassengerBeltlockStatus "State of switch used to determine if Passenger Beltlock is buckled.

00 = unlocked
01 = locked
10 = Error - Beltlock state cannot be determined
11 = not available";
CM_ SG_ 3221225472 DriverBeltlockStatus "State of switch used to determine if Driver Beltlock is buckled.

00 = unlocked
01 = locked
10 = Error - Beltlock state cannot be determined
11 = not available";
CM_ SG_ 3221225472 BatteryCharger2OutputCurrent "Output current of the battery charger connected to the main battery. If positive, this parameter shows the charging current of the battery charger connected to the main battery.  Otherwise, if the charger hardware permits, this parameter represents ...";
CM_ SG_ 3221225472 BatteryCharger2OutputVoltage "Output voltage measured on the battery terminals of the offline battery charger connected to the auxiliary battery.";
CM_ SG_ 3221225472 BatteryCharger2PowerLineState "A state of the battery charger connection to the power line for the charger connected to the auxiliary battery.
0 - Disconnected. The power line is disconnected from the charger.
1 - Connected. The power line is connected to the charger.
2 - ...";
CM_ SG_ 3221225472 BatteryCharger2State "A state of the offline battery charger connected to the auxiliary battery.
0 - Idling. The power line or the battery is disconnected from the charger.
1 - Charging the battery.
2 - Stand-by or maintaining the battery charge.
3 to 12 - Reserved
 ...";
CM_ SG_ 3221225472 BatteryCharger1OutputCurrent "Output current of the battery charger connected to the main battery. If positive, this parameter shows the charging current of the battery charger connected to the main battery.  Otherwise, if the charger hardware permits, this parameter represents ...";
CM_ SG_ 3221225472 BatteryCharger1OutputVoltage "Output voltage measured on the battery terminals of the battery charger connected to the main battery.";
CM_ SG_ 3221225472 BatteryCharger1PowerLineState "A state of the battery charger connection to the power line for the charger connected to the main battery.
0 - Disconnected. The power line is disconnected from the charger.
1 - Connected. The power line is connected to the charger.
2 - Error
3 ...";
CM_ SG_ 3221225472 BatteryCharger1State "A state of the battery charger connected to the main battery.
0 - Idling. The power line or the battery is disconnected from the charger.
1 - Charging the battery.
2 - Stand-by or maintaining the battery charge.
3 to 12 - Reserved
13 - Battery ...";
CM_ SG_ 3221225472 TwoTWCDiffTemp "The differential engine combustion byproducts gas temperature measured between the intake and outlet of the three way catalyst for exhaust bank 2.";
CM_ SG_ 3221225472 OneTWCDiffTemp "The differential engine combustion byproducts gas temperature measured between the intake and outlet of the three way catalyst for exhaust bank 1.";
CM_ SG_ 3221225472 TwoGOCDiffTemp "The differential engine combustion byproducts gas temperature measured between the intake and outlet of the gas oxidation catalyst for exhaust bank 2.  This parameter should be used with engine fueled by gaseous fuel like natural gas or propane ...";
CM_ SG_ 3221225472 OneGOCDiffTemp "The differential engine combustion byproducts gas temperature measured between the intake and outlet of the gas oxidation catalyst for exhaust bank 1.  This parameter should be used with engine fueled by gaseous fuel like natural gas or propane ...";
CM_ SG_ 3221225472 OutTemp "Temperature of engine combustion byproducts leaving the warm up Diesel Oxidation Catalyst in exhaust bank 2.  This diesel parameter should be used with engines fueled by diesel fuel (not gaseous fuel like natural gas or propane).  A separate ...";
CM_ SG_ 3221225472 InTemp "Temperature of engine combustion byproducts entering the warm up Diesel Oxidation Catalyst in exhaust bank 2.  This diesel parameter should be used with engines fueled by diesel fuel (not gaseous fuel like natural gas or propane).  A separate ...";
CM_ SG_ 3221225472 DiffPressPreliminaryFMI "Used to identify the applicable J1939-73 FMI detected in the Three Way Catalytic Converter differential pressure sensor by the manufacturer's sensor control software in exhaust bank 2. When there is no failure FMI 31 is sent. In the case of multiple ...";
CM_ SG_ 3221225472 OutTempPreliminaryFMI "Used to identify the applicable J1939-73 FMI detected in the Three Way Catalyst outlet temperature sensor by the manufacturer's sensor control software in exhaust bank 2. When there is no failure FMI 31 is sent. In the case of multiple failures the ...";
CM_ SG_ 3221225472 InTempPreliminaryFMI "Used to identify the applicable J1939-73 FMI detected in the Three Way Catalyst intake temperature sensor by the manufacturer's sensor control software in exhaust bank 2. When there is no failure FMI 31 is sent. In the case of multiple failures the ...";
CM_ SG_ 3221225472 DiffPress "Exhaust differential pressure measured between the intake and exhaust of a Three Way Catalyst in exhaust bank 2.

(For a single exhaust bank system, refer to parameters in PGN 64838.)";
CM_ SG_ 3221225472 OutTemp "Temperature of engine combustion byproducts leaving the Three Way Catalyst in exhaust bank 2. 
 
(For a single exhaust bank system, refer to parameters in PGN 64838.)";
CM_ SG_ 3221225472 InTemp "Temperature of engine combustion byproducts entering the Three Way Catalyst in exhaust bank 2.

(For a single exhaust bank system, refer to parameters in PGN 64838.)";
CM_ SG_ 3221225472 CorrectedNOx "The corrected outlet NOx value  for aftertreatment 2 shall include all learned adaptions and offsets that are used to adjust the raw signal.
2016 MY and later engines with NOx sensors may be required to output a ‘corrected' NOx sensor signal in ...";
CM_ SG_ 3221225472 NOxSnsrSelfDiagFinalResult "Self-diagnosis result for NOx sensor ATO2 (Aftertreatment Outlet Bank 2) as a ratio of detected value to reference value defined by supplier.
This result is used to determine if the signal resulting from the self-diagnosis test (as represented as a ...";
CM_ SG_ 3221225472 NOxSnsrNH3Correction "Correction of NH3 at the NOx-signal to correct (recalculate) sensor signal on the Engine ECU side.";
CM_ SG_ 3221225472 NOxSnsrNO2Correction "Correction of NO2 at the NOx-signal to correct (recalculate) sensor signal on the Engine ECU side.";
CM_ SG_ 3221225472 NOxSnsrNOxPressCorrection "Correction of pressure NOx-signal to correct (recalculate) sensor signal on the Engine ECU side.";
CM_ SG_ 3221225472 NOxSnsrO2PressCorrection "Correction of pressure Lambda-signal to correct (recalculate) sensor signal on the Engine ECU side.";
CM_ SG_ 3221225472 NOxSnsrOpHours "Counted hours that the NOx-sensor was operated with status 'dewpoint reached'";
CM_ SG_ 3221225472 NOxSnsrNewPartDeviationNOxOffset "New part deviation NOx_Offset to correct (recalculate) sensor signal on the Engine ECU side.";
CM_ SG_ 3221225472 NOxSnsrNewPartDeviationNOxGain "New part deviation NOx_Gain to correct (recalculate) sensor signal on the Engine ECU side.";
CM_ SG_ 3221225472 NOxSnsrHtrRatio "Heater ratio to determine temperature at sensor tip.";
CM_ SG_ 3221225472 SCRInCorrectedNOx "The corrected intake Selective Catalytic Reduction NOx value for aftertreatment 2 shall include all learned adaptions and offsets that are used to adjust the raw signal.
2016 MY and later engines with NOx sensors may be required to output a ...";
CM_ SG_ 3221225472 NOxSnsrSelfDiagFinalResult "Self-diagnosis result for NOx sensor ATI2 (Aftertreatment Intake Bank 2) as a ratio of detected value to reference value defined by supplier.
This result is used to determine if the signal resulting from the self-diagnosis test (as represented as a ...";
CM_ SG_ 3221225472 NOxSnsrNH3Correction "Correction of NH3 at the NOx-signal to correct (recalculate) sensor signal on the Engine ECU side.";
CM_ SG_ 3221225472 NOxSnsrNO2Correction "Correction of NO2 at the NOx-signal to correct (recalculate) sensor signal on the Engine ECU side.";
CM_ SG_ 3221225472 NOxSnsrNOxPressCorrection "Correction of pressure NOx-signal to correct (recalculate) sensor signal on the Engine ECU side.";
CM_ SG_ 3221225472 NOxSnsrO2PressCorrection "Correction of pressure Lambda-signal to correct (recalculate) sensor signal on the Engine ECU side.";
CM_ SG_ 3221225472 NOxSnsrOpHours "Counted hours that the NOx-sensor was operated with status 'dewpoint reached'";
CM_ SG_ 3221225472 NOxSnsrNewPartDeviationNOxOffset "New part deviation NOx_Offset to correct (recalculate) sensor signal on the Engine ECU side.";
CM_ SG_ 3221225472 NOxSnsrNewPartDeviationNOxGain "New part deviation NOx_Gain to correct (recalculate) sensor signal on the Engine ECU side.";
CM_ SG_ 3221225472 NOxSnsrHtrRatio "Heater ratio to determine temperature at sensor tip.";
CM_ SG_ 3221225472 Press2Ctrl "Indicates how the device is controlling the aftertreatment 2 fuel pressure 2 regulating control valve.   0% = fully closed, 100%=fully open.";
CM_ SG_ 3221225472 FlowDiverterVlvCtrl "Indicates how the device is controlling the aftertreatment 2 fuel flow diverter valve. When this valve is on it diverts fuel flow from the Aftertreatment 2 Regeneration Device.

00 off
01 on
10 reserved for SAE assignment
11 not available";
CM_ SG_ 3221225472 PumpRelayCtrl "Indicates how the device is controlling the aftertreatment 2 fuel pump relay.

00 off
01 on
10 reserved for SAE assignment
11 not available";
CM_ SG_ 3221225472 Press2 "Second fuel pressure measurement for the aftertreatment 2 system.";
CM_ SG_ 3221225472 StdDeviationCalOffset "Calibration offset for the soot standard deviation for Aftertreatment 2 Diesel Particulate Filter soot sensor.";
CM_ SG_ 3221225472 MeanCalOffset "Calibration offset for the soot Mean for Aftertreatment 2 Diesel Particulate Filter soot sensor.";
CM_ SG_ 3221225472 OutTemp "This is the temperature measured at the outlet of the warm up oxidation catalytic converter in exhaust bank 1.";
CM_ SG_ 3221225472 InTemp "This is the temperature measured at the intake of the warm up oxidation catalytic converter in exhaust bank 1.";
CM_ SG_ 3221225472 DiffPressPreliminaryFMI "Used to identify the applicable J1939-73 FMI detected in the Three Way Catalytic Converter differential pressure sensor by the manufacturer's sensor control software in exhaust bank 1. When there is no failure FMI 31 is sent. In the case of multiple ...";
CM_ SG_ 3221225472 OutTempPreliminaryFMI "Used to identify the applicable J1939-73 FMI detected in the Three Way Catalyst outlet temperature sensor by the manufacturer's sensor control software in exhaust bank 1. When there is no failure FMI 31 is sent. In the case of multiple failures the ...";
CM_ SG_ 3221225472 InTempPreliminaryFMI "Used to identify the applicable J1939-73 FMI detected in the Three Way Catalyst intake temperature sensor by the manufacturer's sensor control software in exhaust bank 1. When there is no failure FMI 31 is sent. In the case of multiple failures the ...";
CM_ SG_ 3221225472 DiffPress "Exhaust differential pressure measured between the intake and exhaust of a Three Way Catalyst in exhaust bank 1.";
CM_ SG_ 3221225472 OutTemp "Temperature of engine combustion byproducts leaving the Three Way Catalyst in exhaust bank 1.";
CM_ SG_ 3221225472 InTemp "Temperature of engine combustion byproducts entering the Three Way Catalyst in exhaust bank 1.";
CM_ SG_ 3221225472 HtrPreliminaryFMI "Used to identify the applicable J1939-73 FMI detected for the heater of the diesel exhaust fluid tank for aftertreatment system 1 (exhaust bank 1), as detected by the manufacturer's control software.  When there is no failure, FMI 31 is sent. In the ...";
CM_ SG_ 3221225472 SCROpIndSev "Severity status of the operator inducement system for anomalies with the SCR system, such as tampering, low DEF quality, and DEF tank level.  Higher numerical levels indicate more severe levels of inducement.  Level 1 is the least severe.
000 - ...";
CM_ SG_ 3221225472 TempPreliminaryFMI "Used to identify the applicable J1939-73 FMI detected for the diesel exhaust fluid tank temperature for aftertreatment system 1 (exhaust bank 1), as detected by the manufacturer's control software. When there is no failure, FMI 31 is sent. In the ...";
CM_ SG_ 3221225472 DEFTankLowLvlInd "The desired illumination of the driver's warning indicator for diesel exhaust fluid (DEF) tank low level.
000 - Off -  indicates adequate DEF level
e.g., for Euro VI this is used to indicate the driver warning system is non-active for diesel ...";
CM_ SG_ 3221225472 LvlVolPreliminaryFMI "Used to identify the applicable J1939-73 FMI detected in the diesel exhaust fluid tank level sensor by the manufacturer's sensor control software.  This FMI is applicable to either the diesel exhaust fluid tank level or diesel exhaust fluid tank ...";
CM_ SG_ 3221225472 Lvl "The diesel exhaust fluid level height in mm in the diesel exhaust fluid storage container for aftertreatment system 1 (exhaust bank 1).  See SPN 1761 and SPN 7530 for alternate measurements.
Parameter Specific Indicator:
A value of 0xFB indicates ...";
CM_ SG_ 3221225472 Temp1 "Temperature of the diesel exhaust fluid in the storage tank.";
CM_ SG_ 3221225472 Volume "Ratio of volume of diesel exhaust fluid to the total volume of diesel exhaust fluid storage container for aftertreatment system 1 (exhaust bank 1).  0% is empty and 100% is full.  See SPN 3517 and SPN 7530 for alternate measurements.
Parameter ...";
CM_ SG_ 3221225472 CorrectedNOx "The corrected outlet NOx value for aftertreatment 1 shall include all learned adaptions and offsets that are used to adjust the raw signal.
2016 MY and later engines with NOx sensors may be required to output a ‘corrected' NOx sensor signal in ...";
CM_ SG_ 3221225472 NOxSnsrSelfDiagFinalResult "Self-diagnosis result for NOx sensor ATO1 (Aftertreatment Outlet Bank 1) as a ratio of detected value to reference value defined by supplier.
This result is used to determine if the signal resulting from the self-diagnosis test (as represented as a ...";
CM_ SG_ 3221225472 NOxSnsrNH3Correction "Correction of NH3 at the NOx-signal to correct (recalculate) sensor signal on the Engine ECU side.";
CM_ SG_ 3221225472 NOxSnsrNO2Correction "Correction of NO2 at the NOx-signal to correct (recalculate) sensor signal on the Engine ECU side.";
CM_ SG_ 3221225472 NOxSnsrNOxPressCorrection "Correction of pressure NOx-signal to correct (recalculate) sensor signal on the Engine ECU side.";
CM_ SG_ 3221225472 NOxSnsrO2PressCorrection "Correction of pressure Lambda-signal to correct (recalculate) sensor signal on the Engine ECU side.";
CM_ SG_ 3221225472 NOxSnsrOpHours "Counted hours that the NOx-sensor was operated with status 'dewpoint reached'";
CM_ SG_ 3221225472 NOxSnsrNewPartDeviationNOxOffset "New part deviation NOx_Offset to correct (recalculate) sensor signal on the Engine ECU side.";
CM_ SG_ 3221225472 NOxSnsrNewPartDeviationNOxGain "New part deviation NOx_Gain to correct (recalculate) sensor signal on the Engine ECU side.";
CM_ SG_ 3221225472 NOxSnsrHtrRatio "Heater ratio to determine temperature at sensor tip.";
CM_ SG_ 3221225472 SCRInCorrectedNOx "The corrected intake Selective Catalytic Reduction NOx value for aftertreatment 1 shall include all learned adaptions and offsets that are used to adjust the raw signal.
2016 MY and later engines with NOx sensors may be required to output a ...";
CM_ SG_ 3221225472 NOxSnsrSelfDiagFinalResult "Self-diagnosis result for NOx sensor ATI1 (Aftertreatment Intake Bank 1) as a ratio of detected value to reference value defined by supplier.
This result is used to determine if the signal resulting from the self-diagnosis test (as represented as a ...";
CM_ SG_ 3221225472 NOxSnsrNH3Correction "Correction of NH3 at the NOx-signal to correct (recalculate) sensor signal on the Engine ECU side.";
CM_ SG_ 3221225472 NOxSnsrNO2Correction "Correction of NO2 at the NOx-signal to correct (recalculate) sensor signal on the Engine ECU side.";
CM_ SG_ 3221225472 NOxSnsrNOxPressCorrection "Correction of pressure NOx-signal to correct (recalculate) sensor signal on the Engine ECU side.";
CM_ SG_ 3221225472 NOxSnsrO2PressCorrection "Correction of pressure Lambda-signal to correct (recalculate) sensor signal on the Engine ECU side.";
CM_ SG_ 3221225472 NOxSnsrOpHours "Counted hours that the NOx-sensor was operated with status 'dewpoint reached'";
CM_ SG_ 3221225472 NOxSnsrNewPartDeviationNOxOffset "New part deviation NOx_Offset to correct (recalculate) sensor signal on the Engine ECU side.";
CM_ SG_ 3221225472 NOxSnsrNewPartDeviationNOxGain "New part deviation NOx_Gain to correct (recalculate) sensor signal on the Engine ECU side.";
CM_ SG_ 3221225472 NOxSnsrHtrRatio "Heater ratio to determine temperature at sensor tip.";
CM_ SG_ 3221225472 StdDeviationCalOffset "Calibration offset for the soot standard deviation for Aftertreatment 1 Diesel Particulate Filter soot sensor.";
CM_ SG_ 3221225472 MeanCalOffset "Calibration offset for the soot Mean for Aftertreatment 1 Diesel Particulate Filter soot sensor.";
CM_ SG_ 3221225472 Armrest2Switch2 "Status of the second switch located in armrest 2.

00: Off
01: On
10: Reserved
11: Don't care/take no action";
CM_ SG_ 3221225472 Armrest2Switch1 "Status of the first switch located in armrest 2.

00: Off
01: On
10: Reserved
11: Don't care/take no action";
CM_ SG_ 3221225472 Armrest1Switch2 "Status of the second switch located in armrest 1.

00: Off
01: On
10: Reserved
11: Don't care/take no action";
CM_ SG_ 3221225472 Armrest1Switch1 "Status of the first switch located in armrest 1.

00: Off
01: On
10: Reserved
11: Don't care/take no action";
CM_ SG_ 3221225472 AngularRateMeasurementLatency "The estimated measurement latency of the measurement.
NOTE: This is only the sensor latency and does not include any additional latencies that might exist because of the CAN Bus or overall system implementation. Latency is the time from sensor ...";
CM_ SG_ 3221225472 YawRateExRangeFigureOfMerit "Figure of merit for yaw angle measurement.

00 = Yaw rate fully functional. Data is within sensor specification.
01 = Yaw rate degraded. Data is suspect due to environmental conditions.
10 = Error
11 = Not available";
CM_ SG_ 3221225472 RollRateExRangeFigureOfMerit "Figure of merit for roll rate measurement.

00 = Roll rate fully functional. Data is within sensor specification.
01 = Roll rate degraded. Data is suspect due to environmental conditions.
10 = Error
11 = Not available";
CM_ SG_ 3221225472 PitchRateExRangeFigureOfMerit "Figure of merit for pitch rate measurement.

00 = Pitch rate fully functional. Data is within sensor specification.
01 = Pitch rate degraded. Data is suspect due to environmental conditions.
10 = Error
11 = Not available";
CM_ SG_ 3221225472 YawRateExRange "Yaw rate is the rate-of-change of the yaw angle over time.  A positive yaw rate signal results when the object turns clockwise.  This parameter is defined according to a Z-Down axis system and the sign of the value is in accordance to the right-hand ...";
CM_ SG_ 3221225472 RollRateExRange "Roll rate is the rate-of-change of the roll angle over time.  The roll rate for increasing roll to the right is reported with a positive value. Roll angle is the same for both Z-Down and Z-Up axis systems, since both systems have positive X axis ...";
CM_ SG_ 3221225472 PitchRateExRange "Pitch rate is the rate-of-change of the pitch angle over time, where the pitch angle vector is in the direction of travel of the vehicle. The pitch rate for increasing ascent over time is reported with a positive value. This parameter is defined ...";
CM_ SG_ 3221225472 DesulfationStatus "Indicates whether the NOx adsorber desulfation regeneration in the second aftertreatment system is active or inactive

00  Inactive
01  Active
10  Error indicator
11  Not available";
CM_ SG_ 3221225472 DesulfationStatus "Indicates whether the NOx adsorber desulfation regeneration in the first aftertreatment system is active or inactive

00  Inactive
01  Active
10  Error indicator
11  Not available";
CM_ SG_ 3221225472 DEFQuickThawHtrPreliminaryFMI "Used to identify the applicable J1939-73 FMI detected for the heater of the diesel exhaust fluid quick thaw tank for aftertreatment system 2 (exhaust bank 2), as detected by the manufacturer's control software.  When there is no failure, FMI 31 is ...";
CM_ SG_ 3221225472 DEFQuickThawHtr "The diesel exhaust fluid quick thaw tank heater percentage for aftertreatment system 2 (exhaust bank 2). 0% is off. See SPN 5415 for the command for this tank heater.";
CM_ SG_ 3221225472 DEFQuickThawTempPreliminaryFMI "Used to identify the applicable J1939-73 FMI detected for the diesel exhaust fluid quick thaw tank temperature for aftertreatment system 2 (exhaust bank 2), as detected by the manufacturer's control software. When there is no failure, FMI 31 is ...";
CM_ SG_ 3221225472 DEFQuickThawLvlPreliminaryFMI "Used to identify the applicable J1939-73 FMI detected for the fluid level height of the diesel exhaust fluid quick thaw tank for aftertreatment system 2 (exhaust bank 2), as detected by the manufacturer's control software.  This FMI is applicable to ...";
CM_ SG_ 3221225472 DEFQuickThawTankLvl "The diesel exhaust fluid level height in mm in the diesel exhaust fluid quick thaw tank for aftertreatment system 2 (exhaust bank 2).  See SPN 4433 for alternate measurement.
Parameter Specific Indicator:
A value of 0xFB indicates conditions are ...";
CM_ SG_ 3221225472 DEFQuickThawTemp "The diesel exhaust fluid quick thaw tank temperature for aftertreatment system 2 (exhaust bank 2).";
CM_ SG_ 3221225472 DEFQuickThawTankVolume "Ratio of volume of diesel exhaust fluid to the total volume of diesel exhaust fluid storage container for aftertreatment system 2 (exhaust bank 2).  0% is empty and 100% is full.  An alternative to this SPN is SPN 4435.
Parameter Specific ...";
CM_ SG_ 3221225472 HtrPreliminaryFMI "Used to identify the applicable J1939-73 FMI detected for the heater of the diesel exhaust fluid tank for aftertreatment system 2 (exhaust bank 2), as detected by the manufacturer's control software.  When there is no failure, FMI 31 is sent. In the ...";
CM_ SG_ 3221225472 TempPreliminaryFMI "Used to identify the applicable J1939-73 FMI detected for the diesel exhaust fluid tank temperature for aftertreatment system 2 (exhaust bank 2), as detected by the manufacturer's control software. When there is no failure, FMI 31 is sent. In the ...";
CM_ SG_ 3221225472 LvlVolPreliminaryFMI "Used to identify the applicable J1939-73 FMI detected in the diesel exhaust fluid tank level sensor by the manufacturer's sensor control software.  This FMI is applicable to either the diesel exhaust fluid tank level or diesel exhaust fluid tank ...";
CM_ SG_ 3221225472 Lvl "The diesel exhaust fluid level height in mm in the diesel exhaust fluid storage container for aftertreatment system 2 (exhaust bank 2).  See SPN 4426 and SPN 7531 for alternate measurements.
Parameter Specific Indicator:
A value of 0xFB indicates ...";
CM_ SG_ 3221225472 Temp1 "Temperature of the diesel exhaust fluid in the storage tank.";
CM_ SG_ 3221225472 Volume "Ratio of volume of diesel exhaust fluid to the total volume of the diesel exhaust fluid storage container for aftertreatment system 2 (exhaust bank 2).  0% is empty and 100% is full.  See SPN 4428 and SPN 7531 for alternate measurements.
Parameter ...";
CM_ SG_ 3221225472 DosingUnit2DiverterVlv "Command to the valve which determines whether the diesel exhaust fluid of dosing unit 2 is delivered to the injector or is routed back to the diesel exhaust fluid tank. Zero directs all diesel exhaust fluid flow to the injector, 100% sends all ...";
CM_ SG_ 3221225472 TankDrainVlvCmd "Commanded percentage of maximum Aftertreatment 2 Diesel Exhaust Fluid Tank Drain Valve opening. 100% means the the drain valve is fully open providing maximum flow of diesel exhaust fluid out of  the diesel exhaust fluid tank.";
CM_ SG_ 3221225472 PumpSt "State of Aftertreatment 2 Diesel Exhaust Fluid dosing pump.

00  pump operational
01  pump error
10  reserved for SAE assignment
11 not available";
CM_ SG_ 3221225472 TankFillVlvCmd "Commanded percentage of maximum Aftertreatment 2 Diesel Exhaust Fluid Tank Fill Valve opening. 100% means the fill valve is fully open providing maximum flow of diesel exhaust fluid into the diesel exhaust fluid tank.";
CM_ SG_ 3221225472 DosingUnit1DiverterVlv "Command to the valve which determines whether the diesel exhaust fluid of dosing unit 1 is delivered to the injector or is routed back to the diesel exhaust fluid tank. Zero directs all diesel exhaust fluid flow to the injector, 100% sends all ...";
CM_ SG_ 3221225472 PumpDrivePercentage "The percent (command) sent to the motor to control the speed of  the diesel exhaust fluid pump.";
CM_ SG_ 3221225472 Pump1MotorSpd "Rotational speed of the motor driving the first or only pump for the diesel exhaust fluid used in aftertreatment system 2 (exhaust bank 2).";
CM_ SG_ 3221225472 TypeProperty "This parameter indicates the property of the fluid compound in the tank.  A value of 0011 indicates uncontaminated Diesel Exhaust Fluid.
0000 - Urea concentration too high
0001 - Urea concentration too low
0010 - Fluid is diesel
0011 - Diesel ...";
CM_ SG_ 3221225472 OutTempPreliminaryFMI "Used to identify the applicable J1939-73 FMI detected in the SCR outlet temperature sensor by the manufacturer's sensor control software in exhaust bank 2. When there is no failure FMI 31 is sent. In the case of multiple failures the most severe is ...";
CM_ SG_ 3221225472 OutTemp "Temperature of engine combustion byproducts leaving the SCR exhaust in exhaust bank 2.";
CM_ SG_ 3221225472 InTempPreliminaryFMI "Used to identify the applicable J1939-73 FMI detected in the SCR intake temperature sensor by the manufacturer's sensor control software in exhaust bank 2. When there is no failure FMI 31 is sent. In the case of multiple failures the most severe is ...";
CM_ SG_ 3221225472 InTemp "Temperature of engine combustion byproducts entering the SCR in exhaust bank 2.";
CM_ SG_ 3221225472 InAbsPress "Used to read the pressure at the catalyst intake of the selective catalytic reduction system of aftertreatment 2.";
CM_ SG_ 3221225472 InPress "The gage pressure at the intake of the selective catalytic reduction system of Aftertreatment 2.";
CM_ SG_ 3221225472 DiffPressPreliminaryFMI "Used to identify the applicable J1939-73 FMI detected in the SCR differential pressure sensor by the manufacturer's sensor control software in exhaust bank 2. When there is no failure FMI 31 is sent. In the case of multiple failures the most severe ...";
CM_ SG_ 3221225472 DiffPress "Differential pressure measured between the intake and exhaust of an SCR component in exhaust bank 2.";
CM_ SG_ 3221225472 DEFLineHtr10 "The diesel exhaust fluid line heater 10 request for aftertreatment system 2 (exhaust bank 2).

00 = request for heater to be inactive
01 = request for heater to be active
10 = reserved for future assignment by SAE
11 = not available";
CM_ SG_ 3221225472 DEFLineHtr9 "The diesel exhaust fluid line heater 9 request for aftertreatment system 2 (exhaust bank 2).

00 = request for heater to be inactive
01 = request for heater to be active
10 = reserved for future assignment by SAE
11 = not available";
CM_ SG_ 3221225472 DEFLineHtr8 "The diesel exhaust fluid line heater 8 request for aftertreatment system 2 (exhaust bank 2).

00 = request for heater to be inactive
01 = request for heater to be active
10 = reserved for future assignment by SAE
11 = not available";
CM_ SG_ 3221225472 DEFLineHtr7 "The diesel exhaust fluid line heater 7 request for aftertreatment system 2 (exhaust bank 2).

00 = request for heater to be inactive
01 = request for heater to be active
10 = reserved for future assignment by SAE
11 = not available";
CM_ SG_ 3221225472 DEFLineHtr6 "The diesel exhaust fluid line heater 6 request for aftertreatment system 2 (exhaust bank 2).

00 = request for heater to be inactive
01 = request for heater to be active
10 = reserved for future assignment by SAE
11 = not available";
CM_ SG_ 3221225472 DEFLineHtr5 "Identifies the diesel exhaust fluid line heater 5 request for aftertreatment system 2 (exhaust bank 2).

00 request for heater to be inactive 
01 request for heater to be active 
10 reserved for future assignment by SAE 
11 not available";
CM_ SG_ 3221225472 DEFLineHtrRelay3 "The aftertreatment system 2 diesel exhaust fluid line heater relay 3 is used to energize one or more DEF line heaters.

00 - Off
01 - On
10 - Error
11 - Not available";
CM_ SG_ 3221225472 DEFLineHtrRelay2 "The aftertreatment system 2 diesel exhaust fluid line heater relay 2 is used to energize one or more DEF line heaters.

00 - Off
01 - On
10 - Error
11 - Not available";
CM_ SG_ 3221225472 DEFLineHtrRelay1 "The aftertreatment system 2 diesel exhaust fluid line heater relay 1 is used to energize one or more DEF line heaters.

00 - Off
01 - On
10 - Error
11 - Not available";
CM_ SG_ 3221225472 DEFQuickThawHtrCmd "The command for the heater of the diesel exhaust fluid quick thaw tank for aftertreatment system 2 (exhaust bank 2).  See SPN 4438 for the measured heater percentage for the heater of this same tank.";
CM_ SG_ 3221225472 DEFTankHtrCmd "Command for the Aftertreatment 2 Diesel Exhaust Fluid Tank Heater.  A value of 0% means no heating applied, a value of 100% means full heating applied.  See SPN 4431 for the measured value of the Aftertreatment 2 Diesel Exhaust Fluid Tank Heater.";
CM_ SG_ 3221225472 DEFLineHtr4 "The diesel exhaust fluid line heater 4 request for aftertreatment system 2 (exhaust bank 2). 
 
00 request for heater to be inactive 
01 request for heater to be active 
10 reserved for future assignment by SAE 
11 not available";
CM_ SG_ 3221225472 DEFLineHtr3 "The diesel exhaust fluid line heater 3 request for aftertreatment system 2 (exhaust bank 2). 

00 request for heater to be inactive 
01 request for heater to be active 
10 reserved for future assignment by SAE 
11 not available";
CM_ SG_ 3221225472 DEFLineHtr2 "The diesel exhaust fluid line heater 2 request for aftertreatment system 2 (exhaust bank 2). 

00 request for heater to be inactive 
01 request for heater to be active 
10 reserved for future assignment by SAE 
11 not available";
CM_ SG_ 3221225472 DEFLineHtr1 "The diesel exhaust fluid line heater 1 request for aftertreatment system 2 (exhaust bank 2). 

00 request for heater to be inactive 
01 request for heater to be active 
10 reserved for future assignment by SAE 
11 not available";
CM_ SG_ 3221225472 DEFDoserHeatingModeReq "Used if multiple heater modes are available in the Doser.

000   Heater off
001   Heater economy mode
010   Heater automatic mode
011   Heater on
100 - 110    Reserved
111   Not available";
CM_ SG_ 3221225472 DEFDoserFaultSuppressionReq "Used if external devices can warn of conditions that require suppression of potential faults in the doser due to environmental conditions.

00    Error suppression off
01    Error suppression on
10    Reserved
11    Not available";
CM_ SG_ 3221225472 DEFReqQuantityOfIntegrator "Represents the command for the diesel exhaust fluid quantity integrator in the dosing control unit";
CM_ SG_ 3221225472 DEFDosingReqQuantity6594 "Requested dosing quantity of diesel exhaust fluid. This SPN is a high range measurement. See SPN 4401 if high range is not needed.";
CM_ SG_ 3221225472 DEFPumpHtrCmd "Command for the Aftertreatment 2 Diesel Exhaust Fluid Pump Heater.  A value of 0% means no heating commanded, a value of 100% means full heating commanded.";
CM_ SG_ 3221225472 DEFDosingTestInjPermStatus "After a request to permit the DEF dosing test injection has been indicated, this permission status is expected by the DEF control unit for aftertreatment system 2.
00 = not allowed
01 = DEF dosing test injection allowed
10 = error
11 = not ...";
CM_ SG_ 3221225472 DEFHydStiffnessCheckPermStatus "After a request to permit the DEF hydraulic stiffness check has been indicated, this permission status is expected by the DEF control unit for aftertreatment system 2.
00 = not allowed
01 = DEF hydraulic stiffness check allowed
10 = error
11 = ...";
CM_ SG_ 3221225472 SysReqSt "Requested state of SCR system for aftertreatment system 2 (exhaust bank 2).
0000 Dormant (sleep mode)
0001 Preparing dosing readiness (wake up; prepare to operate; wait for start)
0010 Normal dosing operation
0011 System error pending
0100 ...";
CM_ SG_ 3221225472 DEFDosingReqQuantity "Actual requested dosing quantity of diesel exhaust fluid.";
CM_ SG_ 3221225472 DEFLineHtr4PreliminaryFMI "Used to identify the applicable J1939-73 FMI detected in the diesel exhaust fluid line heater 4, by the manufacturer's control software in exhaust bank 2. When there is no failure FMI 31 is sent. In the case of multiple failures the most severe is ...";
CM_ SG_ 3221225472 DEFLineHtr4St "The diesel exhaust fluid line heater 4 state for aftertreatment system 2 (exhaust bank 2).

00 heater inactive 
01 heater active 
10 error 
11 not available";
CM_ SG_ 3221225472 DEFLineHtr3PreliminaryFMI "Used to identify the applicable J1939-73 FMI detected in the diesel exhaust fluid line heater 3, by the manufacturer's control software in exhaust bank 2. When there is no failure FMI 31 is sent. In the case of multiple failures the most severe is ...";
CM_ SG_ 3221225472 DEFLineHtr3St "The diesel exhaust fluid line heater 3 state for aftertreatment system 2 (exhaust bank 2).

00 heater inactive 
01 heater active 
10 error 
11 not available";
CM_ SG_ 3221225472 DEFLineHtr2PreliminaryFMI "Used to identify the applicable J1939-73 FMI detected in the diesel exhaust fluid line heater 2, by the manufacturer's control software in exhaust bank 2. When there is no failure FMI 31 is sent. In the case of multiple failures the most severe is ...";
CM_ SG_ 3221225472 DEFLineHtr2St "The diesel exhaust fluid line heater 2 state for aftertreatment system 2 (exhaust bank 2).

00 heater inactive 
01 heater active 
10 error 
11 not available";
CM_ SG_ 3221225472 DEFLineHtr1PreliminaryFMI "Used to identify the applicable J1939-73 FMI detected in the diesel exhaust fluid line heater 1, by the manufacturer's control software in exhaust bank 2. When there is no failure FMI 31 is sent. In the case of multiple failures the most severe is ...";
CM_ SG_ 3221225472 DEFLineHtr1St "The diesel exhaust fluid line heater 1 state for aftertreatment system 2 (exhaust bank 2).

00 heater inactive 
01 heater active 
10 error 
11 not available";
CM_ SG_ 3221225472 FeedbackCtrlStatus "The SCR feedback control status (open/closed loop) for aftertreatment system 2 (exhaust bank 2).
000 open loop control active
001 closed loop control active
010 reserved for future assignment by SAE
011 reserved for future assignment by SAE
100 ...";
CM_ SG_ 3221225472 VlvExhTempReductionReq "Protection request for the dosing valve of the SCR-system to prevent overheating
000:    no request
001:    reduction request stage 1
010:    reduction request stage 2
011:    reserved for future assignment by SAE
100:    reserved for future ...";
CM_ SG_ 3221225472 DEFDoser1Temp "The temperature (measured closest to dosing valve) of the first or only DEF doser for aftertreatment system 2 (exhaust bank 2).";
CM_ SG_ 3221225472 AirAssistVlv "The position of the valve used to regulate the air supply of an air assist SCR dosing system for an engine. 0% represents no supply and 100% is full supply.";
CM_ SG_ 3221225472 AirAssistAbsPress "The SCR dosing system air assist absolute pressure for aftertreatment system 2 (exhaust bank 2).  The air assist system is used to improve the dosed reagent atomization.";
CM_ SG_ 3221225472 DEFActualDosingQuantity6596 "Actual dosing quantity of diesel exhaust fluid. See SPN 4384 if high range measurement is not needed.";
CM_ SG_ 3221225472 Sys2St "Actual state of SCR system 2
0000 = Dormant (sleep mode)
0001 = Preparing dosing readiness (wake up; prepare to operate; wait for start)
0010 = Normal dosing operation
0011 = System error pending
0100 = Purging (SCR dosing system is removing ...";
CM_ SG_ 3221225472 DEFDoser1AbsPress "The absolute pressure (measured closest to dosing valve) of the first or only DEF doser for aftertreatment system 2 (exhaust bank 2).";
CM_ SG_ 3221225472 DEFActualQuantityOfIntegrator "The SCR requested diesel exhaust fluid integrator total quantity for aftertreatment system 2 (exhaust bank 2).";
CM_ SG_ 3221225472 Sys1St "Actual state of SCR system 1.
0000    Dormant (sleep mode)
0001    Preparing dosing readiness (wake up; prepare to operate; wait for start)
0010    Normal dosing operation
0011    System error pending
0100    Purging (SCR dosing system is ...";
CM_ SG_ 3221225472 DEFActualDosingQuantity "Actual reducing agent quantity of SCR system.";
CM_ SG_ 3221225472 OutNH3GasSnsrHtrCtrl "Indicates the heater status in the warm-up process. Upon receiving a power-up command, the NH3 gas sensor ramps up according to a manufacturer defined profile. The Preheat 1, Preheat 2, and Automatic messages are regions within this profile in ...";
CM_ SG_ 3221225472 OutNH3GasSnsrHtrPreliminaryFMI "Used to identify the applicable J1939-73 FMI detected in the heater of the outlet NH3 exhaust gas sensor by the manufacturer's sensor control software in exhaust bank 2. When there is no failure FMI 31 is sent. In the case of multiple failures the ...";
CM_ SG_ 3221225472 OutNH3GasSnsrAtTemp "Indicates that the heater element of the aftertreatment outlet NH3 gas sensor is within the manufacturer's specified range for accurate measurements in exhaust bank 2.
00 - Heater element is not in range
01 - Heater element is in range
10 - Error
 ...";
CM_ SG_ 3221225472 OutNH3GasSnsrPwrInRange "Indicates that the power supplied to the aftertreatment outlet NH3 gas sensor is within the manufacturer's specification in exhaust bank 2.

00 - Heater element is not in range
01 - Heater element is in range
10 - Error
11 - Not available";
CM_ SG_ 3221225472 OutNH3ReadingStable "Indicates that the NH3 reading of the aftertreatment outlet NH3 sensor is stable as determined by the manufacturer's control software in exhaust bank 2.

00 - Reading is not stable
01 - Reading is stable
10 - Error
11 - Not available";
CM_ SG_ 3221225472 OutNH3SnsrPreliminaryFMI "Used to identify the applicable J1939-73 FMI detected in the aftertreatment outlet NH3 sensor by the manufacturer's sensor control software in exhaust bank 2. When there is no failure FMI 31 is sent. In the case of multiple failures the most severe ...";
CM_ SG_ 3221225472 OutNH3 "The amount of NH3 in the exhaust exiting the aftertreatment system measured by a NH3 sensor at the aftertreatment outlet, represented in NH3 molecule parts per million non-NH3 molecules in exhaust bank 2.";
CM_ SG_ 3221225472 DiffPressPreliminaryFMI "Used to identify the applicable J1939-73 FMI detected in the gas oxidation catalyst differential pressure sensor by the manufacturer's sensor control software in exhaust bank 2. When there is no failure FMI 31 is sent. In the case of multiple ...";
CM_ SG_ 3221225472 OutTempPreliminaryFMI "Used to identify the applicable J1939-73 FMI detected in the gas oxidation catalyst outlet gas temperature sensor by the manufacturer's sensor control software in exhaust bank 2. When there is no failure FMI 31 is sent. In the case of multiple ...";
CM_ SG_ 3221225472 InTempPreliminaryFMI "Used to identify the applicable J1939-73 FMI detected in the gas oxidation catalyst intake gas temperature sensor by the manufacturer's sensor control software in exhaust bank 2. When there is no failure FMI 31 is sent. In the case of multiple ...";
CM_ SG_ 3221225472 DiffPress "Exhaust differential pressure measured between the intake and exhaust of the gas oxidation catalyst in exhaust bank 2.  This parameter should be used with engines fueled by gaseous fuel like natural gas or propane.  A separate parameter has been ...";
CM_ SG_ 3221225472 OutTemp "Temperature of engine combustion byproducts leaving the gas oxidation catalyst in exhaust bank 2.  This parameter should be used with engines fueled by gaseous fuel like natural gas or propane.  A separate parameter has been defined for diesel ...";
CM_ SG_ 3221225472 InTemp "Temperature of engine combustion byproducts entering the gas oxidation catalyst in exhaust bank 2.  This parameter should be used with engines fueled by gaseous fuel like natural gas or propane.  A separate parameter has been defined for diesel ...";
CM_ SG_ 3221225472 DiffPressPreliminaryFMI "Used to identify the applicable J1939-73 FMI detected in the diesel oxidation catalyst differential pressure sensor by the manufacturer's sensor control software in exhaust bank 2. When there is no failure FMI 31 is sent. In the case of multiple ...";
CM_ SG_ 3221225472 OutTempPreliminaryFMI "Used to identify the applicable J1939-73 FMI detected in the diesel oxidation catalyst outlet gas temperature sensor by the manufacturer's sensor control software in exhaust bank 2. When there is no failure FMI 31 is sent. In the case of multiple ...";
CM_ SG_ 3221225472 InTempPreliminaryFMI "Used to identify the applicable J1939-73 FMI detected in the diesel oxidation catalyst intake temperature sensor by the manufacturer's sensor control software in exhaust bank 2. When there is no failure FMI 31 is sent. In the case of multiple ...";
CM_ SG_ 3221225472 DiffPress "Exhaust differential pressure measured between the intake and exhaust of a diesel oxidation catalyst in exhaust bank 2.  This parameter should be used with engines fueled by diesel fuel (not gaseous fuel like natural gas or propane).  A separate ...";
CM_ SG_ 3221225472 OutTemp "Temperature of engine combustion byproducts leaving the diesel oxidation catalyst exhaust in exhaust bank 2.  This parameter should be used with engines fueled by diesel fuel (not gaseous fuel like natural gas or propane).  A separate parameter has ...";
CM_ SG_ 3221225472 InTemp "Temperature of engine combustion byproducts entering the diesel oxidation catalyst in exhaust bank 2.  This parameter should be used with engines fueled by diesel fuel (not gaseous fuel like natural gas or propane).  A separate parameter has been ...";
CM_ SG_ 3221225472 DEFQuickThawHtrPreliminaryFMI "Used to identify the applicable J1939-73 FMI detected for the heater of the diesel exhaust fluid quick thaw tank for aftertreatment system 1 (exhaust bank 1), as detected by the manufacturer's control software.  When there is no failure, FMI 31 is ...";
CM_ SG_ 3221225472 DEFQuickThawHtr "The diesel exhaust fluid quick thaw tank heater percentage for aftertreatment system 1 (exhaust bank 1). 0% is off. See SPN 5414 for the command for this tank heater.";
CM_ SG_ 3221225472 DEFQuickThawTempPreliminaryFMI "Used to identify the applicable J1939-73 FMI detected for the diesel exhaust fluid quick thaw tank temperature for aftertreatment system 1 (exhaust bank 1), as detected by the manufacturer's control software. When there is no failure, FMI 31 is ...";
CM_ SG_ 3221225472 DEFQuickThawLvlVolPreliminaryFMI "Used to identify the applicable J1939-73 FMI detected for the fluid level height of the diesel exhaust fluid quick thaw tank for aftertreatment system 1 (exhaust bank 1), as detected by the manufacturer's control software.  This FMI is applicable to ...";
CM_ SG_ 3221225472 DEFQuickThawTankLvl "The diesel exhaust fluid level height in mm in the diesel exhaust fluid quick thaw tank for aftertreatment system 1 (exhaust bank 1). See SPN 4367 for alternate measurement.
Parameter Specific Indicator:
A value of 0xFB indicates conditions are ...";
CM_ SG_ 3221225472 DEFQuickThawTemp "The diesel exhaust fluid quick thaw tank temperature for aftertreatment system 1 (exhaust bank 1).";
CM_ SG_ 3221225472 DEFQuickThawTankVolume "Ratio of volume of diesel exhaust fluid to the total volume of the diesel exhaust fluid quick thaw tank for aftertreatment system 1 (exhaust bank 1).  0% is empty and 100% is full.  See SPN 4369 for an alternate measurement.
Parameter Specific ...";
CM_ SG_ 3221225472 DosingUnit2DiverterVlv "Command to the valve which determines whether the diesel exhaust fluid on dosing unit 2 is delivered to the injector or is routed back to the diesel exhaust fluid tank. Zero directs all diesel exhaust fluid flow to the injector, 100% sends all ...";
CM_ SG_ 3221225472 Pump "State of the aftertreatment 1 Diesel Exhaust Fluid dosing pump.  Indicates if the pump is currently active (pumping).
00 off
01 on
10 error
11 not available
The aftertreatment 1 Diesel Exhaust Fluid dosing pump is a device that delivers a ...";
CM_ SG_ 3221225472 PumpPwrRelay "The state of the aftertreatment 1 diesel exhaust fluid pump power relay.

00 not active - no power is being applied to the relay
01 active - power is being applied to the relay
10 error
11 not available";
CM_ SG_ 3221225472 TankDrainVlvCmd "Commanded percentage of maximum Aftertreatment 1 Diesel Exhaust Fluid Tank Drain Valve opening. 100% means the drain valve is fully open providing maximum flow of diesel exhaust fluid out of the diesel exhaust fluid tank.";
CM_ SG_ 3221225472 PumpSt "State of the aftertreatment 1 Diesel Exhaust Fluid dosing pump.  Indicates whether or not the pump is operational.

00  pump operational
01  pump error
10  reserved for SAE assignment
11 not available";
CM_ SG_ 3221225472 TankFillVlvCmd "Commanded percentage of maximum Aftertreatment 1 Diesel Exhaust Fluid Tank Fill Valve opening. 100% means the fill valve is fully open providing maximum flow of diesel exhaust fluid into the diesel exhaust fluid tank.";
CM_ SG_ 3221225472 DosingUnit1DiverterVlv "Command to the valve which determines whether the diesel exhaust fluid on dosing unit 1 is delivered to the injector or is routed back to the diesel exhaust fluid tank. Zero directs all diesel exhaust fluid flow to the injector, 100% sends all ...";
CM_ SG_ 3221225472 PumpDrivePercentage "The percent (command) sent to the motor to control the speed of the diesel exhaust fluid pump.";
CM_ SG_ 3221225472 Pump1MotorSpd "Rotational speed of the motor driving the first or only pump for the diesel exhaust fluid used in aftertreatment system 1 (exhaust bank 1).";
CM_ SG_ 3221225472 OutTempPreliminaryFMI "Used to identify the applicable J1939-73 FMI detected in the SCR outlet temperature sensor by the manufacturer's sensor control software in exhaust bank 1. When there is no failure FMI 31 is sent. In the case of multiple failures the most severe is ...";
CM_ SG_ 3221225472 OutTemp "Temperature of engine combustion byproducts leaving the SCR outlet in exhaust bank 1.";
CM_ SG_ 3221225472 InTempPreliminaryFMI "Used to identify the applicable J1939-73 FMI detected in the SCR intake temperature sensor by the manufacturer's sensor control software in exhaust bank 1. When there is no failure FMI 31 is sent. In the case of multiple failures the most severe is ...";
CM_ SG_ 3221225472 InTemp "Temperature of engine combustion byproducts entering the SCR in exhaust bank 1.";
CM_ SG_ 3221225472 InAbsPress "Used to read the pressure at the catalyst intake of the selective catalytic reduction system of aftertreatment 1.";
CM_ SG_ 3221225472 InPress "The gage pressure at the intake of the selective catalytic reduction system of Aftertreatment 1.";
CM_ SG_ 3221225472 DiffPressPreliminaryFMI "Used to identify the applicable J1939-73 FMI detected in the SCR differential pressure sensor by the manufacturer's sensor control software in exhaust bank 1. When there is no failure FMI 31 is sent. In the case of multiple failures the most severe ...";
CM_ SG_ 3221225472 DiffPress "Differential pressure measured between the intake and outlet of an SCR component in exhaust bank 1.";
CM_ SG_ 3221225472 DEFLineHtr10 "The diesel exhaust fluid line heater 10 request for aftertreatment system 1 (exhaust bank 1).

00 = request for heater to be inactive
01 = request for heater to be active
10 = reserved for future assignment by SAE
11 = not available";
CM_ SG_ 3221225472 DEFLineHtr9 "The diesel exhaust fluid line heater 9 request for aftertreatment system 1 (exhaust bank 1).

00 = request for heater to be inactive
01 = request for heater to be active
10 = reserved for future assignment by SAE
11 = not available";
CM_ SG_ 3221225472 DEFLineHtr8 "The diesel exhaust fluid line heater 8 request for aftertreatment system 1 (exhaust bank 1).

00 = request for heater to be inactive
01 = request for heater to be active
10 = reserved for future assignment by SAE
11 = not available";
CM_ SG_ 3221225472 DEFLineHtr7 "The diesel exhaust fluid line heater 7 request for aftertreatment system 1 (exhaust bank 1).

00 = request for heater to be inactive
01 = request for heater to be active
10 = reserved for future assignment by SAE
11 = not available";
CM_ SG_ 3221225472 DEFLineHtr6 "The diesel exhaust fluid line heater 6 request for aftertreatment system 1 (exhaust bank 1).

00 = request for heater to be inactive
01 = request for heater to be active
10 = reserved for future assignment by SAE
11 = not available";
CM_ SG_ 3221225472 DEFLineHtr5 "The diesel exhaust fluid line heater 5 request for aftertreatment system 1 (exhaust bank 1).

00 = request for heater to be inactive
01 = request for heater to be active
10 = reserved for future assignment by SAE
11 = not available";
CM_ SG_ 3221225472 DEFLineHtrRelay3 "The aftertreatment diesel exhaust fluid line heater relay 3 is used to energize one or more DEF line heaters.

00 - Off
01 - On
10 - Error
11 - Not available";
CM_ SG_ 3221225472 DEFLineHtrRelay2 "The Aftertreatment Diesel Exhaust Fluid Line Heater Relay 2 is used to energize one or more DEF line heaters.

00 - Off
01 - On
10 - Error
11 - Not available";
CM_ SG_ 3221225472 DEFLineHtrRelay1 "The Aftertreatment Diesel Exhaust Fluid Line Heater Relay 1 is used to energize one or more DEF line heaters.

00 - Off
01 - On
10 - Error
11 - Not available";
CM_ SG_ 3221225472 DEFPumpHtrCmd "Command for the Aftertreatment 1 Diesel Exhaust Fluid Pump Heater. A value of 0% means no heating commanded, a value of 100% means full heating commanded. See SPN 5706 for the measured value of the Aftertreatment 1 Diesel Exhaust Fluid Heater.";
CM_ SG_ 3221225472 DEFQuickThawHtrCmd "The command for the heater of the diesel exhaust fluid quick thaw tank for aftertreatment system 1 (exhaust bank 1).  See SPN 4372 for the measured heater percentage for the heater of this same tank.";
CM_ SG_ 3221225472 DEFTankHtrCmd "Command for the Aftertreatment 1 Diesel Exhaust Fluid Tank Heater.  A value of 0% means no heating applied, a value of 100% means full heating applied.  See SPN 3363 for the measured value of the Aftertreatment 1 Diesel Exhaust Fluid Tank Heater.";
CM_ SG_ 3221225472 DEFLineHtr4 "The diesel exhaust fluid line heater 4 request for aftertreatment system 1 (exhaust bank 1).
 
00 request for heater to be inactive 
01 request for heater to be active 
10 reserved for future assignment by SAE 
11 not available";
CM_ SG_ 3221225472 DEFLineHtr3 "The diesel exhaust fluid line heater 3 request for aftertreatment system 1 (exhaust bank 1).
 
00 request for heater to be inactive 
01 request for heater to be active 
10 reserved for future assignment by SAE 
11 not available";
CM_ SG_ 3221225472 DEFLineHtr2 "The diesel exhaust fluid line heater 2 request for aftertreatment system 1 (exhaust bank 1).
 
00 request for heater to be inactive 
01 request for heater to be active 
10 reserved for future assignment by SAE 
11 not available";
CM_ SG_ 3221225472 DEFLineHtr1 "The diesel exhaust fluid line heater 1 request for aftertreatment system 1 (exhaust bank 1).
 
00 request for heater to be inactive 
01 request for heater to be active 
10 reserved for future assignment by SAE 
11 not available";
CM_ SG_ 3221225472 DEFDoserHeatingModeReq "Used if multiple heater modes are available in the Doser.

000   Heater off
001   Heater economy mode
010   Heater automatic mode
011   Heater on
100 - 110    Reserved
111   Not available";
CM_ SG_ 3221225472 DEFDoserFaultSuppressionReq "Used if external devices can warn of conditions that require suppression of potential faults in the doser due to environmental conditions.

00    Error suppression off
01    Error suppression on
10    Reserved
11    Not available";
CM_ SG_ 3221225472 DEFDosingReqQuantity6593 "Requested dosing quantity of diesel exhaust fluid. This SPN is a high range measurement. See SPN 4348 if high range is not needed.";
CM_ SG_ 3221225472 DEFDosingTestInjPermStatus "After a request to permit the DEF dosing test injection has been indicated, this permission status is expected by the DEF control unit for aftertreatment system 1.
00 = not allowed
01 = DEF dosing test injection allowed
10 = error
11 = not ...";
CM_ SG_ 3221225472 DEFHydStiffnessCheckPermStatus "After a request to permit the DEF hydraulic stiffness check has been indicated, this permission status is expected by the DEF control unit for aftertreatment system 1.
00 = not allowed
01 = DEF hydraulic stiffness check allowed
10 = error
11 = ...";
CM_ SG_ 3221225472 DEFReqQuantityOfIntegrator "Represents the command for the diesel exhaust fluid quantity integrator in the dosing control unit";
CM_ SG_ 3221225472 SysReqSt "Requested state of SCR system for aftertreatment system 1 (exhaust bank 1).
0000 Dormant (sleep mode)
0001 Preparing dosing readiness (wake up; prepare to operate; wait for start)
0010 Normal dosing operation
0011 System error pending
0100 ...";
CM_ SG_ 3221225472 DEFDosingReqQuantity "Actual requested dosing quantity of diesel exhaust fluid.";
CM_ SG_ 3221225472 DEFLineHtr4PreliminaryFMI "Used to identify the applicable J1939-73 FMI detected in the diesel exhaust fluid line heater 4, by the manufacturer's control software in exhaust bank 1. When there is no failure FMI 31 is sent. In the case of multiple failures the most severe is ...";
CM_ SG_ 3221225472 DEFLineHtr4St "The diesel exhaust fluid line heater 4 state for aftertreatment system 1 (exhaust bank 1). 

00 heater inactive 
01 heater active 
10 error 
11 not available";
CM_ SG_ 3221225472 DEFLineHtr3PreliminaryFMI "Used to identify the applicable J1939-73 FMI detected in the diesel exhaust fluid line heater 3, by the manufacturer's control software in exhaust bank 1. When there is no failure FMI 31 is sent. In the case of multiple failures the most severe is ...";
CM_ SG_ 3221225472 DEFLineHtr3St "The diesel exhaust fluid line heater 3 state for aftertreatment system 1 (exhaust bank 1). 

00 heater inactive 
01 heater active 
10 error 
11 not available";
CM_ SG_ 3221225472 DEFLineHtr2PreliminaryFMI "Used to identify the applicable J1939-73 FMI detected in the diesel exhaust fluid line heater 2, by the manufacturer's control software in exhaust bank 1. When there is no failure FMI 31 is sent. In the case of multiple failures the most severe is ...";
CM_ SG_ 3221225472 DEFLineHtr2St "The diesel exhaust fluid line heater 2 state for aftertreatment system 1 (exhaust bank 1). 
 
00 heater inactive 
01 heater active 
10 error 
11 not available";
CM_ SG_ 3221225472 DEFLineHtr1PreliminaryFMI "Used to identify the applicable J1939-73 FMI detected in the diesel exhaust fluid line heater 1, by the manufacturer's control software in exhaust bank 1. When there is no failure FMI 31 is sent. In the case of multiple failures the most severe is ...";
CM_ SG_ 3221225472 DEFLineHtr1St "The diesel exhaust fluid line heater 1 state for aftertreatment system 1 (exhaust bank 1). 

00 heater inactive 
01 heater active 
10 error 
11 not available";
CM_ SG_ 3221225472 FeedbackCtrlStatus "The SCR feedback control status (open/closed loop) for aftertreatment system 1 (exhaust bank 1).
000 open loop control active
001 closed loop control active
010 reserved for future assignment by SAE
011 reserved for future assignment by SAE
100 ...";
CM_ SG_ 3221225472 VlvExhTempReductionReq "Protection request for the dosing valve of the SCR-system to prevent overheating
000:    no request
001:    reduction request stage 1
010:    reduction request stage 2
011:    reserved for future assignment by SAE
100:    reserved for future ...";
CM_ SG_ 3221225472 DEFDoser1Temp "The temperature (measured closest to dosing valve) of the first or only DEF dosing unit for aftertreatment system 1 (exhaust bank 1).";
CM_ SG_ 3221225472 AirAssistVlv "The position of the valve used to regulate the air supply of an air assist SCR dosing system for an engine. 0% represents no supply and 100% is full supply.";
CM_ SG_ 3221225472 AirAssistAbsPress "The SCR dosing system air assist absolute pressure for aftertreatment system 1 (exhaust bank 1).  The air assist system is used to improve the dosed reagent atomization.";
CM_ SG_ 3221225472 DEFDoser1AbsPress "The absolute pressure (measured closest to dosing valve) of the first or only DEF dosing unit for aftertreatment system 1 (exhaust bank 1).";
CM_ SG_ 3221225472 DEFActualDosingQuantity6595 "Actual dosing quantity of diesel exhaust fluid. See SPN 4331 if high range measurement is not needed.";
CM_ SG_ 3221225472 DEFActualQuantityOfIntegrator "The SCR requested diesel exhaust fluid integrator total quantity for aftertreatment system 1 (exhaust bank 1).";
CM_ SG_ 3221225472 Sys2St "Actual state of SCR system 2
0000 = Dormant (sleep mode)
0001 = Preparing dosing readiness (wake up; prepare to operate; wait for start)
0010 = Normal dosing operation
0011 = System error pending
0100 = Purging (SCR dosing system is removing ...";
CM_ SG_ 3221225472 Sys1St "Actual state of SCR system
0000    Dormant (sleep mode)
0001    Preparing dosing readiness (wake up; prepare to operate; wait for start)
0010    Normal dosing operation
0011    System error pending
0100    Purging (SCR dosing system is removing ...";
CM_ SG_ 3221225472 DEFActualDosingQuantity "Actual reducing agent quantity of SCR-system";
CM_ SG_ 3221225472 OutNH3GasSnsrHtrCtrl "Indicates the heater status in the warm-up process. Upon receiving a power-up command, the NH3 gas sensor ramps up according to a manufacturer defined profile. The Preheat 1, Preheat 2, and Automatic messages are regions within this profile in ...";
CM_ SG_ 3221225472 OutNH3GasSnsrHtrPreliminaryFMI "Used to identify the applicable J1939-73 FMI detected in the heater of the outlet NH3 exhaust gas sensor by the manufacturer's sensor control software in exhaust bank 1. When there is no failure FMI 31 is sent. In the case of multiple failures the ...";
CM_ SG_ 3221225472 OutNH3GasSnsrAtTemp "Indicates that the heater element of the aftertreatment outlet NH3 gas sensor is within the manufacturer's specified range for accurate measurements in exhaust bank 1.
00 - Heater element is not in range
01 - Heater element is in range
10 - Error
 ...";
CM_ SG_ 3221225472 OutNH3GasSnsrPwrInRange "Indicates that the power supplied to the aftertreatment outlet NH3 gas sensor is within the manufacturer's specification in exhaust bank 1.

00 - Power is not in range
01 - Power is in range
10 - Error
11 - Not available";
CM_ SG_ 3221225472 OutNH3ReadingStable "Indicates that the NH3 reading of the aftertreatment outlet NH3 sensor is stable as determined by the manufacturer's control software in exhaust bank 1.

00 - Reading is not stable
01 - Reading is stable
10 - Error
11 - Not available";
CM_ SG_ 3221225472 OutNH3SnsrPreliminaryFMI "Used to identify the applicable J1939-73 FMI detected in the aftertreatment outlet NH3 sensor by the manufacturer's sensor control software in exhaust bank 1. When there is no failure FMI 31 is sent. In the case of multiple failures the most severe ...";
CM_ SG_ 3221225472 OutNH3 "The amount of NH3 in the exhaust exiting the aftertreatment system measured by a NH3 sensor at the aftertreatment outlet, represented in NH3 molecule parts per million non-NH3 molecules in exhaust bank 1.";
CM_ SG_ 3221225472 DiffPressPreliminaryFMI "Used to identify the applicable J1939-73 FMI detected in the gas oxidation catalyst differential pressure sensor by the manufacturer's sensor control software in exhaust bank 1. When there is no failure FMI 31 is sent. In the case of multiple ...";
CM_ SG_ 3221225472 OutTempPreliminaryFMI "Used to identify the applicable J1939-73 FMI detected in the gas oxidation catalyst outlet temperature sensor by the manufacturer's sensor control software in exhaust bank 1. When there is no failure FMI 31 is sent. In the case of multiple failures ...";
CM_ SG_ 3221225472 InTempPreliminaryFMI "Used to identify the applicable J1939-73 FMI detected in the gas oxidation catalyst intake temperature sensor by the manufacturer's sensor control software in exhaust bank 1. When there is no failure FMI 31 is sent. In the case of multiple failures ...";
CM_ SG_ 3221225472 DiffPress "Exhaust differential pressure measured between the intake and exhaust of the gas oxidation catalyst in exhaust bank 1.  This parameter should be used with engines fueled by gaseous fuel like natural gas or propane.  A separate parameter has been ...";
CM_ SG_ 3221225472 OutTemp "Temperature of engine combustion byproducts leaving the gas oxidation catalyst in exhaust bank 1.  This parameter should be used with engines fueled by gaseous fuel like natural gas or propane.  A separate parameter has been defined for diesel ...";
CM_ SG_ 3221225472 InTemp "Temperature of engine combustion byproducts entering the gas oxidation catalyst in exhaust bank 1.  This parameter should be used with engines fueled by gaseous fuel like natural gas or propane.  A separate parameter has been defined for diesel ...";
CM_ SG_ 3221225472 BatteryMainSwitchHoldState "Parameter indicating whether the battery main switch is held due to an external request or not. The state battery main switch held indicates that the battery main switch is about to switch off.
00 Battery main switch not held
01 Battery main ...";
CM_ SG_ 3221225472 Joystick3XAxisDetentPosStatus "Reports when the current joystick position is in the detent position for that axis of travel.

00 Not in the Detent Position
01 In the Detent Position
10 Error Indicator
11 Not Available";
CM_ SG_ 3221225472 Joystick3Button9PressedStatus "Reports when the joystick button has been pressed.

00 Button not pressed
01 Button pressed
10 Error Indicator
11 Not Available";
CM_ SG_ 3221225472 Joystick3Button10PressedStatus "Reports when the joystick button has been pressed.

00 Button not pressed
01 Button pressed
10 Error Indicator
11 Not Available";
CM_ SG_ 3221225472 Joystick3Button11PressedStatus "Reports when the joystick button has been pressed.

00 Button not pressed
01 Button pressed
10 Error Indicator
11 Not Available";
CM_ SG_ 3221225472 Joystick3Button12PressedStatus "Reports when the joystick button has been pressed.

00 Button not pressed
01 Button pressed
10 Error Indicator
11 Not Available";
CM_ SG_ 3221225472 Joystick3YAxisDetentPosStatus "Reports when the current joystick position is in the detent position for that axis of travel.

00 Not in the Detent Position
01 In the Detent Position
10 Error Indicator
11 Not Available";
CM_ SG_ 3221225472 DiffPressPreliminaryFMI "Used to identify the applicable J1939-73 FMI detected in the diesel oxidation catalyst differential pressure sensor by the manufacturer's sensor control software in exhaust bank 1. When there is no failure FMI 31 is sent. In the case of multiple ...";
CM_ SG_ 3221225472 OutTempPreliminaryFMI "Used to identify the applicable J1939-73 FMI detected in the diesel oxidation catalyst outlet gas temperature sensor by the manufacturer's sensor control software in exhaust bank 1. When there is no failure FMI 31 is sent. In the case of multiple ...";
CM_ SG_ 3221225472 InTempPreliminaryFMI "Used to identify the applicable J1939-73 FMI detected in the diesel oxidation catalyst intake temperature sensor by the manufacturer's sensor control software in exhaust bank 1. When there is no failure FMI 31 is sent. In the case of multiple ...";
CM_ SG_ 3221225472 DiffPress "Exhaust differential pressure measured between the intake and exhaust of a diesel oxidation catalyst in exhaust bank 1.  This parameter should be used with engines fueled by diesel fuel (not gaseous fuel like natural gas or propane).  A separate ...";
CM_ SG_ 3221225472 OutTemp "Temperature of engine combustion byproducts leaving the diesel oxidation catalyst exhaust in exhaust bank 1.  This parameter should be used with engines fueled by diesel fuel (not gaseous fuel like natural gas or propane).  A separate parameter has ...";
CM_ SG_ 3221225472 InTemp "Temperature of engine combustion byproducts entering the diesel oxidation catalyst in exhaust bank 1.  This parameter should be used with engines fueled by diesel fuel (not gaseous fuel like natural gas or propane).  A separate parameter has been ...";
CM_ SG_ 3221225472 FlowDiverterVlvCtrl "Indicates how the device is controlling the aftertreatment 1 fuel flow diverter valve. When this valve is on it diverts fuel flow from the Aftertreatment 1 Regeneration Device.

00 off
01 on
10 reserved for SAE assignment
11 not available";
CM_ SG_ 3221225472 PumpRelayCtrl "Indicates how the device is controlling the aftertreatment 1 fuel pump relay.

00 off
01 on
10 reserved for SAE assignment
11 not available";
CM_ SG_ 3221225472 Press2 "Second fuel pressure measurement for the aftertreatment 1 system";
BA_DEF_ SG_  "SigType" ENUM  "Default","Range","RangeSigned","ASCII","Discrete","Control","ReferencePGN","DTC","StringDelimiter","StringLength","StringLengthControl","MessageCounter","MessageChecksum";
BA_DEF_ SG_  "GenSigStartValue" INT 0 2147483647;
BA_DEF_ SG_  "GenSigSendType" ENUM  "Cyclic","OnWrite","OnWriteWithRepetition","OnChange","OnChangeWithRepetition","IfActive","IfActiveWithRepetition","NoSigSendType";
BA_DEF_ SG_  "GenSigILSupport" ENUM  "No","Yes";
BA_DEF_ SG_  "GenSigEVName" STRING ;
BA_DEF_ SG_  "SPN" INT 0 524287;
BA_DEF_ BO_  "TpJ1939VarDlc" ENUM  "No","Yes";
BA_DEF_ BO_  "GenMsgILSupport" ENUM  "No","Yes";
BA_DEF_ BO_  "GenMsgRequestable" INT 0 1;
BA_DEF_ BO_  "GenMsgSendType" ENUM  "cyclic","NotUsed","NotUsed","NotUsed","NotUsed","NotUsed","NotUsed","IfActive","noMsgSendType";
BA_DEF_ BO_  "VFrameFormat" ENUM  "StandardCAN","ExtendedCAN","reserved","J1939PG";
BA_DEF_ SG_  "SystemSignalLongSymbol" STRING ;
BA_DEF_DEF_  "SigType" "Default";
BA_DEF_DEF_  "GenSigStartValue" 0;
BA_DEF_DEF_  "GenSigSendType" "NoSigSendType";
BA_DEF_DEF_  "GenSigILSupport" "Yes";
BA_DEF_DEF_  "GenSigEVName" "Env@Nodename_@Signame";
BA_DEF_DEF_  "SPN" 0;
BA_DEF_DEF_  "TpJ1939VarDlc" "No";
BA_DEF_DEF_  "GenMsgILSupport" "Yes";
BA_DEF_DEF_  "GenMsgRequestable" 1;
BA_DEF_DEF_  "GenMsgSendType" "noMsgSendType";
BA_DEF_DEF_  "VFrameFormat" "J1939PG";
BA_DEF_DEF_  "SystemSignalLongSymbol" "";
BA_ "SPN" SG_ 3221225472 Joystick7Button12PressedStatus 4620;
BA_ "SigType" SG_ 3221225472 Joystick7Button12PressedStatus 4;
BA_ "SPN" SG_ 3221225472 Joystick7Button5PressedStatus 4619;
BA_ "SigType" SG_ 3221225472 Joystick7Button5PressedStatus 4;
BA_ "SPN" SG_ 3221225472 Joystick7Button6PressedStatus 4618;
BA_ "SigType" SG_ 3221225472 Joystick7Button6PressedStatus 4;
BA_ "SPN" SG_ 3221225472 Joystick7Button7PressedStatus 4617;
BA_ "SigType" SG_ 3221225472 Joystick7Button7PressedStatus 4;
BA_ "SPN" SG_ 3221225472 Joystick7Button8PressedStatus 4616;
BA_ "SigType" SG_ 3221225472 Joystick7Button8PressedStatus 4;
BA_ "SPN" SG_ 3221225472 Joystick7Button1PressedStatus 4615;
BA_ "SigType" SG_ 3221225472 Joystick7Button1PressedStatus 4;
BA_ "SPN" SG_ 3221225472 Joystick7Button2PressedStatus 4614;
BA_ "SigType" SG_ 3221225472 Joystick7Button2PressedStatus 4;
BA_ "SPN" SG_ 3221225472 Joystick7Button3PressedStatus 4613;
BA_ "SigType" SG_ 3221225472 Joystick7Button3PressedStatus 4;
BA_ "SPN" SG_ 3221225472 Joystick7Button4PressedStatus 4612;
BA_ "SigType" SG_ 3221225472 Joystick7Button4PressedStatus 4;
BA_ "SPN" SG_ 3221225472 Joystick7XAxisDetentPosStatus 4611;
BA_ "SigType" SG_ 3221225472 Joystick7XAxisDetentPosStatus 4;
BA_ "SPN" SG_ 3221225472 Joystick7YAxisDetentPosStatus 4610;
BA_ "SigType" SG_ 3221225472 Joystick7YAxisDetentPosStatus 4;
BA_ "SPN" SG_ 3221225472 Joystick7YAxisPos 4609;
BA_ "SPN" SG_ 3221225472 Jystck7YAxsLvrFrwrdPstvPosStatus 4608;
BA_ "SigType" SG_ 3221225472 Jystck7YAxsLvrFrwrdPstvPosStatus 4;
BA_ "SPN" SG_ 3221225472 Jystck7YAxsLvrBckNgtivePosStatus 4607;
BA_ "SigType" SG_ 3221225472 Jystck7YAxsLvrBckNgtivePosStatus 4;
BA_ "SPN" SG_ 3221225472 Joystick7YAxisNeutralPosStatus 4606;
BA_ "SigType" SG_ 3221225472 Joystick7YAxisNeutralPosStatus 4;
BA_ "SPN" SG_ 3221225472 Joystick7XAxisPos 4605;
BA_ "SPN" SG_ 3221225472 Jystck7XAxsLvrRghtPstvePosStatus 4604;
BA_ "SigType" SG_ 3221225472 Jystck7XAxsLvrRghtPstvePosStatus 4;
BA_ "SPN" SG_ 3221225472 Jystck7XAxsLvrLftNgtivePosStatus 4603;
BA_ "SigType" SG_ 3221225472 Jystck7XAxsLvrLftNgtivePosStatus 4;
BA_ "SPN" SG_ 3221225472 Joystick7XAxisNeutralPosStatus 4602;
BA_ "SigType" SG_ 3221225472 Joystick7XAxisNeutralPosStatus 4;
BA_ "SPN" SG_ 3221225472 Joystick6Button9PressedStatus 4586;
BA_ "SigType" SG_ 3221225472 Joystick6Button9PressedStatus 4;
BA_ "SPN" SG_ 3221225472 Joystick6Button10PressedStatus 4585;
BA_ "SigType" SG_ 3221225472 Joystick6Button10PressedStatus 4;
BA_ "SPN" SG_ 3221225472 Joystick6Button11PressedStatus 4584;
BA_ "SigType" SG_ 3221225472 Joystick6Button11PressedStatus 4;
BA_ "SPN" SG_ 3221225472 Joystick6Button12PressedStatus 4583;
BA_ "SigType" SG_ 3221225472 Joystick6Button12PressedStatus 4;
BA_ "SPN" SG_ 3221225472 Joystick6Button5PressedStatus 4582;
BA_ "SigType" SG_ 3221225472 Joystick6Button5PressedStatus 4;
BA_ "SPN" SG_ 3221225472 Joystick6Button6PressedStatus 4581;
BA_ "SigType" SG_ 3221225472 Joystick6Button6PressedStatus 4;
BA_ "SPN" SG_ 3221225472 Joystick6Button7PressedStatus 4580;
BA_ "SigType" SG_ 3221225472 Joystick6Button7PressedStatus 4;
BA_ "SPN" SG_ 3221225472 Joystick6Button8PressedStatus 4579;
BA_ "SigType" SG_ 3221225472 Joystick6Button8PressedStatus 4;
BA_ "SPN" SG_ 3221225472 Joystick6Button1PressedStatus 4578;
BA_ "SigType" SG_ 3221225472 Joystick6Button1PressedStatus 4;
BA_ "SPN" SG_ 3221225472 Joystick6Button2PressedStatus 4577;
BA_ "SigType" SG_ 3221225472 Joystick6Button2PressedStatus 4;
BA_ "SPN" SG_ 3221225472 Joystick6Button3PressedStatus 4576;
BA_ "SigType" SG_ 3221225472 Joystick6Button3PressedStatus 4;
BA_ "SPN" SG_ 3221225472 Joystick6Button4PressedStatus 4575;
BA_ "SigType" SG_ 3221225472 Joystick6Button4PressedStatus 4;
BA_ "SPN" SG_ 3221225472 Joystick6XAxisDetentPosStatus 4574;
BA_ "SigType" SG_ 3221225472 Joystick6XAxisDetentPosStatus 4;
BA_ "SPN" SG_ 3221225472 Joystick6YAxisDetentPosStatus 4573;
BA_ "SigType" SG_ 3221225472 Joystick6YAxisDetentPosStatus 4;
BA_ "SPN" SG_ 3221225472 Joystick6YAxisPos 4572;
BA_ "SPN" SG_ 3221225472 Jystck6YAxsLvrFrwrdPstvPosStatus 4571;
BA_ "SigType" SG_ 3221225472 Jystck6YAxsLvrFrwrdPstvPosStatus 4;
BA_ "SPN" SG_ 3221225472 Jystck6YAxsLvrBckNgtivePosStatus 4570;
BA_ "SigType" SG_ 3221225472 Jystck6YAxsLvrBckNgtivePosStatus 4;
BA_ "SPN" SG_ 3221225472 Joystick6YAxisNeutralPosStatus 4569;
BA_ "SigType" SG_ 3221225472 Joystick6YAxisNeutralPosStatus 4;
BA_ "SPN" SG_ 3221225472 Joystick6XAxisPos 4568;
BA_ "SPN" SG_ 3221225472 Jystck6XAxsLvrRghtPstvePosStatus 4567;
BA_ "SigType" SG_ 3221225472 Jystck6XAxsLvrRghtPstvePosStatus 4;
BA_ "SPN" SG_ 3221225472 Jystck6XAxsLvrLftNgtivePosStatus 4566;
BA_ "SigType" SG_ 3221225472 Jystck6XAxsLvrLftNgtivePosStatus 4;
BA_ "SPN" SG_ 3221225472 Joystick6XAxisNeutralPosStatus 4565;
BA_ "SigType" SG_ 3221225472 Joystick6XAxisNeutralPosStatus 4;
BA_ "SPN" SG_ 3221225472 Joystick5Button9PressedStatus 4549;
BA_ "SigType" SG_ 3221225472 Joystick5Button9PressedStatus 4;
BA_ "SPN" SG_ 3221225472 Joystick5Button10PressedStatus 4548;
BA_ "SigType" SG_ 3221225472 Joystick5Button10PressedStatus 4;
BA_ "SPN" SG_ 3221225472 Joystick5Button11PressedStatus 4547;
BA_ "SigType" SG_ 3221225472 Joystick5Button11PressedStatus 4;
BA_ "SPN" SG_ 3221225472 Joystick5Button12PressedStatus 4546;
BA_ "SigType" SG_ 3221225472 Joystick5Button12PressedStatus 4;
BA_ "SPN" SG_ 3221225472 Joystick5Button5PressedStatus 4545;
BA_ "SigType" SG_ 3221225472 Joystick5Button5PressedStatus 4;
BA_ "SPN" SG_ 3221225472 Joystick5Button6PressedStatus 4544;
BA_ "SigType" SG_ 3221225472 Joystick5Button6PressedStatus 4;
BA_ "SPN" SG_ 3221225472 Joystick5Button7PressedStatus 4543;
BA_ "SigType" SG_ 3221225472 Joystick5Button7PressedStatus 4;
BA_ "SPN" SG_ 3221225472 Joystick5Button8PressedStatus 4542;
BA_ "SigType" SG_ 3221225472 Joystick5Button8PressedStatus 4;
BA_ "SPN" SG_ 3221225472 Joystick5Button1PressedStatus 4541;
BA_ "SigType" SG_ 3221225472 Joystick5Button1PressedStatus 4;
BA_ "SPN" SG_ 3221225472 Joystick5Button2PressedStatus 4540;
BA_ "SigType" SG_ 3221225472 Joystick5Button2PressedStatus 4;
BA_ "SPN" SG_ 3221225472 Joystick5Button3PressedStatus 4539;
BA_ "SigType" SG_ 3221225472 Joystick5Button3PressedStatus 4;
BA_ "SPN" SG_ 3221225472 Joystick5Button4PressedStatus 4538;
BA_ "SigType" SG_ 3221225472 Joystick5Button4PressedStatus 4;
BA_ "SPN" SG_ 3221225472 Joystick5XAxisDetentPosStatus 4537;
BA_ "SigType" SG_ 3221225472 Joystick5XAxisDetentPosStatus 4;
BA_ "SPN" SG_ 3221225472 Joystick5YAxisDetentPosStatus 4536;
BA_ "SigType" SG_ 3221225472 Joystick5YAxisDetentPosStatus 4;
BA_ "SPN" SG_ 3221225472 Joystick5YAxisPos 4535;
BA_ "SPN" SG_ 3221225472 Jystck5YAxsLvrFrwrdPstvPosStatus 4534;
BA_ "SigType" SG_ 3221225472 Jystck5YAxsLvrFrwrdPstvPosStatus 4;
BA_ "SPN" SG_ 3221225472 Jystck5YAxsLvrBckNgtivePosStatus 4533;
BA_ "SigType" SG_ 3221225472 Jystck5YAxsLvrBckNgtivePosStatus 4;
BA_ "SPN" SG_ 3221225472 Joystick5YAxisNeutralPosStatus 4532;
BA_ "SigType" SG_ 3221225472 Joystick5YAxisNeutralPosStatus 4;
BA_ "SPN" SG_ 3221225472 Joystick5XAxisPos 4531;
BA_ "SPN" SG_ 3221225472 Jystck5XAxsLvrRghtPstvePosStatus 4530;
BA_ "SigType" SG_ 3221225472 Jystck5XAxsLvrRghtPstvePosStatus 4;
BA_ "SPN" SG_ 3221225472 Jystck5XAxsLvrLftNgtivePosStatus 4529;
BA_ "SigType" SG_ 3221225472 Jystck5XAxsLvrLftNgtivePosStatus 4;
BA_ "SPN" SG_ 3221225472 Joystick5XAxisNeutralPosStatus 4528;
BA_ "SigType" SG_ 3221225472 Joystick5XAxisNeutralPosStatus 4;
BA_ "SPN" SG_ 3221225472 Joystick4Button9PressedStatus 4512;
BA_ "SigType" SG_ 3221225472 Joystick4Button9PressedStatus 4;
BA_ "SPN" SG_ 3221225472 Joystick4Button10PressedStatus 4511;
BA_ "SigType" SG_ 3221225472 Joystick4Button10PressedStatus 4;
BA_ "SPN" SG_ 3221225472 Joystick4Button11PressedStatus 4510;
BA_ "SigType" SG_ 3221225472 Joystick4Button11PressedStatus 4;
BA_ "SPN" SG_ 3221225472 Joystick4Button12PressedStatus 4509;
BA_ "SigType" SG_ 3221225472 Joystick4Button12PressedStatus 4;
BA_ "SPN" SG_ 3221225472 Joystick4Button5PressedStatus 4508;
BA_ "SigType" SG_ 3221225472 Joystick4Button5PressedStatus 4;
BA_ "SPN" SG_ 3221225472 Joystick4Button6PressedStatus 4507;
BA_ "SigType" SG_ 3221225472 Joystick4Button6PressedStatus 4;
BA_ "SPN" SG_ 3221225472 Joystick4Button7PressedStatus 4506;
BA_ "SigType" SG_ 3221225472 Joystick4Button7PressedStatus 4;
BA_ "SPN" SG_ 3221225472 Joystick4Button8PressedStatus 4505;
BA_ "SigType" SG_ 3221225472 Joystick4Button8PressedStatus 4;
BA_ "SPN" SG_ 3221225472 Joystick4Button1PressedStatus 4504;
BA_ "SigType" SG_ 3221225472 Joystick4Button1PressedStatus 4;
BA_ "SPN" SG_ 3221225472 Joystick4Button2PressedStatus 4503;
BA_ "SigType" SG_ 3221225472 Joystick4Button2PressedStatus 4;
BA_ "SPN" SG_ 3221225472 Joystick4Button3PressedStatus 4502;
BA_ "SigType" SG_ 3221225472 Joystick4Button3PressedStatus 4;
BA_ "SPN" SG_ 3221225472 Joystick4Button4PressedStatus 4501;
BA_ "SigType" SG_ 3221225472 Joystick4Button4PressedStatus 4;
BA_ "SPN" SG_ 3221225472 Joystick4XAxisDetentPosStatus 4500;
BA_ "SigType" SG_ 3221225472 Joystick4XAxisDetentPosStatus 4;
BA_ "SPN" SG_ 3221225472 Joystick4YAxisDetentPosStatus 4499;
BA_ "SigType" SG_ 3221225472 Joystick4YAxisDetentPosStatus 4;
BA_ "SPN" SG_ 3221225472 Joystick4YAxisPos 4498;
BA_ "SPN" SG_ 3221225472 Jystck4YAxsLvrFrwrdPstvPosStatus 4497;
BA_ "SigType" SG_ 3221225472 Jystck4YAxsLvrFrwrdPstvPosStatus 4;
BA_ "SPN" SG_ 3221225472 Jystck4YAxsLvrBckNgtivePosStatus 4496;
BA_ "SigType" SG_ 3221225472 Jystck4YAxsLvrBckNgtivePosStatus 4;
BA_ "SPN" SG_ 3221225472 Joystick4YAxisNeutralPosStatus 4495;
BA_ "SigType" SG_ 3221225472 Joystick4YAxisNeutralPosStatus 4;
BA_ "SPN" SG_ 3221225472 Joystick4XAxisPos 4494;
BA_ "SPN" SG_ 3221225472 Jystck4XAxsLvrRghtPstvePosStatus 4493;
BA_ "SigType" SG_ 3221225472 Jystck4XAxsLvrRghtPstvePosStatus 4;
BA_ "SPN" SG_ 3221225472 Jystck4XAxsLvrLftNgtivePosStatus 4492;
BA_ "SigType" SG_ 3221225472 Jystck4XAxsLvrLftNgtivePosStatus 4;
BA_ "SPN" SG_ 3221225472 Joystick4XAxisNeutralPosStatus 4491;
BA_ "SigType" SG_ 3221225472 Joystick4XAxisNeutralPosStatus 4;
BA_ "SPN" SG_ 3221225472 Joystick10Button9PressedStatus 4734;
BA_ "SigType" SG_ 3221225472 Joystick10Button9PressedStatus 4;
BA_ "SPN" SG_ 3221225472 Joystick10Button10PressedStatus 4733;
BA_ "SigType" SG_ 3221225472 Joystick10Button10PressedStatus 4;
BA_ "SPN" SG_ 3221225472 Joystick10Button11PressedStatus 4732;
BA_ "SigType" SG_ 3221225472 Joystick10Button11PressedStatus 4;
BA_ "SPN" SG_ 3221225472 Joystick10Button12PressedStatus 4731;
BA_ "SigType" SG_ 3221225472 Joystick10Button12PressedStatus 4;
BA_ "SPN" SG_ 3221225472 Joystick10Button5PressedStatus 4730;
BA_ "SigType" SG_ 3221225472 Joystick10Button5PressedStatus 4;
BA_ "SPN" SG_ 3221225472 Joystick10Button6PressedStatus 4729;
BA_ "SigType" SG_ 3221225472 Joystick10Button6PressedStatus 4;
BA_ "SPN" SG_ 3221225472 Joystick10Button7PressedStatus 4728;
BA_ "SigType" SG_ 3221225472 Joystick10Button7PressedStatus 4;
BA_ "SPN" SG_ 3221225472 Joystick10Button8PressedStatus 4727;
BA_ "SigType" SG_ 3221225472 Joystick10Button8PressedStatus 4;
BA_ "SPN" SG_ 3221225472 Joystick10Button1PressedStatus 4726;
BA_ "SigType" SG_ 3221225472 Joystick10Button1PressedStatus 4;
BA_ "SPN" SG_ 3221225472 Joystick10Button2PressedStatus 4725;
BA_ "SigType" SG_ 3221225472 Joystick10Button2PressedStatus 4;
BA_ "SPN" SG_ 3221225472 Joystick10Button3PressedStatus 4724;
BA_ "SigType" SG_ 3221225472 Joystick10Button3PressedStatus 4;
BA_ "SPN" SG_ 3221225472 Joystick10Button4PressedStatus 4723;
BA_ "SigType" SG_ 3221225472 Joystick10Button4PressedStatus 4;
BA_ "SPN" SG_ 3221225472 Joystick10XAxisDetentPosStatus 4722;
BA_ "SigType" SG_ 3221225472 Joystick10XAxisDetentPosStatus 4;
BA_ "SPN" SG_ 3221225472 Joystick10YAxisDetentPosStatus 4721;
BA_ "SigType" SG_ 3221225472 Joystick10YAxisDetentPosStatus 4;
BA_ "SPN" SG_ 3221225472 Joystick10YAxisPos 4720;
BA_ "SPN" SG_ 3221225472 Jystck10YAxsLvrFrwrdPstvPsStatus 4719;
BA_ "SigType" SG_ 3221225472 Jystck10YAxsLvrFrwrdPstvPsStatus 4;
BA_ "SPN" SG_ 3221225472 Jystck10YAxsLvrBckNgtvePosStatus 4718;
BA_ "SigType" SG_ 3221225472 Jystck10YAxsLvrBckNgtvePosStatus 4;
BA_ "SPN" SG_ 3221225472 Joystick10YAxisNeutralPosStatus 4717;
BA_ "SigType" SG_ 3221225472 Joystick10YAxisNeutralPosStatus 4;
BA_ "SPN" SG_ 3221225472 Joystick10XAxisPos 4716;
BA_ "SPN" SG_ 3221225472 Jystck10XAxsLvrRghtPstvPosStatus 4715;
BA_ "SigType" SG_ 3221225472 Jystck10XAxsLvrRghtPstvPosStatus 4;
BA_ "SPN" SG_ 3221225472 Jystck10XAxsLvrLftNgtvePosStatus 4714;
BA_ "SigType" SG_ 3221225472 Jystck10XAxsLvrLftNgtvePosStatus 4;
BA_ "SPN" SG_ 3221225472 Joystick10XAxisNeutralPosStatus 4713;
BA_ "SigType" SG_ 3221225472 Joystick10XAxisNeutralPosStatus 4;
BA_ "SPN" SG_ 3221225472 PssngrArbgDctivationSwitchStatus 4962;
BA_ "SigType" SG_ 3221225472 PssngrArbgDctivationSwitchStatus 5;
BA_ "SPN" SG_ 3221225472 Beltlock10Status 4961;
BA_ "SigType" SG_ 3221225472 Beltlock10Status 5;
BA_ "SPN" SG_ 3221225472 Beltlock9Status 4960;
BA_ "SigType" SG_ 3221225472 Beltlock9Status 5;
BA_ "SPN" SG_ 3221225472 Beltlock8Status 4959;
BA_ "SigType" SG_ 3221225472 Beltlock8Status 5;
BA_ "SPN" SG_ 3221225472 Beltlock7Status 4958;
BA_ "SigType" SG_ 3221225472 Beltlock7Status 5;
BA_ "SPN" SG_ 3221225472 Beltlock6Status 4957;
BA_ "SigType" SG_ 3221225472 Beltlock6Status 5;
BA_ "SPN" SG_ 3221225472 Beltlock5Status 4956;
BA_ "SigType" SG_ 3221225472 Beltlock5Status 5;
BA_ "SPN" SG_ 3221225472 Beltlock4Status 4955;
BA_ "SigType" SG_ 3221225472 Beltlock4Status 5;
BA_ "SPN" SG_ 3221225472 Beltlock3Status 4954;
BA_ "SigType" SG_ 3221225472 Beltlock3Status 5;
BA_ "SPN" SG_ 3221225472 PassengerBeltlockStatus 4953;
BA_ "SigType" SG_ 3221225472 PassengerBeltlockStatus 5;
BA_ "SPN" SG_ 3221225472 DriverBeltlockStatus 4952;
BA_ "SigType" SG_ 3221225472 DriverBeltlockStatus 5;
BA_ "SPN" SG_ 3221225472 BatteryCharger2OutputCurrent 4997;
BA_ "SigType" SG_ 3221225472 BatteryCharger2OutputCurrent 1;
BA_ "SPN" SG_ 3221225472 BatteryCharger2OutputVoltage 4996;
BA_ "SigType" SG_ 3221225472 BatteryCharger2OutputVoltage 1;
BA_ "SPN" SG_ 3221225472 BatteryCharger2PowerLineState 4995;
BA_ "SigType" SG_ 3221225472 BatteryCharger2PowerLineState 4;
BA_ "SPN" SG_ 3221225472 BatteryCharger2State 4994;
BA_ "SPN" SG_ 3221225472 BatteryCharger1OutputCurrent 4993;
BA_ "SigType" SG_ 3221225472 BatteryCharger1OutputCurrent 1;
BA_ "SPN" SG_ 3221225472 BatteryCharger1OutputVoltage 4992;
BA_ "SigType" SG_ 3221225472 BatteryCharger1OutputVoltage 1;
BA_ "SPN" SG_ 3221225472 BatteryCharger1PowerLineState 4991;
BA_ "SigType" SG_ 3221225472 BatteryCharger1PowerLineState 4;
BA_ "SPN" SG_ 3221225472 BatteryCharger1State 4990;
BA_ "SPN" SG_ 3221225472 TwoTWCDiffTemp 4780;
BA_ "SigType" SG_ 3221225472 TwoTWCDiffTemp 1;
BA_ "SPN" SG_ 3221225472 OneTWCDiffTemp 4779;
BA_ "SigType" SG_ 3221225472 OneTWCDiffTemp 1;
BA_ "SPN" SG_ 3221225472 TwoGOCDiffTemp 4778;
BA_ "SigType" SG_ 3221225472 TwoGOCDiffTemp 1;
BA_ "SPN" SG_ 3221225472 OneGOCDiffTemp 4777;
BA_ "SigType" SG_ 3221225472 OneGOCDiffTemp 1;
BA_ "SPN" SG_ 3221225472 OutTemp 5316;
BA_ "SigType" SG_ 3221225472 OutTemp 1;
BA_ "SPN" SG_ 3221225472 InTemp 5315;
BA_ "SigType" SG_ 3221225472 InTemp 1;
BA_ "SPN" SG_ 3221225472 DiffPressPreliminaryFMI 4300;
BA_ "SPN" SG_ 3221225472 OutTempPreliminaryFMI 4299;
BA_ "SPN" SG_ 3221225472 InTempPreliminaryFMI 4298;
BA_ "SPN" SG_ 3221225472 DiffPress 4297;
BA_ "SigType" SG_ 3221225472 DiffPress 1;
BA_ "SPN" SG_ 3221225472 OutTemp 4296;
BA_ "SigType" SG_ 3221225472 OutTemp 1;
BA_ "SPN" SG_ 3221225472 InTemp 4295;
BA_ "SigType" SG_ 3221225472 InTemp 1;
BA_ "SPN" SG_ 3221225472 CorrectedNOx 7352;
BA_ "SigType" SG_ 3221225472 CorrectedNOx 1;
BA_ "SPN" SG_ 3221225472 NOxSnsrSelfDiagFinalResult 5719;
BA_ "SigType" SG_ 3221225472 NOxSnsrSelfDiagFinalResult 1;
BA_ "SPN" SG_ 3221225472 NOxSnsrNH3Correction 5051;
BA_ "SigType" SG_ 3221225472 NOxSnsrNH3Correction 1;
BA_ "SPN" SG_ 3221225472 NOxSnsrNO2Correction 5050;
BA_ "SigType" SG_ 3221225472 NOxSnsrNO2Correction 1;
BA_ "SPN" SG_ 3221225472 NOxSnsrNOxPressCorrection 5049;
BA_ "SigType" SG_ 3221225472 NOxSnsrNOxPressCorrection 1;
BA_ "SPN" SG_ 3221225472 NOxSnsrO2PressCorrection 5048;
BA_ "SigType" SG_ 3221225472 NOxSnsrO2PressCorrection 1;
BA_ "SPN" SG_ 3221225472 NOxSnsrOpHours 5723;
BA_ "SigType" SG_ 3221225472 NOxSnsrOpHours 1;
BA_ "SPN" SG_ 3221225472 NOxSnsrNewPartDeviationNOxOffset 5047;
BA_ "SigType" SG_ 3221225472 NOxSnsrNewPartDeviationNOxOffset 1;
BA_ "SPN" SG_ 3221225472 NOxSnsrNewPartDeviationNOxGain 5046;
BA_ "SigType" SG_ 3221225472 NOxSnsrNewPartDeviationNOxGain 1;
BA_ "SPN" SG_ 3221225472 NOxSnsrHtrRatio 5045;
BA_ "SigType" SG_ 3221225472 NOxSnsrHtrRatio 1;
BA_ "SPN" SG_ 3221225472 SCRInCorrectedNOx 7354;
BA_ "SigType" SG_ 3221225472 SCRInCorrectedNOx 1;
BA_ "SPN" SG_ 3221225472 NOxSnsrSelfDiagFinalResult 5720;
BA_ "SigType" SG_ 3221225472 NOxSnsrSelfDiagFinalResult 1;
BA_ "SPN" SG_ 3221225472 NOxSnsrNH3Correction 5044;
BA_ "SigType" SG_ 3221225472 NOxSnsrNH3Correction 1;
BA_ "SPN" SG_ 3221225472 NOxSnsrNO2Correction 5043;
BA_ "SigType" SG_ 3221225472 NOxSnsrNO2Correction 1;
BA_ "SPN" SG_ 3221225472 NOxSnsrNOxPressCorrection 5042;
BA_ "SigType" SG_ 3221225472 NOxSnsrNOxPressCorrection 1;
BA_ "SPN" SG_ 3221225472 NOxSnsrO2PressCorrection 5041;
BA_ "SigType" SG_ 3221225472 NOxSnsrO2PressCorrection 1;
BA_ "SPN" SG_ 3221225472 NOxSnsrOpHours 5724;
BA_ "SigType" SG_ 3221225472 NOxSnsrOpHours 1;
BA_ "SPN" SG_ 3221225472 NOxSnsrNewPartDeviationNOxOffset 5040;
BA_ "SigType" SG_ 3221225472 NOxSnsrNewPartDeviationNOxOffset 1;
BA_ "SPN" SG_ 3221225472 NOxSnsrNewPartDeviationNOxGain 5039;
BA_ "SigType" SG_ 3221225472 NOxSnsrNewPartDeviationNOxGain 1;
BA_ "SPN" SG_ 3221225472 NOxSnsrHtrRatio 5038;
BA_ "SigType" SG_ 3221225472 NOxSnsrHtrRatio 1;
BA_ "SPN" SG_ 3221225472 Press2Ctrl 5428;
BA_ "SigType" SG_ 3221225472 Press2Ctrl 1;
BA_ "SPN" SG_ 3221225472 FlowDiverterVlvCtrl 5427;
BA_ "SigType" SG_ 3221225472 FlowDiverterVlvCtrl 5;
BA_ "SPN" SG_ 3221225472 PumpRelayCtrl 5426;
BA_ "SigType" SG_ 3221225472 PumpRelayCtrl 5;
BA_ "SPN" SG_ 3221225472 Press2 4303;
BA_ "SigType" SG_ 3221225472 Press2 1;
BA_ "SPN" SG_ 3221225472 StdDeviationCalOffset 5498;
BA_ "SigType" SG_ 3221225472 StdDeviationCalOffset 1;
BA_ "SPN" SG_ 3221225472 MeanCalOffset 5497;
BA_ "SigType" SG_ 3221225472 MeanCalOffset 1;
BA_ "SPN" SG_ 3221225472 OutTemp 4810;
BA_ "SigType" SG_ 3221225472 OutTemp 1;
BA_ "SPN" SG_ 3221225472 InTemp 4809;
BA_ "SigType" SG_ 3221225472 InTemp 1;
BA_ "SPN" SG_ 3221225472 DiffPressPreliminaryFMI 4294;
BA_ "SPN" SG_ 3221225472 OutTempPreliminaryFMI 4293;
BA_ "SPN" SG_ 3221225472 InTempPreliminaryFMI 4292;
BA_ "SPN" SG_ 3221225472 DiffPress 4291;
BA_ "SigType" SG_ 3221225472 DiffPress 1;
BA_ "SPN" SG_ 3221225472 OutTemp 4290;
BA_ "SigType" SG_ 3221225472 OutTemp 1;
BA_ "SPN" SG_ 3221225472 InTemp 4289;
BA_ "SigType" SG_ 3221225472 InTemp 1;
BA_ "SPN" SG_ 3221225472 HtrPreliminaryFMI 4366;
BA_ "SPN" SG_ 3221225472 SCROpIndSev 5246;
BA_ "SPN" SG_ 3221225472 TempPreliminaryFMI 4365;
BA_ "SPN" SG_ 3221225472 DEFTankLowLvlInd 5245;
BA_ "SPN" SG_ 3221225472 LvlVolPreliminaryFMI 3532;
BA_ "SPN" SG_ 3221225472 Lvl 3517;
BA_ "SigType" SG_ 3221225472 Lvl 1;
BA_ "SPN" SG_ 3221225472 Temp1 3031;
BA_ "SigType" SG_ 3221225472 Temp1 1;
BA_ "SPN" SG_ 3221225472 Volume 1761;
BA_ "SigType" SG_ 3221225472 Volume 1;
BA_ "SPN" SG_ 3221225472 CorrectedNOx 7351;
BA_ "SigType" SG_ 3221225472 CorrectedNOx 1;
BA_ "SPN" SG_ 3221225472 NOxSnsrSelfDiagFinalResult 5717;
BA_ "SigType" SG_ 3221225472 NOxSnsrSelfDiagFinalResult 1;
BA_ "SPN" SG_ 3221225472 NOxSnsrNH3Correction 5037;
BA_ "SigType" SG_ 3221225472 NOxSnsrNH3Correction 1;
BA_ "SPN" SG_ 3221225472 NOxSnsrNO2Correction 5036;
BA_ "SigType" SG_ 3221225472 NOxSnsrNO2Correction 1;
BA_ "SPN" SG_ 3221225472 NOxSnsrNOxPressCorrection 5035;
BA_ "SigType" SG_ 3221225472 NOxSnsrNOxPressCorrection 1;
BA_ "SPN" SG_ 3221225472 NOxSnsrO2PressCorrection 5034;
BA_ "SigType" SG_ 3221225472 NOxSnsrO2PressCorrection 1;
BA_ "SPN" SG_ 3221225472 NOxSnsrOpHours 5721;
BA_ "SigType" SG_ 3221225472 NOxSnsrOpHours 1;
BA_ "SPN" SG_ 3221225472 NOxSnsrNewPartDeviationNOxOffset 5033;
BA_ "SigType" SG_ 3221225472 NOxSnsrNewPartDeviationNOxOffset 1;
BA_ "SPN" SG_ 3221225472 NOxSnsrNewPartDeviationNOxGain 5032;
BA_ "SigType" SG_ 3221225472 NOxSnsrNewPartDeviationNOxGain 1;
BA_ "SPN" SG_ 3221225472 NOxSnsrHtrRatio 5031;
BA_ "SigType" SG_ 3221225472 NOxSnsrHtrRatio 1;
BA_ "SPN" SG_ 3221225472 SCRInCorrectedNOx 7353;
BA_ "SigType" SG_ 3221225472 SCRInCorrectedNOx 1;
BA_ "SPN" SG_ 3221225472 NOxSnsrSelfDiagFinalResult 5718;
BA_ "SigType" SG_ 3221225472 NOxSnsrSelfDiagFinalResult 1;
BA_ "SPN" SG_ 3221225472 NOxSnsrNH3Correction 5030;
BA_ "SigType" SG_ 3221225472 NOxSnsrNH3Correction 1;
BA_ "SPN" SG_ 3221225472 NOxSnsrNO2Correction 5029;
BA_ "SigType" SG_ 3221225472 NOxSnsrNO2Correction 1;
BA_ "SPN" SG_ 3221225472 NOxSnsrNOxPressCorrection 5028;
BA_ "SigType" SG_ 3221225472 NOxSnsrNOxPressCorrection 1;
BA_ "SPN" SG_ 3221225472 NOxSnsrO2PressCorrection 5027;
BA_ "SigType" SG_ 3221225472 NOxSnsrO2PressCorrection 1;
BA_ "SPN" SG_ 3221225472 NOxSnsrOpHours 5722;
BA_ "SigType" SG_ 3221225472 NOxSnsrOpHours 1;
BA_ "SPN" SG_ 3221225472 NOxSnsrNewPartDeviationNOxOffset 5026;
BA_ "SigType" SG_ 3221225472 NOxSnsrNewPartDeviationNOxOffset 1;
BA_ "SPN" SG_ 3221225472 NOxSnsrNewPartDeviationNOxGain 5025;
BA_ "SigType" SG_ 3221225472 NOxSnsrNewPartDeviationNOxGain 1;
BA_ "SPN" SG_ 3221225472 NOxSnsrHtrRatio 5024;
BA_ "SigType" SG_ 3221225472 NOxSnsrHtrRatio 1;
BA_ "SPN" SG_ 3221225472 StdDeviationCalOffset 5496;
BA_ "SigType" SG_ 3221225472 StdDeviationCalOffset 1;
BA_ "SPN" SG_ 3221225472 MeanCalOffset 5495;
BA_ "SigType" SG_ 3221225472 MeanCalOffset 1;
BA_ "SPN" SG_ 3221225472 Armrest2Switch2 5494;
BA_ "SigType" SG_ 3221225472 Armrest2Switch2 5;
BA_ "SPN" SG_ 3221225472 Armrest2Switch1 5493;
BA_ "SigType" SG_ 3221225472 Armrest2Switch1 5;
BA_ "SPN" SG_ 3221225472 Armrest1Switch2 5492;
BA_ "SigType" SG_ 3221225472 Armrest1Switch2 5;
BA_ "SPN" SG_ 3221225472 Armrest1Switch1 1503;
BA_ "SigType" SG_ 3221225472 Armrest1Switch1 5;
BA_ "SPN" SG_ 3221225472 AngularRateMeasurementLatency 4989;
BA_ "SigType" SG_ 3221225472 AngularRateMeasurementLatency 1;
BA_ "SPN" SG_ 3221225472 YawRateExRangeFigureOfMerit 4988;
BA_ "SigType" SG_ 3221225472 YawRateExRangeFigureOfMerit 5;
BA_ "SPN" SG_ 3221225472 RollRateExRangeFigureOfMerit 4987;
BA_ "SigType" SG_ 3221225472 RollRateExRangeFigureOfMerit 5;
BA_ "SPN" SG_ 3221225472 PitchRateExRangeFigureOfMerit 4986;
BA_ "SigType" SG_ 3221225472 PitchRateExRangeFigureOfMerit 5;
BA_ "SPN" SG_ 3221225472 YawRateExRange 4985;
BA_ "SigType" SG_ 3221225472 YawRateExRange 1;
BA_ "SPN" SG_ 3221225472 RollRateExRange 4984;
BA_ "SigType" SG_ 3221225472 RollRateExRange 1;
BA_ "SPN" SG_ 3221225472 PitchRateExRange 4983;
BA_ "SigType" SG_ 3221225472 PitchRateExRange 1;
BA_ "SPN" SG_ 3221225472 DesulfationStatus 5462;
BA_ "SigType" SG_ 3221225472 DesulfationStatus 5;
BA_ "SPN" SG_ 3221225472 DesulfationStatus 5461;
BA_ "SigType" SG_ 3221225472 DesulfationStatus 5;
BA_ "SPN" SG_ 3221225472 DEFQuickThawHtrPreliminaryFMI 4439;
BA_ "SPN" SG_ 3221225472 DEFQuickThawHtr 4438;
BA_ "SigType" SG_ 3221225472 DEFQuickThawHtr 1;
BA_ "SPN" SG_ 3221225472 DEFQuickThawTempPreliminaryFMI 4437;
BA_ "SPN" SG_ 3221225472 DEFQuickThawLvlPreliminaryFMI 4436;
BA_ "SPN" SG_ 3221225472 DEFQuickThawTankLvl 4435;
BA_ "SigType" SG_ 3221225472 DEFQuickThawTankLvl 1;
BA_ "SPN" SG_ 3221225472 DEFQuickThawTemp 4434;
BA_ "SigType" SG_ 3221225472 DEFQuickThawTemp 1;
BA_ "SPN" SG_ 3221225472 DEFQuickThawTankVolume 4433;
BA_ "SigType" SG_ 3221225472 DEFQuickThawTankVolume 1;
BA_ "SPN" SG_ 3221225472 HtrPreliminaryFMI 4432;
BA_ "SPN" SG_ 3221225472 TempPreliminaryFMI 4430;
BA_ "SPN" SG_ 3221225472 LvlVolPreliminaryFMI 4429;
BA_ "SPN" SG_ 3221225472 Lvl 4428;
BA_ "SigType" SG_ 3221225472 Lvl 1;
BA_ "SPN" SG_ 3221225472 Temp1 4427;
BA_ "SigType" SG_ 3221225472 Temp1 1;
BA_ "SPN" SG_ 3221225472 Volume 4426;
BA_ "SigType" SG_ 3221225472 Volume 1;
BA_ "SPN" SG_ 3221225472 DosingUnit2DiverterVlv 7537;
BA_ "SigType" SG_ 3221225472 DosingUnit2DiverterVlv 1;
BA_ "SPN" SG_ 3221225472 TankDrainVlvCmd 5439;
BA_ "SigType" SG_ 3221225472 TankDrainVlvCmd 1;
BA_ "SPN" SG_ 3221225472 PumpSt 5438;
BA_ "SigType" SG_ 3221225472 PumpSt 5;
BA_ "SPN" SG_ 3221225472 TankFillVlvCmd 5437;
BA_ "SigType" SG_ 3221225472 TankFillVlvCmd 1;
BA_ "SPN" SG_ 3221225472 DosingUnit1DiverterVlv 4442;
BA_ "SigType" SG_ 3221225472 DosingUnit1DiverterVlv 1;
BA_ "SPN" SG_ 3221225472 PumpDrivePercentage 4441;
BA_ "SigType" SG_ 3221225472 PumpDrivePercentage 1;
BA_ "SPN" SG_ 3221225472 Pump1MotorSpd 4440;
BA_ "SigType" SG_ 3221225472 Pump1MotorSpd 1;
BA_ "SPN" SG_ 3221225472 TypeProperty 4425;
BA_ "SPN" SG_ 3221225472 OutTempPreliminaryFMI 4416;
BA_ "SPN" SG_ 3221225472 OutTemp 4415;
BA_ "SigType" SG_ 3221225472 OutTemp 1;
BA_ "SPN" SG_ 3221225472 InTempPreliminaryFMI 4414;
BA_ "SPN" SG_ 3221225472 InTemp 4413;
BA_ "SigType" SG_ 3221225472 InTemp 1;
BA_ "SPN" SG_ 3221225472 InAbsPress 6798;
BA_ "SigType" SG_ 3221225472 InAbsPress 1;
BA_ "SPN" SG_ 3221225472 InPress 6587;
BA_ "SigType" SG_ 3221225472 InPress 1;
BA_ "SPN" SG_ 3221225472 DiffPressPreliminaryFMI 4412;
BA_ "SPN" SG_ 3221225472 DiffPress 4411;
BA_ "SigType" SG_ 3221225472 DiffPress 1;
BA_ "SPN" SG_ 3221225472 DEFLineHtr10 7571;
BA_ "SigType" SG_ 3221225472 DEFLineHtr10 5;
BA_ "SPN" SG_ 3221225472 DEFLineHtr9 7570;
BA_ "SigType" SG_ 3221225472 DEFLineHtr9 5;
BA_ "SPN" SG_ 3221225472 DEFLineHtr8 7569;
BA_ "SigType" SG_ 3221225472 DEFLineHtr8 5;
BA_ "SPN" SG_ 3221225472 DEFLineHtr7 7568;
BA_ "SigType" SG_ 3221225472 DEFLineHtr7 5;
BA_ "SPN" SG_ 3221225472 DEFLineHtr6 7567;
BA_ "SigType" SG_ 3221225472 DEFLineHtr6 5;
BA_ "SPN" SG_ 3221225472 DEFLineHtr5 5490;
BA_ "SigType" SG_ 3221225472 DEFLineHtr5 4;
BA_ "SPN" SG_ 3221225472 DEFLineHtrRelay3 7527;
BA_ "SigType" SG_ 3221225472 DEFLineHtrRelay3 5;
BA_ "SPN" SG_ 3221225472 DEFLineHtrRelay2 7526;
BA_ "SigType" SG_ 3221225472 DEFLineHtrRelay2 5;
BA_ "SPN" SG_ 3221225472 DEFLineHtrRelay1 5973;
BA_ "SigType" SG_ 3221225472 DEFLineHtrRelay1 5;
BA_ "SPN" SG_ 3221225472 DEFQuickThawHtrCmd 5415;
BA_ "SigType" SG_ 3221225472 DEFQuickThawHtrCmd 1;
BA_ "SPN" SG_ 3221225472 DEFTankHtrCmd 5138;
BA_ "SigType" SG_ 3221225472 DEFTankHtrCmd 1;
BA_ "SPN" SG_ 3221225472 DEFLineHtr4 4410;
BA_ "SigType" SG_ 3221225472 DEFLineHtr4 5;
BA_ "SPN" SG_ 3221225472 DEFLineHtr3 4409;
BA_ "SigType" SG_ 3221225472 DEFLineHtr3 5;
BA_ "SPN" SG_ 3221225472 DEFLineHtr2 4408;
BA_ "SigType" SG_ 3221225472 DEFLineHtr2 5;
BA_ "SPN" SG_ 3221225472 DEFLineHtr1 4407;
BA_ "SigType" SG_ 3221225472 DEFLineHtr1 5;
BA_ "SPN" SG_ 3221225472 DEFDoserHeatingModeReq 4406;
BA_ "SPN" SG_ 3221225472 DEFDoserFaultSuppressionReq 4405;
BA_ "SigType" SG_ 3221225472 DEFDoserFaultSuppressionReq 5;
BA_ "SPN" SG_ 3221225472 DEFReqQuantityOfIntegrator 4403;
BA_ "SigType" SG_ 3221225472 DEFReqQuantityOfIntegrator 1;
BA_ "SPN" SG_ 3221225472 DEFDosingReqQuantity6594 6594;
BA_ "SigType" SG_ 3221225472 DEFDosingReqQuantity6594 1;
BA_ "SPN" SG_ 3221225472 DEFPumpHtrCmd 7087;
BA_ "SigType" SG_ 3221225472 DEFPumpHtrCmd 1;
BA_ "SPN" SG_ 3221225472 DEFDosingTestInjPermStatus 7520;
BA_ "SigType" SG_ 3221225472 DEFDosingTestInjPermStatus 5;
BA_ "SPN" SG_ 3221225472 DEFHydStiffnessCheckPermStatus 7519;
BA_ "SigType" SG_ 3221225472 DEFHydStiffnessCheckPermStatus 5;
BA_ "SPN" SG_ 3221225472 SysReqSt 4402;
BA_ "SPN" SG_ 3221225472 DEFDosingReqQuantity 4401;
BA_ "SigType" SG_ 3221225472 DEFDosingReqQuantity 1;
BA_ "SPN" SG_ 3221225472 DEFLineHtr4PreliminaryFMI 4400;
BA_ "SPN" SG_ 3221225472 DEFLineHtr4St 4399;
BA_ "SigType" SG_ 3221225472 DEFLineHtr4St 5;
BA_ "SPN" SG_ 3221225472 DEFLineHtr3PreliminaryFMI 4398;
BA_ "SPN" SG_ 3221225472 DEFLineHtr3St 4397;
BA_ "SigType" SG_ 3221225472 DEFLineHtr3St 5;
BA_ "SPN" SG_ 3221225472 DEFLineHtr2PreliminaryFMI 4396;
BA_ "SPN" SG_ 3221225472 DEFLineHtr2St 4395;
BA_ "SigType" SG_ 3221225472 DEFLineHtr2St 5;
BA_ "SPN" SG_ 3221225472 DEFLineHtr1PreliminaryFMI 4394;
BA_ "SPN" SG_ 3221225472 DEFLineHtr1St 4393;
BA_ "SigType" SG_ 3221225472 DEFLineHtr1St 5;
BA_ "SPN" SG_ 3221225472 FeedbackCtrlStatus 4392;
BA_ "SPN" SG_ 3221225472 VlvExhTempReductionReq 4391;
BA_ "SPN" SG_ 3221225472 DEFDoser1Temp 4390;
BA_ "SigType" SG_ 3221225472 DEFDoser1Temp 1;
BA_ "SPN" SG_ 3221225472 AirAssistVlv 4389;
BA_ "SigType" SG_ 3221225472 AirAssistVlv 1;
BA_ "SPN" SG_ 3221225472 AirAssistAbsPress 4388;
BA_ "SigType" SG_ 3221225472 AirAssistAbsPress 1;
BA_ "SPN" SG_ 3221225472 DEFActualDosingQuantity6596 6596;
BA_ "SigType" SG_ 3221225472 DEFActualDosingQuantity6596 1;
BA_ "SPN" SG_ 3221225472 Sys2St 7525;
BA_ "SPN" SG_ 3221225472 DEFDoser1AbsPress 4387;
BA_ "SigType" SG_ 3221225472 DEFDoser1AbsPress 1;
BA_ "SPN" SG_ 3221225472 DEFActualQuantityOfIntegrator 4386;
BA_ "SigType" SG_ 3221225472 DEFActualQuantityOfIntegrator 1;
BA_ "SPN" SG_ 3221225472 Sys1St 4385;
BA_ "SPN" SG_ 3221225472 DEFActualDosingQuantity 4384;
BA_ "SigType" SG_ 3221225472 DEFActualDosingQuantity 1;
BA_ "SPN" SG_ 3221225472 OutNH3GasSnsrHtrCtrl 4449;
BA_ "SigType" SG_ 3221225472 OutNH3GasSnsrHtrCtrl 5;
BA_ "SPN" SG_ 3221225472 OutNH3GasSnsrHtrPreliminaryFMI 4448;
BA_ "SPN" SG_ 3221225472 OutNH3GasSnsrAtTemp 4447;
BA_ "SigType" SG_ 3221225472 OutNH3GasSnsrAtTemp 5;
BA_ "SPN" SG_ 3221225472 OutNH3GasSnsrPwrInRange 4446;
BA_ "SigType" SG_ 3221225472 OutNH3GasSnsrPwrInRange 5;
BA_ "SPN" SG_ 3221225472 OutNH3ReadingStable 4445;
BA_ "SigType" SG_ 3221225472 OutNH3ReadingStable 5;
BA_ "SPN" SG_ 3221225472 OutNH3SnsrPreliminaryFMI 4444;
BA_ "SPN" SG_ 3221225472 OutNH3 4443;
BA_ "SigType" SG_ 3221225472 OutNH3 1;
BA_ "SPN" SG_ 3221225472 DiffPressPreliminaryFMI 4764;
BA_ "SPN" SG_ 3221225472 OutTempPreliminaryFMI 4763;
BA_ "SPN" SG_ 3221225472 InTempPreliminaryFMI 4762;
BA_ "SPN" SG_ 3221225472 DiffPress 4761;
BA_ "SigType" SG_ 3221225472 DiffPress 1;
BA_ "SPN" SG_ 3221225472 OutTemp 4760;
BA_ "SigType" SG_ 3221225472 OutTemp 1;
BA_ "SPN" SG_ 3221225472 InTemp 4759;
BA_ "SigType" SG_ 3221225472 InTemp 1;
BA_ "SPN" SG_ 3221225472 DiffPressPreliminaryFMI 4776;
BA_ "SPN" SG_ 3221225472 OutTempPreliminaryFMI 4775;
BA_ "SPN" SG_ 3221225472 InTempPreliminaryFMI 4774;
BA_ "SPN" SG_ 3221225472 DiffPress 4773;
BA_ "SigType" SG_ 3221225472 DiffPress 1;
BA_ "SPN" SG_ 3221225472 OutTemp 4772;
BA_ "SigType" SG_ 3221225472 OutTemp 1;
BA_ "SPN" SG_ 3221225472 InTemp 4771;
BA_ "SigType" SG_ 3221225472 InTemp 1;
BA_ "SPN" SG_ 3221225472 DEFQuickThawHtrPreliminaryFMI 4373;
BA_ "SPN" SG_ 3221225472 DEFQuickThawHtr 4372;
BA_ "SigType" SG_ 3221225472 DEFQuickThawHtr 1;
BA_ "SPN" SG_ 3221225472 DEFQuickThawTempPreliminaryFMI 4371;
BA_ "SPN" SG_ 3221225472 DEFQuickThawLvlVolPreliminaryFMI 4370;
BA_ "SPN" SG_ 3221225472 DEFQuickThawTankLvl 4369;
BA_ "SigType" SG_ 3221225472 DEFQuickThawTankLvl 1;
BA_ "SPN" SG_ 3221225472 DEFQuickThawTemp 4368;
BA_ "SigType" SG_ 3221225472 DEFQuickThawTemp 1;
BA_ "SPN" SG_ 3221225472 DEFQuickThawTankVolume 4367;
BA_ "SigType" SG_ 3221225472 DEFQuickThawTankVolume 1;
BA_ "SPN" SG_ 3221225472 DosingUnit2DiverterVlv 7536;
BA_ "SigType" SG_ 3221225472 DosingUnit2DiverterVlv 1;
BA_ "SPN" SG_ 3221225472 Pump 7107;
BA_ "SigType" SG_ 3221225472 Pump 4;
BA_ "SPN" SG_ 3221225472 PumpPwrRelay 7416;
BA_ "SigType" SG_ 3221225472 PumpPwrRelay 4;
BA_ "SPN" SG_ 3221225472 TankDrainVlvCmd 5436;
BA_ "SigType" SG_ 3221225472 TankDrainVlvCmd 1;
BA_ "SPN" SG_ 3221225472 PumpSt 5435;
BA_ "SigType" SG_ 3221225472 PumpSt 5;
BA_ "SPN" SG_ 3221225472 TankFillVlvCmd 5434;
BA_ "SigType" SG_ 3221225472 TankFillVlvCmd 1;
BA_ "SPN" SG_ 3221225472 DosingUnit1DiverterVlv 4376;
BA_ "SigType" SG_ 3221225472 DosingUnit1DiverterVlv 1;
BA_ "SPN" SG_ 3221225472 PumpDrivePercentage 4375;
BA_ "SigType" SG_ 3221225472 PumpDrivePercentage 1;
BA_ "SPN" SG_ 3221225472 Pump1MotorSpd 4374;
BA_ "SigType" SG_ 3221225472 Pump1MotorSpd 1;
BA_ "SPN" SG_ 3221225472 OutTempPreliminaryFMI 4362;
BA_ "SPN" SG_ 3221225472 OutTemp 4363;
BA_ "SigType" SG_ 3221225472 OutTemp 1;
BA_ "SPN" SG_ 3221225472 InTempPreliminaryFMI 4361;
BA_ "SPN" SG_ 3221225472 InTemp 4360;
BA_ "SigType" SG_ 3221225472 InTemp 1;
BA_ "SPN" SG_ 3221225472 InAbsPress 6797;
BA_ "SigType" SG_ 3221225472 InAbsPress 1;
BA_ "SPN" SG_ 3221225472 InPress 6586;
BA_ "SigType" SG_ 3221225472 InPress 1;
BA_ "SPN" SG_ 3221225472 DiffPressPreliminaryFMI 4359;
BA_ "SPN" SG_ 3221225472 DiffPress 4358;
BA_ "SigType" SG_ 3221225472 DiffPress 1;
BA_ "SPN" SG_ 3221225472 DEFLineHtr10 7566;
BA_ "SigType" SG_ 3221225472 DEFLineHtr10 5;
BA_ "SPN" SG_ 3221225472 DEFLineHtr9 7565;
BA_ "SigType" SG_ 3221225472 DEFLineHtr9 5;
BA_ "SPN" SG_ 3221225472 DEFLineHtr8 7564;
BA_ "SigType" SG_ 3221225472 DEFLineHtr8 5;
BA_ "SPN" SG_ 3221225472 DEFLineHtr7 7563;
BA_ "SigType" SG_ 3221225472 DEFLineHtr7 5;
BA_ "SPN" SG_ 3221225472 DEFLineHtr6 7562;
BA_ "SigType" SG_ 3221225472 DEFLineHtr6 5;
BA_ "SPN" SG_ 3221225472 DEFLineHtr5 7561;
BA_ "SigType" SG_ 3221225472 DEFLineHtr5 5;
BA_ "SPN" SG_ 3221225472 DEFLineHtrRelay3 7540;
BA_ "SigType" SG_ 3221225472 DEFLineHtrRelay3 5;
BA_ "SPN" SG_ 3221225472 DEFLineHtrRelay2 7069;
BA_ "SigType" SG_ 3221225472 DEFLineHtrRelay2 4;
BA_ "SPN" SG_ 3221225472 DEFLineHtrRelay1 5491;
BA_ "SigType" SG_ 3221225472 DEFLineHtrRelay1 4;
BA_ "SPN" SG_ 3221225472 DEFPumpHtrCmd 5707;
BA_ "SigType" SG_ 3221225472 DEFPumpHtrCmd 1;
BA_ "SPN" SG_ 3221225472 DEFQuickThawHtrCmd 5414;
BA_ "SigType" SG_ 3221225472 DEFQuickThawHtrCmd 1;
BA_ "SPN" SG_ 3221225472 DEFTankHtrCmd 5137;
BA_ "SigType" SG_ 3221225472 DEFTankHtrCmd 1;
BA_ "SPN" SG_ 3221225472 DEFLineHtr4 4357;
BA_ "SigType" SG_ 3221225472 DEFLineHtr4 5;
BA_ "SPN" SG_ 3221225472 DEFLineHtr3 4356;
BA_ "SigType" SG_ 3221225472 DEFLineHtr3 5;
BA_ "SPN" SG_ 3221225472 DEFLineHtr2 4355;
BA_ "SigType" SG_ 3221225472 DEFLineHtr2 5;
BA_ "SPN" SG_ 3221225472 DEFLineHtr1 4354;
BA_ "SigType" SG_ 3221225472 DEFLineHtr1 5;
BA_ "SPN" SG_ 3221225472 DEFDoserHeatingModeReq 4353;
BA_ "SPN" SG_ 3221225472 DEFDoserFaultSuppressionReq 4352;
BA_ "SigType" SG_ 3221225472 DEFDoserFaultSuppressionReq 5;
BA_ "SPN" SG_ 3221225472 DEFDosingReqQuantity6593 6593;
BA_ "SigType" SG_ 3221225472 DEFDosingReqQuantity6593 1;
BA_ "SPN" SG_ 3221225472 DEFDosingTestInjPermStatus 7518;
BA_ "SigType" SG_ 3221225472 DEFDosingTestInjPermStatus 5;
BA_ "SPN" SG_ 3221225472 DEFHydStiffnessCheckPermStatus 7517;
BA_ "SigType" SG_ 3221225472 DEFHydStiffnessCheckPermStatus 5;
BA_ "SPN" SG_ 3221225472 DEFReqQuantityOfIntegrator 4350;
BA_ "SigType" SG_ 3221225472 DEFReqQuantityOfIntegrator 1;
BA_ "SPN" SG_ 3221225472 SysReqSt 4349;
BA_ "SPN" SG_ 3221225472 DEFDosingReqQuantity 4348;
BA_ "SigType" SG_ 3221225472 DEFDosingReqQuantity 1;
BA_ "SPN" SG_ 3221225472 DEFLineHtr4PreliminaryFMI 4347;
BA_ "SPN" SG_ 3221225472 DEFLineHtr4St 4346;
BA_ "SigType" SG_ 3221225472 DEFLineHtr4St 5;
BA_ "SPN" SG_ 3221225472 DEFLineHtr3PreliminaryFMI 4345;
BA_ "SPN" SG_ 3221225472 DEFLineHtr3St 4344;
BA_ "SigType" SG_ 3221225472 DEFLineHtr3St 5;
BA_ "SPN" SG_ 3221225472 DEFLineHtr2PreliminaryFMI 4343;
BA_ "SPN" SG_ 3221225472 DEFLineHtr2St 4342;
BA_ "SigType" SG_ 3221225472 DEFLineHtr2St 5;
BA_ "SPN" SG_ 3221225472 DEFLineHtr1PreliminaryFMI 4341;
BA_ "SPN" SG_ 3221225472 DEFLineHtr1St 4340;
BA_ "SigType" SG_ 3221225472 DEFLineHtr1St 5;
BA_ "SPN" SG_ 3221225472 FeedbackCtrlStatus 4339;
BA_ "SPN" SG_ 3221225472 VlvExhTempReductionReq 4338;
BA_ "SPN" SG_ 3221225472 DEFDoser1Temp 4337;
BA_ "SigType" SG_ 3221225472 DEFDoser1Temp 1;
BA_ "SPN" SG_ 3221225472 AirAssistVlv 4336;
BA_ "SigType" SG_ 3221225472 AirAssistVlv 1;
BA_ "SPN" SG_ 3221225472 AirAssistAbsPress 4335;
BA_ "SigType" SG_ 3221225472 AirAssistAbsPress 1;
BA_ "SPN" SG_ 3221225472 DEFDoser1AbsPress 4334;
BA_ "SigType" SG_ 3221225472 DEFDoser1AbsPress 1;
BA_ "SPN" SG_ 3221225472 DEFActualDosingQuantity6595 6595;
BA_ "SigType" SG_ 3221225472 DEFActualDosingQuantity6595 1;
BA_ "SPN" SG_ 3221225472 DEFActualQuantityOfIntegrator 4333;
BA_ "SigType" SG_ 3221225472 DEFActualQuantityOfIntegrator 1;
BA_ "SPN" SG_ 3221225472 Sys2St 7524;
BA_ "SPN" SG_ 3221225472 Sys1St 4332;
BA_ "SPN" SG_ 3221225472 DEFActualDosingQuantity 4331;
BA_ "SigType" SG_ 3221225472 DEFActualDosingQuantity 1;
BA_ "SPN" SG_ 3221225472 OutNH3GasSnsrHtrCtrl 4383;
BA_ "SigType" SG_ 3221225472 OutNH3GasSnsrHtrCtrl 5;
BA_ "SPN" SG_ 3221225472 OutNH3GasSnsrHtrPreliminaryFMI 4382;
BA_ "SPN" SG_ 3221225472 OutNH3GasSnsrAtTemp 4381;
BA_ "SigType" SG_ 3221225472 OutNH3GasSnsrAtTemp 5;
BA_ "SPN" SG_ 3221225472 OutNH3GasSnsrPwrInRange 4380;
BA_ "SigType" SG_ 3221225472 OutNH3GasSnsrPwrInRange 5;
BA_ "SPN" SG_ 3221225472 OutNH3ReadingStable 4379;
BA_ "SigType" SG_ 3221225472 OutNH3ReadingStable 5;
BA_ "SPN" SG_ 3221225472 OutNH3SnsrPreliminaryFMI 4378;
BA_ "SPN" SG_ 3221225472 OutNH3 4377;
BA_ "SigType" SG_ 3221225472 OutNH3 1;
BA_ "SPN" SG_ 3221225472 DiffPressPreliminaryFMI 4758;
BA_ "SPN" SG_ 3221225472 OutTempPreliminaryFMI 4757;
BA_ "SPN" SG_ 3221225472 InTempPreliminaryFMI 4756;
BA_ "SPN" SG_ 3221225472 DiffPress 4755;
BA_ "SigType" SG_ 3221225472 DiffPress 1;
BA_ "SPN" SG_ 3221225472 OutTemp 4754;
BA_ "SigType" SG_ 3221225472 OutTemp 1;
BA_ "SPN" SG_ 3221225472 InTemp 4753;
BA_ "SigType" SG_ 3221225472 InTemp 1;
BA_ "SPN" SG_ 3221225472 BatteryMainSwitchHoldState 1681;
BA_ "SigType" SG_ 3221225472 BatteryMainSwitchHoldState 4;
BA_ "SPN" SG_ 3221225472 Joystick3XAxisDetentPosStatus 2754;
BA_ "SigType" SG_ 3221225472 Joystick3XAxisDetentPosStatus 4;
BA_ "SPN" SG_ 3221225472 Joystick3Button9PressedStatus 2767;
BA_ "SigType" SG_ 3221225472 Joystick3Button9PressedStatus 4;
BA_ "SPN" SG_ 3221225472 Joystick3Button10PressedStatus 2768;
BA_ "SigType" SG_ 3221225472 Joystick3Button10PressedStatus 4;
BA_ "SPN" SG_ 3221225472 Joystick3Button11PressedStatus 2769;
BA_ "SigType" SG_ 3221225472 Joystick3Button11PressedStatus 4;
BA_ "SPN" SG_ 3221225472 Joystick3Button12PressedStatus 2770;
BA_ "SigType" SG_ 3221225472 Joystick3Button12PressedStatus 4;
BA_ "SPN" SG_ 3221225472 Joystick3YAxisDetentPosStatus 2755;
BA_ "SigType" SG_ 3221225472 Joystick3YAxisDetentPosStatus 4;
BA_ "SPN" SG_ 3221225472 DiffPressPreliminaryFMI 4770;
BA_ "SPN" SG_ 3221225472 OutTempPreliminaryFMI 4769;
BA_ "SPN" SG_ 3221225472 InTempPreliminaryFMI 4768;
BA_ "SPN" SG_ 3221225472 DiffPress 4767;
BA_ "SigType" SG_ 3221225472 DiffPress 1;
BA_ "SPN" SG_ 3221225472 OutTemp 4766;
BA_ "SigType" SG_ 3221225472 OutTemp 1;
BA_ "SPN" SG_ 3221225472 InTemp 4765;
BA_ "SigType" SG_ 3221225472 InTemp 1;
BA_ "SPN" SG_ 3221225472 FlowDiverterVlvCtrl 5424;
BA_ "SigType" SG_ 3221225472 FlowDiverterVlvCtrl 5;
BA_ "SPN" SG_ 3221225472 PumpRelayCtrl 5423;
BA_ "SigType" SG_ 3221225472 PumpRelayCtrl 5;
BA_ "SPN" SG_ 3221225472 Press2 4077;
BA_ "SigType" SG_ 3221225472 Press2 1;
VAL_ 3221225472 Joystick7Button12PressedStatus 3 "Not Available" 2 "Error Indicator" 1 "Button pressed" 0 "Button not pressed" ;
VAL_ 3221225472 Joystick7Button5PressedStatus 3 "Not Available" 2 "Error Indicator" 1 "Button pressed" 0 "Button not pressed" ;
VAL_ 3221225472 Joystick7Button6PressedStatus 3 "Not Available" 2 "Error Indicator" 1 "Button pressed" 0 "Button not pressed" ;
VAL_ 3221225472 Joystick7Button7PressedStatus 3 "Not Available" 2 "Error Indicator" 1 "Button pressed" 0 "Button not pressed" ;
VAL_ 3221225472 Joystick7Button8PressedStatus 3 "Not Available" 2 "Error Indicator" 1 "Button pressed" 0 "Button not pressed" ;
VAL_ 3221225472 Joystick7Button1PressedStatus 3 "Not Available" 2 "Error Indicator" 1 "Button pressed" 0 "Button not pressed" ;
VAL_ 3221225472 Joystick7Button2PressedStatus 3 "Not Available" 2 "Error Indicator" 1 "Button pressed" 0 "Button not pressed" ;
VAL_ 3221225472 Joystick7Button3PressedStatus 3 "Not Available" 2 "Error Indicator" 1 "Button pressed" 0 "Button not pressed" ;
VAL_ 3221225472 Joystick7Button4PressedStatus 3 "Not Available" 2 "Error Indicator" 1 "Button pressed" 0 "Button not pressed" ;
VAL_ 3221225472 Joystick7XAxisDetentPosStatus 3 "Not Available" 2 "Error Indicator" 1 "In the Detent Position" 0 "Not in the Detent Position" ;
VAL_ 3221225472 Joystick7YAxisDetentPosStatus 3 "Not Available" 2 "Error Indicator" 1 "In the Detent Position" 0 "Not in the Detent Position" ;
VAL_ 3221225472 Jystck7YAxsLvrFrwrdPstvPosStatus 3 "Not Available" 2 "Error Indicator" 1 "On positive side of Neutral" 0 "Not on Positive side of Neutral" ;
VAL_ 3221225472 Jystck7YAxsLvrBckNgtivePosStatus 3 "Not Available" 2 "Error Indicator" 1 "On negative side of Neutral" 0 "Not on negative side of Neutral" ;
VAL_ 3221225472 Joystick7YAxisNeutralPosStatus 3 "Not Available" 2 "Error Indicator" 1 "In Neutral Position" 0 "Not in Neutral Position" ;
VAL_ 3221225472 Jystck7XAxsLvrRghtPstvePosStatus 3 "Not Available" 2 "Error Indicator" 1 "On positive side of Neutral" 0 "Not on Positive side of Neutral" ;
VAL_ 3221225472 Jystck7XAxsLvrLftNgtivePosStatus 3 "Not Available" 2 "Error Indicator" 1 "On negative side of Neutral" 0 "Not on negative side of Neutral" ;
VAL_ 3221225472 Joystick7XAxisNeutralPosStatus 3 "Not Available" 2 "Error Indicator" 1 "In Neutral Position" 0 "Not in Neutral Position" ;
VAL_ 3221225472 Joystick6Button9PressedStatus 3 "Not Available" 2 "Error Indicator" 1 "Button pressed" 0 "Button not pressed" ;
VAL_ 3221225472 Joystick6Button10PressedStatus 3 "Not Available" 2 "Error Indicator" 1 "Button pressed" 0 "Button not pressed" ;
VAL_ 3221225472 Joystick6Button11PressedStatus 3 "Not Available" 2 "Error Indicator" 1 "Button pressed" 0 "Button not pressed" ;
VAL_ 3221225472 Joystick6Button12PressedStatus 3 "Not Available" 2 "Error Indicator" 1 "Button pressed" 0 "Button not pressed" ;
VAL_ 3221225472 Joystick6Button5PressedStatus 3 "Not Available" 2 "Error Indicator" 1 "Button pressed" 0 "Button not pressed" ;
VAL_ 3221225472 Joystick6Button6PressedStatus 3 "Not Available" 2 "Error Indicator" 1 "Button pressed" 0 "Button not pressed" ;
VAL_ 3221225472 Joystick6Button7PressedStatus 3 "Not Available" 2 "Error Indicator" 1 "Button pressed" 0 "Button not pressed" ;
VAL_ 3221225472 Joystick6Button8PressedStatus 3 "Not Available" 2 "Error Indicator" 1 "Button pressed" 0 "Button not pressed" ;
VAL_ 3221225472 Joystick6Button1PressedStatus 3 "Not Available" 2 "Error Indicator" 1 "Button pressed" 0 "Button not pressed" ;
VAL_ 3221225472 Joystick6Button2PressedStatus 3 "Not Available" 2 "Error Indicator" 1 "Button pressed" 0 "Button not pressed" ;
VAL_ 3221225472 Joystick6Button3PressedStatus 3 "Not Available" 2 "Error Indicator" 1 "Button pressed" 0 "Button not pressed" ;
VAL_ 3221225472 Joystick6Button4PressedStatus 3 "Not Available" 2 "Error Indicator" 1 "Button pressed" 0 "Button not pressed" ;
VAL_ 3221225472 Joystick6XAxisDetentPosStatus 3 "Not Available" 2 "Error Indicator" 1 "In the Detent Position" 0 "Not in the Detent Position" ;
VAL_ 3221225472 Joystick6YAxisDetentPosStatus 3 "Not Available" 2 "Error Indicator" 1 "In the Detent Position" 0 "Not in the Detent Position" ;
VAL_ 3221225472 Jystck6YAxsLvrFrwrdPstvPosStatus 3 "Not Available" 2 "Error Indicator" 1 "On positive side of Neutral" 0 "Not on Positive side of Neutral" ;
VAL_ 3221225472 Jystck6YAxsLvrBckNgtivePosStatus 3 "Not Available" 2 "Error Indicator" 1 "On negative side of Neutral" 0 "Not on negative side of Neutral" ;
VAL_ 3221225472 Joystick6YAxisNeutralPosStatus 3 "Not Available" 2 "Error Indicator" 1 "In Neutral Position" 0 "Not in Neutral Position" ;
VAL_ 3221225472 Jystck6XAxsLvrRghtPstvePosStatus 3 "Not Available" 2 "Error Indicator" 1 "On positive side of Neutral" 0 "Not on Positive side of Neutral" ;
VAL_ 3221225472 Jystck6XAxsLvrLftNgtivePosStatus 3 "Not Available" 2 "Error Indicator" 1 "On negative side of Neutral" 0 "Not on negative side of Neutral" ;
VAL_ 3221225472 Joystick6XAxisNeutralPosStatus 3 "Not Available" 2 "Error Indicator" 1 "In Neutral Position" 0 "Not in Neutral Position" ;
VAL_ 3221225472 Joystick5Button9PressedStatus 3 "Not Available" 2 "Error Indicator" 1 "Button pressed" 0 "Button not pressed" ;
VAL_ 3221225472 Joystick5Button10PressedStatus 3 "Not Available" 2 "Error Indicator" 1 "Button pressed" 0 "Button not pressed" ;
VAL_ 3221225472 Joystick5Button11PressedStatus 3 "Not Available" 2 "Error Indicator" 1 "Button pressed" 0 "Button not pressed" ;
VAL_ 3221225472 Joystick5Button12PressedStatus 3 "Not Available" 2 "Error Indicator" 1 "Button pressed" 0 "Button not pressed" ;
VAL_ 3221225472 Joystick5Button5PressedStatus 3 "Not Available" 2 "Error Indicator" 1 "Button pressed" 0 "Button not pressed" ;
VAL_ 3221225472 Joystick5Button6PressedStatus 3 "Not Available" 2 "Error Indicator" 1 "Button pressed" 0 "Button not pressed" ;
VAL_ 3221225472 Joystick5Button7PressedStatus 3 "Not Available" 2 "Error Indicator" 1 "Button pressed" 0 "Button not pressed" ;
VAL_ 3221225472 Joystick5Button8PressedStatus 3 "Not Available" 2 "Error Indicator" 1 "Button pressed" 0 "Button not pressed" ;
VAL_ 3221225472 Joystick5Button1PressedStatus 3 "Not Available" 2 "Error Indicator" 1 "Button pressed" 0 "Button not pressed" ;
VAL_ 3221225472 Joystick5Button2PressedStatus 3 "Not Available" 2 "Error Indicator" 1 "Button pressed" 0 "Button not pressed" ;
VAL_ 3221225472 Joystick5Button3PressedStatus 3 "Not Available" 2 "Error Indicator" 1 "Button pressed" 0 "Button not pressed" ;
VAL_ 3221225472 Joystick5Button4PressedStatus 3 "Not Available" 2 "Error Indicator" 1 "Button pressed" 0 "Button not pressed" ;
VAL_ 3221225472 Joystick5XAxisDetentPosStatus 3 "Not Available" 2 "Error Indicator" 1 "In the Detent Position" 0 "Not in the Detent Position" ;
VAL_ 3221225472 Joystick5YAxisDetentPosStatus 3 "Not Available" 2 "Error Indicator" 1 "In the Detent Position" 0 "Not in the Detent Position" ;
VAL_ 3221225472 Jystck5YAxsLvrFrwrdPstvPosStatus 3 "Not Available" 2 "Error Indicator" 1 "On positive side of Neutral" 0 "Not on Positive side of Neutral" ;
VAL_ 3221225472 Jystck5YAxsLvrBckNgtivePosStatus 3 "Not Available" 2 "Error Indicator" 1 "On negative side of Neutral" 0 "Not on negative side of Neutral" ;
VAL_ 3221225472 Joystick5YAxisNeutralPosStatus 3 "Not Available" 2 "Error Indicator" 1 "In Neutral Position" 0 "Not in Neutral Position" ;
VAL_ 3221225472 Jystck5XAxsLvrRghtPstvePosStatus 3 "Not Available" 2 "Error Indicator" 1 "On positive side of Neutral" 0 "Not on Positive side of Neutral" ;
VAL_ 3221225472 Jystck5XAxsLvrLftNgtivePosStatus 3 "Not Available" 2 "Error Indicator" 1 "On negative side of Neutral" 0 "Not on negative side of Neutral" ;
VAL_ 3221225472 Joystick5XAxisNeutralPosStatus 3 "Not Available" 2 "Error Indicator" 1 "In Neutral Position" 0 "Not in Neutral Position" ;
VAL_ 3221225472 Joystick4Button9PressedStatus 3 "Not Available" 2 "Error Indicator" 1 "Button pressed" 0 "Button not pressed" ;
VAL_ 3221225472 Joystick4Button10PressedStatus 1 "Button pressed" 0 "Button not pressed" 3 "Not Available" 2 "Error Indicator" ;
VAL_ 3221225472 Joystick4Button11PressedStatus 3 "Not Available" 2 "Error Indicator" 1 "Button pressed" 0 "Button not pressed" ;
VAL_ 3221225472 Joystick4Button12PressedStatus 3 "Not Available" 2 "Error Indicator" 1 "Button pressed" 0 "Button not pressed" ;
VAL_ 3221225472 Joystick4Button5PressedStatus 3 "Not Available" 2 "Error Indicator" 1 "Button pressed" 0 "Button not pressed" ;
VAL_ 3221225472 Joystick4Button6PressedStatus 3 "Not Available" 2 "Error Indicator" 1 "Button pressed" 0 "Button not pressed" ;
VAL_ 3221225472 Joystick4Button7PressedStatus 3 "Not Available" 2 "Error Indicator" 1 "Button pressed" 0 "Button not pressed" ;
VAL_ 3221225472 Joystick4Button8PressedStatus 3 "Not Available" 2 "Error Indicator" 1 "Button pressed" 0 "Button not pressed" ;
VAL_ 3221225472 Joystick4Button1PressedStatus 3 "Not Available" 2 "Error Indicator" 1 "Button pressed" 0 "Button not pressed" ;
VAL_ 3221225472 Joystick4Button2PressedStatus 3 "Not Available" 2 "Error Indicator" 1 "Button pressed" 0 "Button not pressed" ;
VAL_ 3221225472 Joystick4Button3PressedStatus 3 "Not Available" 2 "Error Indicator" 1 "Button pressed" 0 "Button not pressed" ;
VAL_ 3221225472 Joystick4Button4PressedStatus 3 "Not Available" 2 "Error Indicator" 1 "Button pressed" 0 "Button not pressed" ;
VAL_ 3221225472 Joystick4XAxisDetentPosStatus 3 "Not Available" 2 "Error Indicator" 1 "In the Detent Position" 0 "Not in the Detent Position" ;
VAL_ 3221225472 Joystick4YAxisDetentPosStatus 3 "Not Available" 2 "Error Indicator" 1 "In the Detent Position" 0 "Not in the Detent Position" ;
VAL_ 3221225472 Jystck4YAxsLvrFrwrdPstvPosStatus 3 "Not Available" 2 "Error Indicator" 1 "On positive side of Neutral" 0 "Not on Positive side of Neutral" ;
VAL_ 3221225472 Jystck4YAxsLvrBckNgtivePosStatus 3 "Not Available" 2 "Error Indicator" 1 "On negative side of Neutral" 0 "Not on negative side of Neutral" ;
VAL_ 3221225472 Joystick4YAxisNeutralPosStatus 3 "Not Available" 2 "Error Indicator" 1 "In Neutral Position" 0 "Not in Neutral Position" ;
VAL_ 3221225472 Jystck4XAxsLvrRghtPstvePosStatus 3 "Not Available" 2 "Error Indicator" 1 "On positive side of Neutral" 0 "Not on Positive side of Neutral" ;
VAL_ 3221225472 Jystck4XAxsLvrLftNgtivePosStatus 3 "Not Available" 2 "Error Indicator" 1 "On negative side of Neutral" 0 "Not on negative side of Neutral" ;
VAL_ 3221225472 Joystick4XAxisNeutralPosStatus 3 "Not Available" 2 "Error Indicator" 1 "In Neutral Position" 0 "Not in Neutral Position" ;
VAL_ 3221225472 Joystick10Button9PressedStatus 3 "Not Available" 2 "Error Indicator" 1 "Button pressed" 0 "Button not pressed" ;
VAL_ 3221225472 Joystick10Button10PressedStatus 3 "Not Available" 2 "Error Indicator" 1 "Button pressed" 0 "Button not pressed" ;
VAL_ 3221225472 Joystick10Button11PressedStatus 3 "Not Available" 2 "Error Indicator" 1 "Button pressed" 0 "Button not pressed" ;
VAL_ 3221225472 Joystick10Button12PressedStatus 3 "Not Available" 2 "Error Indicator" 1 "Button pressed" 0 "Button not pressed" ;
VAL_ 3221225472 Joystick10Button5PressedStatus 3 "Not Available" 2 "Error Indicator" 1 "Button pressed" 0 "Button not pressed" ;
VAL_ 3221225472 Joystick10Button6PressedStatus 3 "Not Available" 2 "Error Indicator" 1 "Button pressed" 0 "Button not pressed" ;
VAL_ 3221225472 Joystick10Button7PressedStatus 3 "Not Available" 2 "Error Indicator" 1 "Button pressed" 0 "Button not pressed" ;
VAL_ 3221225472 Joystick10Button8PressedStatus 3 "Not Available" 2 "Error Indicator" 1 "Button pressed" 0 "Button not pressed" ;
VAL_ 3221225472 Joystick10Button1PressedStatus 3 "Not Available" 2 "Error Indicator" 1 "Button pressed" 0 "Button not pressed" ;
VAL_ 3221225472 Joystick10Button2PressedStatus 3 "Not Available" 2 "Error Indicator" 1 "Button pressed" 0 "Button not pressed" ;
VAL_ 3221225472 Joystick10Button3PressedStatus 3 "Not Available" 2 "Error Indicator" 1 "Button pressed" 0 "Button not pressed" ;
VAL_ 3221225472 Joystick10Button4PressedStatus 3 "Not Available" 2 "Error Indicator" 1 "Button pressed" 0 "Button not pressed" ;
VAL_ 3221225472 Joystick10XAxisDetentPosStatus 3 "Not Available" 2 "Error Indicator" 1 "In the Detent Position" 0 "Not in the Detent Position" ;
VAL_ 3221225472 Joystick10YAxisDetentPosStatus 3 "Not Available" 2 "Error Indicator" 1 "In the Detent Position" 0 "Not in the Detent Position" ;
VAL_ 3221225472 Jystck10YAxsLvrFrwrdPstvPsStatus 3 "Not Available" 2 "Error Indicator" 1 "On positive side of Neutral" 0 "Not on Positive side of Neutral" ;
VAL_ 3221225472 Jystck10YAxsLvrBckNgtvePosStatus 3 "Not Available" 2 "Error Indicator" 1 "On negative side of Neutral" 0 "Not on negative side of Neutral" ;
VAL_ 3221225472 Joystick10YAxisNeutralPosStatus 3 "Not Available" 2 "Error Indicator" 1 "In Neutral Position" 0 "Not in Neutral Position" ;
VAL_ 3221225472 Jystck10XAxsLvrRghtPstvPosStatus 3 "Not Available" 2 "Error Indicator" 1 "On positive side of Neutral" 0 "Not on Positive side of Neutral" ;
VAL_ 3221225472 Jystck10XAxsLvrLftNgtvePosStatus 3 "Not Available" 2 "Error Indicator" 1 "On negative side of Neutral" 0 "Not on negative side of Neutral" ;
VAL_ 3221225472 Joystick10XAxisNeutralPosStatus 3 "Not Available" 2 "Error Indicator" 1 "In Neutral Position" 0 "Not in Neutral Position" ;
VAL_ 3221225472 PssngrArbgDctivationSwitchStatus 3 "not available" 2 "Error" 1 "passenger airbag deactivated" 0 "passenger airbag activated" ;
VAL_ 3221225472 Beltlock10Status 3 "not available" 2 "Error" 1 "locked" 0 "unlocked" ;
VAL_ 3221225472 Beltlock9Status 3 "not available" 2 "Error" 1 "locked" 0 "unlocked" ;
VAL_ 3221225472 Beltlock8Status 3 "not available" 2 "Error" 1 "locked" 0 "unlocked" ;
VAL_ 3221225472 Beltlock7Status 3 "not available" 2 "Error" 1 "locked" 0 "unlocked" ;
VAL_ 3221225472 Beltlock6Status 3 "not available" 2 "Error" 1 "locked" 0 "unlocked" ;
VAL_ 3221225472 Beltlock5Status 3 "not available" 2 "Error" 1 "locked" 0 "unlocked" ;
VAL_ 3221225472 Beltlock4Status 3 "not available" 2 "Error" 1 "locked" 0 "unlocked" ;
VAL_ 3221225472 Beltlock3Status 0 "unlocked" 3 "not available" 2 "Error" 1 "locked" ;
VAL_ 3221225472 PassengerBeltlockStatus 3 "not available" 2 "Error" 1 "locked" 0 "unlocked" ;
VAL_ 3221225472 DriverBeltlockStatus 3 "not available" 2 "Error" 1 "locked" 0 "unlocked" ;
VAL_ 3221225472 BatteryCharger2PowerLineState 3 "Not available" 2 "Error" 1 "Connected" 0 "Disconnected" ;
VAL_ 3221225472 BatteryCharger2State 13 "Battery failure" 2 "Stand-by or maintaining the battery charge." 1 "Charging the battery." 0 "Idling" 15 "Not available." 14 "Charger failure" ;
VAL_ 3221225472 BatteryCharger1PowerLineState 3 "Not available" 2 "Error" 1 "Connected" 0 "Disconnected" ;
VAL_ 3221225472 BatteryCharger1State 15 "Not available." 14 "Charger failure" 13 "Battery failure" 2 "Stand-by or maintaining the battery charge." 1 "Charging the battery." 0 "Idling" ;
VAL_ 3221225472 FlowDiverterVlvCtrl 3 "not available" 2 "reserved for SAE assignment" 1 "on" 0 "off" ;
VAL_ 3221225472 PumpRelayCtrl 3 "not available" 2 "reserved for SAE assignment" 1 "on" 0 "off" ;
VAL_ 3221225472 SCROpIndSev 7 "Not Available / Not Supported" 6 "Temporary Override of Inducement " 5 "Inducement Level 5  .." 4 "Inducement Level 4  .." 3 "Inducement Level 3 … EPA defined SCR Inducement" 2 "Inducement Level 2 … DEF Warning" 1 "Inducement Level 1 … EPA defined SCR Inducement" 0 "Driver Warning" ;
VAL_ 3221225472 DEFTankLowLvlInd 7 "not available" 6 "reserved for SAE assignment" 5 "reserved for SAE assignment" 4 "On fast blink" 3 "reserved for SAE assignment" 2 "reserved for SAE assignment" 1 "On solid" 0 "Off" ;
VAL_ 3221225472 Armrest2Switch2 3 "Don't care/take no action" 2 "Reserved" 1 "On" 0 "Off" ;
VAL_ 3221225472 Armrest2Switch1 3 "Don't care/take no action" 2 "Reserved" 1 "On" 0 "Off" ;
VAL_ 3221225472 Armrest1Switch2 3 "Don't care/take no action" 2 "Reserved" 1 "On" 0 "Off" ;
VAL_ 3221225472 Armrest1Switch1 3 "Don't care/take no action" 2 "Reserved" 1 "On" 0 "Off" ;
VAL_ 3221225472 YawRateExRangeFigureOfMerit 3 "Not available" 2 "Error" 1 "Yaw rate degraded" 0 "Yaw rate fully functional" ;
VAL_ 3221225472 RollRateExRangeFigureOfMerit 3 "Not available" 2 "Error" 1 "Roll rate degraded" 0 "Roll rate fully functional" ;
VAL_ 3221225472 PitchRateExRangeFigureOfMerit 3 "Not available" 2 "Error" 1 "Pitch rate degraded" 0 "Pitch rate fully functional" ;
VAL_ 3221225472 DesulfationStatus 3 "Not available" 2 "Error indicator" 1 "Active" 0 "Inactive" ;
VAL_ 3221225472 DesulfationStatus 3 "Not available" 2 "Error indicator" 1 "Active" 0 "Inactive" ;
VAL_ 3221225472 PumpSt 3 "not available" 2 "reserved for SAE assignment" 1 "pump error" 0 "pump operational" ;
VAL_ 3221225472 TypeProperty 15 "Not available" 14 "Error with diesel exhaust fluid property detection" 13 "Not able to determine fluid property" 12 "Diesel exhaust fluid" 3 "Diesel exhaust fluid is proper mixture" 2 "Fluid is diesel" 1 "Urea concentration too low" 0 "Urea concentration too high" ;
VAL_ 3221225472 DEFLineHtr10 3 "not available" 2 "reserved for future assignment by SAE" 1 "request for heater to be active" 0 "request for heater to be inactive" ;
VAL_ 3221225472 DEFLineHtr9 3 "not available" 2 "reserved for future assignment by SAE" 1 "request for heater to be active" 0 "request for heater to be inactive" ;
VAL_ 3221225472 DEFLineHtr8 3 "not available" 2 "reserved for future assignment by SAE" 1 "request for heater to be active" 0 "request for heater to be inactive" ;
VAL_ 3221225472 DEFLineHtr7 3 "not available" 2 "reserved for future assignment by SAE" 1 "request for heater to be active" 0 "request for heater to be inactive" ;
VAL_ 3221225472 DEFLineHtr6 3 "not available" 2 "reserved for future assignment by SAE" 1 "request for heater to be active" 0 "request for heater to be inactive" ;
VAL_ 3221225472 DEFLineHtr5 3 "not available" 2 "reserved for future assignment by SAE " 1 "request for heater to be active " 0 "request for heater to be inactive " ;
VAL_ 3221225472 DEFLineHtrRelay3 3 "Not Available" 2 "Error" 1 "On" 0 "Off" ;
VAL_ 3221225472 DEFLineHtrRelay2 3 "Not Available" 2 "Error" 1 "On" 0 "Off" ;
VAL_ 3221225472 DEFLineHtrRelay1 3 "Not Available" 2 "Error" 1 "On" 0 "Off" ;
VAL_ 3221225472 DEFLineHtr4 3 "not available" 2 "reserved for future assignment by SAE " 1 "request for heater to be active " 0 "request for heater to be inactive " ;
VAL_ 3221225472 DEFLineHtr3 3 "not available" 2 "reserved for future assignment by SAE " 1 "request for heater to be active " 0 "request for heater to be inactive " ;
VAL_ 3221225472 DEFLineHtr2 3 "not available" 2 "reserved for future assignment by SAE " 1 "request for heater to be active " 0 "request for heater to be inactive " ;
VAL_ 3221225472 DEFLineHtr1 3 "not available" 2 "reserved for future assignment by SAE " 1 "request for heater to be active " 0 "request for heater to be inactive " ;
VAL_ 3221225472 DEFDoserHeatingModeReq 7 "Not available" 3 "Heater on" 2 "Heater automatic mode" 1 "Heater economy mode" 0 "Heater off" ;
VAL_ 3221225472 DEFDoserFaultSuppressionReq 3 "Not available" 2 "Reserved" 1 "Error suppression on" 0 "Error suppression off" ;
VAL_ 3221225472 DEFDosingTestInjPermStatus 3 "not available" 2 "error" 1 "DEF dosing test injection allowed" 0 "not allowed" ;
VAL_ 3221225472 DEFHydStiffnessCheckPermStatus 3 "not available" 2 "error" 1 "DEF hydraulic stiffness check allowed" 0 "not allowed" ;
VAL_ 3221225472 SysReqSt 15 "Not available" 14 "Error" 10 "Service test mode,  dosing not allowed" 9 "Service test mode,  dosing allowed " 8 "Diagnosis" 7 "Shutoff" 6 "Protect mode against cold" 5 "Protect mode against heat" 4 "Reserved for future assignment by SAE " 3 "System error pending " 2 "Normal dosing operation " 1 "Preparing dosing readiness" 0 "Dormant" ;
VAL_ 3221225472 DEFLineHtr4St 3 "not available" 2 "error " 1 "heater active " 0 "heater inactive " ;
VAL_ 3221225472 DEFLineHtr3St 3 "not available" 2 "error " 1 "heater active " 0 "heater inactive " ;
VAL_ 3221225472 DEFLineHtr2St 3 "not available" 2 "error " 1 "heater active " 0 "heater inactive " ;
VAL_ 3221225472 DEFLineHtr1St 3 "not available" 2 "error " 1 "heater active " 0 "heater inactive " ;
VAL_ 3221225472 FeedbackCtrlStatus 7 "not available" 6 "error " 5 "reserved for future assignment by SAE " 4 "reserved for future assignment by SAE " 3 "reserved for future assignment by SAE " 2 "reserved for future assignment by SAE " 1 "closed loop control active " 0 "open loop control active " ;
VAL_ 3221225472 VlvExhTempReductionReq 7 "not available" 6 "error" 5 "reserved for future assignment by SAE" 4 "reserved for future assignment by SAE" 3 "reserved for future assignment by SAE" 2 "reduction request stage 2" 1 "reduction request stage 1" 0 "no request " ;
VAL_ 3221225472 Sys2St 15 "Not available" 14 "Error" 11 "Ok to Power Down" 10 "Service test mode,  dosing not allowed" 9 "Service test mode,  dosing allowed" 8 "Diagnosis" 7 "Shutoff" 6 "Protect mode against cold" 5 "Protect mode against heat" 4 "Purging" 3 "System error pending" 2 "Normal dosing operation" 1 "Preparing dosing readiness" 0 "Dormant" ;
VAL_ 3221225472 Sys1St 15 "Not available" 14 "Error" 11 "Ok to Power Down" 10 "Service test mode,  dosing not allowed" 9 "Service test mode,  dosing allowed " 8 "Diagnosis" 7 "Shutoff" 6 "Protect mode against cold" 5 "Protect mode against heat" 4 "Purging" 3 "System error pending" 2 "Normal dosing operation" 1 "Preparing dosing readiness" 0 "Dormant" ;
VAL_ 3221225472 OutNH3GasSnsrHtrCtrl 3 "Heater off or Not available" 2 "Preheat 1 " 1 "Preheat 2 " 0 "Automatic " ;
VAL_ 3221225472 OutNH3GasSnsrAtTemp 3 "Not available" 2 "Error" 1 "Heater element is in range" 0 "Heater element is not in range" ;
VAL_ 3221225472 OutNH3GasSnsrPwrInRange 3 "Not available" 2 "Error" 1 "Heater element is in range" 0 "Heater element is not in range" ;
VAL_ 3221225472 OutNH3ReadingStable 3 "Not available" 2 "Error" 1 "Reading is stable" 0 "Reading is not stable" ;
VAL_ 3221225472 Pump 3 "not available" 2 "error" 1 "on" 0 "off" ;
VAL_ 3221225472 PumpPwrRelay 3 "not available" 2 "error" 1 "active" 0 "not active" ;
VAL_ 3221225472 PumpSt 3 "not available" 2 "reserved for SAE assignment" 1 "pump error" 0 "pump operational" ;
VAL_ 3221225472 DEFLineHtr10 3 "not available" 2 "reserved for future assignment by SAE" 1 "request for heater to be active" 0 "request for heater to be inactive" ;
VAL_ 3221225472 DEFLineHtr9 3 "not available" 2 "reserved for future assignment by SAE" 1 "request for heater to be active" 0 "request for heater to be inactive" ;
VAL_ 3221225472 DEFLineHtr8 3 "not available" 2 "reserved for future assignment by SAE" 1 "request for heater to be active" 0 "request for heater to be inactive" ;
VAL_ 3221225472 DEFLineHtr7 3 "not available" 2 "reserved for future assignment by SAE" 1 "request for heater to be active" 0 "request for heater to be inactive" ;
VAL_ 3221225472 DEFLineHtr6 3 "not available" 2 "reserved for future assignment by SAE" 1 "request for heater to be active" 0 "request for heater to be inactive" ;
VAL_ 3221225472 DEFLineHtr5 3 "not available" 2 "reserved for future assignment by SAE" 1 "request for heater to be active" 0 "request for heater to be inactive" ;
VAL_ 3221225472 DEFLineHtrRelay3 3 "Not Available" 2 "Error" 1 "On" 0 "Off" ;
VAL_ 3221225472 DEFLineHtrRelay2 3 "Not Available" 2 "Error" 1 "On" 0 "Off" ;
VAL_ 3221225472 DEFLineHtrRelay1 3 "Not Available" 2 "Error" 1 "On" 0 "Off" ;
VAL_ 3221225472 DEFLineHtr4 3 "not available" 2 "reserved for future assignment by SAE " 1 "request for heater to be active " 0 "request for heater to be inactive " ;
VAL_ 3221225472 DEFLineHtr3 3 "not available" 2 "reserved for future assignment by SAE " 1 "request for heater to be active " 0 "request for heater to be inactive " ;
VAL_ 3221225472 DEFLineHtr2 3 "not available" 2 "reserved for future assignment by SAE " 1 "request for heater to be active " 0 "request for heater to be inactive " ;
VAL_ 3221225472 DEFLineHtr1 3 "not available" 2 "reserved for future assignment by SAE " 1 "request for heater to be active " 0 "request for heater to be inactive " ;
VAL_ 3221225472 DEFDoserHeatingModeReq 7 "Not available" 3 "Heater on" 2 "Heater automatic mode" 1 "Heater economy mode" 0 "Heater off" ;
VAL_ 3221225472 DEFDoserFaultSuppressionReq 3 "Not available" 2 "Reserved" 1 "Error suppression on" 0 "Error suppression off" ;
VAL_ 3221225472 DEFDosingTestInjPermStatus 3 "not available" 2 "error" 1 "DEF dosing test injection allowed" 0 "not allowed" ;
VAL_ 3221225472 DEFHydStiffnessCheckPermStatus 3 "not available" 2 "error" 1 "DEF hydraulic stiffness check allowed" 0 "not allowed" ;
VAL_ 3221225472 SysReqSt 15 "Not available" 14 "Error" 10 "Service test mode,  dosing not allowed" 9 "Service test mode,  dosing allowed " 8 "Diagnosis" 7 "Shutoff" 6 "Protect mode against cold" 5 "Protect mode against heat" 4 "Reserved for future assignment by SAE " 3 "System error pending " 2 "Normal dosing operation " 1 "Preparing dosing readiness" 0 "Dormant" ;
VAL_ 3221225472 DEFLineHtr4St 3 "not available" 2 "error " 1 "heater active " 0 "heater inactive " ;
VAL_ 3221225472 DEFLineHtr3St 3 "not available" 2 "error " 1 "heater active " 0 "heater inactive " ;
VAL_ 3221225472 DEFLineHtr2St 3 "not available" 2 "error " 1 "heater active " 0 "heater inactive " ;
VAL_ 3221225472 DEFLineHtr1St 3 "not available" 2 "error " 1 "heater active " 0 "heater inactive " ;
VAL_ 3221225472 FeedbackCtrlStatus 7 "not available" 6 "error " 5 "reserved for future assignment by SAE " 4 "reserved for future assignment by SAE " 3 "reserved for future assignment by SAE " 2 "reserved for future assignment by SAE " 1 "closed loop control active " 0 "open loop control active " ;
VAL_ 3221225472 VlvExhTempReductionReq 7 "not available" 6 "error" 5 "reserved for future assignment by SAE" 4 "reserved for future assignment by SAE" 3 "reserved for future assignment by SAE" 2 "reduction request stage 2" 1 "reduction request stage 1" 0 "no request " ;
VAL_ 3221225472 Sys2St 15 "Not available" 14 "Error" 11 "Ok to Power Down" 10 "Service test mode,  dosing not allowed" 9 "Service test mode,  dosing allowed" 8 "Diagnosis" 7 "Shutoff" 6 "Protect mode against cold" 5 "Protect mode against heat" 4 "Purging" 3 "System error pending" 2 "Normal dosing operation" 1 "Preparing dosing readiness" 0 "Dormant" ;
VAL_ 3221225472 Sys1St 15 "Not available" 14 "Error" 11 "Ok to Power Down" 10 "Service test mode,  dosing not allowed" 9 "Service test mode,  dosing allowed " 8 "Diagnosis" 7 "Shutoff " 6 "Protect mode against cold " 5 "Protect mode against heat " 4 "Purging" 3 "System error pending" 2 "Normal dosing operation" 1 "Preparing dosing readiness" 0 "Dormant" ;
VAL_ 3221225472 OutNH3GasSnsrHtrCtrl 3 "Heater off or not available" 2 "Preheat 1 " 1 "Preheat 2 " 0 "Automatic " ;
VAL_ 3221225472 OutNH3GasSnsrAtTemp 3 "Not available" 2 "Error" 1 "Heater element is in range" 0 "Heater element is not in range" ;
VAL_ 3221225472 OutNH3GasSnsrPwrInRange 3 "Not available" 2 "Error" 1 "Power is in range" 0 "Power is not in range" ;
VAL_ 3221225472 OutNH3ReadingStable 3 "Not available" 2 "Error" 1 "Reading is stable" 0 "Reading is not stable" ;
VAL_ 3221225472 BatteryMainSwitchHoldState 3 "Don't care/take no action" 2 "Reserved" 1 "Battery main switch held" 0 "Battery main switch not held" ;
VAL_ 3221225472 Joystick3XAxisDetentPosStatus 3 "Not Available" 2 "Error Indicator" 1 "In the Detent Position" 0 "Not in the Detent Position" ;
VAL_ 3221225472 Joystick3Button9PressedStatus 3 "Not Available" 2 "Error Indicator" 1 "Button pressed" 0 "Button not pressed" ;
VAL_ 3221225472 Joystick3Button10PressedStatus 3 "Not Available" 2 "Error Indicator" 1 "Button pressed" 0 "Button not pressed" ;
VAL_ 3221225472 Joystick3Button11PressedStatus 3 "Not Available" 2 "Error Indicator" 1 "Button pressed" 0 "Button not pressed" ;
VAL_ 3221225472 Joystick3Button12PressedStatus 3 "Not Available" 2 "Error Indicator" 1 "Button pressed" 0 "Button not pressed" ;
VAL_ 3221225472 Joystick3YAxisDetentPosStatus 3 "Not Available" 2 "Error Indicator" 1 "In the Detent Position" 0 "Not in the Detent Position" ;
VAL_ 3221225472 FlowDiverterVlvCtrl 3 "not available" 2 "reserved for SAE assignment" 1 "on" 0 "off" ;
VAL_ 3221225472 PumpRelayCtrl 3 "not available" 2 "reserved for SAE assignment" 1 "on" 0 "off" ;
