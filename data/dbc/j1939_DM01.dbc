VERSION ""

NS_ :

BS_:

BU_: PowertrainControlModule AtmosphericSensor SafetyRestraintSystem2 Aftertreatment_2_GasOutlet Aftertreatment_2_GasIntake DieselPartFilterControl Turbocharger SafetyRestraintSystem1 CabDisplay2 Aftertreatment_1_GasOutlet Aftertreatment_1_GasIntake OnBoardDataLogger OffBoardDiagnosticTool2 OffBoardDiagnosticTool1 FileServer ParkingBrakeController SeatController2 FanDriveController SteeringColumnUnit CommunicationUnitRadio CommunicationUnitSatellite CommunicationUnitCellular PropulsionBatteryCharger ChassisController2 ChassisController1 EngineValveControl AuxiliaryHeater2 AuxiliaryHeater1 ClutchUnit RampControl InformationSystem1 SuspensionSystemController2 OilSensor VehicleDynamicStability ExhaustEmissionController TransmissionDisplay2 TransmissionDisplay1 ClimateControl2 WaterPumpController RearAxleSteeringController LightingOperatorControl SeatController1 IgnitionController2 IgnitionController1 TirePressureController CabController2 CabController1 PneumaticSystemController SuspensionSystemController1 HydraulicPumpController EnduranceBrakingSystem RetarderExhaustEngine2 OnBoardDiagnosticUnit HeadwayController RetarderExhaustEngine1 CabDisplay1 ManagementComputer VirtualTerminal OffVehicleGateway PowerTakeOffFront HitchControl AuxiliaryValveControl BodyController TractorTrailerBridge1 StarterSystem ElectricalSystem VehicleSecurity VehicleNavigation AerodynamicControl ElectricalChargingSystem ClimateControl1 TripRecorder InstrumentCluster SuspensionDriveAxle2 SuspensionDriveAxle1 SuspensionSteerAxle SteeringController FuelSystem CruiseControl RetarderDriveline RetarderEngine BrakesDriveAxle2 BrakesDriveAxle1 BrakesSystemController BrakesSteerAxle AxleDrive2 AxleDrive1 AxleSteering PowerTakeOff ShiftConsoleSecondary ShiftConsolePrimary Transmission2 Transmission1 Engine2 Engine1

BO_ 3221225472 VECTOR__INDEPENDENT_SIG_MSG: 0 Vector__XXX
 SG_ CrnkAttmptCntOnPrsntStartAttempt : 0|8@1+ (1,0) [0|250] "" Vector__XXX
 SG_ EngIntakeManifoldPressCtrlMode : 0|2@1+ (1,0) [0|3] "" Vector__XXX
 SG_ EngRotationDirection : 0|2@1+ (1,0) [0|3] "" Vector__XXX
 SG_ EngRatedSpeed : 0|16@1+ (0.125,0) [0|8031.875] "rpm" Vector__XXX
 SG_ EngRatedPower : 0|16@1+ (0.5,0) [0|32127.5] "kW" Vector__XXX
 SG_ AFT2ExhDewPoint : 0|2@1+ (1,0) [0|3] "" Vector__XXX
 SG_ AFT2InDewPoint : 0|2@1+ (1,0) [0|3] "" Vector__XXX
 SG_ AFT1ExhDewPoint : 0|2@1+ (1,0) [0|3] "" Vector__XXX
 SG_ AFT1InDewPoint : 0|2@1+ (1,0) [0|3] "" Vector__XXX
 SG_ AFT1ExhGasMFR : 0|16@1+ (0.2,0) [0|12851] "kg/h" Vector__XXX
 SG_ EstEngPrsiticLossesPercentTorque : 0|8@1+ (1,-125) [0|125] "%" Vector__XXX
 SG_ EngnsDsrdOprtngSpdAsymmtryAdjstm : 0|8@1+ (1,0) [0|250] "" Vector__XXX
 SG_ EnginesDesiredOperatingSpeed : 0|16@1+ (0.125,0) [0|8031.875] "rpm" Vector__XXX
 SG_ NominalFrictionPercentTorque : 0|8@1+ (1,-125) [-125|125] "%" Vector__XXX
 SG_ EstPumpingPercentTorque : 0|8@1+ (1,-125) [-125|125] "%" Vector__XXX
 SG_ ActlMaxAvailableEngPercentTorque : 0|8@1+ (0.4,0) [0|100] "%" Vector__XXX
 SG_ SCRThermalManagementActive : 0|2@1+ (1,0) [0|3] "" Vector__XXX
 SG_ DPFThermalManagementActive : 0|2@1+ (1,0) [0|3] "" Vector__XXX
 SG_ MmntaryEngMaxPowerEnableFeedback : 0|2@1+ (1,0) [0|3] "" Vector__XXX
 SG_ VhcleAccelerationRateLimitStatus : 0|2@1+ (1,0) [0|3] "" Vector__XXX
 SG_ AccelPedalPos2 : 0|8@1+ (0.4,0) [0|100] "%" Vector__XXX
 SG_ RemoteAccelPedalPos : 0|8@1+ (0.4,0) [0|100] "%" Vector__XXX
 SG_ EngPercentLoadAtCurrentSpeed : 0|8@1+ (1,0) [0|125] "%" Vector__XXX
 SG_ AccelPedalPos1 : 0|8@1+ (0.4,0) [0|100] "%" Vector__XXX
 SG_ AccelPedal2LowIdleSwitch : 0|2@1+ (1,0) [0|3] "" Vector__XXX
 SG_ RoadSpeedLimitStatus : 0|2@1+ (1,0) [0|3] "" Vector__XXX
 SG_ AccelPedalKickdownSwitch : 0|2@1+ (1,0) [0|3] "" Vector__XXX
 SG_ AccelPedal1LowIdleSwitch : 0|2@1+ (1,0) [0|3] "" Vector__XXX
 SG_ EngDemandPercentTorque : 0|8@1+ (1,-125) [-125|125] "%" Vector__XXX
 SG_ EngStarterMode : 0|4@1+ (1,0) [0|15] "" Vector__XXX
 SG_ SrcAddrssOfCntrllngDvcForEngCtrl : 0|8@1+ (1,0) [0|253] "" Vector__XXX
 SG_ EngSpeed : 0|16@1+ (0.125,0) [0|8031.875] "rpm" Vector__XXX
 SG_ ActualEngPercentTorque : 0|8@1+ (1,-125) [0|125] "%" Vector__XXX
 SG_ DriversDemandEngPercentTorque : 0|8@1+ (1,-125) [0|125] "%" Vector__XXX
 SG_ ActlEngPrcntTorqueHighResolution : 0|4@1+ (0.125,0) [0|0.875] "%" Vector__XXX
 SG_ EngTorqueMode : 0|4@1+ (1,0) [0|15] "" Vector__XXX
 SG_ ECUHardwareID : 0|8@1+ (1,0) [0|255] "" Vector__XXX
 SG_ ECUManufacturerName : 0|8@1+ (1,0) [0|255] "" Vector__XXX
 SG_ ECUType : 0|8@1+ (1,0) [0|255] "" Vector__XXX
 SG_ ECULocation : 0|8@1+ (1,0) [0|255] "" Vector__XXX
 SG_ ECUSerialNumber : 0|8@1+ (1,0) [0|255] "" Vector__XXX
 SG_ ECUPartNumber : 0|8@1+ (1,0) [0|255] "" Vector__XXX
 SG_ EngMinContinuousTorque : 0|8@1+ (1,-125) [-125|125] "%" Vector__XXX
 SG_ EngMaxContinuousTorque : 0|8@1+ (1,-125) [-125|125] "%" Vector__XXX
 SG_ EngMinContinuousRPM : 0|8@1+ (32,0) [0|8000] "rpm" Vector__XXX
 SG_ EngMaxContinuousRPM : 0|8@1+ (32,0) [0|8000] "rpm" Vector__XXX
 SG_ EngHghLmtThrshldFrMnCntnsTrqFrmE : 0|8@1+ (1,-125) [-125|125] "%" Vector__XXX
 SG_ EngLwLmtThrshldFrMxTorqueFromEng : 0|8@1+ (1,-125) [-125|125] "%" Vector__XXX
 SG_ EngHghLmtThrshldFrMnCntnusEngRPM : 0|8@1+ (32,0) [0|8000] "rpm" Vector__XXX
 SG_ EngLwLmtThrsholdForMaxRPMFromEng : 0|8@1+ (32,0) [0|8000] "rpm" Vector__XXX
 SG_ SupportTSC1CtrlPurposeGroup4 : 0|8@1+ (1,0) [0|255] "" Vector__XXX
 SG_ SupportTSC1CtrlPurposeGroup3 : 0|8@1+ (1,0) [0|255] "" Vector__XXX
 SG_ SupportTSC1CtrlPurposeGroup2 : 0|8@1+ (1,0) [0|255] "" Vector__XXX
 SG_ SupportTSC1CtrlPurposeGroup1 : 0|8@1+ (1,0) [0|255] "" Vector__XXX
 SG_ SupportVariableRateTSC1Message : 0|8@1+ (1,0) [0|255] "" Vector__XXX
 SG_ EngDefaultTorqueLimit : 0|16@1+ (1,0) [0|64255] "Nm" Vector__XXX
 SG_ EngMomentOfInertia : 0|16@1+ (0.004,0) [0|257.02] "kg•m²" Vector__XXX
 SG_ EngExRngRqstdSpdCtrlRngUpprLimit : 0|16@1+ (0.125,0) [0|8031.875] "rpm" Vector__XXX
 SG_ EngRqstdTrqueCtrlRangeUpperLimit : 0|8@1+ (1,-125) [0|125] "%" Vector__XXX
 SG_ EngRqstdTrqueCtrlRangeLowerLimit : 0|8@1+ (1,-125) [0|125] "%" Vector__XXX
 SG_ EngRqstdSpeedCtrlRangeUpperLimit : 0|8@1+ (10,0) [0|2500] "rpm" Vector__XXX
 SG_ EngRqstdSpeedCtrlRangeLowerLimit : 0|8@1+ (10,0) [0|2500] "rpm" Vector__XXX
 SG_ EngMaxMomentaryOverrideTimeLimit : 0|8@1+ (0.1,0) [0|25] "s" Vector__XXX
 SG_ EngMxMmentaryOverrideSpeedPoint7 : 0|16@1+ (0.125,0) [0|8031.875] "rpm" Vector__XXX
 SG_ EngReferenceTorque : 0|16@1+ (1,0) [0|64255] "Nm" Vector__XXX
 SG_ EngGain : 0|16@1+ (0.00078125,0) [0|50.19] "%/rpm" Vector__XXX
 SG_ EngSpeedAtHighIdlePoint6 : 0|16@1+ (0.125,0) [0|8031.875] "rpm" Vector__XXX
 SG_ EngPercentTorqueAtPoint5 : 0|8@1+ (1,-125) [0|125] "%" Vector__XXX
 SG_ EngSpeedAtPoint5 : 0|16@1+ (0.125,0) [0|8031.875] "rpm" Vector__XXX
 SG_ EngPercentTorqueAtPoint4 : 0|8@1+ (1,-125) [0|125] "%" Vector__XXX
 SG_ EngSpeedAtPoint4 : 0|16@1+ (0.125,0) [0|8031.875] "rpm" Vector__XXX
 SG_ EngPercentTorqueAtPoint3 : 0|8@1+ (1,-125) [0|125] "%" Vector__XXX
 SG_ EngSpeedAtPoint3 : 0|16@1+ (0.125,0) [0|8031.875] "rpm" Vector__XXX
 SG_ EngPercentTorqueAtPoint2 : 0|8@1+ (1,-125) [0|125] "%" Vector__XXX
 SG_ EngSpeedAtPoint2 : 0|16@1+ (0.125,0) [0|8031.875] "rpm" Vector__XXX
 SG_ EngPercentTorqueAtIdlePoint1 : 0|8@1+ (1,-125) [0|125] "%" Vector__XXX
 SG_ EngSpeedAtIdlePoint1 : 0|16@1+ (0.125,0) [0|8031.875] "rpm" Vector__XXX
 SG_ EmergencyBrakingActive : 0|2@1+ (1,0) [0|3] "" Vector__XXX
 SG_ PrkngBrakeActuatorFullyActivated : 0|2@1+ (1,0) [0|3] "" Vector__XXX
 SG_ XBRAccelerationLimit : 0|8@1+ (0.1,-12.5) [-10|10] "m/s²" Vector__XXX
 SG_ XBRActiveCtrlMode : 0|4@1+ (1,0) [0|15] "" Vector__XXX
 SG_ XBRSystemState : 0|2@1+ (1,0) [0|3] "" Vector__XXX
 SG_ FoundationBrakeUse : 0|2@1+ (1,0) [0|3] "" Vector__XXX
 SG_ HillHolderMode : 0|3@1+ (1,0) [0|7] "" Vector__XXX
 SG_ HaltBrakeMode : 0|3@1+ (1,0) [0|7] "" Vector__XXX
 SG_ BrakeTempWarning : 0|2@1+ (1,0) [0|3] "" Vector__XXX
 SG_ BrkLnngRmningRearAxle3RightWheel : 0|8@1+ (0.4,0) [0|100] "%" Vector__XXX
 SG_ BrkLnngRminingRearAxle3LeftWheel : 0|8@1+ (0.4,0) [0|100] "%" Vector__XXX
 SG_ BrkLnngRmningRearAxle2RightWheel : 0|8@1+ (0.4,0) [0|100] "%" Vector__XXX
 SG_ BrkLnngRminingRearAxle2LeftWheel : 0|8@1+ (0.4,0) [0|100] "%" Vector__XXX
 SG_ BrkLnngRmningRearAxle1RightWheel : 0|8@1+ (0.4,0) [0|100] "%" Vector__XXX
 SG_ BrkLnngRminingRearAxle1LeftWheel : 0|8@1+ (0.4,0) [0|100] "%" Vector__XXX
 SG_ BrkLnngRmningFrontAxleRightWheel : 0|8@1+ (0.4,0) [0|100] "%" Vector__XXX
 SG_ BrkLnngRminingFrontAxleLeftWheel : 0|8@1+ (0.4,0) [0|100] "%" Vector__XXX
 SG_ BrkAppPrssHghRngRrAxl3RightWheel : 0|8@1+ (5,0) [0|1250] "kPa" Vector__XXX
 SG_ BrkAppPrssHghRngRrAxle3LeftWheel : 0|8@1+ (5,0) [0|1250] "kPa" Vector__XXX
 SG_ BrkAppPrssHghRngRrAxl2RightWheel : 0|8@1+ (5,0) [0|1250] "kPa" Vector__XXX
 SG_ BrkAppPrssHghRngRrAxle2LeftWheel : 0|8@1+ (5,0) [0|1250] "kPa" Vector__XXX
 SG_ BrkAppPrssHghRngRrAxle1LeftWheel : 0|8@1+ (5,0) [0|1250] "kPa" Vector__XXX
 SG_ BrkAppPrssHghRngFrntAxlRghtWheel : 0|8@1+ (5,0) [0|1250] "kPa" Vector__XXX
 SG_ BrkAppPrssHghRngFrntAxlLeftWheel : 0|8@1+ (5,0) [0|1250] "kPa" Vector__XXX
 SG_ BrkAppPrssHghRngRrAxl1RightWheel : 0|8@1+ (5,0) [0|1250] "kPa" Vector__XXX
 SG_ RelativeSpeedRearAxle2RightWheel : 0|8@1+ (0.0625,-7.8125) [-7.8125|7.8125] "km/h" Vector__XXX
 SG_ RelativeSpeedRearAxle2LeftWheel : 0|8@1+ (0.0625,-7.8125) [-7.8125|7.8125] "km/h" Vector__XXX
 SG_ RelativeSpeedRearAxle1RightWheel : 0|8@1+ (0.0625,-7.8125) [-7.8125|7.8125] "km/h" Vector__XXX
 SG_ RelativeSpeedRearAxle1LeftWheel : 0|8@1+ (0.0625,-7.8125) [-7.8125|7.8125] "km/h" Vector__XXX
 SG_ RelativeSpeedFrontAxleRightWheel : 0|8@1+ (0.0625,-7.8125) [-7.8125|7.8125] "km/h" Vector__XXX
 SG_ RelativeSpeedFrontAxleLeftWheel : 0|8@1+ (0.0625,-7.8125) [-7.8125|7.8125] "km/h" Vector__XXX
 SG_ FrontAxleSpeed : 0|16@1+ (0.00390625,0) [0|250.996] "km/h" Vector__XXX
 SG_ TrctrMntdTrailerABSWarningSignal : 0|2@1+ (1,0) [0|3] "" Vector__XXX
 SG_ TrailerABSStatus : 0|2@1+ (1,0) [0|3] "" Vector__XXX
 SG_ HaltBrakeSwitch : 0|2@1+ (1,0) [0|3] "" Vector__XXX
 SG_ SrcAddrssOfCntrllngDvcFrBrkeCtrl : 0|8@1+ (1,0) [0|253] "" Vector__XXX
 SG_ ATC_ASRInformationSignal : 0|2@1+ (1,0) [0|3] "" Vector__XXX
 SG_ ABS_EBSAmberWarningSignal : 0|2@1+ (1,0) [0|3] "" Vector__XXX
 SG_ EBSRedWarningSignal : 0|2@1+ (1,0) [0|3] "" Vector__XXX
 SG_ ABSFullyOperational : 0|2@1+ (1,0) [0|3] "" Vector__XXX
 SG_ EngRetarderSelection : 0|8@1+ (0.4,0) [0|100] "%" Vector__XXX
 SG_ RemoteAccelEnableSwitch : 0|2@1+ (1,0) [0|3] "" Vector__XXX
 SG_ EngAuxShutdownSwitch : 0|2@1+ (1,0) [0|3] "" Vector__XXX
 SG_ EngDerateSwitch : 0|2@1+ (1,0) [0|3] "" Vector__XXX
 SG_ AccelInterlockSwitch : 0|2@1+ (1,0) [0|3] "" Vector__XXX
 SG_ TractionCtrlOverrideSwitch : 0|2@1+ (1,0) [0|3] "" Vector__XXX
 SG_ ASRHillHolderSwitch : 0|2@1+ (1,0) [0|3] "" Vector__XXX
 SG_ ASROffroadSwitch : 0|2@1+ (1,0) [0|3] "" Vector__XXX
 SG_ ABSOffroadSwitch : 0|2@1+ (1,0) [0|3] "" Vector__XXX
 SG_ BrakePedalPos : 0|8@1+ (0.4,0) [0|100] "%" Vector__XXX
 SG_ EBSBrakeSwitch : 0|2@1+ (1,0) [0|3] "" Vector__XXX
 SG_ AntiLockBrakingActive : 0|2@1+ (1,0) [0|3] "" Vector__XXX
 SG_ ASRBrakeCtrlActive : 0|2@1+ (1,0) [0|3] "" Vector__XXX
 SG_ ASREngCtrlActive : 0|2@1+ (1,0) [0|3] "" Vector__XXX
 SG_ DiffLockStRearAxle3 : 0|2@1+ (1,0) [0|3] "" Vector__XXX
 SG_ RearAxleGroupEngagementStatus : 0|2@1+ (1,0) [0|3] "" Vector__XXX
 SG_ FrontAxleGroupEngagementStatus : 0|2@1+ (1,0) [0|3] "" Vector__XXX
 SG_ DiffLockStateCentralRear : 0|2@1+ (1,0) [0|3] "" Vector__XXX
 SG_ DiffLockStateCentralFront : 0|2@1+ (1,0) [0|3] "" Vector__XXX
 SG_ DiffLockStateCentral : 0|2@1+ (1,0) [0|3] "" Vector__XXX
 SG_ DiffLockStateRearAxle2 : 0|2@1+ (1,0) [0|3] "" Vector__XXX
 SG_ DiffLockStateRearAxle1 : 0|2@1+ (1,0) [0|3] "" Vector__XXX
 SG_ DiffLockStateFrontAxle2 : 0|2@1+ (1,0) [0|3] "" Vector__XXX
 SG_ DiffLockStateFrontAxle1 : 0|2@1+ (1,0) [0|3] "" Vector__XXX
 SG_ EngExRangeCoolantPress : 0|8@1+ (4,0) [0|1000] "kPa" Vector__XXX
 SG_ SeaWaterPumpOutletPress : 0|8@1+ (2,0) [0|500] "kPa" Vector__XXX
 SG_ EngAuxCoolantTemp : 0|8@1+ (1,-40) [-40|210] "°C" Vector__XXX
 SG_ EngAuxCoolantPress : 0|8@1+ (4,0) [0|1000] "kPa" Vector__XXX
 SG_ Driver2Identification : 0|8@1+ (1,0) [0|255] "" Vector__XXX
 SG_ Driver1Identification : 0|8@1+ (1,0) [0|255] "" Vector__XXX
 SG_ EngOilFilterDiffPress7471 : 0|8@1+ (5,0) [0|1250] "kPa" Vector__XXX
 SG_ FuelLevel2 : 0|8@1+ (0.4,0) [0|100] "%" Vector__XXX
 SG_ CargoAmbientTemp : 0|16@1+ (0.03125,-273) [-273|1734.96875] "°C" Vector__XXX
 SG_ EngOilFilterDiffPress : 0|8@1+ (0.5,0) [0|125] "kPa" Vector__XXX
 SG_ FuelLevel1 : 0|8@1+ (0.4,0) [0|100] "%" Vector__XXX
 SG_ WasherFluidLevel : 0|8@1+ (0.4,0) [0|100] "%" Vector__XXX
 SG_ EngCyl8AverageCombustionDuration : 0|16@1+ (0.0078125,0) [0|501.99] "deg" Vector__XXX
 SG_ EngCyl8AvrgCntrOfCmbustionTiming : 0|16@1+ (0.0078125,-250) [-250|250.992] "deg" Vector__XXX
 SG_ EngCyl8AvrgStrtOfCmbustionTiming : 0|16@1+ (0.0078125,-250) [-250|250.992] "deg" Vector__XXX
 SG_ EngCyl8IndctedMeanEffectivePress : 0|16@1+ (0.0001220703125,-1) [-1|6.84362793] "MPa" Vector__XXX
 SG_ EngCyl7AverageCombustionDuration : 0|16@1+ (0.0078125,0) [0|501.99] "deg" Vector__XXX
 SG_ EngCyl7AvrgCntrOfCmbustionTiming : 0|16@1+ (0.0078125,-250) [-250|250.992] "deg" Vector__XXX
 SG_ EngCyl7AvrgStrtOfCmbustionTiming : 0|16@1+ (0.0078125,-250) [-250|250.992] "deg" Vector__XXX
 SG_ EngCyl7IndctedMeanEffectivePress : 0|16@1+ (0.0001220703125,-1) [-1|6.84362793] "MPa" Vector__XXX
 SG_ EngCyl6AverageCombustionDuration : 0|16@1+ (0.0078125,0) [0|501.99] "deg" Vector__XXX
 SG_ EngCyl6AvrgCntrOfCmbustionTiming : 0|16@1+ (0.0078125,-250) [-250|250.992] "deg" Vector__XXX
 SG_ EngCyl6AvrgStrtOfCmbustionTiming : 0|16@1+ (0.0078125,-250) [-250|250.992] "deg" Vector__XXX
 SG_ EngCyl6IndctedMeanEffectivePress : 0|16@1+ (0.0001220703125,-1) [-1|6.84362793] "MPa" Vector__XXX
 SG_ EngCyl5AverageCombustionDuration : 0|16@1+ (0.0078125,0) [0|501.99] "deg" Vector__XXX
 SG_ EngCyl5AvrgCntrOfCmbustionTiming : 0|16@1+ (0.0078125,-250) [-250|250.992] "deg" Vector__XXX
 SG_ EngCyl5AvrgStrtOfCmbustionTiming : 0|16@1+ (0.0078125,-250) [-250|250.992] "deg" Vector__XXX
 SG_ EngCyl5IndctedMeanEffectivePress : 0|16@1+ (0.0001220703125,-1) [-1|6.84362793] "MPa" Vector__XXX
 SG_ EngCyl4AverageCombustionDuration : 0|16@1+ (0.0078125,0) [0|501.99] "deg" Vector__XXX
 SG_ EngCyl4AvrgCntrOfCmbustionTiming : 0|16@1+ (0.0078125,-250) [-250|250.992] "deg" Vector__XXX
 SG_ EngCyl4AvrgStrtOfCmbustionTiming : 0|16@1+ (0.0078125,-250) [-250|250.992] "deg" Vector__XXX
 SG_ EngCyl4IndctedMeanEffectivePress : 0|16@1+ (0.0001220703125,-1) [-1|6.84362793] "MPa" Vector__XXX
 SG_ EngCyl3AverageCombustionDuration : 0|16@1+ (0.0078125,0) [0|501.99] "deg" Vector__XXX
 SG_ EngCyl3AvrgCntrOfCmbustionTiming : 0|16@1+ (0.0078125,-250) [-250|250.992] "deg" Vector__XXX
 SG_ EngCyl3AvrgStrtOfCmbustionTiming : 0|16@1+ (0.0078125,-250) [-250|250.992] "deg" Vector__XXX
 SG_ EngCyl3IndctedMeanEffectivePress : 0|16@1+ (0.0001220703125,-1) [-1|6.84362793] "MPa" Vector__XXX
 SG_ EngCldStrtFlIgniterRelayFeedback : 0|2@1+ (1,0) [0|3] "" Vector__XXX
 SG_ EngColdStartFuelIgniterRelay : 0|2@1+ (1,0) [0|3] "" Vector__XXX
 SG_ EngColdStartFuelIgniterCmd : 0|8@1+ (0.4,0) [0|100] "%" Vector__XXX
 SG_ EngStartEnableDevice2Config : 0|4@1+ (1,0) [0|15] "" Vector__XXX
 SG_ EngStartEnableDevice1Config : 0|4@1+ (1,0) [0|15] "" Vector__XXX
 SG_ EngStartEnableDevice2 : 0|2@1+ (1,0) [0|3] "" Vector__XXX
 SG_ EngStartEnableDevice1 : 0|2@1+ (1,0) [0|3] "" Vector__XXX
 SG_ PoweredVehicleWeight : 0|16@1+ (10,0) [0|642550] "kg" Vector__XXX
 SG_ GrossCombinationVehicleWeight : 0|16@1+ (10,0) [0|642550] "kg" Vector__XXX
 SG_ MxCntinuousRetarderTorqueLimitRq : 0|8@1+ (1,-125) [-125|0] "%" Vector__XXX
 SG_ MnCntinuousRetarderTorqueLimitRq : 0|8@1+ (1,-125) [-125|0] "%" Vector__XXX
 SG_ MxContinuousRetarderSpeedLimitRq : 0|8@1+ (32,0) [0|8000] "rpm" Vector__XXX
 SG_ MnContinuousRetarderSpeedLimitRq : 0|8@1+ (32,0) [0|8000] "rpm" Vector__XXX
 SG_ EngTorqueLimitRqMaxContinuous : 0|8@1+ (1,-125) [0|125] "%" Vector__XXX
 SG_ EngTorqueLimitRqMinContinuous : 0|8@1+ (1,-125) [0|125] "%" Vector__XXX
 SG_ EngSpeedLimitRqMaxContinuous : 0|8@1+ (32,0) [0|8000] "rpm" Vector__XXX
 SG_ EngSpeedLimitRqMinContinuous : 0|8@1+ (32,0) [0|8000] "rpm" Vector__XXX
 SG_ EngAverageCombustionTime : 0|16@1+ (0.01,0) [0|642.55] "ms" Vector__XXX
 SG_ EngDesiredCombustionTime : 0|16@1+ (0.01,0) [0|642.55] "ms" Vector__XXX
 SG_ EngCyl20CombustionTime : 0|16@1+ (0.01,0) [0|642.55] "ms" Vector__XXX
 SG_ EngCyl19CombustionTime : 0|16@1+ (0.01,0) [0|642.55] "ms" Vector__XXX
 SG_ EngCyl18CombustionTime : 0|16@1+ (0.01,0) [0|642.55] "ms" Vector__XXX
 SG_ EngCyl17CombustionTime : 0|16@1+ (0.01,0) [0|642.55] "ms" Vector__XXX
 SG_ EngCyl16CombustionTime : 0|16@1+ (0.01,0) [0|642.55] "ms" Vector__XXX
 SG_ EngCyl15CombustionTime : 0|16@1+ (0.01,0) [0|642.55] "ms" Vector__XXX
 SG_ EngCyl14CombustionTime : 0|16@1+ (0.01,0) [0|642.55] "ms" Vector__XXX
 SG_ EngCyl13CombustionTime : 0|16@1+ (0.01,0) [0|642.55] "ms" Vector__XXX
 SG_ EngCyl12CombustionTime : 0|16@1+ (0.01,0) [0|642.55] "ms" Vector__XXX
 SG_ EngCyl11CombustionTime : 0|16@1+ (0.01,0) [0|642.55] "ms" Vector__XXX
 SG_ EngCyl10CombustionTime : 0|16@1+ (0.01,0) [0|642.55] "ms" Vector__XXX
 SG_ EngCyl9CombustionTime : 0|16@1+ (0.01,0) [0|642.55] "ms" Vector__XXX
 SG_ EngCyl8CombustionTime : 0|16@1+ (0.01,0) [0|642.55] "ms" Vector__XXX
 SG_ EngCyl7CombustionTime : 0|16@1+ (0.01,0) [0|642.55] "ms" Vector__XXX
 SG_ EngCyl6CombustionTime : 0|16@1+ (0.01,0) [0|642.55] "ms" Vector__XXX
 SG_ EngCyl5CombustionTime : 0|16@1+ (0.01,0) [0|642.55] "ms" Vector__XXX
 SG_ EngCyl4CombustionTime : 0|16@1+ (0.01,0) [0|642.55] "ms" Vector__XXX
 SG_ EngCyl3CombustionTime : 0|16@1+ (0.01,0) [0|642.55] "ms" Vector__XXX
 SG_ EngCyl2CombustionTime : 0|16@1+ (0.01,0) [0|642.55] "ms" Vector__XXX
 SG_ EngCyl1CombustionTime : 0|16@1+ (0.01,0) [0|642.55] "ms" Vector__XXX
 SG_ TotalCountOfConfigChangesMade : 0|16@1+ (1,0) [0|64255] "" Vector__XXX
 SG_ EngAirShutoffManualSw : 0|2@1+ (1,0) [0|3] "" Vector__XXX
 SG_ EngAirShutoffTestSw : 0|2@1+ (1,0) [0|3] "" Vector__XXX
 SG_ HornSw : 0|2@1+ (1,0) [0|3] "" Vector__XXX
 SG_ OpKeySwDelayedBatOff : 0|2@1+ (1,0) [0|3] "" Vector__XXX
 SG_ OpKeySwStart : 0|2@1+ (1,0) [0|3] "" Vector__XXX
 SG_ OpKeySwIgntPwr : 0|2@1+ (1,0) [0|3] "" Vector__XXX
 SG_ OpKeySwAccessoryPwr : 0|2@1+ (1,0) [0|3] "" Vector__XXX
 SG_ MomentaryOpKeySw : 0|2@1+ (1,0) [0|3] "" Vector__XXX
 SG_ AFTSCRDosingModeCmd : 0|3@1+ (1,0) [0|7] "" Vector__XXX
 SG_ OpKeyDetected : 0|2@1+ (1,0) [0|3] "" Vector__XXX
 SG_ VehTrailerStatus : 0|2@1+ (1,0) [0|3] "" Vector__XXX
 SG_ TransOilLevelRq : 0|2@1+ (1,0) [0|3] "" Vector__XXX
 SG_ FifthWheelReleaseCtrl : 0|2@1+ (1,0) [0|3] "" Vector__XXX
 SG_ FfthWhlRleaseCtrlSecurityLockout : 0|2@1+ (1,0) [0|3] "" Vector__XXX
 SG_ TransferCaseSelectorSwitch : 0|3@1+ (1,0) [0|7] "" Vector__XXX
 SG_ SelectedMaxVehicleSpeedLimit : 0|8@1+ (1,0) [0|250] "" Vector__XXX
 SG_ RqCabZoneHeating : 0|2@1+ (1,0) [0|3] "" Vector__XXX
 SG_ RqEngZoneHeating : 0|2@1+ (1,0) [0|3] "" Vector__XXX
 SG_ AuxHeaterModeRq : 0|4@1+ (1,0) [0|15] "" Vector__XXX
 SG_ EngAutomaticStartEnableSwitch : 0|2@1+ (1,0) [0|3] "" Vector__XXX
 SG_ AtomaticGearShiftingEnableSwitch : 0|2@1+ (1,0) [0|3] "" Vector__XXX
 SG_ AFTRegenForceSw : 0|2@1+ (1,0) [0|3] "" Vector__XXX
 SG_ AFTRegenInhSw : 0|2@1+ (1,0) [0|3] "" Vector__XXX
 SG_ VhclLmtngSpdGovernorEnableSwitch : 0|2@1+ (1,0) [0|3] "" Vector__XXX
 SG_ VhclLmtngSpdGvrnrIncrementSwitch : 0|2@1+ (1,0) [0|3] "" Vector__XXX
 SG_ VhclLmtngSpdGvrnrDecrementSwitch : 0|2@1+ (1,0) [0|3] "" Vector__XXX
 SG_ ParkBrakeCmd : 0|2@1+ (1,0) [0|3] "" Vector__XXX
 SG_ SeatBeltSwitch : 0|2@1+ (1,0) [0|3] "" Vector__XXX
 SG_ OperatorSeatDirectionSwitch : 0|2@1+ (1,0) [0|3] "" Vector__XXX
 SG_ BatteryMainSwitchHoldRq : 0|2@1+ (1,0) [0|3] "" Vector__XXX
 SG_ AuxHeaterCoolantPumpRq : 0|2@1+ (1,0) [0|3] "" Vector__XXX
 SG_ CabInteriorTempCmd : 0|16@1+ (0.03125,-273) [-273|1734.96875] "°C" Vector__XXX
 SG_ RequestedPercentFanSpeed : 0|8@1+ (0.4,0) [0|100] "%" Vector__XXX
 SG_ SwtchBcklghtIllmntnBrghtnssPrcnt : 0|8@1+ (0.4,0) [0|100] "%" Vector__XXX
 SG_ IlluminationBrightnessPercent : 0|8@1+ (0.4,0) [0|100] "%" Vector__XXX
 SG_ SwtchIndctnIllmntnBrghtnssPrcent : 0|8@1+ (0.4,0) [0|100] "%" Vector__XXX
 SG_ UnitNumber : 0|8@1+ (1,0) [0|255] "" Vector__XXX
 SG_ SerialNumber : 0|8@1+ (1,0) [0|255] "" Vector__XXX
 SG_ Model : 0|8@1+ (1,0) [0|255] "" Vector__XXX
 SG_ Make : 0|8@1+ (1,0) [0|255] "" Vector__XXX
 SG_ EngShutdownOverrideSwitch : 0|2@1+ (1,0) [0|3] "" Vector__XXX
 SG_ EngTestModeSwitch : 0|2@1+ (1,0) [0|3] "" Vector__XXX
 SG_ EngIdleDecrementSwitch : 0|2@1+ (1,0) [0|3] "" Vector__XXX
 SG_ EngIdleIncrementSwitch : 0|2@1+ (1,0) [0|3] "" Vector__XXX
 SG_ CruiseCtrlStates : 0|3@1+ (1,0) [0|7] "" Vector__XXX
 SG_ PTOGovernorState : 0|5@1+ (1,0) [0|31] "" Vector__XXX
 SG_ CruiseCtrlSetSpeed : 0|8@1+ (1,0) [0|250] "km/h" Vector__XXX
 SG_ CruiseCtrlAccelerateSwitch : 0|2@1+ (1,0) [0|3] "" Vector__XXX
 SG_ CruiseCtrlResumeSwitch : 0|2@1+ (1,0) [0|3] "" Vector__XXX
 SG_ CruiseCtrlCoastSwitch : 0|2@1+ (1,0) [0|3] "" Vector__XXX
 SG_ CruiseCtrlSetSwitch : 0|2@1+ (1,0) [0|3] "" Vector__XXX
 SG_ ClutchSwitch : 0|2@1+ (1,0) [0|3] "" Vector__XXX
 SG_ BrakeSwitch : 0|2@1+ (1,0) [0|3] "" Vector__XXX
 SG_ CruiseCtrlEnableSwitch : 0|2@1+ (1,0) [0|3] "" Vector__XXX
 SG_ CruiseCtrlActive : 0|2@1+ (1,0) [0|3] "" Vector__XXX
 SG_ WheelBasedVehicleSpeed : 0|16@1+ (0.00390625,0) [0|250.996] "km/h" Vector__XXX
 SG_ ParkBrakeReleaseInhibitRq : 0|2@1+ (1,0) [0|3] "" Vector__XXX
 SG_ CruiseCtrlPauseSwitch : 0|2@1+ (1,0) [0|3] "" Vector__XXX
 SG_ ParkingBrakeSwitch : 0|2@1+ (1,0) [0|3] "" Vector__XXX
 SG_ TwoSpeedAxleSwitch : 0|2@1+ (1,0) [0|3] "" Vector__XXX
 SG_ MaxVehicleSpeedLimit6808 : 0|16@1+ (0.00390625,0) [0|250.996] "km/h" Vector__XXX
 SG_ CruiseCtrlLowSetLimitSpeed : 0|8@1+ (1,0) [0|250] "km/h" Vector__XXX
 SG_ CruiseCtrlHighSetLimitSpeed : 0|8@1+ (1,0) [0|250] "km/h" Vector__XXX
 SG_ AuxHeaterMaxOutputPower : 0|16@1+ (2,0) [0|128510] "W" Vector__XXX
 SG_ TripServiceBrakeApplications : 0|32@1+ (1,0) [0|4211081215] "appl" Vector__XXX
 SG_ TripServiceBrakeDistance : 0|32@1+ (0.125,0) [0|526385151.875] "km" Vector__XXX
 SG_ TripCompressionBrakeDistance : 0|32@1+ (0.125,0) [0|526385151.875] "km" Vector__XXX
 SG_ TotalCompressionBrakeDistance : 0|32@1+ (0.125,0) [0|526385151.875] "km" Vector__XXX
 SG_ CbA_CRfrgrntCmpressorOutletPress : 0|8@1+ (16,0) [0|4000] "kPa" Vector__XXX
 SG_ SLIBattery4Temp : 0|8@1+ (1,-40) [-40|210] "°C" Vector__XXX
 SG_ SLIBattery3Temp : 0|8@1+ (1,-40) [-40|210] "°C" Vector__XXX
 SG_ Battery2Temp : 0|8@1+ (1,-40) [-40|210] "°C" Vector__XXX
 SG_ Battery1Temp : 0|8@1+ (1,-40) [-40|210] "°C" Vector__XXX
 SG_ VhclAccelerationRateLimitLampCmd : 0|2@1+ (1,0) [0|3] "" Vector__XXX
 SG_ EngSpeedVeryHighLampCmd : 0|2@1+ (1,0) [0|3] "" Vector__XXX
 SG_ EngSpeedHighLampCmd : 0|2@1+ (1,0) [0|3] "" Vector__XXX
 SG_ EngCtrlModule3ReadyForUseLampCmd : 0|2@1+ (1,0) [0|3] "" Vector__XXX
 SG_ EngCtrlModule2ReadyForUseLampCmd : 0|2@1+ (1,0) [0|3] "" Vector__XXX
 SG_ EngCtrlModule1ReadyForUseLampCmd : 0|2@1+ (1,0) [0|3] "" Vector__XXX
 SG_ EngFuelFilterRestrictedLampCmd : 0|2@1+ (1,0) [0|3] "" Vector__XXX
 SG_ EngAirFilterRestrictionLampCmd : 0|2@1+ (1,0) [0|3] "" Vector__XXX
 SG_ EngIdleManagementActiveLampCmd : 0|2@1+ (1,0) [0|3] "" Vector__XXX
 SG_ EngCoolantLevelLowLampCmd : 0|2@1+ (1,0) [0|3] "" Vector__XXX
 SG_ EngCoolantTempHighLampCmd : 0|2@1+ (1,0) [0|3] "" Vector__XXX
 SG_ EngOilPressLowLampCmd : 0|2@1+ (1,0) [0|3] "" Vector__XXX
 SG_ CmprssnBrkEnblSwtchIndctrLampCmd : 0|2@1+ (1,0) [0|3] "" Vector__XXX
 SG_ EngBrakeActiveLampCmd : 0|2@1+ (1,0) [0|3] "" Vector__XXX
 SG_ OBDMalfunctionIndicatorLampCmd : 0|2@1+ (1,0) [0|3] "" Vector__XXX
 SG_ EngRedStopLampCmd : 0|2@1+ (1,0) [0|3] "" Vector__XXX
 SG_ EngAmberWarningLampCmd : 0|2@1+ (1,0) [0|3] "" Vector__XXX
 SG_ EngProtectLampCmd : 0|2@1+ (1,0) [0|3] "" Vector__XXX
 SG_ RolloverSensorType : 0|4@1+ (1,0) [0|15] "" Vector__XXX
 SG_ RearCollisionSensor4Type : 0|4@1+ (1,0) [0|15] "" Vector__XXX
 SG_ RearCollisionSensor3Type : 0|4@1+ (1,0) [0|15] "" Vector__XXX
 SG_ RearCollisionSensor2Type : 0|4@1+ (1,0) [0|15] "" Vector__XXX
 SG_ RearCollisionSensor1Type : 0|4@1+ (1,0) [0|15] "" Vector__XXX
 SG_ SideCollisionSensorRearRightType : 0|4@1+ (1,0) [0|15] "" Vector__XXX
 SG_ SdCllisionSensorMidRearRightType : 0|4@1+ (1,0) [0|15] "" Vector__XXX
 SG_ SdCllsionSensorMidFrontRightType : 0|4@1+ (1,0) [0|15] "" Vector__XXX
 SG_ SdeCollisionSensorFrontRightType : 0|4@1+ (1,0) [0|15] "" Vector__XXX
 SG_ SideCollisionSensorRearLeftType : 0|4@1+ (1,0) [0|15] "" Vector__XXX
 SG_ SdCollisionSensorMidRearLeftType : 0|4@1+ (1,0) [0|15] "" Vector__XXX
 SG_ SdCllisionSensorMidFrontLeftType : 0|4@1+ (1,0) [0|15] "" Vector__XXX
 SG_ SideCollisionSensorFrontLeftType : 0|4@1+ (1,0) [0|15] "" Vector__XXX
 SG_ FrontalCollisionSensor4Type : 0|4@1+ (1,0) [0|15] "" Vector__XXX
 SG_ FrontalCollisionSensor3Type : 0|4@1+ (1,0) [0|15] "" Vector__XXX
 SG_ FrontalCollisionSensor2Type : 0|4@1+ (1,0) [0|15] "" Vector__XXX
 SG_ FrontalCollisionSensor1Type : 0|4@1+ (1,0) [0|15] "" Vector__XXX
 SG_ CrashChecksum : 0|4@1+ (1,0) [0|15] "" Vector__XXX
 SG_ CrashCounter : 0|4@1+ (1,0) [0|15] "" Vector__XXX
 SG_ CrashType : 0|5@1+ (1,0) [0|31] "" Vector__XXX
 SG_ EngChrgArClr2PrecoolerEfficiency : 0|8@1+ (0.4,0) [0|100] "%" Vector__XXX
 SG_ EngChrgArClr2PrecoolerOutletTemp : 0|16@1+ (0.03125,-273) [-273|1734.96875] "°C" Vector__XXX
 SG_ EngChrgArClr2PrecoolerIntakeTemp : 0|16@1+ (0.03125,-273) [-273|1734.96875] "°C" Vector__XXX
 SG_ EngChargeAirCooler2Efficiency : 0|8@1+ (0.4,0) [0|100] "%" Vector__XXX
 SG_ EngChrgeAirCooler2AmbientAirTemp : 0|16@1+ (0.03125,-273) [-273|1734.96875] "°C" Vector__XXX
 SG_ EngChargeAirCooler2OutletTemp : 0|16@1+ (0.03125,-273) [-273|1734.96875] "°C" Vector__XXX
 SG_ EngChargeAirCooler2IntakeTemp : 0|16@1+ (0.03125,-273) [-273|1734.96875] "°C" Vector__XXX
 SG_ EngChrgArClr1PrecoolerEfficiency : 0|8@1+ (0.4,0) [0|100] "%" Vector__XXX
 SG_ EngChrgArClr1PrecoolerOutletTemp : 0|16@1+ (0.03125,-273) [-273|1734.96875] "°C" Vector__XXX
 SG_ EngChrgArClr1PrecoolerIntakeTemp : 0|16@1+ (0.03125,-273) [-273|1734.96875] "°C" Vector__XXX
 SG_ EngChargeAirCooler1Efficiency : 0|8@1+ (0.4,0) [0|100] "%" Vector__XXX
 SG_ EngChrgeAirCooler1AmbientAirTemp : 0|16@1+ (0.03125,-273) [-273|1734.96875] "°C" Vector__XXX
 SG_ EngChargeAirCooler1IntakeTemp : 0|16@1+ (0.03125,-273) [-273|1734.96875] "°C" Vector__XXX
 SG_ Joystick9Button9PressedStatus : 0|2@1+ (1,0) [0|3] "" Vector__XXX
 SG_ Joystick9Button10PressedStatus : 0|2@1+ (1,0) [0|3] "" Vector__XXX
 SG_ Joystick9Button11PressedStatus : 0|2@1+ (1,0) [0|3] "" Vector__XXX
 SG_ Joystick9Button12PressedStatus : 0|2@1+ (1,0) [0|3] "" Vector__XXX
 SG_ Joystick9Button5PressedStatus : 0|2@1+ (1,0) [0|3] "" Vector__XXX
 SG_ Joystick9Button6PressedStatus : 0|2@1+ (1,0) [0|3] "" Vector__XXX
 SG_ Joystick9Button7PressedStatus : 0|2@1+ (1,0) [0|3] "" Vector__XXX
 SG_ Joystick9Button8PressedStatus : 0|2@1+ (1,0) [0|3] "" Vector__XXX
 SG_ Joystick9Button1PressedStatus : 0|2@1+ (1,0) [0|3] "" Vector__XXX
 SG_ Joystick9Button2PressedStatus : 0|2@1+ (1,0) [0|3] "" Vector__XXX
 SG_ Joystick9Button3PressedStatus : 0|2@1+ (1,0) [0|3] "" Vector__XXX
 SG_ Joystick9Button4PressedStatus : 0|2@1+ (1,0) [0|3] "" Vector__XXX
 SG_ Joystick9XAxisDetentPosStatus : 0|2@1+ (1,0) [0|3] "" Vector__XXX
 SG_ Joystick9YAxisDetentPosStatus : 0|2@1+ (1,0) [0|3] "" Vector__XXX
 SG_ Joystick9YAxisPos : 0|10@1+ (0.1,0) [0|102] "%" Vector__XXX
 SG_ Jystck9YAxsLvrFrwrdPstvPosStatus : 0|2@1+ (1,0) [0|3] "" Vector__XXX
 SG_ Jystck9YAxsLvrBckNgtivePosStatus : 0|2@1+ (1,0) [0|3] "" Vector__XXX
 SG_ Joystick9YAxisNeutralPosStatus : 0|2@1+ (1,0) [0|3] "" Vector__XXX
 SG_ Joystick9XAxisPos : 0|10@1+ (0.1,0) [0|102] "%" Vector__XXX
 SG_ Jystck9XAxsLvrRghtPstvePosStatus : 0|2@1+ (1,0) [0|3] "" Vector__XXX
 SG_ Jystck9XAxsLvrLftNgtivePosStatus : 0|2@1+ (1,0) [0|3] "" Vector__XXX
 SG_ Joystick9XAxisNeutralPosStatus : 0|2@1+ (1,0) [0|3] "" Vector__XXX
 SG_ Joystick8Button9PressedStatus : 0|2@1+ (1,0) [0|3] "" Vector__XXX
 SG_ Joystick8Button10PressedStatus : 0|2@1+ (1,0) [0|3] "" Vector__XXX
 SG_ Joystick8Button11PressedStatus : 0|2@1+ (1,0) [0|3] "" Vector__XXX
 SG_ Joystick8Button12PressedStatus : 0|2@1+ (1,0) [0|3] "" Vector__XXX
 SG_ Joystick8Button5PressedStatus : 0|2@1+ (1,0) [0|3] "" Vector__XXX
 SG_ Joystick8Button6PressedStatus : 0|2@1+ (1,0) [0|3] "" Vector__XXX
 SG_ Joystick8Button7PressedStatus : 0|2@1+ (1,0) [0|3] "" Vector__XXX
 SG_ Joystick8Button8PressedStatus : 0|2@1+ (1,0) [0|3] "" Vector__XXX
 SG_ Joystick8Button1PressedStatus : 0|2@1+ (1,0) [0|3] "" Vector__XXX
 SG_ Joystick8Button2PressedStatus : 0|2@1+ (1,0) [0|3] "" Vector__XXX
 SG_ Joystick8Button3PressedStatus : 0|2@1+ (1,0) [0|3] "" Vector__XXX
 SG_ Joystick8Button4PressedStatus : 0|2@1+ (1,0) [0|3] "" Vector__XXX
 SG_ Joystick8XAxisDetentPosStatus : 0|2@1+ (1,0) [0|3] "" Vector__XXX
 SG_ Joystick8YAxisDetentPosStatus : 0|2@1+ (1,0) [0|3] "" Vector__XXX
 SG_ Joystick8YAxisPos : 0|10@1+ (0.1,0) [0|102] "%" Vector__XXX
 SG_ Jystck8YAxsLvrFrwrdPstvPosStatus : 0|2@1+ (1,0) [0|3] "" Vector__XXX
 SG_ Jystck8YAxsLvrBckNgtivePosStatus : 0|2@1+ (1,0) [0|3] "" Vector__XXX
 SG_ Joystick8YAxisNeutralPosStatus : 0|2@1+ (1,0) [0|3] "" Vector__XXX
 SG_ Joystick8XAxisPos : 0|10@1+ (0.1,0) [0|102] "%" Vector__XXX
 SG_ Jystck8XAxsLvrRghtPstvePosStatus : 0|2@1+ (1,0) [0|3] "" Vector__XXX
 SG_ Jystck8XAxsLvrLftNgtivePosStatus : 0|2@1+ (1,0) [0|3] "" Vector__XXX
 SG_ Joystick8XAxisNeutralPosStatus : 0|2@1+ (1,0) [0|3] "" Vector__XXX
 SG_ Joystick7Button9PressedStatus : 0|2@1+ (1,0) [0|3] "" Vector__XXX
 SG_ Joystick7Button10PressedStatus : 0|2@1+ (1,0) [0|3] "" Vector__XXX
 SG_ Joystick7Button11PressedStatus : 0|2@1+ (1,0) [0|3] "" Vector__XXX

CM_ SG_ 3221225472 CrnkAttmptCntOnPrsntStartAttempt "Reports the number of cranking cycles undergone during the present start attempt.
Note:  This is intended to be used in conjunction with Maximum Crank Attempts per Start Attempt, in order to give a FMI 0 diagnostic on this parameter when the count ...";
CM_ SG_ 3221225472 EngIntakeManifoldPressCtrlMode "Indicates that the Boost Pressure Closed Loop Control status either open loop or closed loop.

00  Open loop 
01  Closed loop 
10  SAE reserved
11  Not available";
CM_ SG_ 3221225472 EngRotationDirection "Direction of engine rotation, as reported by the engine.  Direction convention as viewed by an observer standing at the rear of the engine, viewing the flywheel.
00 - CounterClockWise (CCW)
01 - ClockWise (CW)
10 - Unknown  (Rotation Direction ...";
CM_ SG_ 3221225472 EngRatedSpeed "The maximum governed rotational velocity of the engine crankshaft under full load conditions.  Note that the engine speed at point 2 (SPN 528) is equal to rated engine speed only in the case when the engine has not been derated.  Please also ...";
CM_ SG_ 3221225472 EngRatedPower "Net brake power that the engine will deliver continuously, specified for a given application at a rated speed.";
CM_ SG_ 3221225472 AFT2ExhDewPoint "Indicates that the temperature on the exhaust side of the aftertreatment has exceeded the dew point, as estimated by the ECU in exhaust bank 2.

00 - Not exceeded the dew point
01 - Exceeded the dew point
10 - Error
11 - Not available";
CM_ SG_ 3221225472 AFT2InDewPoint "Indicates that the temperature on the intake side of the aftertreatment system has exceeded the dew point, as estimated by the ECU in exhaust bank 2.

00 - Not exceeded the dew point
01 - Exceeded the dew point
10 - Error
11 - Not available";
CM_ SG_ 3221225472 AFT1ExhDewPoint "Indicates that the temperature on the exhaust side of the aftertreatment has exceeded the dew point, as estimated by the ECU in exhaust bank 1.

00 - Not exceeded the dew point
01 - Exceeded the dew point
10 - Error
11 - Not available";
CM_ SG_ 3221225472 AFT1InDewPoint "Indicates that the temperature on the intake side of the aftertreatment system has exceeded the dew point, as estimated by the ECU in exhaust bank 1.

00 - Not exceeded the dew point
01 - Exceeded the dew point
10 - Error
11 - Not available";
CM_ SG_ 3221225472 AFT1ExhGasMFR "Measured/calculated exhaust gas mass upstream of the aftertreatment system in exhaust bank 1 and 2.";
CM_ SG_ 3221225472 EstEngPrsiticLossesPercentTorque "The calculated torque that indicates the estimated amount of torque loss due to engine parasitics, such as cooling fan, air compressor, air conditioning, etc. It is expressed as a percent of Engine Reference Torque.
If there are multiple devices on ...";
CM_ SG_ 3221225472 EngnsDsrdOprtngSpdAsymmtryAdjstm "This byte is utilized in transmission gear selection routines and indicates the engine's preference of lower versus higher engine speeds should its desired speed not be achievable.  This is a scaled ratio such that 125 represents an equal preference ...";
CM_ SG_ 3221225472 EnginesDesiredOperatingSpeed "An indication by the engine of the optimal operating speed of the engine for the current existing conditions.  These conditions may include the torque generated to accommodate powertrain demands from the operator (via the accelerator pedal), cruise ...";
CM_ SG_ 3221225472 NominalFrictionPercentTorque "The calculated torque that indicates the amount of torque required by the basic engine itself added by the loss torque of accessories. It contains the frictional and thermodynamic loss of the engine itself, pumping torque loss (SPN 5398), and the ...";
CM_ SG_ 3221225472 EstPumpingPercentTorque "The calculated torque that indicates the estimated amount of torque loss due to the engine air handling system. The value transmitted in this parameter is included in SPN 514 (Nominal Friction - Percent Torque).  The data is transmitted as a percent ...";
CM_ SG_ 3221225472 ActlMaxAvailableEngPercentTorque "This is the maximum amount of torque that the engine can immediately deliver as a percentage of the reference engine torque (SPN 544).  The Actual Maximum Available Engine - Percent Torque shall take into consideration all engine torque derates ...";
CM_ SG_ 3221225472 SCRThermalManagementActive "Indicates that the exhaust temperatures have been elevated for regeneration of the SCR aftertreatment system or in preparation of regeneration of the SCR aftertreatment system.
00 - SCR Thermal Management is not active
01 - SCR Thermal Management ...";
CM_ SG_ 3221225472 DPFThermalManagementActive "Indicates that the exhaust temperatures have been elevated for regeneration of the diesel particulate filter aftertreatment system or in preparation of regeneration of the diesel particulate aftertreatment system.
00 - DPF Thermal Management is not ...";
CM_ SG_ 3221225472 MmntaryEngMaxPowerEnableFeedback "Momentarily requesting Engine Maximum Power Enable - feature support feedback

00 disabled
01 supported 
10 reserved
11 don't care";
CM_ SG_ 3221225472 VhcleAccelerationRateLimitStatus "Status (active or not active) of the system used to limit maximum forward vehicle acceleration.
00     Limit not active
01     Limit active
10     Reserved
11     Not available
NOTE:  The effects of emission control limits, such as engine ...";
CM_ SG_ 3221225472 AccelPedalPos2 "The ratio of actual position of the second analog engine speed/torque request input device (such as an accelerator pedal or throttle lever) to the maximum position of the input device.  This parameter is intended for secondary accelerator control in ...";
CM_ SG_ 3221225472 RemoteAccelPedalPos "The ratio of actual position of the remote analog engine speed/torque request input device (such as an accelerator pedal or throttle lever) to the maximum position of the input device.
For example, in on-highway vehicles this could be an ...";
CM_ SG_ 3221225472 EngPercentLoadAtCurrentSpeed "The ratio of actual engine percent torque (indicated) to maximum indicated torque available at the current engine speed, clipped to zero torque during engine braking.";
CM_ SG_ 3221225472 AccelPedalPos1 "The ratio of actual position of the analog engine speed/torque request input device (such as an accelerator pedal or throttle lever) to the maximum position of the input device.  This parameter is intended for the primary accelerator control in an ...";
CM_ SG_ 3221225472 AccelPedal2LowIdleSwitch "Switch signal which indicates the state of the accelerator pedal 2 low idle switch.  The low idle switch is defined in SAE J1843.
00    Accelerator pedal 2 not in low idle condition
01    Accelerator pedal 2 in low idle condition
10    Error
11 ...";
CM_ SG_ 3221225472 RoadSpeedLimitStatus "Status (active or not active) of the system used to limit maximum vehicle velocity.
00 - Active
01 - Not Active
10 - Error
11 - Not available
NOTE - While somewhat inconsistent with other J1939 status parameters, the states defining 00 = active ...";
CM_ SG_ 3221225472 AccelPedalKickdownSwitch "Switch signal which indicates whether the accelerator pedal kickdown switch is opened or closed.  The kickdown switch is defined in SAE J1843.

00 - Kickdown passive
01 - Kickdown active
10 - Error
11 - Not available";
CM_ SG_ 3221225472 AccelPedal1LowIdleSwitch "Switch signal which indicates the state of the accelerator pedal 1 low idle switch.  The low idle switch is defined in SAE Recommended Practice J1843.
00 - Accelerator pedal 1 not in low idle condition
01 - Accelerator pedal 1 in low idle ...";
CM_ SG_ 3221225472 EngDemandPercentTorque "The requested torque output of the engine by all dynamic internal inputs, including smoke control, noise control and low and high speed governing.";
CM_ SG_ 3221225472 EngStarterMode "There are several phases in a starting action and different reasons why a start cannot take place.
0000 start not requested
0001 starter active, gear not engaged
0010 starter active, gear engaged
0011 start finished; starter not active after ...";
CM_ SG_ 3221225472 SrcAddrssOfCntrllngDvcForEngCtrl "The source address of the SAE J1939 device currently controlling the engine.  It is used to expand the torque mode parameter (see SPN 899) in cases where control is in response to an ECU that is not listed in Table SPN899_A.  Its value may be the ...";
CM_ SG_ 3221225472 EngSpeed "Actual engine speed which is calculated over a minimum crankshaft angle of 720 degrees divided by the number of cylinders.";
CM_ SG_ 3221225472 ActualEngPercentTorque "The calculated output torque of the engine.  The data is transmitted in indicated torque as a percent of reference engine torque (see the engine configuration message, PGN 65251).  The engine percent torque value will not be less than zero and it ...";
CM_ SG_ 3221225472 DriversDemandEngPercentTorque "The requested torque output of the engine by the driver. It is based on input from the following requestors external to the powertrain: operator (via the accelerator pedal), cruise control and/or road speed limit governor. Dynamic commands from ...";
CM_ SG_ 3221225472 ActlEngPrcntTorqueHighResolution "This parameter displays an additional torque in percent of the reference engine torque.
When the MSB is set to 1, this parameter is not available.  When the MSB is set to 0, bits 1 to 3 indicate the desired torque with resolution of 0.125%/bit  ...";
CM_ SG_ 3221225472 EngTorqueMode "State signal which indicates which engine torque mode is currently generating, limiting, or controlling the torque.  Note that the modes are not in prioritized order. Not all modes may be relevant for a given device.  Some devices may not implement ...";
CM_ SG_ 3221225472 ECUHardwareID "The ECU Hardware ID provides information to identify a specific ECU hardware version.
As an example, on a CAN network, this parameter can be used to uniquely identify the hardware version that is relevant for the interface of the ECU to the CAN ...";
CM_ SG_ 3221225472 ECUManufacturerName "The name of the manufacturer of the physical ECU.

This name may be different than the manufacturer identified by the Manufacturer Code (SPN 2838) and listed in table B10 of J1939.";
CM_ SG_ 3221225472 ECUType "The type of ECU.  One example of a use of the ECU type could be for classifying ECU capabilities, such as I/O.";
CM_ SG_ 3221225472 ECULocation "The location of the ECU within a network.";
CM_ SG_ 3221225472 ECUSerialNumber "The serial number of the physical ECU.";
CM_ SG_ 3221225472 ECUPartNumber "The part number of the physical ECU.";
CM_ SG_ 3221225472 EngMinContinuousTorque "Applied limit for minimum continuous engine torque";
CM_ SG_ 3221225472 EngMaxContinuousTorque "Applied limit for maximum continuous engine torque.";
CM_ SG_ 3221225472 EngMinContinuousRPM "Applied limit for minimum continuous engine RPM";
CM_ SG_ 3221225472 EngMaxContinuousRPM "Applied limit for maximum continuous engine RPM";
CM_ SG_ 3221225472 EngHghLmtThrshldFrMnCntnsTrqFrmE "Maximum allowable value for minimum continuous torque from engine";
CM_ SG_ 3221225472 EngLwLmtThrshldFrMxTorqueFromEng "Minimum allowable value for maximum continuous torque from engine";
CM_ SG_ 3221225472 EngHghLmtThrshldFrMnCntnusEngRPM "Maximum allowable value for minimum continuous RPM from engine";
CM_ SG_ 3221225472 EngLwLmtThrsholdForMaxRPMFromEng "Minimum allowable value for maximum continuous RPM from engine";
CM_ SG_ 3221225472 SupportTSC1CtrlPurposeGroup4 "This parameter indicates which TSC1 control purposes are supported in group 4 of 4. One bit is used to convey the support of each Control Purpose. A value of 0 equals supported and a value of 1 equals not supported. This bit logic is used to allow ...";
CM_ SG_ 3221225472 SupportTSC1CtrlPurposeGroup3 "This parameter indicates which TSC1 control purposes are supported in group 3 of 4. One bit is used to convey the support of each Control Purpose. A value of 0 equals supported and a value of 1 equals not supported. This bit logic is used to allow ...";
CM_ SG_ 3221225472 SupportTSC1CtrlPurposeGroup2 "This parameter indicates which TSC1 control purposes are supported in group 2 of 4. One bit is used to convey the support of each Control Purpose. A value of 0 equals supported and a value of 1 equals not supported. This bit logic is used to allow ...";
CM_ SG_ 3221225472 SupportTSC1CtrlPurposeGroup1 "This parameter indicates which TSC1 control purposes are supported in group 1 of 4. One bit is used to convey the support of each Control Purpose. A value of 0 equals supported and a value of 1 equals not supported. This bit logic is used to allow ...";
CM_ SG_ 3221225472 SupportVariableRateTSC1Message "This parameter indicates which TSC1 transmission rates are supported by the engine ECU in addition to the required 10ms transmission rate for temporary powertrain control purposes.
Bit Position      Transmission Rate
1                      1000 ms ...";
CM_ SG_ 3221225472 EngDefaultTorqueLimit "Companion parameter to Transmission Torque Limit (SPN 1845).  This 'echo' parameter provides confirmation to the transmission that the engine has received and will invoke the requested Transmission Torque Limit in the event that J1939 communication ...";
CM_ SG_ 3221225472 EngMomentOfInertia "Moment of inertia for the engine, including items driven full-time by the engine such as fuel, oil and cooling pumps.  The inertia from the following items are not included: flywheel, alternator, compressor, fan, and other engine-driven accessories.";
CM_ SG_ 3221225472 EngExRngRqstdSpdCtrlRngUpprLimit "The maximum engine speed regardless of load that the engine will allow when operating in a speed control/limit mode, excluding any maximum momentary engine override speed, if supported.
When the limit is higher than 2500 RPM the 'Requested Speed ...";
CM_ SG_ 3221225472 EngRqstdTrqueCtrlRangeUpperLimit "The maximum engine torque that the engine will allow when operating in a torque control/limit mode.";
CM_ SG_ 3221225472 EngRqstdTrqueCtrlRangeLowerLimit "The minimum engine torque that the engine will allow when operating in a torque control/limit mode.";
CM_ SG_ 3221225472 EngRqstdSpeedCtrlRangeUpperLimit "The maximum engine speed regardless of load that the engine will allow when operating in a speed control/limit mode, excluding any maximum momentary engine override speed, if supported.";
CM_ SG_ 3221225472 EngRqstdSpeedCtrlRangeLowerLimit "The minimum engine speed that the engine will allow when operating in a speed control/limit mode.";
CM_ SG_ 3221225472 EngMaxMomentaryOverrideTimeLimit "The maximum time limit allowed to override the engine's high idle speed.";
CM_ SG_ 3221225472 EngMxMmentaryOverrideSpeedPoint7 "The maximum engine speed above high idle allowed by the engine control during a momentary high idle override.  This duration of the override is limited by the maximum momentary override time limit, SPN 534.";
CM_ SG_ 3221225472 EngReferenceTorque "This parameter is the 100% reference value for all defined indicated engine torque parameters.  It is only defined once and doesn't change if a different engine torque map becomes valid.";
CM_ SG_ 3221225472 EngGain "The endspeed governor is defined as a linear line with the following equations (Capital letters mean physical values, small letters mean normalized values).  Refer to Figures PGN65251_A and PGN65251_B.
The gain KP/kp is defined as a positive value ...";
CM_ SG_ 3221225472 EngSpeedAtHighIdlePoint6 "Engine speed of high idle (point 6) of the engine torque map (see PGN 65251 and supporting document).  In engine configuration mode 3 (see Figure PGN65251_C), point 6 is not defined by the engine torque map but by the governor characteristic and the ...";
CM_ SG_ 3221225472 EngPercentTorqueAtPoint5 "The torque limit that indicates the available engine torque which can be provided by the engine at point 3, 4, and 5 of the engine map (see PGN 65251 and supporting documents).  It is required that one of these points indicate the peak torque point ...";
CM_ SG_ 3221225472 EngSpeedAtPoint5 "Engine speed of point 3, 4, and 5 of the engine torque map (see PGN 65251 and supporting document).  It is recommended that one of these points indicate the peak torque point for the current engine torque map.  Points 3, 4, and 5 are optional and ...";
CM_ SG_ 3221225472 EngPercentTorqueAtPoint4 "The torque limit that indicates the available engine torque which can be provided by the engine at point 3, 4, and 5 of the engine map (see PGN 65251 and supporting documents).  It is required that one of these points indicate the peak torque point ...";
CM_ SG_ 3221225472 EngSpeedAtPoint4 "Engine speed of point 3, 4, and 5 of the engine torque map (see PGN 65251 and supporting document).  It is recommended that one of these points indicate the peak torque point for the current engine torque map.  Points 3, 4, and 5 are optional and ...";
CM_ SG_ 3221225472 EngPercentTorqueAtPoint3 "The torque limit that indicates the available engine torque which can be provided by the engine at point 3, 4, and 5 of the engine map (see PGN 65251 and supporting documents)..  It is required that one of these points indicate the peak torque point ...";
CM_ SG_ 3221225472 EngSpeedAtPoint3 "Engine speed of point 3, 4, and 5 of the engine torque map (see PGN 65251 and supporting document).  It is recommended that one of these points indicate the peak torque point for the current engine torque map.  Points 3, 4, and 5 are optional and ...";
CM_ SG_ 3221225472 EngPercentTorqueAtPoint2 "The torque limit that indicates the available engine torque which can be provided by the engine at point 2 of the engine map (see PGN 65251 and supporting documents).  In engine configuration mode 1 and 3 (see Table PGN65251_A see PGN 65251), point ...";
CM_ SG_ 3221225472 EngSpeedAtPoint2 "Engine speed of point 2 of the engine torque map (see PGN 65251 and supporting document).  In engine configuration mode 1 and 3, point 2 is defined as the kick-in point from which torque is reduced to zero.  In mode 2 (see Table PGN65251_A), there ...";
CM_ SG_ 3221225472 EngPercentTorqueAtIdlePoint1 "The torque limit that indicates the available engine torque which can be provided by the engine at idle speed.  This parameter may be influenced by engine temperature (after power up) and other stationary changes (calibration offsets, sensor ...";
CM_ SG_ 3221225472 EngSpeedAtIdlePoint1 "Stationary low idle speed of engine which includes influences due to engine temperature (after power up) and other stationary changes (calibration offsets, sensor failures, etc).  This parameter is point 1 of the engine configuration map (see PGN ...";
CM_ SG_ 3221225472 EmergencyBrakingActive "Signal which indicates an emergency braking situation (ref. ECE Regulation 13 paragraph 5.2.1.31) with high  deceleration values.  This signal can be used to activate the hazard lights (ref ECE Regulation 48 paragraph 6.23) to
indicate other road ...";
CM_ SG_ 3221225472 PrkngBrakeActuatorFullyActivated "Signal which indicates when the parking brake actuator is fully activated.  (see also SPN 70 and 619).

00 - Parking Brake Actuator not fully activated
01 - Parking Brake Actuator fully activated
10 - Error
11 - Not available";
CM_ SG_ 3221225472 XBRAccelerationLimit "The brake system may temporarily or generally limit the maximum brake performance available for external systems. A temporary limit may be nessary due to high brake temperature; a general limit may be defined by the vehicle manufacturer, e.g. a ...";
CM_ SG_ 3221225472 XBRActiveCtrlMode "This parameter indicates which XBR Control Mode is executed by the brake system.
0000                No brake demand being executed (default mode)
0001                Driver's brake demand being executed, no external brake demand
0010 ...";
CM_ SG_ 3221225472 XBRSystemState "This parameter indicates which external brake control is allowed.
00 - Any external brake demand will be accepted (brake system fully operational)
01 - Only external brake demand of highest XBR Priority (00) will be accepted  (e.g. because the ...";
CM_ SG_ 3221225472 FoundationBrakeUse "This parameter indicates if the brake system presently uses the foundation brakes.

00   Foundation brakes not in use
01   Foundation brakes in use
10   Reserved
11   Not available";
CM_ SG_ 3221225472 HillHolderMode "Signal which indicates the current mode of the hill holder function.
000            Inactive
001            Active
010            Active, but will change to inactive in a short time.  (This mode may be used to warn the driver)
011 ...";
CM_ SG_ 3221225472 HaltBrakeMode "Signal which indicates the current mode of the halt brake function.
000            Inactive
001            Active
010            Active, but not functioning properly.  (This mode may be used to warn the driver)
011 - 101  Not defined
110 ...";
CM_ SG_ 3221225472 BrakeTempWarning "This parameter indicates if the temperature in the service brakes exceeds a certain value. It can be used for a warning information for the driver. The temperature warning value is vehicle manufacturer specific.
00 Not Active
01 Active
10 ...";
CM_ SG_ 3221225472 BrkLnngRmningRearAxle3RightWheel "The percentage of brake lining which can still be measured for the right wheel on the rear axle #3.  100% represents new brake linings, 0% represents totally worn brake linings.";
CM_ SG_ 3221225472 BrkLnngRminingRearAxle3LeftWheel "The percentage of brake lining which can still be measured for the left wheel on the rear axle #3.  100% represents new brake linings, 0% represents totally worn brake linings.";
CM_ SG_ 3221225472 BrkLnngRmningRearAxle2RightWheel "The percentage of brake lining which can still be measured for the right wheel on the rear axle #2.  100% represents new brake linings, 0% represents totally worn brake linings.";
CM_ SG_ 3221225472 BrkLnngRminingRearAxle2LeftWheel "The percentage of brake lining which can still be measured for the left wheel on the rear axle #2.  100% represents new brake linings, 0% represents totally worn brake linings.";
CM_ SG_ 3221225472 BrkLnngRmningRearAxle1RightWheel "The percentage of brake lining which can still be measured for the right wheel on the rear axle #1.  100% represents new brake linings, 0% represents totally worn brake linings.";
CM_ SG_ 3221225472 BrkLnngRminingRearAxle1LeftWheel "The percentage of brake lining which can still be measured for the left wheel on the rear axle #1.  100% represents new brake linings, 0% represents totally worn brake linings.";
CM_ SG_ 3221225472 BrkLnngRmningFrontAxleRightWheel "The percentage of brake lining which can still be measured for the right wheel on the front axle.  100% represents new brake linings, 0% represents totally worn brake linings.";
CM_ SG_ 3221225472 BrkLnngRminingFrontAxleLeftWheel "The percentage of brake lining which can still be measured for the left wheel on the front axle.  100% represents new brake linings, 0% represents totally worn brake linings.";
CM_ SG_ 3221225472 BrkAppPrssHghRngRrAxl3RightWheel "The brake application pressure for the right wheel on the rear axle #3.";
CM_ SG_ 3221225472 BrkAppPrssHghRngRrAxle3LeftWheel "The brake application pressure for the left wheel on the rear axle #3.";
CM_ SG_ 3221225472 BrkAppPrssHghRngRrAxl2RightWheel "The brake application pressure for the right wheel on the rear axle #2.";
CM_ SG_ 3221225472 BrkAppPrssHghRngRrAxle2LeftWheel "The brake application pressure for the left wheel on the rear axle #2.";
CM_ SG_ 3221225472 BrkAppPrssHghRngRrAxle1LeftWheel "The brake application pressure for the left wheel on the rear axle #1.";
CM_ SG_ 3221225472 BrkAppPrssHghRngFrntAxlRghtWheel "The brake application pressure for the right wheel on the front axle.";
CM_ SG_ 3221225472 BrkAppPrssHghRngFrntAxlLeftWheel "The brake application pressure for the left wheel on the front axle.";
CM_ SG_ 3221225472 BrkAppPrssHghRngRrAxl1RightWheel "The brake application pressure for the right wheel on the rear axle #1.";
CM_ SG_ 3221225472 RelativeSpeedRearAxle2RightWheel "The speed of the rear axle #2, right wheel relative to the front axle speed, SPN 904.";
CM_ SG_ 3221225472 RelativeSpeedRearAxle2LeftWheel "The speed of the rear axle #2, left wheel relative to the front axle speed, SPN 904.";
CM_ SG_ 3221225472 RelativeSpeedRearAxle1RightWheel "The speed of the rear axle #1, right wheel relative to the front axle speed, SPN 904.";
CM_ SG_ 3221225472 RelativeSpeedRearAxle1LeftWheel "The speed of the rear axle #1, left wheel relative to the front axle speed, SPN 904.";
CM_ SG_ 3221225472 RelativeSpeedFrontAxleRightWheel "The speed of the front axle, right wheel relative to the front axle speed, SPN 904.";
CM_ SG_ 3221225472 RelativeSpeedFrontAxleLeftWheel "The speed of the front axle, left wheel relative to the front axle speed, SPN 904.";
CM_ SG_ 3221225472 FrontAxleSpeed "The average speed of the two front wheels.";
CM_ SG_ 3221225472 TrctrMntdTrailerABSWarningSignal "This parameter commands the tractor-mounted trailer ABS optical warning signal.

00 Off
01 On 
10 Reserved
11 Take no action";
CM_ SG_ 3221225472 TrailerABSStatus "State signal which indicates that ABS in the trailer is actively controlling the brakes.  A message is sent to the tractor from the trailer (i.e. by PLC). The receiving device in the tractor transfers this information to the J1939 network.  At the ...";
CM_ SG_ 3221225472 HaltBrakeSwitch "Switch signal which indicates the position of the halt brake switch.

00    Halt brake switch passive
01    Halt brake switch active
10    Error
11    Not available";
CM_ SG_ 3221225472 SrcAddrssOfCntrllngDvcFrBrkeCtrl "The source address of the SAE J1939 device currently controlling the brake system. Its value may be the source address of the ECU transmitting the message (which means that no external SAE J1939 message is providing the active command) or the source ...";
CM_ SG_ 3221225472 ATC_ASRInformationSignal "This parameter commands the ATC/ASR driver information signal, for example a dash lamp.

00 Off
01 On 
10 Reserved
11 Take no action";
CM_ SG_ 3221225472 ABS_EBSAmberWarningSignal "This parameter commands the ABS/EBS amber/yellow optical warning signal

00 Off
01 On
10 Reserved
11 Take no action";
CM_ SG_ 3221225472 EBSRedWarningSignal "This parameter commands the EBS red optical warning signal

00 Off
01 On
10 Reserved
11 Take no action";
CM_ SG_ 3221225472 ABSFullyOperational "Signal which indicates whether an ABS system is fully operational or whether its functionality is reduced by a defect or by an intended action (e.g., by activation of an ABS-off-road switch or during special diagnostic procedures).  There are cases ...";
CM_ SG_ 3221225472 EngRetarderSelection "The position of the operator controlled selector, expressed as a percentage and determined by the ratio of the current position of the selector to its maximum possible position. Zero percent means no braking torque is requested by the operator from ...";
CM_ SG_ 3221225472 RemoteAccelEnableSwitch "Switch signal which indicates that the remote accelerator has been enabled and controls the engine.
00 - Off
01 - On
10 - Error
11 - Not available
NOTE-The accelerator interlock switch (see SPN 972) must be disabled in order for the remote ...";
CM_ SG_ 3221225472 EngAuxShutdownSwitch "Switch signal which requests that all engine fueling stop.

00 - Off
01 - On
10 - Error
11 - Not available";
CM_ SG_ 3221225472 EngDerateSwitch "Switch signal used to activate the torque limiting feature of the engine.  The specific nature of torque limiting should be verified with the manufacturer.

00 - Off
01 - On
10 - Error
11 - Not available";
CM_ SG_ 3221225472 AccelInterlockSwitch "Switch signal used to disable the accelerator and remote accelerator inputs, causing the engine to return to idle.

00 - Off
01 - On
10 - Error
11 - Not available";
CM_ SG_ 3221225472 TractionCtrlOverrideSwitch "Switch signal which indicates the position of the traction control override switch.  The traction control override signal disables the automatic traction control function allowing the wheels to spin.
00 - Off
01 - On
10 - Error
11 - Not ...";
CM_ SG_ 3221225472 ASRHillHolderSwitch "Switch signal which indicates the position of the ASR 'hill holder' switch.

00 - ASR 'hill holder' switch passive
01 - ASR 'hill holder' switch active
10 - Error
11 - Not available";
CM_ SG_ 3221225472 ASROffroadSwitch "Switch signal which indicates the position of the ASR off-road switch.

00 - ASR off-road switch passive
01 - ASR off-road switch active
10 - Error
11 - Not available";
CM_ SG_ 3221225472 ABSOffroadSwitch "Switch signal which indicates the position of the ABS off-road switch.

00 - ABS off-road switch passive
01 - ABS off-road switch active
10 - Error
11 - Not available";
CM_ SG_ 3221225472 BrakePedalPos "Ratio of brake pedal position to maximum pedal position.  Used for electric brake applications. 0% means no braking. Also when there are two brake pedals on the machine (Left Brake Pedal Position SPN 3033 and Right Brake Pedal Position SPN 3032) the ...";
CM_ SG_ 3221225472 EBSBrakeSwitch "Switch signal which indicates that the brake pedal is being pressed.  The EBS brake switch is independent of the brake light switch and has no provisions for external connections.
00 - Brake pedal is not being pressed
01 - Brake pedal is being ...";
CM_ SG_ 3221225472 AntiLockBrakingActive "State signal which indicates that the ABS is active.  The signal is set active when wheel brake pressure actually starts to be modulated by ABS and is reset to passive when all wheels are in a stable condition for a certain time.  The signal can ...";
CM_ SG_ 3221225472 ASRBrakeCtrlActive "State signal which indicates that ASR brake control is active. Active means that ASR actually controls wheel brake pressure at one or more wheels of the driven axle(s).
00 - ASR brake control passive but installed
01 - ASR brake control active
10 ...";
CM_ SG_ 3221225472 ASREngCtrlActive "State signal which indicates that ASR engine control has been commanded to be active. Active means that ASR actually tries to control the engine. This state signal is independent of other control commands to the engine (e.g., from the transmission) ...";
CM_ SG_ 3221225472 DiffLockStRearAxle3 "State used which indicates the condition of the rear axle 3 differential lock. The differential locks are located as defined in figure SPN 564_A.
[Ed note:  Forum comment resolution is in process.  The figure may need to be updated further and/or ...";
CM_ SG_ 3221225472 RearAxleGroupEngagementStatus "Rear axle group engagement status

00 rear axle group disengaged 
01 rear axle group engaged
10 error
11 not available";
CM_ SG_ 3221225472 FrontAxleGroupEngagementStatus "Front axle group engagement status 

00 front axle group disengaged 
01 front axle group engaged
10 error
11 not available";
CM_ SG_ 3221225472 DiffLockStateCentralRear "State used which indicates the condition of the central rear differential lock.  The differential locks are located as defined in figure SPN564_A.

00 Differential lock disengaged
01 Differential lock engaged
10 Error
11 Not available";
CM_ SG_ 3221225472 DiffLockStateCentralFront "State used which indicates the condition of the central front differential lock.  The differential locks are located as defined in figure SPN564_A.

00 Differential lock disengaged
01 Differential lock engaged
10 Error
11 Not available";
CM_ SG_ 3221225472 DiffLockStateCentral "State used which indicates the condition of the central differential lock.  The differential locks are located as defined in attached figure SPN564_A.

00 Differential lock disengaged
01 Differential lock engaged
10 Error
11 Not available";
CM_ SG_ 3221225472 DiffLockStateRearAxle2 "State used which indicates the condition of the rear axle 2 differential lock.  The differential locks are located as defined in figure SPN 564_A.

00 Differential lock disengaged
01 Differential lock engaged
10 Error
11 Not available";
CM_ SG_ 3221225472 DiffLockStateRearAxle1 "State used which indicates the condition of the rear axle 1 differential lock.  The differential locks are located as defined in figure SPN 564_A.

00 Differential lock disengaged
01 Differential lock engaged
10 Error
11 Not available";
CM_ SG_ 3221225472 DiffLockStateFrontAxle2 "State used which indicates the condition of the front axle 2 differential lock. The differential locks are located as defined in figure SPN 564_A.

00 Differential lock disengaged
01 Differential lock engaged
10 Error
11 Not available";
CM_ SG_ 3221225472 DiffLockStateFrontAxle1 "State used which indicates the condition of the front axle 1 differential lock.  The differential locks are located as defined in figure SPN564_A.

00 Differential lock disengaged
01 Differential lock engaged
10 Error
11 Not available";
CM_ SG_ 3221225472 EngExRangeCoolantPress "Gage pressure of liquid found in engine cooling system.

See also SPN 109 for alternate range and resolution.";
CM_ SG_ 3221225472 SeaWaterPumpOutletPress "Gauge pressure of liquid found at outlet of sea water pump in sea water cooling system.";
CM_ SG_ 3221225472 EngAuxCoolantTemp "Temperature of coolant found in the intercooler which is located after the turbocharger.";
CM_ SG_ 3221225472 EngAuxCoolantPress "Gage pressure of coolant found in the intercooler which is located after the turbocharger.";
CM_ SG_ 3221225472 Driver2Identification "Used to obtain the driver identity.";
CM_ SG_ 3221225472 Driver1Identification "Used to obtain the driver identity.";
CM_ SG_ 3221225472 EngOilFilterDiffPress7471 "Change in engine oil pressure, measured across the filter, due to the filter and any accumulation of solid or semisolid material on or in the filter. See SPN 99 for alternate resolution.";
CM_ SG_ 3221225472 FuelLevel2 "Ratio of volume of fuel to the total volume of fuel in the second or right-side storage container.  When Fuel Level 2 is not used, Fuel Level 1 (SPN 96) represents the total fuel in all fuel storage containers.";
CM_ SG_ 3221225472 CargoAmbientTemp "Temperature of air inside vehicle container used to accommodate cargo.";
CM_ SG_ 3221225472 EngOilFilterDiffPress "Change in engine oil pressure, measured across the filter, due to the filter and any accumulation of solid or semisolid material on or in the filter.  See SPN 7471 for alternate resolution.";
CM_ SG_ 3221225472 FuelLevel1 "Ratio of volume of fuel to the total volume of fuel storage container.
When Fuel Level 2 (SPN 38) is not used, Fuel Level 1 represents the total fuel in all fuel storage containers.  When Fuel Level 2 is used, Fuel Level 1 represents the fuel level ...";
CM_ SG_ 3221225472 WasherFluidLevel "Ratio of volume of liquid to total container volume of fluid reservoir in windshield wash system.";
CM_ SG_ 3221225472 EngCyl8AverageCombustionDuration "Average duration of combustion calculated over defined number of combustion cycles for engine cylinder 8 with reference to the crank angle.  Combustion duration is the difference between end of combustion and start of combustion expressed, in this ...";
CM_ SG_ 3221225472 EngCyl8AvrgCntrOfCmbustionTiming "Average timing calculated over defined number of combustion cycles for the center of combustion in engine cylinder 8 with reference to the crank angle.  Center of Combustion is used to indicate the combustion efficiency.  When the combustion happens ...";
CM_ SG_ 3221225472 EngCyl8AvrgStrtOfCmbustionTiming "Average start of combustion timing calculated over defined number of combustion cycles for engine cylinder 8 with reference to the crank angle.  When the combustion happens after the TDC (Top Dead Center) of this cylinder, the timing is referred in ...";
CM_ SG_ 3221225472 EngCyl8IndctedMeanEffectivePress "Average cylinder pressure calculated over defined number of combustion cycles for engine cylinder 8.  Negative range is to cover thermodynamic behavior during misfire.";
CM_ SG_ 3221225472 EngCyl7AverageCombustionDuration "Average duration of combustion calculated over defined number of combustion cycles for engine cylinder 7 with reference to the crank angle.  Combustion duration is the difference between end of combustion and start of combustion expressed, in this ...";
CM_ SG_ 3221225472 EngCyl7AvrgCntrOfCmbustionTiming "Average timing calculated over defined number of combustion cycles for the center of combustion in engine cylinder 7 with reference to the crank angle.  Center of Combustion is used to indicate the combustion efficiency.  When the combustion happens ...";
CM_ SG_ 3221225472 EngCyl7AvrgStrtOfCmbustionTiming "Average start of combustion timing calculated over defined number of combustion cycles for engine cylinder 7 with reference to the crank angle.  When the combustion happens after the TDC (Top Dead Center) of this cylinder, the timing is referred in ...";
CM_ SG_ 3221225472 EngCyl7IndctedMeanEffectivePress "Average cylinder pressure calculated over defined number of combustion cycles for engine cylinder 7.  Negative range is to cover thermodynamic behavior during misfire.";
CM_ SG_ 3221225472 EngCyl6AverageCombustionDuration "Average duration of combustion calculated over defined number of combustion cycles for engine cylinder 6 with reference to the crank angle.  Combustion duration is the difference between end of combustion and start of combustion expressed, in this ...";
CM_ SG_ 3221225472 EngCyl6AvrgCntrOfCmbustionTiming "Average timing calculated over defined number of combustion cycles for the center of combustion in engine cylinder 6 with reference to the crank angle.  Center of Combustion is used to indicate the combustion efficiency.  When the combustion happens ...";
CM_ SG_ 3221225472 EngCyl6AvrgStrtOfCmbustionTiming "Average start of combustion timing calculated over defined number of combustion cycles for engine cylinder 6 with reference to the crank angle.  When the combustion happens after the TDC (Top Dead Center) of this cylinder, the timing is referred in ...";
CM_ SG_ 3221225472 EngCyl6IndctedMeanEffectivePress "Average cylinder pressure calculated over defined number of combustion cycles for engine cylinder 6.  Negative range is to cover thermodynamic behavior during misfire.";
CM_ SG_ 3221225472 EngCyl5AverageCombustionDuration "Average duration of combustion calculated over defined number of combustion cycles for engine cylinder 5 with reference to the crank angle.  Combustion duration is the difference between end of combustion and start of combustion expressed, in this ...";
CM_ SG_ 3221225472 EngCyl5AvrgCntrOfCmbustionTiming "Average timing calculated over defined number of combustion cycles for the center of combustion in engine cylinder 5 with reference to the crank angle.  Center of Combustion is used to indicate the combustion efficiency.  When the combustion happens ...";
CM_ SG_ 3221225472 EngCyl5AvrgStrtOfCmbustionTiming "Average start of combustion timing calculated over defined number of combustion cycles for engine cylinder 5 with reference to the crank angle.  When the combustion happens after the TDC (Top Dead Center) of this cylinder, the timing is referred in ...";
CM_ SG_ 3221225472 EngCyl5IndctedMeanEffectivePress "Average cylinder pressure calculated over defined number of combustion cycles for engine cylinder 5.  Negative range is to cover thermodynamic behavior during misfire.";
CM_ SG_ 3221225472 EngCyl4AverageCombustionDuration "Average duration of combustion calculated over defined number of combustion cycles for engine cylinder 4 with reference to the crank angle.  Combustion duration is the difference between end of combustion and start of combustion expressed, in this ...";
CM_ SG_ 3221225472 EngCyl4AvrgCntrOfCmbustionTiming "Average timing calculated over defined number of combustion cycles for the center of combustion in engine cylinder 4 with reference to the crank angle.  Center of Combustion is used to indicate the combustion efficiency.  When the combustion happens ...";
CM_ SG_ 3221225472 EngCyl4AvrgStrtOfCmbustionTiming "Average start of combustion timing calculated over defined number of combustion cycles for engine cylinder 4 with reference to the crank angle.  When the combustion happens after the TDC (Top Dead Center) of this cylinder, the timing is referred in ...";
CM_ SG_ 3221225472 EngCyl4IndctedMeanEffectivePress "Average cylinder pressure calculated over defined number of combustion cycles for engine cylinder 4.  Negative range is to cover thermodynamic behavior during misfire.";
CM_ SG_ 3221225472 EngCyl3AverageCombustionDuration "Average duration of combustion calculated over defined number of combustion cycles for engine cylinder 3 with reference to the crank angle.  Combustion duration is the difference between end of combustion and start of combustion expressed, in this ...";
CM_ SG_ 3221225472 EngCyl3AvrgCntrOfCmbustionTiming "Average timing calculated over defined number of combustion cycles for the center of combustion in engine cylinder 3 with reference to the crank angle.  Center of Combustion is used to indicate the combustion efficiency.  When the combustion happens ...";
CM_ SG_ 3221225472 EngCyl3AvrgStrtOfCmbustionTiming "Average start of combustion timing calculated over defined number of combustion cycles for engine cylinder 3 with reference to the crank angle.  When the combustion happens after the TDC (Top Dead Center) of this cylinder, the timing is referred in ...";
CM_ SG_ 3221225472 EngCyl3IndctedMeanEffectivePress "Average cylinder pressure calculated over defined number of combustion cycles for engine cylinder 3.  Negative range is to cover thermodynamic behavior during misfire.";
CM_ SG_ 3221225472 EngCldStrtFlIgniterRelayFeedback "Feedback state of the engine cold start fuel igniter relay which indicates the status of the relay output.

00  Off
01  On
10  Error
11  Not available";
CM_ SG_ 3221225472 EngColdStartFuelIgniterRelay "The engine cold start fuel igniter relay control command.  This command controls the relay, not the igniter.

00  Off
01  On
10  Reserved
11  Don't care/take no action";
CM_ SG_ 3221225472 EngColdStartFuelIgniterCmd "The engine cold start fuel igniter control command, normalized to %, where 0% represents fully off and 100% represents fully on.";
CM_ SG_ 3221225472 EngStartEnableDevice2Config "The start enable device installed for start enable device 2.
0000 - no start enable device 2 installed
0001 - glow plugs installed
0010 - fuelled start installed
0011 - ether injection installed
0100 - electric intake air heater installed
0101 ...";
CM_ SG_ 3221225472 EngStartEnableDevice1Config "The start enable device installed for start enable device 1.
0000 - no start enable device 1 installed
0001 - glow plugs installed
0010 - fuelled start installed
0011 - ether injection installed
0100 - electric intake air heater installed
0101 ...";
CM_ SG_ 3221225472 EngStartEnableDevice2 "Devices that assist an engine in starting, e.g. intake heaters, ether, or an alternate/secondary starting aid.  May be of the same type or different than Start Enable Device 1 (SPN 626). Parameter indicating whether the start enable device 2 is ON ...";
CM_ SG_ 3221225472 EngStartEnableDevice1 "Devices that assist an Engine in starting, e.g. intake heaters and ether.  Primary starting aid.
Parameter indicating whether the start enable device 1 is ON or OFF

00 - start enable OFF
01 - start enable ON
10 - reserved
11 - not available";
CM_ SG_ 3221225472 PoweredVehicleWeight "Total mass imposed by the tires of the powered vehicle on the road surface.  Does not include the trailer.";
CM_ SG_ 3221225472 GrossCombinationVehicleWeight "The total weight of the truck and all attached trailers.";
CM_ SG_ 3221225472 MxCntinuousRetarderTorqueLimitRq "Requested maximum continuous retarder torque (operating range: -125 to 0%)";
CM_ SG_ 3221225472 MnCntinuousRetarderTorqueLimitRq "Requested minimum continuous retarder torque (operating range: -125 to 0%)";
CM_ SG_ 3221225472 MxContinuousRetarderSpeedLimitRq "Requested maximum continuous retarder speed";
CM_ SG_ 3221225472 MnContinuousRetarderSpeedLimitRq "Requested minimum continuous retarder speed";
CM_ SG_ 3221225472 EngTorqueLimitRqMaxContinuous "Requested maximum continuous engine torque (operating range: 0 to 125%)";
CM_ SG_ 3221225472 EngTorqueLimitRqMinContinuous "Requested minimum continuous engine torque (operating range: 0 to 125%)";
CM_ SG_ 3221225472 EngSpeedLimitRqMaxContinuous "Requested maximum continuous engine speed";
CM_ SG_ 3221225472 EngSpeedLimitRqMinContinuous "Requested minimum continuous engine speed";
CM_ SG_ 3221225472 EngAverageCombustionTime "The average combustion time of all cylinders of an engine.";
CM_ SG_ 3221225472 EngDesiredCombustionTime "The desired combustion time based upon engine load and speed lookup maps.";
CM_ SG_ 3221225472 EngCyl20CombustionTime "The amount of time from when the ignition of the fuel is initiated to when the fuel is completely ignited (i.e., the flame front has propagated across the cylinder).";
CM_ SG_ 3221225472 EngCyl19CombustionTime "The amount of time from when the ignition of the fuel is initiated to when the fuel is completely ignited (i.e., the flame front has propagated across the cylinder).";
CM_ SG_ 3221225472 EngCyl18CombustionTime "The amount of time from when the ignition of the fuel is initiated to when the fuel is completely ignited (i.e., the flame front has propagated across the cylinder).";
CM_ SG_ 3221225472 EngCyl17CombustionTime "The amount of time from when the ignition of the fuel is initiated to when the fuel is completely ignited (i.e., the flame front has propagated across the cylinder).";
CM_ SG_ 3221225472 EngCyl16CombustionTime "The amount of time from when the ignition of the fuel is initiated to when the fuel is completely ignited (i.e., the flame front has propagated across the cylinder).";
CM_ SG_ 3221225472 EngCyl15CombustionTime "The amount of time from when the ignition of the fuel is initiated to when the fuel is completely ignited (i.e., the flame front has propagated across the cylinder).";
CM_ SG_ 3221225472 EngCyl14CombustionTime "The amount of time from when the ignition of the fuel is initiated to when the fuel is completely ignited (i.e., the flame front has propagated across the cylinder).";
CM_ SG_ 3221225472 EngCyl13CombustionTime "The amount of time from when the ignition of the fuel is initiated to when the fuel is completely ignited (i.e., the flame front has propagated across the cylinder).";
CM_ SG_ 3221225472 EngCyl12CombustionTime "The amount of time from when the ignition of the fuel is initiated to when the fuel is completely ignited (i.e., the flame front has propagated across the cylinder).";
CM_ SG_ 3221225472 EngCyl11CombustionTime "The amount of time from when the ignition of the fuel is initiated to when the fuel is completely ignited (i.e., the flame front has propagated across the cylinder).";
CM_ SG_ 3221225472 EngCyl10CombustionTime "The amount of time from when the ignition of the fuel is initiated to when the fuel is completely ignited (i.e., the flame front has propagated across the cylinder).";
CM_ SG_ 3221225472 EngCyl9CombustionTime "The amount of time from when the ignition of the fuel is initiated to when the fuel is completely ignited (i.e., the flame front has propagated across the cylinder).";
CM_ SG_ 3221225472 EngCyl8CombustionTime "The amount of time from when the ignition of the fuel is initiated to when the fuel is completely ignited (i.e., the flame front has propagated across the cylinder).";
CM_ SG_ 3221225472 EngCyl7CombustionTime "The amount of time from when the ignition of the fuel is initiated to when the fuel is completely ignited (i.e., the flame front has propagated across the cylinder).";
CM_ SG_ 3221225472 EngCyl6CombustionTime "The amount of time from when the ignition of the fuel is initiated to when the fuel is completely ignited (i.e., the flame front has propagated across the cylinder).";
CM_ SG_ 3221225472 EngCyl5CombustionTime "The amount of time from when the ignition of the fuel is initiated to when the fuel is completely ignited (i.e., the flame front has propagated across the cylinder).";
CM_ SG_ 3221225472 EngCyl4CombustionTime "The amount of time from when the ignition of the fuel is initiated to when the fuel is completely ignited (i.e., the flame front has propagated across the cylinder).";
CM_ SG_ 3221225472 EngCyl3CombustionTime "The amount of time from when the ignition of the fuel is initiated to when the fuel is completely ignited (i.e., the flame front has propagated across the cylinder).";
CM_ SG_ 3221225472 EngCyl2CombustionTime "The amount of time from when the ignition of the fuel is initiated to when the fuel is completely ignited (i.e., the flame front has propagated across the cylinder).";
CM_ SG_ 3221225472 EngCyl1CombustionTime "The amount of time from when the ignition of the fuel is initiated to when the fuel is completely ignited (i.e., the flame front has propagated across the cylinder).";
CM_ SG_ 3221225472 TotalCountOfConfigChangesMade "Total number of times changes have been made to any of the configurable parameters.";
CM_ SG_ 3221225472 EngAirShutoffManualSw "This switch will be used by the operator to activate the engine air shutoff valve, which will cause the engine to shut down.

00b = Off
01b = On
10b = Error
11b = Not available";
CM_ SG_ 3221225472 EngAirShutoffTestSw "This switch, commonly a momentary switch, when activated will enable the test mode for the engine air shutoff valve. When all applicable criteria are true, the air shutoff valve will activate and shut down the engine.
00b = Off
01b = On
10b = ...";
CM_ SG_ 3221225472 HornSw "Activates the vehicle (city) horn

00b = Horn switch is off
01b = Horn switch is on
10b = Error
11b = Not Available";
CM_ SG_ 3221225472 OpKeySwDelayedBatOff "Indicates a state in which the main battery switch will be opened after a short delay. This allows the battery to be disconnected (as may be required by ADR regulations) while avoiding memory corruption due to unexpected loss of battery power.
This ...";
CM_ SG_ 3221225472 OpKeySwStart "Indicates that the start state of the operator key switch is active. This state is also known in DIN 75552 as KL50
This parameter represents the capability of a rotary key switch position, a keyless switch state, or a state determined by the ...";
CM_ SG_ 3221225472 OpKeySwIgntPwr "Indicates that the ignition (or run) state of the operator key switch is active. This state is also known in DIN 75552 as KL15. Devices should use SPN 158 to report voltage at their switched battery input.
This parameter represents the ...";
CM_ SG_ 3221225472 OpKeySwAccessoryPwr "Indicates that the accessory state of the operator key switch is active.
This parameter represents the capability of a rotary key switch position, a keyless switch state, or a state determined by the Momentary Operator Key Switch button ...";
CM_ SG_ 3221225472 MomentaryOpKeySw "Momentary switch (possibly a push button switch) that indicates the operator's desire to enter accessory mode, enter run mode, enter crank mode, activate the propulsion system, or initiate another behavior as determined by the manufacturer. This ...";
CM_ SG_ 3221225472 AFTSCRDosingModeCmd "Request the aftertreatment system to run in standard or reduced mode.
Standard indicates that the system will dose at higher capacity where the reduced mode will dose at a lower capacity.  (e.g., IMO 3 to IMO 2 in Marine Applications)
000b = ...";
CM_ SG_ 3221225472 OpKeyDetected "Indicates that a key is physically inserted in the key switch, or for keyless systems, that a valid key is within activation range.

00b = No key detected
01b = Key is detected
10b = Error
11b = Not Available";
CM_ SG_ 3221225472 VehTrailerStatus "Indicates a trailer is connected to the towing mechanism.  This is not intended to indicate that the trailer is latched.

00 - Trailer is not detected
01 - Trailer is detected
10 - Error
11 - Not available";
CM_ SG_ 3221225472 TransOilLevelRq "Conveys operator or vehicle system desire for a transmission oil level reading to be taken. 

00 - No transmission oil level reading desired
01 - Transmission oil level reading desired
10 - Reserved
11 - Don't care / take no action";
CM_ SG_ 3221225472 FifthWheelReleaseCtrl "Operator input used to release the fifth wheel. Fifth Wheel Release Control Security Lockout and other conditions must be properly enabled before this will function.
00   Coupler Locked
01   Coupler Unlocked, trailer can be unhitched or hitched
 ...";
CM_ SG_ 3221225472 FfthWhlRleaseCtrlSecurityLockout "Operator's fifth wheel release control interlock. This operator input must be enabled prior to activating the fifth wheel release control (SPN 3314).
00    Fifth wheel release Disabled
01    Fifth wheel release Enabled
10    Error
11    Not ...";
CM_ SG_ 3221225472 TransferCaseSelectorSwitch "Operator switch to select the condition of the transfer case.  States 000 and 001 should be used if the transfer case only functions to switch between 2-wheel and 4-wheel drive.  If the transfer case includes a High / Low Range function, states 011 ...";
CM_ SG_ 3221225472 SelectedMaxVehicleSpeedLimit "User selected maximum vehicle speed.  If one is selected, then this SPN must equal one of the maximum vehicle speeds #1-#7 from PGN 64997 - Maximum Vehicle Speed Limit Status . If different maximum vehicle speed requests are present from different ...";
CM_ SG_ 3221225472 RqCabZoneHeating "Request to activate cab zone heating.

00 Do not heat cab engine zone
01 Heat cab zone
10 Reserved
11 Don't care/take no action";
CM_ SG_ 3221225472 RqEngZoneHeating "Request to activate engine zone heating.

00 Do not heat engine zone
01 Heat engine zone
10 Reserved
11 Don't care/take no action";
CM_ SG_ 3221225472 AuxHeaterModeRq "Request to activate the auxiliary heater.
0000 De-activate auxiliary heater
0001 Off due to ADR per European Regulations for Transport of hazardous materials
0010 Economy mode
0011 Normal mode
0100 Heater pump up-keep
0101-1000 Reserved
 ...";
CM_ SG_ 3221225472 EngAutomaticStartEnableSwitch "Switch signal which enables the idle management system to be enabled. When this system is enabled with the engine in an idle mode and safe operating conditions existing, then the engine may be started or stopped automatically.
00 - Switch in the ...";
CM_ SG_ 3221225472 AtomaticGearShiftingEnableSwitch "Indicates that automated gear shifting is enabled via a switch

    00 = Automated Gear Shifting is disabled
    01 = Automated Gear Shifting is enabled
    10 = Error
    11 = Not available";
CM_ SG_ 3221225472 AFTRegenForceSw "Indicates the state of a switch available to the operator that forces aftertreatment regeneration.
00 not active
01 active
10 error
11 not available
This SPN would be 'not active' when aftertreatment regeneration is allowed to occur normally ...";
CM_ SG_ 3221225472 AFTRegenInhSw "Indicates the state of a switch available to the operator that inhibits aftertreatment regeneration.
00 not active
01 active
10 error
11 not available
This SPN would be 'not active' when aftertreatment regeneration is allowed to occur normally ...";
CM_ SG_ 3221225472 VhclLmtngSpdGovernorEnableSwitch "Switch signal which enables the Vehicle Limiting Speed Governor (VLSG) such that the vehicle speed may be either increased or decreased when the engine is off idle.

00 - Switch disabled
01 - Switched enabled
10 - Error
11 - Not available";
CM_ SG_ 3221225472 VhclLmtngSpdGvrnrIncrementSwitch "Switch signal which increases the Vehicle Limiting Speed Governor (VLSG).

00 - Switch in the off state
01 - Switch in the on state - increase
10 - Error
11 - Not available";
CM_ SG_ 3221225472 VhclLmtngSpdGvrnrDecrementSwitch "Switch signal which decreases the Vehicle Limiting Speed Governor (VLSG).

00 - Switch in the off state
01 - Switch in the on state - decrease
10 - Error
11 - Not available";
CM_ SG_ 3221225472 ParkBrakeCmd "Request by a secondary device to command the Park Brake.  The Park Brake controller should treat this as a request and should apply the Park Brake as determined by the controller.
Feedback of the park brake actuation may utilize SPN 70, SPN 619 or ...";
CM_ SG_ 3221225472 SeatBeltSwitch "State of switch used to determine if Seat Belt is buckled

00 NOT Buckled
01 OK - Seat Belt is buckled
10 Error - Switch state cannot be determined
11 Not Available";
CM_ SG_ 3221225472 OperatorSeatDirectionSwitch "Senses whether the operator seat is in the forward driving position

00 Operator seat not facing forward
01 Operator seat is facing forward
10 Error
11 Not Available";
CM_ SG_ 3221225472 BatteryMainSwitchHoldRq "Request to hold the battery main switch.

00 Release Battery Main Switch
01 Hold Battery Main Switch
10 undefined
11 Don't care/take no action";
CM_ SG_ 3221225472 AuxHeaterCoolantPumpRq "Indicates whether to activate the auxiliary heater coolant water pump.

00 Deactivate water pump
01 Activate water pump
10 Reserved
11 Don't care/take no action";
CM_ SG_ 3221225472 CabInteriorTempCmd "Parameter used to command a certain cab interior temperature.

Note: See also SPN 170.  SPN 1662 is an additional diagnostic SPN associated with cab temperature.";
CM_ SG_ 3221225472 RequestedPercentFanSpeed "Fan speed of the first or only fan in the system as a ratio of the actual fan drive (current speed) to the fully engaged fan drive (maximum fan speed). A two state fan (off/on) will use 0% and 100% respectively. A three state fan ...";
CM_ SG_ 3221225472 SwtchBcklghtIllmntnBrghtnssPrcnt "Commanded switch backlight brightness level for all operator control switches.  This is separate from the cab display illumination Brightness Percent parameter.
Note:  If a single device is used to control both the backlight brightness level of the ...";
CM_ SG_ 3221225472 IlluminationBrightnessPercent "Commanded backlight brightness level for all cab displays.  

Note:  If a separate device is used to independently control the switch backlight brightness level, see SPN 5532.";
CM_ SG_ 3221225472 SwtchIndctnIllmntnBrghtnssPrcent "Commanded switch indication illumination brightness level for all operator control switches. This is separate from the cab display illumination Brightness Percent parameter.
Note: If a single device is used to control both the indication brightness ...";
CM_ SG_ 3221225472 UnitNumber "Owner assigned unit number for the power unit of the vehicle.

NOTE: The ASCII character '*' is reserved as a delimiter.";
CM_ SG_ 3221225472 SerialNumber "Serial number of the component.

NOTE - The ASCII character '*' is reserved as a delimiter.";
CM_ SG_ 3221225472 Model "Model of the component.

NOTE - The ASCII character '*' is reserved as a delimiter.";
CM_ SG_ 3221225472 Make "Make of the component corresponding to the codes defined in the American Trucking Association Vehicle Maintenance Reporting Standard (ATA/VMRS).
Note:  This parameter is to be transmitted as a 5 character ASCII string;  as a zero length string, if ...";
CM_ SG_ 3221225472 EngShutdownOverrideSwitch "Switch signal which indicates the position of the engine shutdown override switch.  This switch function allows the operator to override an impending engine shutdown.

00 - Off
01 - On
10 - Error
11 - Not available";
CM_ SG_ 3221225472 EngTestModeSwitch "Switch signal which indicates the position of the engine diagnostic test mode switch.

00 - Off
01 - On
10 - Error
11 - Not available";
CM_ SG_ 3221225472 EngIdleDecrementSwitch "Switch signal which indicates the position of the idle decrement switch.

00 - Off
01 - On
10 - Error
11 - Not available";
CM_ SG_ 3221225472 EngIdleIncrementSwitch "Switch signal which indicates the position of the idle increment switch.

00 - Off
01 - On
10 - Error
11 - Not available";
CM_ SG_ 3221225472 CruiseCtrlStates "This parameter is used to indicate the current state, or mode, of operation by the cruise control device.  This is a status parameter.
000 - Off/Disabled
001 - Hold
010 - Accelerate
011 - Decelerate
100 - Resume
101 - Set
110 - Accelerator ...";
CM_ SG_ 3221225472 PTOGovernorState "This parameter is used to indicate the current state or mode of operation by the power takeoff (PTO) governor.  In lieu of support for PTO Drive Engagement parameters, this parameter may represent the status of a PTO drive.  The broadcasting device ...";
CM_ SG_ 3221225472 CruiseCtrlSetSpeed "Value of set (chosen) velocity of velocity control system.  See SPN 6809 for an alternate resolution.
If an algorithm that can modify the cruise control set point exists in the system, such as Predictive Cruise Control or Adaptive Cruise Control, ...";
CM_ SG_ 3221225472 CruiseCtrlAccelerateSwitch "Switch signal of the cruise control activator which indicates that the activator is in the position 'accelerate.'
00 - Cruise control activator not in the position 'accelerate'
01 - Cruise control activator in position 'accelerate'
10 - Error
11 ...";
CM_ SG_ 3221225472 CruiseCtrlResumeSwitch "Switch signal of the cruise control activator which indicates that the activator is in the position 'resume.'
00 - Cruise control activator not in the position 'resume'
01 - Cruise control activator in position 'resume'
10 - Error
11 - Not ...";
CM_ SG_ 3221225472 CruiseCtrlCoastSwitch "Switch signal of the cruise control activator which indicates that the activator is in the position 'coast (decelerate).'
00 - Cruise control activator not in the position 'coast'
01 - Cruise control activator in position 'coast'
10 - Error
11 - ...";
CM_ SG_ 3221225472 CruiseCtrlSetSwitch "Switch signal of the cruise control activator which indicates that the activator is in the position 'set.'

00 - Cruise control activator not in the position 'set'
01 - Cruise control activator in position 'set'
10 - Error
11 - Not available";
CM_ SG_ 3221225472 ClutchSwitch "Switch signal which indicates that the clutch pedal is being pressed. It is necessary for a safe drivetrain behavior that the clutch switch is set before the clutch is opened (cruise control function).
00 - Clutch pedal released
01 - Clutch pedal ...";
CM_ SG_ 3221225472 BrakeSwitch "Switch signal which indicates that the driver operated brake foot pedal is being pressed.  This brake foot pedal is controlling the vehicles' service brake (total vehicle braking application, not park brakes).  It is necessary for safe drivetrain ...";
CM_ SG_ 3221225472 CruiseCtrlEnableSwitch "Switch signal which indicates that it is possible to manage the cruise control function.

00 - Cruise control disabled
01 - Cruise control enabled
10 - Error
11 - Not available";
CM_ SG_ 3221225472 CruiseCtrlActive "Cruise control is switched on.  It is not ensured that the engine is controlled by cruise control, as in the case of a large driver's demand the engine is controlled by the driver while cruise control is active (maximum selection of cruise control ...";
CM_ SG_ 3221225472 WheelBasedVehicleSpeed "Speed of the vehicle as calculated from wheel or tailshaft speed.";
CM_ SG_ 3221225472 ParkBrakeReleaseInhibitRq "Park Brake Release Inhibit Request signals the desire that an applied park brake remain applied and limit the ability of the vehicle to be moved.
00 - Park Brake Release Inhibit not requested
01 - Park Brake Release Inhibit requested
10 - SAE ...";
CM_ SG_ 3221225472 CruiseCtrlPauseSwitch "Switch signal which indicates the position of the Cruise Control Pause Switch used on Remote Cruise Control applications. The Cruise Control Pause Switch signal temporarily disables the Cruise Control function.
00 - Off
01 - On
10 - Error ...";
CM_ SG_ 3221225472 ParkingBrakeSwitch "Switch signal which indicates when the parking brake is set. In general the switch actuated by the operator's park brake control, whether a pedal, lever or other control mechanism  (see also SPN 619 and 5275).
00 - Parking brake not set
01 - ...";
CM_ SG_ 3221225472 TwoSpeedAxleSwitch "Switch signal which indicates the current axle range.

00 - Low speed range
01 - High speed range
10 - Error
11 - Not available";
CM_ SG_ 3221225472 MaxVehicleSpeedLimit6808 "Maximum vehicle velocity allowed. See SPN 74 for an alternate resolution.";
CM_ SG_ 3221225472 CruiseCtrlLowSetLimitSpeed "Minimum vehicle velocity at which cruise can be set or minimum vehicle velocity for cruise operation before it will exit cruise control operation.";
CM_ SG_ 3221225472 CruiseCtrlHighSetLimitSpeed "Maximum vehicle velocity at which cruise can be set.

If Cruise Control Adjusted Maximum Speed (SPN 7495) is supported, then SPN 7495 has priority over SPN 87. See the definition for SPN 7495 for more details.";
CM_ SG_ 3221225472 AuxHeaterMaxOutputPower "The maximum output power of the auxiliary heater.";
CM_ SG_ 3221225472 TripServiceBrakeApplications "Total number of times the service brakes have been activated since the last trip reset.  Brake applications of less than 0.5 s are not counted and lengthy brake applications (longer than 0.5 s) are counted as a single event.
NOTE - Definition and ...";
CM_ SG_ 3221225472 TripServiceBrakeDistance "Total distance over which the service brakes have been active since the last trip reset.";
CM_ SG_ 3221225472 TripCompressionBrakeDistance "Total distance over which the compression brakes have been active since the last trip reset.";
CM_ SG_ 3221225472 TotalCompressionBrakeDistance "Total distance over which the compression brakes have been active for the life of the engine.";
CM_ SG_ 3221225472 CbA_CRfrgrntCmpressorOutletPress "This is the gage pressure at the compressor outlet in the cab air conditioning system.";
CM_ SG_ 3221225472 SLIBattery4Temp "Temperature of the battery 4 used for starting the engine, for lighting, and for ignition (SLI). 

The relation to physical location is determined by the equipment manufacturer.";
CM_ SG_ 3221225472 SLIBattery3Temp "Temperature of the battery 3 used for starting the engine, for lighting, and for ignition (SLI). 

The relation to physical location is determined by the equipment manufacturer.";
CM_ SG_ 3221225472 Battery2Temp "Temperature of the battery 2 used for starting the engine, for lighting, and for ignition (SLI). 

The relation to physical location is determined by the equipment manufacturer.";
CM_ SG_ 3221225472 Battery1Temp "Temperature of the battery 1 used for starting the engine, for lighting, and for ignition (SLI). 

The relation to physical location is determined by the equipment manufacturer.";
CM_ SG_ 3221225472 VhclAccelerationRateLimitLampCmd "Command signal directly controlling the Vehicle Acceleration Rate Limit Lamp.
00 - Lamp Off
01 - Lamp On
10 - Reserved
11 - Not available
NOTE: SPN 2979 is the original parameter used to provide vehicle acceleration rate limit status.  This ...";
CM_ SG_ 3221225472 EngSpeedVeryHighLampCmd "Command signal directly controlling the Engine Speed Very High Warning lamp.

00 - Lamp Off
01 - Lamp On
10 - Reserved
11 - Not available";
CM_ SG_ 3221225472 EngSpeedHighLampCmd "Command signal directly controlling the Engine Speed High Warning lamp.

00 - Lamp Off
01 - Lamp On
10 - Reserved
11 - Not available";
CM_ SG_ 3221225472 EngCtrlModule3ReadyForUseLampCmd "Command signal directly controlling the Engine Control Module 3 Ready for Use Lamp. This lamp is used to indicate whether ECM 3 can control the operation of the engine. In case of a failure in ECM 3, lamp will be turned OFF.
00 - Lamp Off
01 - ...";
CM_ SG_ 3221225472 EngCtrlModule2ReadyForUseLampCmd "Command signal directly controlling the Engine Control Module 2 Ready for Use Lamp. This lamp is used to indicate whether ECM 2 can control the operation of the engine. In case of a failure in ECM 2, lamp will be turned OFF.
00 - Lamp Off
01 - ...";
CM_ SG_ 3221225472 EngCtrlModule1ReadyForUseLampCmd "Command signal directly controlling the Engine Control Module 1 Ready for use Lamp. This lamp is used to indicate whether ECM 1 can control the operation of the engine. In case of a failure in ECM 1, lamp will be turned OFF.
00 - Lamp Off
01 - ...";
CM_ SG_ 3221225472 EngFuelFilterRestrictedLampCmd "Command signal directly controlling the Engine Fuel Filter Restricted Lamp.

00 - Lamp Off
01 - Lamp On
10 - Reserved
11 - Not available";
CM_ SG_ 3221225472 EngAirFilterRestrictionLampCmd "Command signal directly controlling the Engine Air Filter Restriction Lamp.

00 - Lamp Off
01 - Lamp On
10 - Reserved
11 - Not available";
CM_ SG_ 3221225472 EngIdleManagementActiveLampCmd "Command signal directly controlling the Engine Idle Management Active Lamp

00 - Lamp Off
01 - Lamp On
10 - Reserved
11 - Not available

Note:  SPN 1661 should be used for reporting diagnostics of the Engine Idle Management Active Lamp.";
CM_ SG_ 3221225472 EngCoolantLevelLowLampCmd "Command signal directly controlling the Engine Coolant Level Low Lamp

00 - Lamp Off
01 - Lamp On
10 - Reserved
11 - Not available";
CM_ SG_ 3221225472 EngCoolantTempHighLampCmd "Command signal directly controlling the Engine Coolant Temperature High Lamp

00 - Lamp Off
01 - Lamp On
10 - Reserved
11 - Not available";
CM_ SG_ 3221225472 EngOilPressLowLampCmd "Command signal directly controlling the Engine Oil Pressure Low Lamp

00 - Lamp Off
01 - Lamp On
10 - Reserved
11 - Not available";
CM_ SG_ 3221225472 CmprssnBrkEnblSwtchIndctrLampCmd "Command signal directly controlling Compression Brake Enable Switch Indicator Lamp.  The compression brake switch indicator signals the status of the compression brake enable switch to the operator.
00 - Lamp OFF
01 - Lamp ON
10 - Reserved
11 - ...";
CM_ SG_ 3221225472 EngBrakeActiveLampCmd "Command signal directly controlling the Engine Brake Active Lamp. This is used for engine based retarders.

00 - Lamp Off
01 - Lamp On
10 - Reserved
11 - Not available";
CM_ SG_ 3221225472 OBDMalfunctionIndicatorLampCmd "Command signal directly controlling the OBD Malfunction Indicator Lamp

00 - Lamp Off
01 - Lamp On
10 - Reserved
11 - Not available

Note:  SPN 1213 should be used for reporting diagnostics of the OBD Malfunction Indicator Lamp.";
CM_ SG_ 3221225472 EngRedStopLampCmd "Command signal directly controlling the Engine Red Stop Lamp

00 - Lamp Off
01 - Lamp On
10 - Reserved
11 - Not available

Note:  SPN 623 should be used for reporting diagnostics of the Engine Red Stop Lamp.";
CM_ SG_ 3221225472 EngAmberWarningLampCmd "Command signal directly controlling the Engine Amber Warning Lamp

00 - Lamp Off
01 - Lamp On
10 - Reserved
11 - Not available

Note:  SPN 624 should be used for reporting diagnostics of the Engine Amber Warning Lamp.";
CM_ SG_ 3221225472 EngProtectLampCmd "Command signal directly controlling the Engine Protect Lamp

00 - Lamp Off
01 - Lamp On
10 - Reserved
11 - Not available

Note:  SPN 987 should be used for reporting diagnostics of the Engine Protect Lamp.";
CM_ SG_ 3221225472 RolloverSensorType "Type of Rollover Sensor.
0000 = acceleration sensor
0001 = pressure sensor
0010 = rollrate sensor
0011 = sonic sensor
0100 = fiber-optic sensor
0101 = radar sensor
0110 = lidar sensor
0111 = optical sensor
1000-1101 =  Reserved
1110 = ...";
CM_ SG_ 3221225472 RearCollisionSensor4Type "Type of Rear Collision Sensor 4.
0000 = acceleration sensor
0001 = pressure sensor
0010 = rollrate sensor
0011 = sonic sensor
0100 = fiber-optic sensor
0101 = radar sensor
0110 = lidar sensor
0111 = optical sensor
1000-1101 =  Reserved
 ...";
CM_ SG_ 3221225472 RearCollisionSensor3Type "Type of Rear Collision Sensor 3.
0000 = acceleration sensor
0001 = pressure sensor
0010 = rollrate sensor
0011 = sonic sensor
0100 = fiber-optic sensor
0101 = radar sensor
0110 = lidar sensor
0111 = optical sensor
1000-1101 =  Reserved
 ...";
CM_ SG_ 3221225472 RearCollisionSensor2Type "Type of Rear Collision Sensor 2.
0000 = acceleration sensor
0001 = pressure sensor
0010 = rollrate sensor
0011 = sonic sensor
0100 = fiber-optic sensor
0101 = radar sensor
0110 = lidar sensor
0111 = optical sensor
1000-1101 =  Reserved
 ...";
CM_ SG_ 3221225472 RearCollisionSensor1Type "Type of Rear Collision Sensor 1.
0000 = acceleration sensor
0001 = pressure sensor
0010 = rollrate sensor
0011 = sonic sensor
0100 = fiber-optic sensor
0101 = radar sensor
0110 = lidar sensor
0111 = optical sensor
1000-1101 =  Reserved
 ...";
CM_ SG_ 3221225472 SideCollisionSensorRearRightType "Type of Side Collision Sensor Rear - Right.
0000 = acceleration sensor
0001 = pressure sensor
0010 = rollrate sensor
0011 = sonic sensor
0100 = fiber-optic sensor
0101 = radar sensor
0110 = lidar sensor
0111 = optical sensor
1000-1101 = ...";
CM_ SG_ 3221225472 SdCllisionSensorMidRearRightType "Type of Side Collision Sensor Mid Rear - Right.
0000 = acceleration sensor
0001 = pressure sensor
0010 = rollrate sensor
0011 = sonic sensor
0100 = fiber-optic sensor
0101 = radar sensor
0110 = lidar sensor
0111 = optical sensor
1000-1101 = ...";
CM_ SG_ 3221225472 SdCllsionSensorMidFrontRightType "Type of Side Collision Sensor Mid Front - Right.
0000 = acceleration sensor
0001 = pressure sensor
0010 = rollrate sensor
0011 = sonic sensor
0100 = fiber-optic sensor
0101 = radar sensor
0110 = lidar sensor
0111 = optical sensor
1000-1101 ...";
CM_ SG_ 3221225472 SdeCollisionSensorFrontRightType "Type of Side Collision Sensor Front - Right.
0000 = acceleration sensor
0001 = pressure sensor
0010 = rollrate sensor
0011 = sonic sensor
0100 = fiber-optic sensor
0101 = radar sensor
0110 = lidar sensor
0111 = optical sensor
1000-1101 = ...";
CM_ SG_ 3221225472 SideCollisionSensorRearLeftType "Type of Side Collision Sensor Rear - Left.
0000 = acceleration sensor
0001 = pressure sensor
0010 = rollrate sensor
0011 = sonic sensor
0100 = fiber-optic sensor
0101 = radar sensor
0110 = lidar sensor
0111 = optical sensor
1000-1101 = ...";
CM_ SG_ 3221225472 SdCollisionSensorMidRearLeftType "Type of Side Collision Sensor Mid Rear - Left.
0000 = acceleration sensor
0001 = pressure sensor
0010 = rollrate sensor
0011 = sonic sensor
0100 = fiber-optic sensor
0101 = radar sensor
0110 = lidar sensor
0111 = optical sensor
1000-1101 = ...";
CM_ SG_ 3221225472 SdCllisionSensorMidFrontLeftType "Type of Side Collision Sensor Mid Front - Left.
0000 = acceleration sensor
0001 = pressure sensor
0010 = rollrate sensor
0011 = sonic sensor
0100 = fiber-optic sensor
0101 = radar sensor
0110 = lidar sensor
0111 = optical sensor
1000-1101 = ...";
CM_ SG_ 3221225472 SideCollisionSensorFrontLeftType "Type of Side Collision Sensor Front - Left.
0000 = acceleration sensor
0001 = pressure sensor
0010 = rollrate sensor
0011 = sonic sensor
0100 = fiber-optic sensor
0101 = radar sensor
0110 = lidar sensor
0111 = optical sensor
1000-1101 = ...";
CM_ SG_ 3221225472 FrontalCollisionSensor4Type "Type of Frontal Collision Sensor 4.
0000 = acceleration sensor
0001 = pressure sensor
0010 = rollrate sensor
0011 = sonic sensor
0100 = fiber-optic sensor
0101 = radar sensor
0110 = lidar sensor
0111 = optical sensor
1000-1101 =  Reserved
 ...";
CM_ SG_ 3221225472 FrontalCollisionSensor3Type "Type of Frontal Collision Sensor 3.
0000 = acceleration sensor
0001 = pressure sensor
0010 = rollrate sensor
0011 = sonic sensor
0100 = fiber-optic sensor
0101 = radar sensor
0110 = lidar sensor
0111 = optical sensor
1000-1101 =  Reserved
 ...";
CM_ SG_ 3221225472 FrontalCollisionSensor2Type "Type of Frontal Collision Sensor 2.
0000 = acceleration sensor
0001 = pressure sensor
0010 = rollrate sensor
0011 = sonic sensor
0100 = fiber-optic sensor
0101 = radar sensor
0110 = lidar sensor
0111 = optical sensor
1000-1101 =  Reserved
 ...";
CM_ SG_ 3221225472 FrontalCollisionSensor1Type "Type of Frontal Collision Sensor 1.
0000 = acceleration sensor
0001 = pressure sensor
0010 = rollrate sensor
0011 = sonic sensor
0100 = fiber-optic sensor
0101 = radar sensor
0110 = lidar sensor
0111 = optical sensor
1000-1101 =  Reserved
 ...";
CM_ SG_ 3221225472 CrashChecksum "The Crash Checksum is used to verify the signal path from the airbag ECU to other devices in case of a crash.
The 4 bit checksum is the sum of the high nibble and the low nibble of the sum of the identifier, the first 7 data bytes and the 4 bit ...";
CM_ SG_ 3221225472 CrashCounter "The Crash Counter prevents other ECUs from reacting to a faulty transmission of the Crash Notification PGN and serves as a safety mechanism. The Crash Counter becomes incremented by 1 for every sent message, starting with '0'. (0 follows 15)";
CM_ SG_ 3221225472 CrashType "Type of crash event. 

00001 = frontal crash
00010 = rear crash
00100 = side crash (left)
01000 = side crash (right)
10000 = rollover

It is possible to combine different Crash Types. (e.g. frontal and side crash (left) = 00101)";
CM_ SG_ 3221225472 EngChrgArClr2PrecoolerEfficiency "Engine charge air cooler 2 (CAC2) precooler efficiency is an indication of the precooler's ability to reduce the temperature of the gas that is being routed through the precooler. 0% = no reduction in temperature, 100% = maximum cooling. The CAC2 ...";
CM_ SG_ 3221225472 EngChrgArClr2PrecoolerOutletTemp "Temperature of the combustion air measured at the charge air cooler 2 precooler outlet.";
CM_ SG_ 3221225472 EngChrgArClr2PrecoolerIntakeTemp "Temperature of the combustion air measured at the charge air cooler 2 precooler Intake.";
CM_ SG_ 3221225472 EngChargeAirCooler2Efficiency "Engine charge air cooler 2 (CAC2) is an indication of the CAC's ability to reduce the temperature of the combustion air that is being routed through the CAC. 0% = no reduction in temperature, 100% = maximum cooling. The CAC2 efficiency is calculated ...";
CM_ SG_ 3221225472 EngChrgeAirCooler2AmbientAirTemp "Temperature of the air surrounding charge air cooler 2.";
CM_ SG_ 3221225472 EngChargeAirCooler2OutletTemp "Temperature of combustion air after it exits from the Charge Air Cooler 2 but before any mixing of recirculated exhaust gas.";
CM_ SG_ 3221225472 EngChargeAirCooler2IntakeTemp "Temperature of the combustion air measured at the charge air cooler 2 Intake.";
CM_ SG_ 3221225472 EngChrgArClr1PrecoolerEfficiency "Engine charge air cooler 1 (CAC1) precooler efficiency is an indication of the precooler's ability to reduce the temperature of the combustion air that is being routed through the precooler. 0% = no reduction in temperature, 100% = maximum cooling ...";
CM_ SG_ 3221225472 EngChrgArClr1PrecoolerOutletTemp "Temperature of the combustion air measured at the charge air cooler 1 precooler outlet.";
CM_ SG_ 3221225472 EngChrgArClr1PrecoolerIntakeTemp "Temperature of the combustion air measured at the charge air cooler 1 precooler intake.";
CM_ SG_ 3221225472 EngChargeAirCooler1Efficiency "Engine charge air cooler 1(CAC1) efficiency is an indication of the CAC's ability to reduce the temperature of the combustion air that is being routed through the CAC1. 0% = no reduction in temperature, 100% = maximum cooling. The CAC1 efficiency is ...";
CM_ SG_ 3221225472 EngChrgeAirCooler1AmbientAirTemp "Temperature of the air surrounding charge air cooler 1.";
CM_ SG_ 3221225472 EngChargeAirCooler1IntakeTemp "Temperature of the combustion air measured at the CAC 1 Intake.";
CM_ SG_ 3221225472 Joystick9Button9PressedStatus "Reports when the joystick button has been pressed.

00 Button not pressed
01 Button pressed
10 Error Indicator
11 Not Available";
CM_ SG_ 3221225472 Joystick9Button10PressedStatus "Reports when the joystick button has been pressed.

00 Button not pressed
01 Button pressed
10 Error Indicator
11 Not Available";
CM_ SG_ 3221225472 Joystick9Button11PressedStatus "Reports when the joystick button has been pressed.

00 Button not pressed
01 Button pressed
10 Error Indicator
11 Not Available";
CM_ SG_ 3221225472 Joystick9Button12PressedStatus "Reports when the joystick button has been pressed.

00 Button not pressed
01 Button pressed
10 Error Indicator
11 Not Available";
CM_ SG_ 3221225472 Joystick9Button5PressedStatus "Reports when the joystick button has been pressed.

00 Button not pressed
01 Button pressed
10 Error Indicator
11 Not Available";
CM_ SG_ 3221225472 Joystick9Button6PressedStatus "Reports when the joystick button has been pressed.

00 Button not pressed
01 Button pressed
10 Error Indicator
11 Not Available";
CM_ SG_ 3221225472 Joystick9Button7PressedStatus "Reports when the joystick button has been pressed.

00 Button not pressed
01 Button pressed
10 Error Indicator
11 Not Available";
CM_ SG_ 3221225472 Joystick9Button8PressedStatus "Reports when the joystick button has been pressed.

00 Button not pressed
01 Button pressed
10 Error Indicator
11 Not Available";
CM_ SG_ 3221225472 Joystick9Button1PressedStatus "Reports when the joystick button has been pressed.

00 Button not pressed
01 Button pressed
10 Error Indicator
11 Not Available";
CM_ SG_ 3221225472 Joystick9Button2PressedStatus "Reports when the joystick button has been pressed.

00 Button not pressed
01 Button pressed
10 Error Indicator
11 Not Available";
CM_ SG_ 3221225472 Joystick9Button3PressedStatus "Reports when the joystick button has been pressed.

00 Button not pressed
01 Button pressed
10 Error Indicator
11 Not Available";
CM_ SG_ 3221225472 Joystick9Button4PressedStatus "Reports when the joystick button has been pressed.

00 Button not pressed
01 Button pressed
10 Error Indicator
11 Not Available";
CM_ SG_ 3221225472 Joystick9XAxisDetentPosStatus "Reports when the current joystick position is in the detent position for that axis of travel.

00 Not in the Detent Position
01 In the Detent Position
10 Error Indicator
11 Not Available";
CM_ SG_ 3221225472 Joystick9YAxisDetentPosStatus "Reports when the current joystick position is in the detent position for that axis of travel.

00 Not in the Detent Position
01 In the Detent Position
10 Error Indicator
11 Not Available";
CM_ SG_ 3221225472 Joystick9YAxisPos "The position of the joystick in the relative motion of travel from the neutral position.  Position value of 0 is Neutral and position value 1000 (100%) is the end of linear zone.  Value of 1022 indicates an error has occurred.";
CM_ SG_ 3221225472 Jystck9YAxsLvrFrwrdPstvPosStatus "Reports when the current joystick position is on the positive travel side (forward, right, clockwise, up) relative to the neutral position for that axis of travel.
00 Not on Positive side of Neutral
01 On positive side of Neutral
10 Error ...";
CM_ SG_ 3221225472 Jystck9YAxsLvrBckNgtivePosStatus "Reports when the current joystick position is on the negative travel side (back, left, counterclockwise, down) relative to the neutral position for that axis of travel.
00 Not on negative side of Neutral
01 On negative side of Neutral
10 Error ...";
CM_ SG_ 3221225472 Joystick9YAxisNeutralPosStatus "Reports when the current joystick position is in the neutral position for that axis of travel.  The neutral position measurement must be determined from some mechanism other than the axis position measurement device.
00 Not in Neutral Position
01 ...";
CM_ SG_ 3221225472 Joystick9XAxisPos "The position of the joystick in the relative motion of travel from the neutral position.  Position value of 0 is Neutral and position value 1000 (100%) is the end of linear zone.  Value of 1022 indicates an error has occurred.";
CM_ SG_ 3221225472 Jystck9XAxsLvrRghtPstvePosStatus "Reports when the current joystick position is on the positive travel side (forward, right, clockwise, up) relative to the neutral position for that axis of travel.
00 Not on Positive side of Neutral
01 On positive side of Neutral
10 Error ...";
CM_ SG_ 3221225472 Jystck9XAxsLvrLftNgtivePosStatus "Reports when the current joystick position is on the negative travel side (back, left, counterclockwise, down) relative to the neutral position for that axis of travel.
00 Not on negative side of Neutral
01 On negative side of Neutral
10 Error ...";
CM_ SG_ 3221225472 Joystick9XAxisNeutralPosStatus "Reports when the current joystick position is in the neutral position for that axis of travel.  The neutral position measurement must be determined from some mechanism other than the axis position measurement device.
00 Not in Neutral Position
01 ...";
CM_ SG_ 3221225472 Joystick8Button9PressedStatus "Reports when the joystick button has been pressed.

00 Button not pressed
01 Button pressed
10 Error Indicator
11 Not Available";
CM_ SG_ 3221225472 Joystick8Button10PressedStatus "Reports when the joystick button has been pressed.

00 Button not pressed
01 Button pressed
10 Error Indicator
11 Not Available";
CM_ SG_ 3221225472 Joystick8Button11PressedStatus "Reports when the joystick button has been pressed.

00 Button not pressed
01 Button pressed
10 Error Indicator
11 Not Available";
CM_ SG_ 3221225472 Joystick8Button12PressedStatus "Reports when the joystick button has been pressed.

00 Button not pressed
01 Button pressed
10 Error Indicator
11 Not Available";
CM_ SG_ 3221225472 Joystick8Button5PressedStatus "Reports when the joystick button has been pressed.

00 Button not pressed
01 Button pressed
10 Error Indicator
11 Not Available";
CM_ SG_ 3221225472 Joystick8Button6PressedStatus "Reports when the joystick button has been pressed.

00 Button not pressed
01 Button pressed
10 Error Indicator
11 Not Available";
CM_ SG_ 3221225472 Joystick8Button7PressedStatus "Reports when the joystick button has been pressed.

00 Button not pressed
01 Button pressed
10 Error Indicator
11 Not Available";
CM_ SG_ 3221225472 Joystick8Button8PressedStatus "Reports when the joystick button has been pressed.

00 Button not pressed
01 Button pressed
10 Error Indicator
11 Not Available";
CM_ SG_ 3221225472 Joystick8Button1PressedStatus "Reports when the joystick button has been pressed.

00 Button not pressed
01 Button pressed
10 Error Indicator
11 Not Available";
CM_ SG_ 3221225472 Joystick8Button2PressedStatus "Reports when the joystick button has been pressed.

00 Button not pressed
01 Button pressed
10 Error Indicator
11 Not Available";
CM_ SG_ 3221225472 Joystick8Button3PressedStatus "Reports when the joystick button has been pressed.

00 Button not pressed
01 Button pressed
10 Error Indicator
11 Not Available";
CM_ SG_ 3221225472 Joystick8Button4PressedStatus "Reports when the joystick button has been pressed.

00 Button not pressed
01 Button pressed
10 Error Indicator
11 Not Available";
CM_ SG_ 3221225472 Joystick8XAxisDetentPosStatus "Reports when the current joystick position is in the detent position for that axis of travel.

00 Not in the Detent Position
01 In the Detent Position
10 Error Indicator
11 Not Available";
CM_ SG_ 3221225472 Joystick8YAxisDetentPosStatus "Reports when the current joystick position is in the detent position for that axis of travel.

00 Not in the Detent Position
01 In the Detent Position
10 Error Indicator
11 Not Available";
CM_ SG_ 3221225472 Joystick8YAxisPos "The position of the joystick in the relative motion of travel from the neutral position.  Position value of 0 is Neutral and position value 1000 (100%) is the end of linear zone.  Value of 1022 indicates an error has occurred.";
CM_ SG_ 3221225472 Jystck8YAxsLvrFrwrdPstvPosStatus "Reports when the current joystick position is on the positive travel side (forward, right, clockwise, up) relative to the neutral position for that axis of travel.
00 Not on Positive side of Neutral
01 On positive side of Neutral
10 Error ...";
CM_ SG_ 3221225472 Jystck8YAxsLvrBckNgtivePosStatus "Reports when the current joystick position is on the negative travel side (back, left, counterclockwise, down) relative to the neutral position for that axis of travel.
00 Not on negative side of Neutral
01 On negative side of Neutral
10 Error ...";
CM_ SG_ 3221225472 Joystick8YAxisNeutralPosStatus "Reports when the current joystick position is in the neutral position for that axis of travel.  The neutral position measurement must be determined from some mechanism other than the axis position measurement device.
00 Not in Neutral Position
01 ...";
CM_ SG_ 3221225472 Joystick8XAxisPos "The position of the joystick in the relative motion of travel from the neutral position.  Position value of 0 is Neutral and position value 1000 (100%) is the end of linear zone.  Value of 1022 indicates an error has occurred.";
CM_ SG_ 3221225472 Jystck8XAxsLvrRghtPstvePosStatus "Reports when the current joystick position is on the positive travel side (forward, right, clockwise, up) relative to the neutral position for that axis of travel.
00 Not on Positive side of Neutral
01 On positive side of Neutral
10 Error ...";
CM_ SG_ 3221225472 Jystck8XAxsLvrLftNgtivePosStatus "Reports when the current joystick position is on the negative travel side (back, left, counterclockwise, down) relative to the neutral position for that axis of travel.
00 Not on negative side of Neutral
01 On negative side of Neutral
10 Error ...";
CM_ SG_ 3221225472 Joystick8XAxisNeutralPosStatus "Reports when the current joystick position is in the neutral position for that axis of travel.  The neutral position measurement must be determined from some mechanism other than the axis position measurement device.
00 Not in Neutral Position
01 ...";
CM_ SG_ 3221225472 Joystick7Button9PressedStatus "Reports when the joystick button has been pressed.

00 Button not pressed
01 Button pressed
10 Error Indicator
11 Not Available";
CM_ SG_ 3221225472 Joystick7Button10PressedStatus "Reports when the joystick button has been pressed.

00 Button not pressed
01 Button pressed
10 Error Indicator
11 Not Available";
CM_ SG_ 3221225472 Joystick7Button11PressedStatus "Reports when the joystick button has been pressed.

00 Button not pressed
01 Button pressed
10 Error Indicator
11 Not Available";
BA_DEF_ SG_  "SigType" ENUM  "Default","Range","RangeSigned","ASCII","Discrete","Control","ReferencePGN","DTC","StringDelimiter","StringLength","StringLengthControl","MessageCounter","MessageChecksum";
BA_DEF_ SG_  "GenSigStartValue" INT 0 2147483647;
BA_DEF_ SG_  "GenSigSendType" ENUM  "Cyclic","OnWrite","OnWriteWithRepetition","OnChange","OnChangeWithRepetition","IfActive","IfActiveWithRepetition","NoSigSendType";
BA_DEF_ SG_  "GenSigILSupport" ENUM  "No","Yes";
BA_DEF_ SG_  "GenSigEVName" STRING ;
BA_DEF_ SG_  "SPN" INT 0 524287;
BA_DEF_ BO_  "TpJ1939VarDlc" ENUM  "No","Yes";
BA_DEF_ BO_  "GenMsgILSupport" ENUM  "No","Yes";
BA_DEF_ BO_  "GenMsgRequestable" INT 0 1;
BA_DEF_ BO_  "GenMsgSendType" ENUM  "cyclic","NotUsed","NotUsed","NotUsed","NotUsed","NotUsed","NotUsed","IfActive","noMsgSendType";
BA_DEF_ BO_  "VFrameFormat" ENUM  "StandardCAN","ExtendedCAN","reserved","J1939PG";
BA_DEF_ SG_  "SystemSignalLongSymbol" STRING ;
BA_DEF_DEF_  "SigType" "Default";
BA_DEF_DEF_  "GenSigStartValue" 0;
BA_DEF_DEF_  "GenSigSendType" "NoSigSendType";
BA_DEF_DEF_  "GenSigILSupport" "Yes";
BA_DEF_DEF_  "GenSigEVName" "Env@Nodename_@Signame";
BA_DEF_DEF_  "SPN" 0;
BA_DEF_DEF_  "TpJ1939VarDlc" "No";
BA_DEF_DEF_  "GenMsgILSupport" "Yes";
BA_DEF_DEF_  "GenMsgRequestable" 1;
BA_DEF_DEF_  "GenMsgSendType" "noMsgSendType";
BA_DEF_DEF_  "VFrameFormat" "J1939PG";
BA_DEF_DEF_  "SystemSignalLongSymbol" "";
BA_ "SPN" SG_ 3221225472 CrnkAttmptCntOnPrsntStartAttempt 3671;
BA_ "SigType" SG_ 3221225472 CrnkAttmptCntOnPrsntStartAttempt 1;
BA_ "SPN" SG_ 3221225472 EngIntakeManifoldPressCtrlMode 5465;
BA_ "SigType" SG_ 3221225472 EngIntakeManifoldPressCtrlMode 5;
BA_ "SPN" SG_ 3221225472 EngRotationDirection 3669;
BA_ "SigType" SG_ 3221225472 EngRotationDirection 4;
BA_ "SPN" SG_ 3221225472 EngRatedSpeed 189;
BA_ "SigType" SG_ 3221225472 EngRatedSpeed 1;
BA_ "SPN" SG_ 3221225472 EngRatedPower 166;
BA_ "SigType" SG_ 3221225472 EngRatedPower 1;
BA_ "SPN" SG_ 3221225472 AFT2ExhDewPoint 3240;
BA_ "SigType" SG_ 3221225472 AFT2ExhDewPoint 5;
BA_ "SPN" SG_ 3221225472 AFT2InDewPoint 3239;
BA_ "SigType" SG_ 3221225472 AFT2InDewPoint 5;
BA_ "SPN" SG_ 3221225472 AFT1ExhDewPoint 3238;
BA_ "SigType" SG_ 3221225472 AFT1ExhDewPoint 5;
BA_ "SPN" SG_ 3221225472 AFT1InDewPoint 3237;
BA_ "SigType" SG_ 3221225472 AFT1InDewPoint 5;
BA_ "SPN" SG_ 3221225472 AFT1ExhGasMFR 3236;
BA_ "SigType" SG_ 3221225472 AFT1ExhGasMFR 1;
BA_ "SPN" SG_ 3221225472 EstEngPrsiticLossesPercentTorque 2978;
BA_ "GenSigStartValue" SG_ 3221225472 EstEngPrsiticLossesPercentTorque 125;
BA_ "SigType" SG_ 3221225472 EstEngPrsiticLossesPercentTorque 1;
BA_ "SPN" SG_ 3221225472 EngnsDsrdOprtngSpdAsymmtryAdjstm 519;
BA_ "SigType" SG_ 3221225472 EngnsDsrdOprtngSpdAsymmtryAdjstm 1;
BA_ "SPN" SG_ 3221225472 EnginesDesiredOperatingSpeed 515;
BA_ "SigType" SG_ 3221225472 EnginesDesiredOperatingSpeed 1;
BA_ "SPN" SG_ 3221225472 NominalFrictionPercentTorque 514;
BA_ "SigType" SG_ 3221225472 NominalFrictionPercentTorque 1;
BA_ "SPN" SG_ 3221225472 EstPumpingPercentTorque 5398;
BA_ "SigType" SG_ 3221225472 EstPumpingPercentTorque 1;
BA_ "SPN" SG_ 3221225472 ActlMaxAvailableEngPercentTorque 3357;
BA_ "SigType" SG_ 3221225472 ActlMaxAvailableEngPercentTorque 1;
BA_ "SPN" SG_ 3221225472 SCRThermalManagementActive 5400;
BA_ "SigType" SG_ 3221225472 SCRThermalManagementActive 5;
BA_ "SPN" SG_ 3221225472 DPFThermalManagementActive 5399;
BA_ "SigType" SG_ 3221225472 DPFThermalManagementActive 5;
BA_ "SPN" SG_ 3221225472 MmntaryEngMaxPowerEnableFeedback 5021;
BA_ "SigType" SG_ 3221225472 MmntaryEngMaxPowerEnableFeedback 5;
BA_ "SPN" SG_ 3221225472 VhcleAccelerationRateLimitStatus 2979;
BA_ "SigType" SG_ 3221225472 VhcleAccelerationRateLimitStatus 5;
BA_ "SPN" SG_ 3221225472 AccelPedalPos2 29;
BA_ "SigType" SG_ 3221225472 AccelPedalPos2 1;
BA_ "SPN" SG_ 3221225472 RemoteAccelPedalPos 974;
BA_ "SigType" SG_ 3221225472 RemoteAccelPedalPos 1;
BA_ "SPN" SG_ 3221225472 EngPercentLoadAtCurrentSpeed 92;
BA_ "SigType" SG_ 3221225472 EngPercentLoadAtCurrentSpeed 1;
BA_ "SPN" SG_ 3221225472 AccelPedalPos1 91;
BA_ "SigType" SG_ 3221225472 AccelPedalPos1 1;
BA_ "SPN" SG_ 3221225472 AccelPedal2LowIdleSwitch 2970;
BA_ "SigType" SG_ 3221225472 AccelPedal2LowIdleSwitch 4;
BA_ "SPN" SG_ 3221225472 RoadSpeedLimitStatus 1437;
BA_ "SigType" SG_ 3221225472 RoadSpeedLimitStatus 5;
BA_ "SPN" SG_ 3221225472 AccelPedalKickdownSwitch 559;
BA_ "SigType" SG_ 3221225472 AccelPedalKickdownSwitch 4;
BA_ "SPN" SG_ 3221225472 AccelPedal1LowIdleSwitch 558;
BA_ "SigType" SG_ 3221225472 AccelPedal1LowIdleSwitch 4;
BA_ "SPN" SG_ 3221225472 EngDemandPercentTorque 2432;
BA_ "SigType" SG_ 3221225472 EngDemandPercentTorque 1;
BA_ "SPN" SG_ 3221225472 EngStarterMode 1675;
BA_ "SPN" SG_ 3221225472 SrcAddrssOfCntrllngDvcForEngCtrl 1483;
BA_ "SPN" SG_ 3221225472 EngSpeed 190;
BA_ "SigType" SG_ 3221225472 EngSpeed 1;
BA_ "SPN" SG_ 3221225472 ActualEngPercentTorque 513;
BA_ "GenSigStartValue" SG_ 3221225472 ActualEngPercentTorque 125;
BA_ "SigType" SG_ 3221225472 ActualEngPercentTorque 1;
BA_ "SPN" SG_ 3221225472 DriversDemandEngPercentTorque 512;
BA_ "GenSigStartValue" SG_ 3221225472 DriversDemandEngPercentTorque 125;
BA_ "SigType" SG_ 3221225472 DriversDemandEngPercentTorque 1;
BA_ "SPN" SG_ 3221225472 ActlEngPrcntTorqueHighResolution 4154;
BA_ "SPN" SG_ 3221225472 EngTorqueMode 899;
BA_ "SPN" SG_ 3221225472 ECUHardwareID 6714;
BA_ "SigType" SG_ 3221225472 ECUHardwareID 8;
BA_ "SPN" SG_ 3221225472 ECUManufacturerName 4304;
BA_ "SigType" SG_ 3221225472 ECUManufacturerName 8;
BA_ "SPN" SG_ 3221225472 ECUType 2904;
BA_ "SigType" SG_ 3221225472 ECUType 8;
BA_ "SPN" SG_ 3221225472 ECULocation 2903;
BA_ "SigType" SG_ 3221225472 ECULocation 8;
BA_ "SPN" SG_ 3221225472 ECUSerialNumber 2902;
BA_ "SigType" SG_ 3221225472 ECUSerialNumber 8;
BA_ "SPN" SG_ 3221225472 ECUPartNumber 2901;
BA_ "SigType" SG_ 3221225472 ECUPartNumber 8;
BA_ "SPN" SG_ 3221225472 EngMinContinuousTorque 1775;
BA_ "SigType" SG_ 3221225472 EngMinContinuousTorque 1;
BA_ "SPN" SG_ 3221225472 EngMaxContinuousTorque 1774;
BA_ "SigType" SG_ 3221225472 EngMaxContinuousTorque 1;
BA_ "SPN" SG_ 3221225472 EngMinContinuousRPM 1773;
BA_ "SigType" SG_ 3221225472 EngMinContinuousRPM 1;
BA_ "SPN" SG_ 3221225472 EngMaxContinuousRPM 1772;
BA_ "SigType" SG_ 3221225472 EngMaxContinuousRPM 1;
BA_ "SPN" SG_ 3221225472 EngHghLmtThrshldFrMnCntnsTrqFrmE 1771;
BA_ "SigType" SG_ 3221225472 EngHghLmtThrshldFrMnCntnsTrqFrmE 1;
BA_ "SPN" SG_ 3221225472 EngLwLmtThrshldFrMxTorqueFromEng 1770;
BA_ "SigType" SG_ 3221225472 EngLwLmtThrshldFrMxTorqueFromEng 1;
BA_ "SPN" SG_ 3221225472 EngHghLmtThrshldFrMnCntnusEngRPM 1769;
BA_ "SigType" SG_ 3221225472 EngHghLmtThrshldFrMnCntnusEngRPM 1;
BA_ "SPN" SG_ 3221225472 EngLwLmtThrsholdForMaxRPMFromEng 1768;
BA_ "SigType" SG_ 3221225472 EngLwLmtThrsholdForMaxRPMFromEng 1;
BA_ "SPN" SG_ 3221225472 SupportTSC1CtrlPurposeGroup4 3348;
BA_ "SPN" SG_ 3221225472 SupportTSC1CtrlPurposeGroup3 3347;
BA_ "SPN" SG_ 3221225472 SupportTSC1CtrlPurposeGroup2 3346;
BA_ "SPN" SG_ 3221225472 SupportTSC1CtrlPurposeGroup1 3345;
BA_ "SPN" SG_ 3221225472 SupportVariableRateTSC1Message 3344;
BA_ "SPN" SG_ 3221225472 EngDefaultTorqueLimit 1846;
BA_ "SigType" SG_ 3221225472 EngDefaultTorqueLimit 1;
BA_ "SPN" SG_ 3221225472 EngMomentOfInertia 1794;
BA_ "SigType" SG_ 3221225472 EngMomentOfInertia 1;
BA_ "SPN" SG_ 3221225472 EngExRngRqstdSpdCtrlRngUpprLimit 1712;
BA_ "SigType" SG_ 3221225472 EngExRngRqstdSpdCtrlRngUpprLimit 1;
BA_ "SPN" SG_ 3221225472 EngRqstdTrqueCtrlRangeUpperLimit 538;
BA_ "GenSigStartValue" SG_ 3221225472 EngRqstdTrqueCtrlRangeUpperLimit 125;
BA_ "SigType" SG_ 3221225472 EngRqstdTrqueCtrlRangeUpperLimit 1;
BA_ "SPN" SG_ 3221225472 EngRqstdTrqueCtrlRangeLowerLimit 537;
BA_ "GenSigStartValue" SG_ 3221225472 EngRqstdTrqueCtrlRangeLowerLimit 125;
BA_ "SigType" SG_ 3221225472 EngRqstdTrqueCtrlRangeLowerLimit 1;
BA_ "SPN" SG_ 3221225472 EngRqstdSpeedCtrlRangeUpperLimit 536;
BA_ "SigType" SG_ 3221225472 EngRqstdSpeedCtrlRangeUpperLimit 1;
BA_ "SPN" SG_ 3221225472 EngRqstdSpeedCtrlRangeLowerLimit 535;
BA_ "SigType" SG_ 3221225472 EngRqstdSpeedCtrlRangeLowerLimit 1;
BA_ "SPN" SG_ 3221225472 EngMaxMomentaryOverrideTimeLimit 534;
BA_ "SigType" SG_ 3221225472 EngMaxMomentaryOverrideTimeLimit 1;
BA_ "SPN" SG_ 3221225472 EngMxMmentaryOverrideSpeedPoint7 533;
BA_ "SigType" SG_ 3221225472 EngMxMmentaryOverrideSpeedPoint7 1;
BA_ "SPN" SG_ 3221225472 EngReferenceTorque 544;
BA_ "SigType" SG_ 3221225472 EngReferenceTorque 1;
BA_ "SPN" SG_ 3221225472 EngGain 545;
BA_ "SigType" SG_ 3221225472 EngGain 1;
BA_ "SPN" SG_ 3221225472 EngSpeedAtHighIdlePoint6 532;
BA_ "SigType" SG_ 3221225472 EngSpeedAtHighIdlePoint6 1;
BA_ "SPN" SG_ 3221225472 EngPercentTorqueAtPoint5 543;
BA_ "GenSigStartValue" SG_ 3221225472 EngPercentTorqueAtPoint5 125;
BA_ "SigType" SG_ 3221225472 EngPercentTorqueAtPoint5 1;
BA_ "SPN" SG_ 3221225472 EngSpeedAtPoint5 531;
BA_ "SigType" SG_ 3221225472 EngSpeedAtPoint5 1;
BA_ "SPN" SG_ 3221225472 EngPercentTorqueAtPoint4 542;
BA_ "GenSigStartValue" SG_ 3221225472 EngPercentTorqueAtPoint4 125;
BA_ "SigType" SG_ 3221225472 EngPercentTorqueAtPoint4 1;
BA_ "SPN" SG_ 3221225472 EngSpeedAtPoint4 530;
BA_ "SigType" SG_ 3221225472 EngSpeedAtPoint4 1;
BA_ "SPN" SG_ 3221225472 EngPercentTorqueAtPoint3 541;
BA_ "GenSigStartValue" SG_ 3221225472 EngPercentTorqueAtPoint3 125;
BA_ "SigType" SG_ 3221225472 EngPercentTorqueAtPoint3 1;
BA_ "SPN" SG_ 3221225472 EngSpeedAtPoint3 529;
BA_ "SigType" SG_ 3221225472 EngSpeedAtPoint3 1;
BA_ "SPN" SG_ 3221225472 EngPercentTorqueAtPoint2 540;
BA_ "GenSigStartValue" SG_ 3221225472 EngPercentTorqueAtPoint2 125;
BA_ "SigType" SG_ 3221225472 EngPercentTorqueAtPoint2 1;
BA_ "SPN" SG_ 3221225472 EngSpeedAtPoint2 528;
BA_ "SigType" SG_ 3221225472 EngSpeedAtPoint2 1;
BA_ "SPN" SG_ 3221225472 EngPercentTorqueAtIdlePoint1 539;
BA_ "GenSigStartValue" SG_ 3221225472 EngPercentTorqueAtIdlePoint1 125;
BA_ "SigType" SG_ 3221225472 EngPercentTorqueAtIdlePoint1 1;
BA_ "SPN" SG_ 3221225472 EngSpeedAtIdlePoint1 188;
BA_ "SigType" SG_ 3221225472 EngSpeedAtIdlePoint1 1;
BA_ "SPN" SG_ 3221225472 EmergencyBrakingActive 5847;
BA_ "SigType" SG_ 3221225472 EmergencyBrakingActive 5;
BA_ "SPN" SG_ 3221225472 PrkngBrakeActuatorFullyActivated 5275;
BA_ "SigType" SG_ 3221225472 PrkngBrakeActuatorFullyActivated 4;
BA_ "SPN" SG_ 3221225472 XBRAccelerationLimit 2921;
BA_ "GenSigStartValue" SG_ 3221225472 XBRAccelerationLimit 25;
BA_ "SigType" SG_ 3221225472 XBRAccelerationLimit 1;
BA_ "SPN" SG_ 3221225472 XBRActiveCtrlMode 2918;
BA_ "SPN" SG_ 3221225472 XBRSystemState 2917;
BA_ "SigType" SG_ 3221225472 XBRSystemState 5;
BA_ "SPN" SG_ 3221225472 FoundationBrakeUse 2919;
BA_ "SigType" SG_ 3221225472 FoundationBrakeUse 5;
BA_ "SPN" SG_ 3221225472 HillHolderMode 2912;
BA_ "SPN" SG_ 3221225472 HaltBrakeMode 2913;
BA_ "SPN" SG_ 3221225472 BrakeTempWarning 3839;
BA_ "SigType" SG_ 3221225472 BrakeTempWarning 5;
BA_ "SPN" SG_ 3221225472 BrkLnngRmningRearAxle3RightWheel 1106;
BA_ "SigType" SG_ 3221225472 BrkLnngRmningRearAxle3RightWheel 1;
BA_ "SPN" SG_ 3221225472 BrkLnngRminingRearAxle3LeftWheel 1105;
BA_ "SigType" SG_ 3221225472 BrkLnngRminingRearAxle3LeftWheel 1;
BA_ "SPN" SG_ 3221225472 BrkLnngRmningRearAxle2RightWheel 1104;
BA_ "SigType" SG_ 3221225472 BrkLnngRmningRearAxle2RightWheel 1;
BA_ "SPN" SG_ 3221225472 BrkLnngRminingRearAxle2LeftWheel 1103;
BA_ "SigType" SG_ 3221225472 BrkLnngRminingRearAxle2LeftWheel 1;
BA_ "SPN" SG_ 3221225472 BrkLnngRmningRearAxle1RightWheel 1102;
BA_ "SigType" SG_ 3221225472 BrkLnngRmningRearAxle1RightWheel 1;
BA_ "SPN" SG_ 3221225472 BrkLnngRminingRearAxle1LeftWheel 1101;
BA_ "SigType" SG_ 3221225472 BrkLnngRminingRearAxle1LeftWheel 1;
BA_ "SPN" SG_ 3221225472 BrkLnngRmningFrontAxleRightWheel 1100;
BA_ "SigType" SG_ 3221225472 BrkLnngRmningFrontAxleRightWheel 1;
BA_ "SPN" SG_ 3221225472 BrkLnngRminingFrontAxleLeftWheel 1099;
BA_ "SigType" SG_ 3221225472 BrkLnngRminingFrontAxleLeftWheel 1;
BA_ "SPN" SG_ 3221225472 BrkAppPrssHghRngRrAxl3RightWheel 1098;
BA_ "SigType" SG_ 3221225472 BrkAppPrssHghRngRrAxl3RightWheel 1;
BA_ "SPN" SG_ 3221225472 BrkAppPrssHghRngRrAxle3LeftWheel 1097;
BA_ "SigType" SG_ 3221225472 BrkAppPrssHghRngRrAxle3LeftWheel 1;
BA_ "SPN" SG_ 3221225472 BrkAppPrssHghRngRrAxl2RightWheel 1096;
BA_ "SigType" SG_ 3221225472 BrkAppPrssHghRngRrAxl2RightWheel 1;
BA_ "SPN" SG_ 3221225472 BrkAppPrssHghRngRrAxle2LeftWheel 1095;
BA_ "SigType" SG_ 3221225472 BrkAppPrssHghRngRrAxle2LeftWheel 1;
BA_ "SPN" SG_ 3221225472 BrkAppPrssHghRngRrAxle1LeftWheel 1093;
BA_ "SigType" SG_ 3221225472 BrkAppPrssHghRngRrAxle1LeftWheel 1;
BA_ "SPN" SG_ 3221225472 BrkAppPrssHghRngFrntAxlRghtWheel 1092;
BA_ "SigType" SG_ 3221225472 BrkAppPrssHghRngFrntAxlRghtWheel 1;
BA_ "SPN" SG_ 3221225472 BrkAppPrssHghRngFrntAxlLeftWheel 1091;
BA_ "SigType" SG_ 3221225472 BrkAppPrssHghRngFrntAxlLeftWheel 1;
BA_ "SPN" SG_ 3221225472 BrkAppPrssHghRngRrAxl1RightWheel 1094;
BA_ "SigType" SG_ 3221225472 BrkAppPrssHghRngRrAxl1RightWheel 1;
BA_ "SPN" SG_ 3221225472 RelativeSpeedRearAxle2RightWheel 910;
BA_ "SigType" SG_ 3221225472 RelativeSpeedRearAxle2RightWheel 1;
BA_ "SPN" SG_ 3221225472 RelativeSpeedRearAxle2LeftWheel 909;
BA_ "SigType" SG_ 3221225472 RelativeSpeedRearAxle2LeftWheel 1;
BA_ "SPN" SG_ 3221225472 RelativeSpeedRearAxle1RightWheel 908;
BA_ "SigType" SG_ 3221225472 RelativeSpeedRearAxle1RightWheel 1;
BA_ "SPN" SG_ 3221225472 RelativeSpeedRearAxle1LeftWheel 907;
BA_ "SigType" SG_ 3221225472 RelativeSpeedRearAxle1LeftWheel 1;
BA_ "SPN" SG_ 3221225472 RelativeSpeedFrontAxleRightWheel 906;
BA_ "SigType" SG_ 3221225472 RelativeSpeedFrontAxleRightWheel 1;
BA_ "SPN" SG_ 3221225472 RelativeSpeedFrontAxleLeftWheel 905;
BA_ "SigType" SG_ 3221225472 RelativeSpeedFrontAxleLeftWheel 1;
BA_ "SPN" SG_ 3221225472 FrontAxleSpeed 904;
BA_ "SigType" SG_ 3221225472 FrontAxleSpeed 1;
BA_ "SPN" SG_ 3221225472 TrctrMntdTrailerABSWarningSignal 1792;
BA_ "SigType" SG_ 3221225472 TrctrMntdTrailerABSWarningSignal 5;
BA_ "SPN" SG_ 3221225472 TrailerABSStatus 1836;
BA_ "SigType" SG_ 3221225472 TrailerABSStatus 5;
BA_ "SPN" SG_ 3221225472 HaltBrakeSwitch 2911;
BA_ "SigType" SG_ 3221225472 HaltBrakeSwitch 4;
BA_ "SPN" SG_ 3221225472 SrcAddrssOfCntrllngDvcFrBrkeCtrl 1481;
BA_ "SPN" SG_ 3221225472 ATC_ASRInformationSignal 1793;
BA_ "SigType" SG_ 3221225472 ATC_ASRInformationSignal 5;
BA_ "SPN" SG_ 3221225472 ABS_EBSAmberWarningSignal 1438;
BA_ "SigType" SG_ 3221225472 ABS_EBSAmberWarningSignal 5;
BA_ "SPN" SG_ 3221225472 EBSRedWarningSignal 1439;
BA_ "SigType" SG_ 3221225472 EBSRedWarningSignal 5;
BA_ "SPN" SG_ 3221225472 ABSFullyOperational 1243;
BA_ "SigType" SG_ 3221225472 ABSFullyOperational 5;
BA_ "SPN" SG_ 3221225472 EngRetarderSelection 973;
BA_ "SigType" SG_ 3221225472 EngRetarderSelection 1;
BA_ "SPN" SG_ 3221225472 RemoteAccelEnableSwitch 969;
BA_ "SigType" SG_ 3221225472 RemoteAccelEnableSwitch 4;
BA_ "SPN" SG_ 3221225472 EngAuxShutdownSwitch 970;
BA_ "SigType" SG_ 3221225472 EngAuxShutdownSwitch 4;
BA_ "SPN" SG_ 3221225472 EngDerateSwitch 971;
BA_ "SigType" SG_ 3221225472 EngDerateSwitch 4;
BA_ "SPN" SG_ 3221225472 AccelInterlockSwitch 972;
BA_ "SigType" SG_ 3221225472 AccelInterlockSwitch 4;
BA_ "SPN" SG_ 3221225472 TractionCtrlOverrideSwitch 1238;
BA_ "SigType" SG_ 3221225472 TractionCtrlOverrideSwitch 4;
BA_ "SPN" SG_ 3221225472 ASRHillHolderSwitch 577;
BA_ "SigType" SG_ 3221225472 ASRHillHolderSwitch 4;
BA_ "SPN" SG_ 3221225472 ASROffroadSwitch 576;
BA_ "SigType" SG_ 3221225472 ASROffroadSwitch 4;
BA_ "SPN" SG_ 3221225472 ABSOffroadSwitch 575;
BA_ "SigType" SG_ 3221225472 ABSOffroadSwitch 4;
BA_ "SPN" SG_ 3221225472 BrakePedalPos 521;
BA_ "SigType" SG_ 3221225472 BrakePedalPos 1;
BA_ "SPN" SG_ 3221225472 EBSBrakeSwitch 1121;
BA_ "SigType" SG_ 3221225472 EBSBrakeSwitch 4;
BA_ "SPN" SG_ 3221225472 AntiLockBrakingActive 563;
BA_ "SigType" SG_ 3221225472 AntiLockBrakingActive 5;
BA_ "SPN" SG_ 3221225472 ASRBrakeCtrlActive 562;
BA_ "SigType" SG_ 3221225472 ASRBrakeCtrlActive 5;
BA_ "SPN" SG_ 3221225472 ASREngCtrlActive 561;
BA_ "SigType" SG_ 3221225472 ASREngCtrlActive 5;
BA_ "SPN" SG_ 3221225472 DiffLockStRearAxle3 7716;
BA_ "SigType" SG_ 3221225472 DiffLockStRearAxle3 5;
BA_ "SPN" SG_ 3221225472 RearAxleGroupEngagementStatus 3820;
BA_ "SigType" SG_ 3221225472 RearAxleGroupEngagementStatus 5;
BA_ "SPN" SG_ 3221225472 FrontAxleGroupEngagementStatus 3819;
BA_ "SigType" SG_ 3221225472 FrontAxleGroupEngagementStatus 5;
BA_ "SPN" SG_ 3221225472 DiffLockStateCentralRear 566;
BA_ "SigType" SG_ 3221225472 DiffLockStateCentralRear 5;
BA_ "SPN" SG_ 3221225472 DiffLockStateCentralFront 565;
BA_ "SigType" SG_ 3221225472 DiffLockStateCentralFront 5;
BA_ "SPN" SG_ 3221225472 DiffLockStateCentral 564;
BA_ "SigType" SG_ 3221225472 DiffLockStateCentral 5;
BA_ "SPN" SG_ 3221225472 DiffLockStateRearAxle2 570;
BA_ "SigType" SG_ 3221225472 DiffLockStateRearAxle2 5;
BA_ "SPN" SG_ 3221225472 DiffLockStateRearAxle1 569;
BA_ "SigType" SG_ 3221225472 DiffLockStateRearAxle1 5;
BA_ "SPN" SG_ 3221225472 DiffLockStateFrontAxle2 568;
BA_ "SigType" SG_ 3221225472 DiffLockStateFrontAxle2 5;
BA_ "SPN" SG_ 3221225472 DiffLockStateFrontAxle1 567;
BA_ "SigType" SG_ 3221225472 DiffLockStateFrontAxle1 5;
BA_ "SPN" SG_ 3221225472 EngExRangeCoolantPress 20;
BA_ "SigType" SG_ 3221225472 EngExRangeCoolantPress 1;
BA_ "SPN" SG_ 3221225472 SeaWaterPumpOutletPress 2435;
BA_ "SigType" SG_ 3221225472 SeaWaterPumpOutletPress 1;
BA_ "SPN" SG_ 3221225472 EngAuxCoolantTemp 1212;
BA_ "SigType" SG_ 3221225472 EngAuxCoolantTemp 1;
BA_ "SPN" SG_ 3221225472 EngAuxCoolantPress 1203;
BA_ "SigType" SG_ 3221225472 EngAuxCoolantPress 1;
BA_ "SPN" SG_ 3221225472 Driver2Identification 1626;
BA_ "SigType" SG_ 3221225472 Driver2Identification 8;
BA_ "SPN" SG_ 3221225472 Driver1Identification 1625;
BA_ "SigType" SG_ 3221225472 Driver1Identification 8;
BA_ "SPN" SG_ 3221225472 EngOilFilterDiffPress7471 7471;
BA_ "SigType" SG_ 3221225472 EngOilFilterDiffPress7471 1;
BA_ "SPN" SG_ 3221225472 FuelLevel2 38;
BA_ "SigType" SG_ 3221225472 FuelLevel2 1;
BA_ "SPN" SG_ 3221225472 CargoAmbientTemp 169;
BA_ "SigType" SG_ 3221225472 CargoAmbientTemp 1;
BA_ "SPN" SG_ 3221225472 EngOilFilterDiffPress 99;
BA_ "SigType" SG_ 3221225472 EngOilFilterDiffPress 1;
BA_ "SPN" SG_ 3221225472 FuelLevel1 96;
BA_ "SigType" SG_ 3221225472 FuelLevel1 1;
BA_ "SPN" SG_ 3221225472 WasherFluidLevel 80;
BA_ "SigType" SG_ 3221225472 WasherFluidLevel 1;
BA_ "SPN" SG_ 3221225472 EngCyl8AverageCombustionDuration 6514;
BA_ "SigType" SG_ 3221225472 EngCyl8AverageCombustionDuration 1;
BA_ "SPN" SG_ 3221225472 EngCyl8AvrgCntrOfCmbustionTiming 6513;
BA_ "SigType" SG_ 3221225472 EngCyl8AvrgCntrOfCmbustionTiming 1;
BA_ "SPN" SG_ 3221225472 EngCyl8AvrgStrtOfCmbustionTiming 6512;
BA_ "SigType" SG_ 3221225472 EngCyl8AvrgStrtOfCmbustionTiming 1;
BA_ "SPN" SG_ 3221225472 EngCyl8IndctedMeanEffectivePress 6511;
BA_ "SigType" SG_ 3221225472 EngCyl8IndctedMeanEffectivePress 1;
BA_ "SPN" SG_ 3221225472 EngCyl7AverageCombustionDuration 6510;
BA_ "SigType" SG_ 3221225472 EngCyl7AverageCombustionDuration 1;
BA_ "SPN" SG_ 3221225472 EngCyl7AvrgCntrOfCmbustionTiming 6509;
BA_ "SigType" SG_ 3221225472 EngCyl7AvrgCntrOfCmbustionTiming 1;
BA_ "SPN" SG_ 3221225472 EngCyl7AvrgStrtOfCmbustionTiming 6508;
BA_ "SigType" SG_ 3221225472 EngCyl7AvrgStrtOfCmbustionTiming 1;
BA_ "SPN" SG_ 3221225472 EngCyl7IndctedMeanEffectivePress 6507;
BA_ "SigType" SG_ 3221225472 EngCyl7IndctedMeanEffectivePress 1;
BA_ "SPN" SG_ 3221225472 EngCyl6AverageCombustionDuration 6506;
BA_ "SigType" SG_ 3221225472 EngCyl6AverageCombustionDuration 1;
BA_ "SPN" SG_ 3221225472 EngCyl6AvrgCntrOfCmbustionTiming 6505;
BA_ "SigType" SG_ 3221225472 EngCyl6AvrgCntrOfCmbustionTiming 1;
BA_ "SPN" SG_ 3221225472 EngCyl6AvrgStrtOfCmbustionTiming 6504;
BA_ "SigType" SG_ 3221225472 EngCyl6AvrgStrtOfCmbustionTiming 1;
BA_ "SPN" SG_ 3221225472 EngCyl6IndctedMeanEffectivePress 6503;
BA_ "SigType" SG_ 3221225472 EngCyl6IndctedMeanEffectivePress 1;
BA_ "SPN" SG_ 3221225472 EngCyl5AverageCombustionDuration 6502;
BA_ "SigType" SG_ 3221225472 EngCyl5AverageCombustionDuration 1;
BA_ "SPN" SG_ 3221225472 EngCyl5AvrgCntrOfCmbustionTiming 6501;
BA_ "SigType" SG_ 3221225472 EngCyl5AvrgCntrOfCmbustionTiming 1;
BA_ "SPN" SG_ 3221225472 EngCyl5AvrgStrtOfCmbustionTiming 6500;
BA_ "SigType" SG_ 3221225472 EngCyl5AvrgStrtOfCmbustionTiming 1;
BA_ "SPN" SG_ 3221225472 EngCyl5IndctedMeanEffectivePress 6499;
BA_ "SigType" SG_ 3221225472 EngCyl5IndctedMeanEffectivePress 1;
BA_ "SPN" SG_ 3221225472 EngCyl4AverageCombustionDuration 6498;
BA_ "SigType" SG_ 3221225472 EngCyl4AverageCombustionDuration 1;
BA_ "SPN" SG_ 3221225472 EngCyl4AvrgCntrOfCmbustionTiming 6497;
BA_ "SigType" SG_ 3221225472 EngCyl4AvrgCntrOfCmbustionTiming 1;
BA_ "SPN" SG_ 3221225472 EngCyl4AvrgStrtOfCmbustionTiming 6496;
BA_ "SigType" SG_ 3221225472 EngCyl4AvrgStrtOfCmbustionTiming 1;
BA_ "SPN" SG_ 3221225472 EngCyl4IndctedMeanEffectivePress 6495;
BA_ "SigType" SG_ 3221225472 EngCyl4IndctedMeanEffectivePress 1;
BA_ "SPN" SG_ 3221225472 EngCyl3AverageCombustionDuration 6494;
BA_ "SigType" SG_ 3221225472 EngCyl3AverageCombustionDuration 1;
BA_ "SPN" SG_ 3221225472 EngCyl3AvrgCntrOfCmbustionTiming 6493;
BA_ "SigType" SG_ 3221225472 EngCyl3AvrgCntrOfCmbustionTiming 1;
BA_ "SPN" SG_ 3221225472 EngCyl3AvrgStrtOfCmbustionTiming 6492;
BA_ "SigType" SG_ 3221225472 EngCyl3AvrgStrtOfCmbustionTiming 1;
BA_ "SPN" SG_ 3221225472 EngCyl3IndctedMeanEffectivePress 6491;
BA_ "SigType" SG_ 3221225472 EngCyl3IndctedMeanEffectivePress 1;
BA_ "SPN" SG_ 3221225472 EngCldStrtFlIgniterRelayFeedback 5550;
BA_ "SigType" SG_ 3221225472 EngCldStrtFlIgniterRelayFeedback 4;
BA_ "SPN" SG_ 3221225472 EngColdStartFuelIgniterRelay 5549;
BA_ "SigType" SG_ 3221225472 EngColdStartFuelIgniterRelay 5;
BA_ "SPN" SG_ 3221225472 EngColdStartFuelIgniterCmd 5548;
BA_ "SigType" SG_ 3221225472 EngColdStartFuelIgniterCmd 1;
BA_ "SPN" SG_ 3221225472 EngStartEnableDevice2Config 2898;
BA_ "SPN" SG_ 3221225472 EngStartEnableDevice1Config 2899;
BA_ "SPN" SG_ 3221225472 EngStartEnableDevice2 1804;
BA_ "SigType" SG_ 3221225472 EngStartEnableDevice2 5;
BA_ "SPN" SG_ 3221225472 EngStartEnableDevice1 626;
BA_ "SigType" SG_ 3221225472 EngStartEnableDevice1 5;
BA_ "SPN" SG_ 3221225472 PoweredVehicleWeight 1585;
BA_ "SigType" SG_ 3221225472 PoweredVehicleWeight 1;
BA_ "SPN" SG_ 3221225472 GrossCombinationVehicleWeight 1760;
BA_ "SigType" SG_ 3221225472 GrossCombinationVehicleWeight 1;
BA_ "SPN" SG_ 3221225472 MxCntinuousRetarderTorqueLimitRq 1791;
BA_ "SigType" SG_ 3221225472 MxCntinuousRetarderTorqueLimitRq 1;
BA_ "SPN" SG_ 3221225472 MnCntinuousRetarderTorqueLimitRq 1790;
BA_ "SigType" SG_ 3221225472 MnCntinuousRetarderTorqueLimitRq 1;
BA_ "SPN" SG_ 3221225472 MxContinuousRetarderSpeedLimitRq 1789;
BA_ "SigType" SG_ 3221225472 MxContinuousRetarderSpeedLimitRq 1;
BA_ "SPN" SG_ 3221225472 MnContinuousRetarderSpeedLimitRq 1788;
BA_ "SigType" SG_ 3221225472 MnContinuousRetarderSpeedLimitRq 1;
BA_ "SPN" SG_ 3221225472 EngTorqueLimitRqMaxContinuous 1787;
BA_ "GenSigStartValue" SG_ 3221225472 EngTorqueLimitRqMaxContinuous 125;
BA_ "SigType" SG_ 3221225472 EngTorqueLimitRqMaxContinuous 1;
BA_ "SPN" SG_ 3221225472 EngTorqueLimitRqMinContinuous 1786;
BA_ "GenSigStartValue" SG_ 3221225472 EngTorqueLimitRqMinContinuous 125;
BA_ "SigType" SG_ 3221225472 EngTorqueLimitRqMinContinuous 1;
BA_ "SPN" SG_ 3221225472 EngSpeedLimitRqMaxContinuous 1785;
BA_ "SigType" SG_ 3221225472 EngSpeedLimitRqMaxContinuous 1;
BA_ "SPN" SG_ 3221225472 EngSpeedLimitRqMinContinuous 1784;
BA_ "SigType" SG_ 3221225472 EngSpeedLimitRqMinContinuous 1;
BA_ "SPN" SG_ 3221225472 EngAverageCombustionTime 1465;
BA_ "SigType" SG_ 3221225472 EngAverageCombustionTime 1;
BA_ "SPN" SG_ 3221225472 EngDesiredCombustionTime 1464;
BA_ "SigType" SG_ 3221225472 EngDesiredCombustionTime 1;
BA_ "SPN" SG_ 3221225472 EngCyl20CombustionTime 1463;
BA_ "SigType" SG_ 3221225472 EngCyl20CombustionTime 1;
BA_ "SPN" SG_ 3221225472 EngCyl19CombustionTime 1462;
BA_ "SigType" SG_ 3221225472 EngCyl19CombustionTime 1;
BA_ "SPN" SG_ 3221225472 EngCyl18CombustionTime 1461;
BA_ "SigType" SG_ 3221225472 EngCyl18CombustionTime 1;
BA_ "SPN" SG_ 3221225472 EngCyl17CombustionTime 1460;
BA_ "SigType" SG_ 3221225472 EngCyl17CombustionTime 1;
BA_ "SPN" SG_ 3221225472 EngCyl16CombustionTime 1459;
BA_ "SigType" SG_ 3221225472 EngCyl16CombustionTime 1;
BA_ "SPN" SG_ 3221225472 EngCyl15CombustionTime 1458;
BA_ "SigType" SG_ 3221225472 EngCyl15CombustionTime 1;
BA_ "SPN" SG_ 3221225472 EngCyl14CombustionTime 1457;
BA_ "SigType" SG_ 3221225472 EngCyl14CombustionTime 1;
BA_ "SPN" SG_ 3221225472 EngCyl13CombustionTime 1456;
BA_ "SigType" SG_ 3221225472 EngCyl13CombustionTime 1;
BA_ "SPN" SG_ 3221225472 EngCyl12CombustionTime 1455;
BA_ "SigType" SG_ 3221225472 EngCyl12CombustionTime 1;
BA_ "SPN" SG_ 3221225472 EngCyl11CombustionTime 1454;
BA_ "SigType" SG_ 3221225472 EngCyl11CombustionTime 1;
BA_ "SPN" SG_ 3221225472 EngCyl10CombustionTime 1453;
BA_ "SigType" SG_ 3221225472 EngCyl10CombustionTime 1;
BA_ "SPN" SG_ 3221225472 EngCyl9CombustionTime 1452;
BA_ "SigType" SG_ 3221225472 EngCyl9CombustionTime 1;
BA_ "SPN" SG_ 3221225472 EngCyl8CombustionTime 1451;
BA_ "SigType" SG_ 3221225472 EngCyl8CombustionTime 1;
BA_ "SPN" SG_ 3221225472 EngCyl7CombustionTime 1450;
BA_ "SigType" SG_ 3221225472 EngCyl7CombustionTime 1;
BA_ "SPN" SG_ 3221225472 EngCyl6CombustionTime 1449;
BA_ "SigType" SG_ 3221225472 EngCyl6CombustionTime 1;
BA_ "SPN" SG_ 3221225472 EngCyl5CombustionTime 1448;
BA_ "SigType" SG_ 3221225472 EngCyl5CombustionTime 1;
BA_ "SPN" SG_ 3221225472 EngCyl4CombustionTime 1447;
BA_ "SigType" SG_ 3221225472 EngCyl4CombustionTime 1;
BA_ "SPN" SG_ 3221225472 EngCyl3CombustionTime 1446;
BA_ "SigType" SG_ 3221225472 EngCyl3CombustionTime 1;
BA_ "SPN" SG_ 3221225472 EngCyl2CombustionTime 1445;
BA_ "SigType" SG_ 3221225472 EngCyl2CombustionTime 1;
BA_ "SPN" SG_ 3221225472 EngCyl1CombustionTime 1444;
BA_ "SigType" SG_ 3221225472 EngCyl1CombustionTime 1;
BA_ "SPN" SG_ 3221225472 TotalCountOfConfigChangesMade 2887;
BA_ "SigType" SG_ 3221225472 TotalCountOfConfigChangesMade 1;
BA_ "SPN" SG_ 3221225472 VehTrailerStatus 7711;
BA_ "SigType" SG_ 3221225472 VehTrailerStatus 4;
BA_ "SPN" SG_ 3221225472 TransOilLevelRq 3809;
BA_ "SigType" SG_ 3221225472 TransOilLevelRq 5;
BA_ "SPN" SG_ 3221225472 FifthWheelReleaseCtrl 3314;
BA_ "SigType" SG_ 3221225472 FifthWheelReleaseCtrl 4;
BA_ "SPN" SG_ 3221225472 FfthWhlRleaseCtrlSecurityLockout 3315;
BA_ "SigType" SG_ 3221225472 FfthWhlRleaseCtrlSecurityLockout 4;
BA_ "SPN" SG_ 3221225472 TransferCaseSelectorSwitch 2796;
BA_ "SPN" SG_ 3221225472 SelectedMaxVehicleSpeedLimit 2596;
BA_ "SigType" SG_ 3221225472 SelectedMaxVehicleSpeedLimit 1;
BA_ "SPN" SG_ 3221225472 RqCabZoneHeating 1686;
BA_ "SigType" SG_ 3221225472 RqCabZoneHeating 5;
BA_ "SPN" SG_ 3221225472 RqEngZoneHeating 1685;
BA_ "SigType" SG_ 3221225472 RqEngZoneHeating 5;
BA_ "SPN" SG_ 3221225472 AuxHeaterModeRq 1683;
BA_ "SPN" SG_ 3221225472 EngAutomaticStartEnableSwitch 1656;
BA_ "SigType" SG_ 3221225472 EngAutomaticStartEnableSwitch 4;
BA_ "SPN" SG_ 3221225472 AtomaticGearShiftingEnableSwitch 1666;
BA_ "SigType" SG_ 3221225472 AtomaticGearShiftingEnableSwitch 4;
BA_ "SPN" SG_ 3221225472 AFTRegenForceSw 3696;
BA_ "SigType" SG_ 3221225472 AFTRegenForceSw 4;
BA_ "SPN" SG_ 3221225472 AFTRegenInhSw 3695;
BA_ "SigType" SG_ 3221225472 AFTRegenInhSw 4;
BA_ "SPN" SG_ 3221225472 VhclLmtngSpdGovernorEnableSwitch 1653;
BA_ "SigType" SG_ 3221225472 VhclLmtngSpdGovernorEnableSwitch 4;
BA_ "SPN" SG_ 3221225472 VhclLmtngSpdGvrnrIncrementSwitch 1654;
BA_ "SigType" SG_ 3221225472 VhclLmtngSpdGvrnrIncrementSwitch 4;
BA_ "SPN" SG_ 3221225472 VhclLmtngSpdGvrnrDecrementSwitch 1655;
BA_ "SigType" SG_ 3221225472 VhclLmtngSpdGvrnrDecrementSwitch 4;
BA_ "SPN" SG_ 3221225472 ParkBrakeCmd 5630;
BA_ "SigType" SG_ 3221225472 ParkBrakeCmd 5;
BA_ "SPN" SG_ 3221225472 SeatBeltSwitch 1856;
BA_ "SigType" SG_ 3221225472 SeatBeltSwitch 4;
BA_ "SPN" SG_ 3221225472 OperatorSeatDirectionSwitch 1714;
BA_ "SigType" SG_ 3221225472 OperatorSeatDirectionSwitch 4;
BA_ "SPN" SG_ 3221225472 BatteryMainSwitchHoldRq 1682;
BA_ "SigType" SG_ 3221225472 BatteryMainSwitchHoldRq 5;
BA_ "SPN" SG_ 3221225472 AuxHeaterCoolantPumpRq 1684;
BA_ "SigType" SG_ 3221225472 AuxHeaterCoolantPumpRq 5;
BA_ "SPN" SG_ 3221225472 CabInteriorTempCmd 1691;
BA_ "SigType" SG_ 3221225472 CabInteriorTempCmd 1;
BA_ "SPN" SG_ 3221225472 RequestedPercentFanSpeed 986;
BA_ "SigType" SG_ 3221225472 RequestedPercentFanSpeed 1;
BA_ "SPN" SG_ 3221225472 SwtchBcklghtIllmntnBrghtnssPrcnt 5532;
BA_ "SigType" SG_ 3221225472 SwtchBcklghtIllmntnBrghtnssPrcnt 1;
BA_ "SPN" SG_ 3221225472 IlluminationBrightnessPercent 1487;
BA_ "SigType" SG_ 3221225472 IlluminationBrightnessPercent 1;
BA_ "SPN" SG_ 3221225472 SwtchIndctnIllmntnBrghtnssPrcent 6820;
BA_ "SigType" SG_ 3221225472 SwtchIndctnIllmntnBrghtnssPrcent 1;
BA_ "SPN" SG_ 3221225472 UnitNumber 233;
BA_ "SigType" SG_ 3221225472 UnitNumber 8;
BA_ "SPN" SG_ 3221225472 SerialNumber 588;
BA_ "SigType" SG_ 3221225472 SerialNumber 8;
BA_ "SPN" SG_ 3221225472 Model 587;
BA_ "SigType" SG_ 3221225472 Model 8;
BA_ "SPN" SG_ 3221225472 Make 586;
BA_ "SigType" SG_ 3221225472 Make 8;
BA_ "SPN" SG_ 3221225472 EngShutdownOverrideSwitch 1237;
BA_ "SigType" SG_ 3221225472 EngShutdownOverrideSwitch 4;
BA_ "SPN" SG_ 3221225472 EngTestModeSwitch 966;
BA_ "SigType" SG_ 3221225472 EngTestModeSwitch 4;
BA_ "SPN" SG_ 3221225472 EngIdleDecrementSwitch 967;
BA_ "SigType" SG_ 3221225472 EngIdleDecrementSwitch 4;
BA_ "SPN" SG_ 3221225472 EngIdleIncrementSwitch 968;
BA_ "SigType" SG_ 3221225472 EngIdleIncrementSwitch 4;
BA_ "SPN" SG_ 3221225472 CruiseCtrlStates 527;
BA_ "SPN" SG_ 3221225472 PTOGovernorState 976;
BA_ "SPN" SG_ 3221225472 CruiseCtrlSetSpeed 86;
BA_ "SigType" SG_ 3221225472 CruiseCtrlSetSpeed 1;
BA_ "SPN" SG_ 3221225472 CruiseCtrlAccelerateSwitch 602;
BA_ "SigType" SG_ 3221225472 CruiseCtrlAccelerateSwitch 4;
BA_ "SPN" SG_ 3221225472 CruiseCtrlResumeSwitch 601;
BA_ "SigType" SG_ 3221225472 CruiseCtrlResumeSwitch 4;
BA_ "SPN" SG_ 3221225472 CruiseCtrlCoastSwitch 600;
BA_ "SigType" SG_ 3221225472 CruiseCtrlCoastSwitch 4;
BA_ "SPN" SG_ 3221225472 CruiseCtrlSetSwitch 599;
BA_ "SigType" SG_ 3221225472 CruiseCtrlSetSwitch 4;
BA_ "SPN" SG_ 3221225472 ClutchSwitch 598;
BA_ "SigType" SG_ 3221225472 ClutchSwitch 4;
BA_ "SPN" SG_ 3221225472 BrakeSwitch 597;
BA_ "SigType" SG_ 3221225472 BrakeSwitch 4;
BA_ "SPN" SG_ 3221225472 CruiseCtrlEnableSwitch 596;
BA_ "SigType" SG_ 3221225472 CruiseCtrlEnableSwitch 4;
BA_ "SPN" SG_ 3221225472 CruiseCtrlActive 595;
BA_ "SigType" SG_ 3221225472 CruiseCtrlActive 4;
BA_ "SPN" SG_ 3221225472 WheelBasedVehicleSpeed 84;
BA_ "SigType" SG_ 3221225472 WheelBasedVehicleSpeed 1;
BA_ "SPN" SG_ 3221225472 ParkBrakeReleaseInhibitRq 3807;
BA_ "SigType" SG_ 3221225472 ParkBrakeReleaseInhibitRq 5;
BA_ "SPN" SG_ 3221225472 CruiseCtrlPauseSwitch 1633;
BA_ "SigType" SG_ 3221225472 CruiseCtrlPauseSwitch 4;
BA_ "SPN" SG_ 3221225472 ParkingBrakeSwitch 70;
BA_ "SigType" SG_ 3221225472 ParkingBrakeSwitch 4;
BA_ "SPN" SG_ 3221225472 TwoSpeedAxleSwitch 69;
BA_ "SigType" SG_ 3221225472 TwoSpeedAxleSwitch 4;
BA_ "SPN" SG_ 3221225472 MaxVehicleSpeedLimit6808 6808;
BA_ "SigType" SG_ 3221225472 MaxVehicleSpeedLimit6808 1;
BA_ "SPN" SG_ 3221225472 CruiseCtrlLowSetLimitSpeed 88;
BA_ "SigType" SG_ 3221225472 CruiseCtrlLowSetLimitSpeed 1;
BA_ "SPN" SG_ 3221225472 CruiseCtrlHighSetLimitSpeed 87;
BA_ "SigType" SG_ 3221225472 CruiseCtrlHighSetLimitSpeed 1;
BA_ "SPN" SG_ 3221225472 AuxHeaterMaxOutputPower 1690;
BA_ "SigType" SG_ 3221225472 AuxHeaterMaxOutputPower 1;
BA_ "SPN" SG_ 3221225472 TripServiceBrakeApplications 993;
BA_ "SigType" SG_ 3221225472 TripServiceBrakeApplications 1;
BA_ "SPN" SG_ 3221225472 TripServiceBrakeDistance 992;
BA_ "SigType" SG_ 3221225472 TripServiceBrakeDistance 1;
BA_ "SPN" SG_ 3221225472 TripCompressionBrakeDistance 991;
BA_ "SigType" SG_ 3221225472 TripCompressionBrakeDistance 1;
BA_ "SPN" SG_ 3221225472 TotalCompressionBrakeDistance 990;
BA_ "SigType" SG_ 3221225472 TotalCompressionBrakeDistance 1;
BA_ "SPN" SG_ 3221225472 CbA_CRfrgrntCmpressorOutletPress 2609;
BA_ "SigType" SG_ 3221225472 CbA_CRfrgrntCmpressorOutletPress 1;
BA_ "SPN" SG_ 3221225472 SLIBattery4Temp 2780;
BA_ "SigType" SG_ 3221225472 SLIBattery4Temp 1;
BA_ "SPN" SG_ 3221225472 SLIBattery3Temp 2779;
BA_ "SigType" SG_ 3221225472 SLIBattery3Temp 1;
BA_ "SPN" SG_ 3221225472 Battery2Temp 1801;
BA_ "SigType" SG_ 3221225472 Battery2Temp 1;
BA_ "SPN" SG_ 3221225472 Battery1Temp 1800;
BA_ "SigType" SG_ 3221225472 Battery1Temp 1;
BA_ "SPN" SG_ 3221225472 VhclAccelerationRateLimitLampCmd 6899;
BA_ "SigType" SG_ 3221225472 VhclAccelerationRateLimitLampCmd 5;
BA_ "SPN" SG_ 3221225472 EngSpeedVeryHighLampCmd 6710;
BA_ "SigType" SG_ 3221225472 EngSpeedVeryHighLampCmd 5;
BA_ "SPN" SG_ 3221225472 EngSpeedHighLampCmd 6709;
BA_ "SigType" SG_ 3221225472 EngSpeedHighLampCmd 5;
BA_ "SPN" SG_ 3221225472 EngCtrlModule3ReadyForUseLampCmd 6207;
BA_ "SigType" SG_ 3221225472 EngCtrlModule3ReadyForUseLampCmd 5;
BA_ "SPN" SG_ 3221225472 EngCtrlModule2ReadyForUseLampCmd 6206;
BA_ "SigType" SG_ 3221225472 EngCtrlModule2ReadyForUseLampCmd 5;
BA_ "SPN" SG_ 3221225472 EngCtrlModule1ReadyForUseLampCmd 6205;
BA_ "SigType" SG_ 3221225472 EngCtrlModule1ReadyForUseLampCmd 5;
BA_ "SPN" SG_ 3221225472 EngFuelFilterRestrictedLampCmd 5469;
BA_ "SigType" SG_ 3221225472 EngFuelFilterRestrictedLampCmd 5;
BA_ "SPN" SG_ 3221225472 EngAirFilterRestrictionLampCmd 5086;
BA_ "SigType" SG_ 3221225472 EngAirFilterRestrictionLampCmd 5;
BA_ "SPN" SG_ 3221225472 EngIdleManagementActiveLampCmd 5085;
BA_ "SigType" SG_ 3221225472 EngIdleManagementActiveLampCmd 5;
BA_ "SPN" SG_ 3221225472 EngCoolantLevelLowLampCmd 5084;
BA_ "SigType" SG_ 3221225472 EngCoolantLevelLowLampCmd 5;
BA_ "SPN" SG_ 3221225472 EngCoolantTempHighLampCmd 5083;
BA_ "SigType" SG_ 3221225472 EngCoolantTempHighLampCmd 5;
BA_ "SPN" SG_ 3221225472 EngOilPressLowLampCmd 5082;
BA_ "SigType" SG_ 3221225472 EngOilPressLowLampCmd 5;
BA_ "SPN" SG_ 3221225472 CmprssnBrkEnblSwtchIndctrLampCmd 3987;
BA_ "SigType" SG_ 3221225472 CmprssnBrkEnblSwtchIndctrLampCmd 5;
BA_ "SPN" SG_ 3221225472 EngBrakeActiveLampCmd 5081;
BA_ "SigType" SG_ 3221225472 EngBrakeActiveLampCmd 5;
BA_ "SPN" SG_ 3221225472 OBDMalfunctionIndicatorLampCmd 5080;
BA_ "SigType" SG_ 3221225472 OBDMalfunctionIndicatorLampCmd 5;
BA_ "SPN" SG_ 3221225472 EngRedStopLampCmd 5079;
BA_ "SigType" SG_ 3221225472 EngRedStopLampCmd 5;
BA_ "SPN" SG_ 3221225472 EngAmberWarningLampCmd 5078;
BA_ "SigType" SG_ 3221225472 EngAmberWarningLampCmd 5;
BA_ "SPN" SG_ 3221225472 EngProtectLampCmd 5077;
BA_ "SigType" SG_ 3221225472 EngProtectLampCmd 5;
BA_ "SPN" SG_ 3221225472 RolloverSensorType 4934;
BA_ "SPN" SG_ 3221225472 RearCollisionSensor4Type 4933;
BA_ "SPN" SG_ 3221225472 RearCollisionSensor3Type 4932;
BA_ "SPN" SG_ 3221225472 RearCollisionSensor2Type 4931;
BA_ "SPN" SG_ 3221225472 RearCollisionSensor1Type 4930;
BA_ "SPN" SG_ 3221225472 SideCollisionSensorRearRightType 4929;
BA_ "SPN" SG_ 3221225472 SdCllisionSensorMidRearRightType 4928;
BA_ "SPN" SG_ 3221225472 SdCllsionSensorMidFrontRightType 4927;
BA_ "SPN" SG_ 3221225472 SdeCollisionSensorFrontRightType 4926;
BA_ "SPN" SG_ 3221225472 SideCollisionSensorRearLeftType 4925;
BA_ "SPN" SG_ 3221225472 SdCollisionSensorMidRearLeftType 4924;
BA_ "SPN" SG_ 3221225472 SdCllisionSensorMidFrontLeftType 4923;
BA_ "SPN" SG_ 3221225472 SideCollisionSensorFrontLeftType 4922;
BA_ "SPN" SG_ 3221225472 FrontalCollisionSensor4Type 4921;
BA_ "SPN" SG_ 3221225472 FrontalCollisionSensor3Type 4920;
BA_ "SPN" SG_ 3221225472 FrontalCollisionSensor2Type 4919;
BA_ "SPN" SG_ 3221225472 FrontalCollisionSensor1Type 4918;
BA_ "SPN" SG_ 3221225472 CrashChecksum 4975;
BA_ "SigType" SG_ 3221225472 CrashChecksum 12;
BA_ "SPN" SG_ 3221225472 CrashCounter 4974;
BA_ "SigType" SG_ 3221225472 CrashCounter 11;
BA_ "SPN" SG_ 3221225472 CrashType 4973;
BA_ "SPN" SG_ 3221225472 EngChrgArClr2PrecoolerEfficiency 5288;
BA_ "SigType" SG_ 3221225472 EngChrgArClr2PrecoolerEfficiency 1;
BA_ "SPN" SG_ 3221225472 EngChrgArClr2PrecoolerOutletTemp 5287;
BA_ "SigType" SG_ 3221225472 EngChrgArClr2PrecoolerOutletTemp 1;
BA_ "SPN" SG_ 3221225472 EngChrgArClr2PrecoolerIntakeTemp 5286;
BA_ "SigType" SG_ 3221225472 EngChrgArClr2PrecoolerIntakeTemp 1;
BA_ "SPN" SG_ 3221225472 EngChargeAirCooler2Efficiency 5292;
BA_ "SigType" SG_ 3221225472 EngChargeAirCooler2Efficiency 1;
BA_ "SPN" SG_ 3221225472 EngChrgeAirCooler2AmbientAirTemp 5291;
BA_ "SigType" SG_ 3221225472 EngChrgeAirCooler2AmbientAirTemp 1;
BA_ "SPN" SG_ 3221225472 EngChargeAirCooler2OutletTemp 5290;
BA_ "SigType" SG_ 3221225472 EngChargeAirCooler2OutletTemp 1;
BA_ "SPN" SG_ 3221225472 EngChargeAirCooler2IntakeTemp 5289;
BA_ "SigType" SG_ 3221225472 EngChargeAirCooler2IntakeTemp 1;
BA_ "SPN" SG_ 3221225472 EngChrgArClr1PrecoolerEfficiency 5282;
BA_ "SigType" SG_ 3221225472 EngChrgArClr1PrecoolerEfficiency 1;
BA_ "SPN" SG_ 3221225472 EngChrgArClr1PrecoolerOutletTemp 5281;
BA_ "SigType" SG_ 3221225472 EngChrgArClr1PrecoolerOutletTemp 1;
BA_ "SPN" SG_ 3221225472 EngChrgArClr1PrecoolerIntakeTemp 5280;
BA_ "SigType" SG_ 3221225472 EngChrgArClr1PrecoolerIntakeTemp 1;
BA_ "SPN" SG_ 3221225472 EngChargeAirCooler1Efficiency 5285;
BA_ "SigType" SG_ 3221225472 EngChargeAirCooler1Efficiency 1;
BA_ "SPN" SG_ 3221225472 EngChrgeAirCooler1AmbientAirTemp 5284;
BA_ "SigType" SG_ 3221225472 EngChrgeAirCooler1AmbientAirTemp 1;
BA_ "SPN" SG_ 3221225472 EngChargeAirCooler1IntakeTemp 5283;
BA_ "SigType" SG_ 3221225472 EngChargeAirCooler1IntakeTemp 1;
BA_ "SPN" SG_ 3221225472 Joystick9Button9PressedStatus 4697;
BA_ "SigType" SG_ 3221225472 Joystick9Button9PressedStatus 4;
BA_ "SPN" SG_ 3221225472 Joystick9Button10PressedStatus 4696;
BA_ "SigType" SG_ 3221225472 Joystick9Button10PressedStatus 4;
BA_ "SPN" SG_ 3221225472 Joystick9Button11PressedStatus 4695;
BA_ "SigType" SG_ 3221225472 Joystick9Button11PressedStatus 4;
BA_ "SPN" SG_ 3221225472 Joystick9Button12PressedStatus 4694;
BA_ "SigType" SG_ 3221225472 Joystick9Button12PressedStatus 4;
BA_ "SPN" SG_ 3221225472 Joystick9Button5PressedStatus 4693;
BA_ "SigType" SG_ 3221225472 Joystick9Button5PressedStatus 4;
BA_ "SPN" SG_ 3221225472 Joystick9Button6PressedStatus 4692;
BA_ "SigType" SG_ 3221225472 Joystick9Button6PressedStatus 4;
BA_ "SPN" SG_ 3221225472 Joystick9Button7PressedStatus 4691;
BA_ "SigType" SG_ 3221225472 Joystick9Button7PressedStatus 4;
BA_ "SPN" SG_ 3221225472 Joystick9Button8PressedStatus 4690;
BA_ "SigType" SG_ 3221225472 Joystick9Button8PressedStatus 4;
BA_ "SPN" SG_ 3221225472 Joystick9Button1PressedStatus 4689;
BA_ "SigType" SG_ 3221225472 Joystick9Button1PressedStatus 4;
BA_ "SPN" SG_ 3221225472 Joystick9Button2PressedStatus 4688;
BA_ "SigType" SG_ 3221225472 Joystick9Button2PressedStatus 4;
BA_ "SPN" SG_ 3221225472 Joystick9Button3PressedStatus 4687;
BA_ "SigType" SG_ 3221225472 Joystick9Button3PressedStatus 4;
BA_ "SPN" SG_ 3221225472 Joystick9Button4PressedStatus 4686;
BA_ "SigType" SG_ 3221225472 Joystick9Button4PressedStatus 4;
BA_ "SPN" SG_ 3221225472 Joystick9XAxisDetentPosStatus 4685;
BA_ "SigType" SG_ 3221225472 Joystick9XAxisDetentPosStatus 4;
BA_ "SPN" SG_ 3221225472 Joystick9YAxisDetentPosStatus 4684;
BA_ "SigType" SG_ 3221225472 Joystick9YAxisDetentPosStatus 4;
BA_ "SPN" SG_ 3221225472 Joystick9YAxisPos 4683;
BA_ "SPN" SG_ 3221225472 Jystck9YAxsLvrFrwrdPstvPosStatus 4682;
BA_ "SigType" SG_ 3221225472 Jystck9YAxsLvrFrwrdPstvPosStatus 4;
BA_ "SPN" SG_ 3221225472 Jystck9YAxsLvrBckNgtivePosStatus 4681;
BA_ "SigType" SG_ 3221225472 Jystck9YAxsLvrBckNgtivePosStatus 4;
BA_ "SPN" SG_ 3221225472 Joystick9YAxisNeutralPosStatus 4680;
BA_ "SigType" SG_ 3221225472 Joystick9YAxisNeutralPosStatus 4;
BA_ "SPN" SG_ 3221225472 Joystick9XAxisPos 4679;
BA_ "SPN" SG_ 3221225472 Jystck9XAxsLvrRghtPstvePosStatus 4678;
BA_ "SigType" SG_ 3221225472 Jystck9XAxsLvrRghtPstvePosStatus 4;
BA_ "SPN" SG_ 3221225472 Jystck9XAxsLvrLftNgtivePosStatus 4677;
BA_ "SigType" SG_ 3221225472 Jystck9XAxsLvrLftNgtivePosStatus 4;
BA_ "SPN" SG_ 3221225472 Joystick9XAxisNeutralPosStatus 4676;
BA_ "SigType" SG_ 3221225472 Joystick9XAxisNeutralPosStatus 4;
BA_ "SPN" SG_ 3221225472 Joystick8Button9PressedStatus 4660;
BA_ "SigType" SG_ 3221225472 Joystick8Button9PressedStatus 4;
BA_ "SPN" SG_ 3221225472 Joystick8Button10PressedStatus 4659;
BA_ "SigType" SG_ 3221225472 Joystick8Button10PressedStatus 4;
BA_ "SPN" SG_ 3221225472 Joystick8Button11PressedStatus 4658;
BA_ "SigType" SG_ 3221225472 Joystick8Button11PressedStatus 4;
BA_ "SPN" SG_ 3221225472 Joystick8Button12PressedStatus 4657;
BA_ "SigType" SG_ 3221225472 Joystick8Button12PressedStatus 4;
BA_ "SPN" SG_ 3221225472 Joystick8Button5PressedStatus 4656;
BA_ "SigType" SG_ 3221225472 Joystick8Button5PressedStatus 4;
BA_ "SPN" SG_ 3221225472 Joystick8Button6PressedStatus 4655;
BA_ "SigType" SG_ 3221225472 Joystick8Button6PressedStatus 4;
BA_ "SPN" SG_ 3221225472 Joystick8Button7PressedStatus 4654;
BA_ "SigType" SG_ 3221225472 Joystick8Button7PressedStatus 4;
BA_ "SPN" SG_ 3221225472 Joystick8Button8PressedStatus 4653;
BA_ "SigType" SG_ 3221225472 Joystick8Button8PressedStatus 4;
BA_ "SPN" SG_ 3221225472 Joystick8Button1PressedStatus 4652;
BA_ "SigType" SG_ 3221225472 Joystick8Button1PressedStatus 4;
BA_ "SPN" SG_ 3221225472 Joystick8Button2PressedStatus 4651;
BA_ "SigType" SG_ 3221225472 Joystick8Button2PressedStatus 4;
BA_ "SPN" SG_ 3221225472 Joystick8Button3PressedStatus 4650;
BA_ "SigType" SG_ 3221225472 Joystick8Button3PressedStatus 4;
BA_ "SPN" SG_ 3221225472 Joystick8Button4PressedStatus 4649;
BA_ "SigType" SG_ 3221225472 Joystick8Button4PressedStatus 4;
BA_ "SPN" SG_ 3221225472 Joystick8XAxisDetentPosStatus 4648;
BA_ "SigType" SG_ 3221225472 Joystick8XAxisDetentPosStatus 4;
BA_ "SPN" SG_ 3221225472 Joystick8YAxisDetentPosStatus 4647;
BA_ "SigType" SG_ 3221225472 Joystick8YAxisDetentPosStatus 4;
BA_ "SPN" SG_ 3221225472 Joystick8YAxisPos 4646;
BA_ "SPN" SG_ 3221225472 Jystck8YAxsLvrFrwrdPstvPosStatus 4645;
BA_ "SigType" SG_ 3221225472 Jystck8YAxsLvrFrwrdPstvPosStatus 4;
BA_ "SPN" SG_ 3221225472 Jystck8YAxsLvrBckNgtivePosStatus 4644;
BA_ "SigType" SG_ 3221225472 Jystck8YAxsLvrBckNgtivePosStatus 4;
BA_ "SPN" SG_ 3221225472 Joystick8YAxisNeutralPosStatus 4643;
BA_ "SigType" SG_ 3221225472 Joystick8YAxisNeutralPosStatus 4;
BA_ "SPN" SG_ 3221225472 Joystick8XAxisPos 4642;
BA_ "SPN" SG_ 3221225472 Jystck8XAxsLvrRghtPstvePosStatus 4641;
BA_ "SigType" SG_ 3221225472 Jystck8XAxsLvrRghtPstvePosStatus 4;
BA_ "SPN" SG_ 3221225472 Jystck8XAxsLvrLftNgtivePosStatus 4640;
BA_ "SigType" SG_ 3221225472 Jystck8XAxsLvrLftNgtivePosStatus 4;
BA_ "SPN" SG_ 3221225472 Joystick8XAxisNeutralPosStatus 4639;
BA_ "SigType" SG_ 3221225472 Joystick8XAxisNeutralPosStatus 4;
BA_ "SPN" SG_ 3221225472 Joystick7Button9PressedStatus 4623;
BA_ "SigType" SG_ 3221225472 Joystick7Button9PressedStatus 4;
BA_ "SPN" SG_ 3221225472 Joystick7Button10PressedStatus 4622;
BA_ "SigType" SG_ 3221225472 Joystick7Button10PressedStatus 4;
BA_ "SPN" SG_ 3221225472 Joystick7Button11PressedStatus 4621;
BA_ "SigType" SG_ 3221225472 Joystick7Button11PressedStatus 4;
VAL_ 3221225472 EngIntakeManifoldPressCtrlMode 3 "Not available" 2 "SAE reserved" 1 "Closed loop " 0 "Open loop " ;
VAL_ 3221225472 EngRotationDirection 3 "Not Available" 2 "Unknown " 1 "ClockWise" 0 "CounterClockWise" ;
VAL_ 3221225472 AFT2ExhDewPoint 3 "Not available" 2 "Error" 1 "Exceeded the dew point" 0 "Not exceeded the dew point" ;
VAL_ 3221225472 AFT2InDewPoint 3 "Not available" 2 "Error" 1 "Exceeded the dew point" 0 "Not exceeded the dew point" ;
VAL_ 3221225472 AFT1ExhDewPoint 3 "Not available" 2 "Error" 1 "Exceeded the dew point" 0 "Not exceeded the dew point" ;
VAL_ 3221225472 AFT1InDewPoint 3 "Not available" 2 "Error" 1 "Exceeded the dew point" 0 "Not exceeded the dew point" ;
VAL_ 3221225472 SCRThermalManagementActive 3 "Don't care" 2 "Reserved" 1 "SCR Thermal Management is active" 0 "SCR Thermal Management is not active" ;
VAL_ 3221225472 DPFThermalManagementActive 3 "Don't care" 2 "Reserved" 1 "DPF Thermal Management is active" 0 "DPF Thermal Management is not active" ;
VAL_ 3221225472 MmntaryEngMaxPowerEnableFeedback 3 "don't care" 2 "reserved" 1 "supported " 0 "disabled" ;
VAL_ 3221225472 VhcleAccelerationRateLimitStatus 3 "Not available" 2 "Reserved" 1 "Limit active" 0 "Limit not active" ;
VAL_ 3221225472 AccelPedal2LowIdleSwitch 3 "Not available" 2 "Error" 1 "Accelerator pedal 2 in low idle condition" 0 "Accelerator pedal 2 not in low idle condition" ;
VAL_ 3221225472 RoadSpeedLimitStatus 3 "Not available" 2 "Error" 1 "Not Active" 0 "Active" ;
VAL_ 3221225472 AccelPedalKickdownSwitch 3 "Not available" 2 "Error" 1 "Kickdown active" 0 "Kickdown passive" ;
VAL_ 3221225472 AccelPedal1LowIdleSwitch 3 "Not available" 2 "Error" 1 "Accelerator pedal 1 in low idle condition" 0 "Accelerator pedal 1 not in low idle condition" ;
VAL_ 3221225472 EngStarterMode 8 "InhibDueToStarterOver-temp" 7 "starterInhDueToActiveImmobilizer" 6 "DrivelineEngagedOrOtherTransInh" 5 "InhibDueToEngNotReadyForStart" 4 "starterInhibDueToEngRunning" 3 "start finished" 2 "starterActiveGearEngaged" 1 "starterActiveGearNotEngaged" 0 "start not requested" 15 "not available" 14 "error" 13 "errorLegacyImplementationOnly" 12 "starter inhibited" 11 "Reserved" 10 "ActiveSCRinducement" 9 "IntakeAirShutoffValveBeingActive" ;
VAL_ 3221225472 EmergencyBrakingActive 3 "not available" 2 "reserved" 1 "active" 0 "inactive" ;
VAL_ 3221225472 PrkngBrakeActuatorFullyActivated 3 "Not available" 2 "Error" 1 "Parking Brake Actuator fully activated" 0 "Parking Brake Actuator not fully activated" ;
VAL_ 3221225472 XBRActiveCtrlMode 15 "Not available" 3 "Maximum mode of XBR acceleration control being executed" 2 "Addition mode of XBR acceleration control being executed" 1 "Driver's brake demand being executed" 0 "No brake demand being executed" ;
VAL_ 3221225472 XBRSystemState 3 "not available" 2 "No external brake demand will be accepted" 1 "Only external brake demand of highest XBR Priority" 0 "Any external brake demand will be accepted" ;
VAL_ 3221225472 FoundationBrakeUse 3 "Not available" 2 "Reserved" 1 "Foundation brakes in use" 0 "Foundation brakes not in use" ;
VAL_ 3221225472 HillHolderMode 7 "Not available" 6 "Hill holder not functional" 3 "Active,  but may activate parking brake if needed." 2 "Active,  but will change to inactive in a short time" 1 "Active" 0 "Inactive" ;
VAL_ 3221225472 HaltBrakeMode 7 "Not available" 6 "Halt brake not functional" 2 "Active,  but not functioning properly" 1 "Active" 0 "Inactive" ;
VAL_ 3221225472 BrakeTempWarning 3 "not available" 2 "Reserved" 1 "Active" 0 "Not Active" ;
VAL_ 3221225472 TrctrMntdTrailerABSWarningSignal 3 "Take no action" 2 "Reserved" 1 "On" 0 "Off" ;
VAL_ 3221225472 TrailerABSStatus 3 "Trailer ABS Status Information Not Available or Parameter Not Supported" 2 "Reserved" 1 "Trailer ABS Active" 0 "Trailer ABS Status Information Available But Not Active" ;
VAL_ 3221225472 HaltBrakeSwitch 3 "Not available" 2 "Error" 1 "Halt brake switch active" 0 "Halt brake switch passive" ;
VAL_ 3221225472 ATC_ASRInformationSignal 3 "Take no action" 2 "Reserved" 1 "On" 0 "Off" ;
VAL_ 3221225472 ABS_EBSAmberWarningSignal 3 "Take no action" 2 "Reserved" 1 "On" 0 "Off" ;
VAL_ 3221225472 EBSRedWarningSignal 3 "Take no action" 2 "Reserved" 1 "On" 0 "Off" ;
VAL_ 3221225472 ABSFullyOperational 3 "Not available" 2 "Reserved" 1 "Fully Operational" 0 "Not Fully Operational" ;
VAL_ 3221225472 RemoteAccelEnableSwitch 3 "Not Available" 2 "Error" 1 "On" 0 "Off" ;
VAL_ 3221225472 EngAuxShutdownSwitch 3 "Not Available" 2 "Error" 1 "On" 0 "Off" ;
VAL_ 3221225472 EngDerateSwitch 3 "Not Available" 2 "Error" 1 "On" 0 "Off" ;
VAL_ 3221225472 AccelInterlockSwitch 3 "Not Available" 2 "Error" 1 "On" 0 "Off" ;
VAL_ 3221225472 TractionCtrlOverrideSwitch 3 "Not available or not installed" 2 "Error" 1 "On" 0 "Off" ;
VAL_ 3221225472 ASRHillHolderSwitch 3 "Not available" 2 "Error" 1 "ASR 'hill holder' switch active" 0 "ASR 'hill holder' switch passive" ;
VAL_ 3221225472 ASROffroadSwitch 3 "Not available" 2 "Error" 1 "ASR off-road switch active" 0 "ASR off-road switch passive" ;
VAL_ 3221225472 ABSOffroadSwitch 3 "Not available" 2 "Error" 1 "ABS off-road switch active" 0 "ABS off-road switch passive" ;
VAL_ 3221225472 EBSBrakeSwitch 3 "Not available" 2 "Error" 1 "Brake pedal is being pressed" 0 "Brake pedal is not being pressed" ;
VAL_ 3221225472 AntiLockBrakingActive 3 "Not available" 2 "Reserved" 1 "ABS active" 0 "ABS passive but installed" ;
VAL_ 3221225472 ASRBrakeCtrlActive 3 "Not available" 2 "Reserved" 1 "ASR brake control active" 0 "ASR brake control passive but installed" ;
VAL_ 3221225472 ASREngCtrlActive 3 "Not available" 2 "Reserved" 1 "ASR engine control active" 0 "ASR engine control passive but installed" ;
VAL_ 3221225472 RearAxleGroupEngagementStatus 3 "not available" 2 "error" 1 "rear axle group engaged" 0 "rear axle group disengaged " ;
VAL_ 3221225472 FrontAxleGroupEngagementStatus 3 "not available" 2 "error" 1 "front axle group engaged" 0 "front axle group disengaged " ;
VAL_ 3221225472 DiffLockStateCentralRear 3 "Not available" 2 "Error" 1 "Differential lock engaged" 0 "Differential lock disengaged" ;
VAL_ 3221225472 DiffLockStateCentralFront 3 "Not available" 2 "Error" 1 "Differential lock engaged" 0 "Differential lock disengaged" ;
VAL_ 3221225472 DiffLockStateCentral 3 "Not available" 2 "Error" 1 "Differential lock engaged" 0 "Differential lock disengaged" ;
VAL_ 3221225472 DiffLockStateRearAxle2 3 "Not available" 2 "Error" 1 "Differential lock engaged" 0 "Differential lock disengaged" ;
VAL_ 3221225472 DiffLockStateRearAxle1 3 "Not available" 2 "Error" 1 "Differential lock engaged" 0 "Differential lock disengaged" ;
VAL_ 3221225472 DiffLockStateFrontAxle2 3 "Not available" 2 "Error" 1 "Differential lock engaged" 0 "Differential lock disengaged" ;
VAL_ 3221225472 DiffLockStateFrontAxle1 3 "Not available" 2 "Error" 1 "Differential lock engaged" 0 "Differential lock disengaged" ;
VAL_ 3221225472 EngCldStrtFlIgniterRelayFeedback 3 "Not Available" 2 "Error" 1 "On" 0 "Off" ;
VAL_ 3221225472 EngColdStartFuelIgniterRelay 3 "Don't care/take no action" 2 "Reserved" 1 "On" 0 "Off" ;
VAL_ 3221225472 EngStartEnableDevice2Config 15 "not available" 4 "electric intake air heater installed" 3 "ether injection installed" 2 "fuelled start installed" 1 "glow plugs installed" 0 "no start enable device 2 installed" ;
VAL_ 3221225472 EngStartEnableDevice1Config 15 "not available" 4 "electric intake air heater installed" 3 "ether injection installed" 2 "fuelled start installed" 1 "glow plugs installed" 0 "no start enable device 1 installed" ;
VAL_ 3221225472 EngStartEnableDevice2 3 "not available" 2 "reserved" 1 "start enable ON" 0 "start enable OFF" ;
VAL_ 3221225472 EngStartEnableDevice1 3 "not available" 2 "reserved" 1 "start enable ON" 0 "start enable OFF" ;
VAL_ 3221225472 EngAirShutoffManualSw 3 "Not Available" 2 "Error" 1 "On" 0 "Off" ;
VAL_ 3221225472 EngAirShutoffTestSw 3 "Not Available" 2 "Error" 1 "On" 0 "Off" ;
VAL_ 3221225472 HornSw 3 "Not Available" 2 "Error" 1 "Horn switch is on" 0 "Horn switch is off" ;
VAL_ 3221225472 OpKeySwDelayedBatOff 3 "Not Available" 2 "Error" 1 "Battery power will be removed after delay" 0 "Delayed battery off state not active" ;
VAL_ 3221225472 OpKeySwStart 3 "Not Available" 2 "Error" 1 "Start state is active" 0 "Start state is not active" ;
VAL_ 3221225472 OpKeySwIgntPwr 3 "Not Available" 2 "Error" 1 "Ignition state is active" 0 "Ignition state is not active" ;
VAL_ 3221225472 OpKeySwAccessoryPwr 3 "Not Available" 2 "Error" 1 "Accessory power state active" 0 "Accessory power state not active" ;
VAL_ 3221225472 MomentaryOpKeySw 3 "Not Available" 2 "Error" 1 "Button is depressed" 0 "Button is not depressed" ;
VAL_ 3221225472 AFTSCRDosingModeCmd 7 "Don't care/Take no Action" 6 "Reserved for status error value" 5 "Reserved" 4 "Reserved" 3 "Reserved" 2 "Reserved" 1 "Reduced SCR Dosing Mode" 0 "Standard SCR Dosing Mode" ;
VAL_ 3221225472 OpKeyDetected 3 "Not Available" 2 "Error" 1 "Key is detected" 0 "No key detected" ;
VAL_ 3221225472 VehTrailerStatus 3 "Not available" 2 "Error" 1 "Trailer is detected" 0 "Trailer is not detected" ;
VAL_ 3221225472 TransOilLevelRq 3 "Don't care / take no action" 2 "Reserved" 1 "Transmission oil level reading desired" 0 "No transmission oil level reading desired" ;
VAL_ 3221225472 FifthWheelReleaseCtrl 3 "Not Available" 2 "Error" 1 "Coupler Unlocked" 0 "Coupler Locked" ;
VAL_ 3221225472 FfthWhlRleaseCtrlSecurityLockout 3 "Not Available" 2 "Error   " 1 "Fifth wheel release Enabled" 0 "Fifth wheel release Disabled" ;
VAL_ 3221225472 TransferCaseSelectorSwitch 7 "Not available" 6 "Error indicator" 5 "Reserved for SAE assignment" 4 "four wheel low or Off Highway Range" 2 "Neutral" 1 "four wheel high Normal or On Highway Range" 0 "two wheel high Normal or On Highway Range" 3 "two wheel low or Off Highway Range" ;
VAL_ 3221225472 RqCabZoneHeating 3 "Don't care/take no action" 2 "Reserved" 1 "Heat cab zone" 0 "Do not heat cab engine zone" ;
VAL_ 3221225472 RqEngZoneHeating 3 "Don't care/take no action" 2 "Reserved" 1 "Heat engine zone" 0 "Do not heat engine zone" ;
VAL_ 3221225472 AuxHeaterModeRq 15 "Don't care/take no action" 14 "Reserved" 4 "Heater pump up-keep" 3 "Normal mode" 2 "Economy mode" 1 "OffDueToADRForTranspOfHazMater" 0 "De-activate auxiliary heater" ;
VAL_ 3221225472 EngAutomaticStartEnableSwitch 3 "Not available" 2 "Error" 1 "Switch in the on state" 0 "Switch in the off state" ;
VAL_ 3221225472 AtomaticGearShiftingEnableSwitch 3 "Not available" 2 "Error" 1 "Automated Gear Shifting is enabled" 0 "Automated Gear Shifting is disabled" ;
VAL_ 3221225472 AFTRegenForceSw 3 "not available " 2 "error " 1 "active " 0 "not active " ;
VAL_ 3221225472 AFTRegenInhSw 3 "not available " 2 "error " 1 "active " 0 "not active " ;
VAL_ 3221225472 VhclLmtngSpdGovernorEnableSwitch 3 "Not available" 2 "Error" 1 "Switched enabled" 0 "Switch disabled" ;
VAL_ 3221225472 VhclLmtngSpdGvrnrIncrementSwitch 3 "Not available" 2 "Error" 1 "Switch in the on state" 0 "Switch in the off state" ;
VAL_ 3221225472 VhclLmtngSpdGvrnrDecrementSwitch 2 "Error" 1 "Switch in the on state" 0 "Switch in the off state" 3 "Not available" ;
VAL_ 3221225472 ParkBrakeCmd 3 "Don't care/Take no action" 2 "SAE Reserved  " 1 "Park Brake apply requested" 0 "Park Brake apply not requested" ;
VAL_ 3221225472 SeatBeltSwitch 3 "Not Available" 2 "Error" 1 "OK" 0 "NOT Buckled" ;
VAL_ 3221225472 OperatorSeatDirectionSwitch 3 "Not Available" 2 "Error" 1 "Operator seat is facing forward" 0 "Operator seat not facing forward" ;
VAL_ 3221225472 BatteryMainSwitchHoldRq 3 "Don't care/take no action" 2 "undefined" 1 "Hold Battery Main Switch" 0 "Release Battery Main Switch" ;
VAL_ 3221225472 AuxHeaterCoolantPumpRq 3 "Don't care/take no action" 2 "Reserved" 1 "Activate water pump" 0 "Deactivate water pump" ;
VAL_ 3221225472 EngShutdownOverrideSwitch 3 "Not Available" 2 "Error" 1 "On" 0 "Off" ;
VAL_ 3221225472 EngTestModeSwitch 3 "Not Available" 2 "Error" 1 "On" 0 "Off" ;
VAL_ 3221225472 EngIdleDecrementSwitch 3 "Not Available" 2 "Error" 1 "On" 0 "Off" ;
VAL_ 3221225472 EngIdleIncrementSwitch 3 "Not Available" 2 "Error" 1 "On" 0 "Off" ;
VAL_ 3221225472 CruiseCtrlStates 7 "Not available" 6 "Accelerator Override" 5 "Set" 4 "Resume" 3 "Decelerate" 2 "Accelerate" 1 "Hold" 0 "Off/Disabled" ;
VAL_ 3221225472 PTOGovernorState 31 "Not available" 19 "PTO set speed memory 2" 18 "PTO set speed memory 1" 17 "Preprogrammed set speed 8" 16 "Preprogrammed set speed 7" 15 "Preprogrammed set speed 6" 14 "Preprogrammed set speed 5" 13 "Preprogrammed set speed 4" 12 "Preprogrammed set speed 3" 11 "Preprogrammed set speed 2" 10 "Preprogrammed set speed 1" 9 "Accelerator Override" 8 "Accelerate" 7 "Resume" 6 "Decelerate/Coast" 5 "Set" 4 "Remote Standby" 3 "Standby" 2 "Remote Hold" 1 "Hold" 0 "Off/Disabled" ;
VAL_ 3221225472 CruiseCtrlAccelerateSwitch 3 "Not available" 2 "Error" 1 "Cruise control activator in position 'accelerate'" 0 "Cruise control activator not in the position 'accelerate'" ;
VAL_ 3221225472 CruiseCtrlResumeSwitch 3 "Not available" 2 "Error" 1 "Cruise control activator in position 'resume'" 0 "Cruise control activator not in the position 'resume'" ;
VAL_ 3221225472 CruiseCtrlCoastSwitch 3 "Not available" 2 "Error" 1 "Cruise control activator in position 'coast'" 0 "Cruise control activator not in the position 'coast'" ;
VAL_ 3221225472 CruiseCtrlSetSwitch 3 "Not available" 2 "Error" 1 "Cruise control activator in position 'set'" 0 "Cruise control activator not in the position 'set'" ;
VAL_ 3221225472 ClutchSwitch 3 "Not available" 2 "Error" 1 "Clutch pedal depressed" 0 "Clutch pedal released" ;
VAL_ 3221225472 BrakeSwitch 3 "Not Available" 2 "Error" 1 "Brake pedal depressed" 0 "Brake pedal released" ;
VAL_ 3221225472 CruiseCtrlEnableSwitch 3 "Not available" 2 "Error" 1 "Cruise control enabled" 0 "Cruise control disabled" ;
VAL_ 3221225472 CruiseCtrlActive 3 "Not available" 2 "Error" 1 "Cruise control switched on" 0 "Cruise control switched off" ;
VAL_ 3221225472 ParkBrakeReleaseInhibitRq 3 "Unavailable" 2 "SAE reserved" 1 "Park Brake Release Inhibit requested" 0 "Park Brake Release Inhibit not requested" ;
VAL_ 3221225472 CruiseCtrlPauseSwitch 3 "-Take No Action" 2 "- Error Indicator" 1 "- On" 0 "- Off" ;
VAL_ 3221225472 ParkingBrakeSwitch 3 "Not available" 2 "Error" 1 "Parking brake set" 0 "Parking brake not set" ;
VAL_ 3221225472 TwoSpeedAxleSwitch 3 "Not available" 2 "Error" 1 "High speed range" 0 "Low speed range" ;
VAL_ 3221225472 VhclAccelerationRateLimitLampCmd 3 "Not available" 2 "Reserved" 1 "Lamp On" 0 "Lamp Off" ;
VAL_ 3221225472 EngSpeedVeryHighLampCmd 3 "Not available" 2 "Reserved" 1 "Lamp On" 0 "Lamp Off" ;
VAL_ 3221225472 EngSpeedHighLampCmd 3 "Not available" 2 "Reserved" 1 "Lamp On" 0 "Lamp Off" ;
VAL_ 3221225472 EngCtrlModule3ReadyForUseLampCmd 3 "Not available" 2 "Reserved" 1 "Lamp On" 0 "Lamp Off" ;
VAL_ 3221225472 EngCtrlModule2ReadyForUseLampCmd 3 "Not available" 2 "Reserved" 1 "Lamp On" 0 "Lamp Off" ;
VAL_ 3221225472 EngCtrlModule1ReadyForUseLampCmd 3 "Not available" 2 "Reserved" 1 "Lamp On" 0 "Lamp Off" ;
VAL_ 3221225472 EngFuelFilterRestrictedLampCmd 3 "Not available" 2 "Reserved" 1 "Lamp On" 0 "Lamp Off" ;
VAL_ 3221225472 EngAirFilterRestrictionLampCmd 3 "Not available" 2 "Reserved" 1 "Lamp On" 0 "Lamp Off" ;
VAL_ 3221225472 EngIdleManagementActiveLampCmd 3 "Not available" 2 "Reserved" 1 "Lamp On" 0 "Lamp Off" ;
VAL_ 3221225472 EngCoolantLevelLowLampCmd 3 "Not available" 2 "Reserved" 1 "Lamp On" 0 "Lamp Off" ;
VAL_ 3221225472 EngCoolantTempHighLampCmd 3 "Not available" 2 "Reserved" 1 "Lamp On" 0 "Lamp Off" ;
VAL_ 3221225472 EngOilPressLowLampCmd 3 "Not available" 2 "Reserved" 1 "Lamp On" 0 "Lamp Off" ;
VAL_ 3221225472 CmprssnBrkEnblSwtchIndctrLampCmd 3 "Not available" 2 "Reserved" 1 "Lamp ON" 0 "Lamp OFF" ;
VAL_ 3221225472 EngBrakeActiveLampCmd 3 "Not available" 2 "Reserved" 1 "Lamp On" 0 "Lamp Off" ;
VAL_ 3221225472 OBDMalfunctionIndicatorLampCmd 3 "Not available" 2 "Reserved" 1 "Lamp On" 0 "Lamp Off" ;
VAL_ 3221225472 EngRedStopLampCmd 3 "Not available" 2 "Reserved" 1 "Lamp On" 0 "Lamp Off" ;
VAL_ 3221225472 EngAmberWarningLampCmd 3 "Not available" 2 "Reserved" 1 "Lamp On" 0 "Lamp Off" ;
VAL_ 3221225472 EngProtectLampCmd 3 "Not available" 2 "Reserved" 1 "Lamp On" 0 "Lamp Off" ;
VAL_ 3221225472 RolloverSensorType 15 "not available" 14 "Error" 7 "optical sensor" 6 "lidar sensor" 5 "radar sensor" 4 "fiber-optic sensor" 3 "sonic sensor" 2 "rollrate sensor" 1 "pressure sensor" 0 "acceleration sensor" ;
VAL_ 3221225472 RearCollisionSensor4Type 15 "not available" 14 "Error" 7 "optical sensor" 6 "lidar sensor" 5 "radar sensor" 4 "fiber-optic sensor" 3 "sonic sensor" 2 "rollrate sensor" 1 "pressure sensor" 0 "acceleration sensor" ;
VAL_ 3221225472 RearCollisionSensor3Type 15 "not available" 14 "Error" 7 "optical sensor" 6 "lidar sensor" 5 "radar sensor" 4 "fiber-optic sensor" 3 "sonic sensor" 2 "rollrate sensor" 1 "pressure sensor" 0 "acceleration sensor" ;
VAL_ 3221225472 RearCollisionSensor2Type 15 "not available" 14 "Error" 7 "optical sensor" 6 "lidar sensor" 5 "radar sensor" 4 "fiber-optic sensor" 3 "sonic sensor" 2 "rollrate sensor" 1 "pressure sensor" 0 "acceleration sensor" ;
VAL_ 3221225472 RearCollisionSensor1Type 15 "not available" 14 "Error" 7 "optical sensor" 6 "lidar sensor" 5 "radar sensor" 4 "fiber-optic sensor" 3 "sonic sensor" 2 "rollrate sensor" 1 "pressure sensor" 0 "acceleration sensor" ;
VAL_ 3221225472 SideCollisionSensorRearRightType 15 "not available" 14 "Error" 7 "optical sensor" 6 "lidar sensor" 5 "radar sensor" 4 "fiber-optic sensor" 3 "sonic sensor" 2 "rollrate sensor" 1 "pressure sensor" 0 "acceleration sensor" ;
VAL_ 3221225472 SdCllisionSensorMidRearRightType 15 "not available" 14 "Error" 7 "optical sensor" 6 "lidar sensor" 5 "radar sensor" 4 "fiber-optic sensor" 3 "sonic sensor" 2 "rollrate sensor" 1 "pressure sensor" 0 "acceleration sensor" ;
VAL_ 3221225472 SdCllsionSensorMidFrontRightType 15 "not available" 14 "Error" 7 "optical sensor" 6 "lidar sensor" 5 "radar sensor" 4 "fiber-optic sensor" 3 "sonic sensor" 2 "rollrate sensor" 1 "pressure sensor" 0 "acceleration sensor" ;
VAL_ 3221225472 SdeCollisionSensorFrontRightType 15 "not available" 14 "Error" 7 "optical sensor" 6 "lidar sensor" 5 "radar sensor" 4 "fiber-optic sensor" 3 "sonic sensor" 2 "rollrate sensor" 1 "pressure sensor" 0 "acceleration sensor" ;
VAL_ 3221225472 SideCollisionSensorRearLeftType 15 "not available" 14 "Error" 7 "optical sensor" 6 "lidar sensor" 5 "radar sensor" 4 "fiber-optic sensor" 3 "sonic sensor" 2 "rollrate sensor" 1 "pressure sensor" 0 "acceleration sensor" ;
VAL_ 3221225472 SdCollisionSensorMidRearLeftType 15 "not available" 14 "Error" 7 "optical sensor" 6 "lidar sensor" 5 "radar sensor" 4 "fiber-optic sensor" 3 "sonic sensor" 2 "rollrate sensor" 1 "pressure sensor" 0 "acceleration sensor" ;
VAL_ 3221225472 SdCllisionSensorMidFrontLeftType 15 "not available" 14 "Error" 7 "optical sensor" 6 "lidar sensor" 5 "radar sensor" 4 "fiber-optic sensor" 3 "sonic sensor" 2 "rollrate sensor" 1 "pressure sensor" 0 "acceleration sensor" ;
VAL_ 3221225472 SideCollisionSensorFrontLeftType 15 "not available" 14 "Error" 7 "optical sensor" 6 "lidar sensor" 5 "radar sensor" 4 "fiber-optic sensor" 3 "sonic sensor" 2 "rollrate sensor" 1 "pressure sensor" 0 "acceleration sensor" ;
VAL_ 3221225472 FrontalCollisionSensor4Type 15 "not available" 14 "Error" 7 "optical sensor" 6 "lidar sensor" 5 "radar sensor" 4 "fiber-optic sensor" 3 "sonic sensor" 2 "rollrate sensor" 1 "pressure sensor" 0 "acceleration sensor" ;
VAL_ 3221225472 FrontalCollisionSensor3Type 15 "not available" 14 "Error" 7 "optical sensor" 6 "lidar sensor" 5 "radar sensor" 4 "fiber-optic sensor" 3 "sonic sensor" 2 "rollrate sensor" 1 "pressure sensor" 0 "acceleration sensor" ;
VAL_ 3221225472 FrontalCollisionSensor2Type 15 "not available" 14 "Error" 7 "optical sensor" 6 "lidar sensor" 5 "radar sensor" 4 "fiber-optic sensor" 3 "sonic sensor" 2 "rollrate sensor" 1 "pressure sensor" 0 "acceleration sensor" ;
VAL_ 3221225472 FrontalCollisionSensor1Type 15 "not available" 14 "Error" 7 "optical sensor" 6 "lidar sensor" 5 "radar sensor" 4 "fiber-optic sensor" 3 "sonic sensor" 2 "rollrate sensor" 1 "pressure sensor" 0 "acceleration sensor" ;
VAL_ 3221225472 CrashType 16 "rollover" 8 "side crash, right)" 4 "side crash, left)" 2 "rear crash" 1 "frontal crash" ;
VAL_ 3221225472 Joystick9Button9PressedStatus 3 "Not Available" 2 "Error Indicator" 1 "Button pressed" 0 "Button not pressed" ;
VAL_ 3221225472 Joystick9Button10PressedStatus 3 "Not Available" 2 "Error Indicator" 1 "Button pressed" 0 "Button not pressed" ;
VAL_ 3221225472 Joystick9Button11PressedStatus 3 "Not Available" 2 "Error Indicator" 1 "Button pressed" 0 "Button not pressed" ;
VAL_ 3221225472 Joystick9Button12PressedStatus 3 "Not Available" 2 "Error Indicator" 1 "Button pressed" 0 "Button not pressed" ;
VAL_ 3221225472 Joystick9Button5PressedStatus 3 "Not Available" 2 "Error Indicator" 1 "Button pressed" 0 "Button not pressed" ;
VAL_ 3221225472 Joystick9Button6PressedStatus 3 "Not Available" 2 "Error Indicator" 1 "Button pressed" 0 "Button not pressed" ;
VAL_ 3221225472 Joystick9Button7PressedStatus 3 "Not Available" 2 "Error Indicator" 1 "Button pressed" 0 "Button not pressed" ;
VAL_ 3221225472 Joystick9Button8PressedStatus 3 "Not Available" 2 "Error Indicator" 1 "Button pressed" 0 "Button not pressed" ;
VAL_ 3221225472 Joystick9Button1PressedStatus 3 "Not Available" 2 "Error Indicator" 1 "Button pressed" 0 "Button not pressed" ;
VAL_ 3221225472 Joystick9Button2PressedStatus 3 "Not Available" 2 "Error Indicator" 1 "Button pressed" 0 "Button not pressed" ;
VAL_ 3221225472 Joystick9Button3PressedStatus 3 "Not Available" 2 "Error Indicator" 1 "Button pressed" 0 "Button not pressed" ;
VAL_ 3221225472 Joystick9Button4PressedStatus 3 "Not Available" 2 "Error Indicator" 1 "Button pressed" 0 "Button not pressed" ;
VAL_ 3221225472 Joystick9XAxisDetentPosStatus 3 "Not Available" 2 "Error Indicator" 1 "In the Detent Position" 0 "Not in the Detent Position" ;
VAL_ 3221225472 Joystick9YAxisDetentPosStatus 3 "Not Available" 2 "Error Indicator" 1 "In the Detent Position" 0 "Not in the Detent Position" ;
VAL_ 3221225472 Jystck9YAxsLvrFrwrdPstvPosStatus 3 "Not Available" 2 "Error Indicator" 1 "On positive side of Neutral" 0 "Not on Positive side of Neutral" ;
VAL_ 3221225472 Jystck9YAxsLvrBckNgtivePosStatus 3 "Not Available" 2 "Error Indicator" 1 "On negative side of Neutral" 0 "Not on negative side of Neutral" ;
VAL_ 3221225472 Joystick9YAxisNeutralPosStatus 3 "Not Available" 2 "Error Indicator" 1 "In Neutral Position" 0 "Not in Neutral Position" ;
VAL_ 3221225472 Jystck9XAxsLvrRghtPstvePosStatus 3 "Not Available" 2 "Error Indicator" 1 "On positive side of Neutral" 0 "Not on Positive side of Neutral" ;
VAL_ 3221225472 Jystck9XAxsLvrLftNgtivePosStatus 3 "Not Available" 2 "Error Indicator" 1 "On negative side of Neutral" 0 "Not on negative side of Neutral" ;
VAL_ 3221225472 Joystick9XAxisNeutralPosStatus 3 "Not Available" 2 "Error Indicator" 1 "In Neutral Position" 0 "Not in Neutral Position" ;
VAL_ 3221225472 Joystick8Button9PressedStatus 3 "Not Available" 2 "Error Indicator" 1 "Button pressed" 0 "Button not pressed" ;
VAL_ 3221225472 Joystick8Button10PressedStatus 3 "Not Available" 2 "Error Indicator" 1 "Button pressed" 0 "Button not pressed" ;
VAL_ 3221225472 Joystick8Button11PressedStatus 3 "Not Available" 2 "Error Indicator" 1 "Button pressed" 0 "Button not pressed" ;
VAL_ 3221225472 Joystick8Button12PressedStatus 3 "Not Available" 2 "Error Indicator" 1 "Button pressed" 0 "Button not pressed" ;
VAL_ 3221225472 Joystick8Button5PressedStatus 3 "Not Available" 2 "Error Indicator" 1 "Button pressed" 0 "Button not pressed" ;
VAL_ 3221225472 Joystick8Button6PressedStatus 3 "Not Available" 2 "Error Indicator" 1 "Button pressed" 0 "Button not pressed" ;
VAL_ 3221225472 Joystick8Button7PressedStatus 3 "Not Available" 2 "Error Indicator" 1 "Button pressed" 0 "Button not pressed" ;
VAL_ 3221225472 Joystick8Button8PressedStatus 3 "Not Available" 2 "Error Indicator" 1 "Button pressed" 0 "Button not pressed" ;
VAL_ 3221225472 Joystick8Button1PressedStatus 3 "Not Available" 2 "Error Indicator" 1 "Button pressed" 0 "Button not pressed" ;
VAL_ 3221225472 Joystick8Button2PressedStatus 3 "Not Available" 2 "Error Indicator" 1 "Button pressed" 0 "Button not pressed" ;
VAL_ 3221225472 Joystick8Button3PressedStatus 3 "Not Available" 2 "Error Indicator" 1 "Button pressed" 0 "Button not pressed" ;
VAL_ 3221225472 Joystick8Button4PressedStatus 3 "Not Available" 2 "Error Indicator" 1 "Button pressed" 0 "Button not pressed" ;
VAL_ 3221225472 Joystick8XAxisDetentPosStatus 3 "Not Available" 2 "Error Indicator" 1 "In the Detent Position" 0 "Not in the Detent Position" ;
VAL_ 3221225472 Joystick8YAxisDetentPosStatus 3 "Not Available" 2 "Error Indicator" 1 "In the Detent Position" 0 "Not in the Detent Position" ;
VAL_ 3221225472 Jystck8YAxsLvrFrwrdPstvPosStatus 3 "Not Available" 2 "Error Indicator" 1 "On positive side of Neutral" 0 "Not on Positive side of Neutral" ;
VAL_ 3221225472 Jystck8YAxsLvrBckNgtivePosStatus 3 "Not Available" 2 "Error Indicator" 1 "On negative side of Neutral" 0 "Not on negative side of Neutral" ;
VAL_ 3221225472 Joystick8YAxisNeutralPosStatus 3 "Not Available" 2 "Error Indicator" 1 "In Neutral Position" 0 "Not in Neutral Position" ;
VAL_ 3221225472 Jystck8XAxsLvrRghtPstvePosStatus 3 "Not Available" 2 "Error Indicator" 1 "On positive side of Neutral" 0 "Not on Positive side of Neutral" ;
VAL_ 3221225472 Jystck8XAxsLvrLftNgtivePosStatus 3 "Not Available" 2 "Error Indicator" 1 "On negative side of Neutral" 0 "Not on negative side of Neutral" ;
VAL_ 3221225472 Joystick8XAxisNeutralPosStatus 3 "Not Available" 2 "Error Indicator" 1 "In Neutral Position" 0 "Not in Neutral Position" ;
VAL_ 3221225472 Joystick7Button9PressedStatus 3 "Not Available" 2 "Error Indicator" 1 "Button pressed" 0 "Button not pressed" ;
VAL_ 3221225472 Joystick7Button10PressedStatus 3 "Not Available" 2 "Error Indicator" 1 "Button pressed" 0 "Button not pressed" ;
VAL_ 3221225472 Joystick7Button11PressedStatus 3 "Not Available" 2 "Error Indicator" 1 "Button pressed" 0 "Button not pressed" ;
