VERSION ""

NS_ :

BS_:

BU_:

BO_ 2583065854 CENTLOCKIN_KeyFob: 8 Vector__XXX
 SG_ CentralLockRequest : 0|3@1+ (1,0) [0|7] "-" Vector__XXX

BO_ 2583066110 CENTLOCKIN_MobApp: 8 Vector__XXX
 SG_ CentralLockRequest : 0|3@1+ (1,0) [0|7] "-" Vector__XXX

BO_ 2583065598 CENTLOCKOUT: 2 Vector__XXX
 SG_ CentralLockFailState : 8|4@1+ (1,0) [0|15] "-" Vector__XXX
 SG_ CentralLockCommand : 0|5@1+ (1,0) [0|31] "-" Vector__XXX

BO_ 2583062526 CENTLOCKIN_HMI: 8 Vector__XXX
 SG_ CentralLockRequest : 0|3@1+ (1,0) [0|7] "-" Vector__XXX

CM_ "$File: //depot/auto/dbc/Software_Modules/Closures_System/CENTLOCK/0.3.1.0/CENTLOCK.dbc $
$Change: 215969 $
$DateTime: 2024/08/21 09:57:07 $
$Revision: #1 $";
CM_ SG_ 2583065854 CentralLockRequest "State of user request for doors central locking
";
CM_ SG_ 2583066110 CentralLockRequest "State of user request for doors central locking
";
CM_ SG_ 2583065598 CentralLockFailState "State of central lock command execution failure
";
CM_ SG_ 2583065598 CentralLockCommand "State of closures system command for doors central locking
";
CM_ SG_ 2583062526 CentralLockRequest "State of user request for doors central locking
";
BA_DEF_ SG_  "SigType" ENUM  "Default","Range","RangeSigned","ASCII","Discrete","Control","ReferencePGN","DTC","StringDelimiter","StringLength","StringLengthControl","MessageCounter","MessageChecksum";
BA_DEF_ SG_  "GenSigEVName" STRING ;
BA_DEF_ SG_  "GenSigILSupport" ENUM  "No","Yes";
BA_DEF_ SG_  "GenSigSendType" ENUM  "Cyclic","OnWrite","OnWriteWithRepetition","OnChange","OnChangeWithRepetition","IfActive","IfActiveWithRepetition","NoSigSendType";
BA_DEF_ BO_  "SendOnChange" ENUM  "No","Yes";
BA_DEF_ SG_  "GenSigStartValue" INT 0 2147483647;
BA_DEF_ BO_  "GenMsgILSupport" ENUM  "No","Yes";
BA_DEF_ BU_  "NmStationAddress" INT 0 255;
BA_DEF_ BO_  "GenMsgSendType" ENUM  "cyclic","NotUsed","IfActive","NotUsed","NotUsed","NotUsed","NotUsed","NotUsed","noMsgSendType";
BA_DEF_ BO_  "GenMsgRequestable" INT 0 1;
BA_DEF_ BO_  "GenMsgCycleTime" INT 0 3600000;
BA_DEF_ BO_  "Producer" STRING ;
BA_DEF_  "DBName" STRING ;
BA_DEF_  "BusType" STRING ;
BA_DEF_  "ProtocolType" STRING ;
BA_DEF_ BO_  "VFrameFormat" ENUM  "StandardCAN","ExtendedCAN","reserved","J1939PG";
BA_DEF_DEF_  "SigType" "Default";
BA_DEF_DEF_  "GenSigEVName" "Env@Nodename_@Signame";
BA_DEF_DEF_  "GenSigILSupport" "Yes";
BA_DEF_DEF_  "GenSigSendType" "NoSigSendType";
BA_DEF_DEF_  "SendOnChange" "No";
BA_DEF_DEF_  "GenSigStartValue" 0;
BA_DEF_DEF_  "GenMsgILSupport" "Yes";
BA_DEF_DEF_  "NmStationAddress" 254;
BA_DEF_DEF_  "GenMsgSendType" "noMsgSendType";
BA_DEF_DEF_  "GenMsgRequestable" 1;
BA_DEF_DEF_  "GenMsgCycleTime" 0;
BA_DEF_DEF_  "DBName" "";
BA_DEF_DEF_  "BusType" "CAN";
BA_DEF_DEF_  "ProtocolType" "J1939";
BA_DEF_DEF_  "VFrameFormat" "J1939PG";
BA_ "DBName" "CBDRS";
BA_ "SendOnChange" BO_ 2583065854 1;
BA_ "GenMsgSendType" BO_ 2583065854 0;
BA_ "GenMsgCycleTime" BO_ 2583065854 1000;
BA_ "SendOnChange" BO_ 2583066110 1;
BA_ "GenMsgSendType" BO_ 2583066110 0;
BA_ "GenMsgCycleTime" BO_ 2583066110 1000;
BA_ "SendOnChange" BO_ 2583065598 1;
BA_ "GenMsgSendType" BO_ 2583065598 0;
BA_ "GenMsgCycleTime" BO_ 2583065598 1000;
BA_ "SendOnChange" BO_ 2583062526 1;
BA_ "GenMsgCycleTime" BO_ 2583062526 1000;
BA_ "GenMsgSendType" BO_ 2583062526 0;
BA_ "GenSigStartValue" SG_ 2583066110 CentralLockRequest 7;
BA_ "GenSigStartValue" SG_ 2583065598 CentralLockFailState 15;
BA_ "GenSigStartValue" SG_ 2583065598 CentralLockCommand 1;
BA_ "GenSigStartValue" SG_ 2583062526 CentralLockRequest 7;
BA_ "Producer" BO_ 2583065598 "CLS";
VAL_ 2583065854 CentralLockRequest 7 "Not Available" 6 "Error" 5 "Unlock Cargo Side Door" 4 "Unlock Cargo Rear Door" 3 "Unlock Passenger Door" 2 "Unlock Driver Door" 1 "Fully Lock Vehicle" 0 "Unlock Vehicle" ;
VAL_ 2583066110 CentralLockRequest 7 "Not Available" 6 "Error" 5 "Unlock Cargo Side Door" 4 "Unlock Cargo Rear Door" 3 "Unlock Passenger Door" 2 "Unlock Driver Door" 1 "Fully Lock Vehicle" 0 "Unlock Vehicle" ;
VAL_ 2583065598 CentralLockFailState 15 "Not Available" 14 "Error" 13 "Reserved6" 12 "Reserved5" 11 "Reserved4" 10 "Reserved3" 9 "Reserved2" 8 "Reserved1" 7 "Centlock In Fault" 6 "Cargo Side Door Unlock Fail" 5 "Cargo Rear Door Unlock Fail" 4 "Passenger Door Unlock Fail" 3 "Driver Door Unlock Fail" 2 "Vehicle Fully Lock Fail" 1 "Vehicle Unlock Fail" 0 "No Fail" ;
VAL_ 2583065598 CentralLockCommand 30 "Error" 28 "Reserved" 26 "Reserved" 24 "Reserved" 22 "Reserved" 31 "Not Available" 29 "Reserved" 27 "Reserved" 25 "Reserved" 23 "Reserved" 21 "Reserved" 19 "Reserved" 18 "Reserved" 17 "Reserved" 20 "Reserved" 16 "Reserved" 15 "Reserved" 14 "Unlock Driver Door Internal" 13 "Unlock Driver Door" 12 "Lock Driver Door Internal" 11 "Lock Driver Door" 10 "Unlock All Doors Internal" 9 "Unlock All Doors" 8 "Lock All Doors Internal" 7 "Lock All Doors" 6 "Find Car Action" 5 "User Near Vehicle" 4 "User Out of Vehicle" 3 "Bye Action" 2 "Welcome Action" 1 "Sleep Vehicle" 0 "Wake Up Vehicle" ;
VAL_ 2583062526 CentralLockRequest 7 "Not Available" 6 "Error" 5 "Unlock Cargo Side Door" 4 "Unlock Cargo Rear Door" 3 "Unlock Passenger Door" 2 "Unlock Driver Door" 1 "Fully Lock Vehicle" 0 "Unlock Vehicle" ;
