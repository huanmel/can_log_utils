VERSION ""

NS_ :

BS_:

BU_:

BO_ 2566883070 DoorLockNotify: 1 Vector__XXX
 SG_ RollerShutterLatchNotify : 3|3@1+ (1,0) [0|3] "-" Vector__XXX
 SG_ DoorLatchNotify : 0|3@1+ (1,0) [0|3] "-" Vector__XXX

CM_ "$File: //depot/auto/dbc/Software_Modules/Closures_System/CLSAVAS/0.1.2.0/CLSAVAS.dbc $
$Change: 215970 $
$DateTime: 2024/08/21 09:57:38 $
$Revision: #1 $";
CM_ BO_ 2566883070 "Notifications from Doors to AVAS";
CM_ SG_ 2566883070 RollerShutterLatchNotify "Roller Shutter AVAS notification";
CM_ SG_ 2566883070 DoorLatchNotify "Doors AVAS notification";
BA_DEF_ SG_  "SigType" ENUM  "Default","Range","RangeSigned","ASCII","Discrete","Control","ReferencePGN","DTC","StringDelimiter","StringLength","StringLengthControl","MessageCounter","MessageChecksum";
BA_DEF_ SG_  "GenSigEVName" STRING ;
BA_DEF_ SG_  "GenSigILSupport" ENUM  "No","Yes";
BA_DEF_ SG_  "GenSigSendType" ENUM  "Cyclic","OnWrite","OnWriteWithRepetition","OnChange","OnChangeWithRepetition","IfActive","IfActiveWithRepetition","NoSigSendType";
BA_DEF_ BO_  "SendOnChange" ENUM  "No","Yes";
BA_DEF_ SG_  "GenSigStartValue" INT 0 2147483647;
BA_DEF_ BO_  "GenMsgDelayTime" INT 0 1000;
BA_DEF_ BO_  "GenMsgILSupport" ENUM  "No","Yes";
BA_DEF_ BU_  "NmStationAddress" INT 0 255;
BA_DEF_ BO_  "GenMsgSendType" ENUM  "cyclic","NotUsed","IfActive","NotUsed","NotUsed","NotUsed","NotUsed","NotUsed","noMsgSendType";
BA_DEF_ BO_  "GenMsgRequestable" INT 0 1;
BA_DEF_ BO_  "GenMsgCycleTime" INT 0 3600000;
BA_DEF_  "DBName" STRING ;
BA_DEF_  "BusType" STRING ;
BA_DEF_  "ProtocolType" STRING ;
BA_DEF_ BO_  "VFrameFormat" ENUM  "StandardCAN","ExtendedCAN","reserved","J1939PG";
BA_DEF_ BO_  "Producer" STRING ;
BA_DEF_DEF_  "SigType" "Default";
BA_DEF_DEF_  "GenSigEVName" "Env@Nodename_@Signame";
BA_DEF_DEF_  "GenSigILSupport" "Yes";
BA_DEF_DEF_  "GenSigSendType" "NoSigSendType";
BA_DEF_DEF_  "SendOnChange" "No";
BA_DEF_DEF_  "GenSigStartValue" 0;
BA_DEF_DEF_  "GenMsgDelayTime" 0;
BA_DEF_DEF_  "GenMsgILSupport" "Yes";
BA_DEF_DEF_  "NmStationAddress" 254;
BA_DEF_DEF_  "GenMsgSendType" "noMsgSendType";
BA_DEF_DEF_  "GenMsgRequestable" 1;
BA_DEF_DEF_  "GenMsgCycleTime" 0;
BA_DEF_DEF_  "DBName" "";
BA_DEF_DEF_  "BusType" "CAN";
BA_DEF_DEF_  "ProtocolType" "J1939";
BA_DEF_DEF_  "VFrameFormat" "J1939PG";
BA_ "DBName" "CBDRS";
BA_ "GenMsgDelayTime" BO_ 2566883070 100;
BA_ "SendOnChange" BO_ 2566883070 1;
BA_ "GenMsgCycleTime" BO_ 2566883070 1000;
BA_ "GenMsgSendType" BO_ 2566883070 0;
BA_ "Producer" BO_ 2566883070 "CLS";
VAL_ 2566883070 RollerShutterLatchNotify 3 "Not Available" 2 "Error" 1 "Active" 0 "Inactive" ;
VAL_ 2566883070 DoorLatchNotify 3 "Not Available" 2 "Error" 1 "Active" 0 "Inactive" ;
