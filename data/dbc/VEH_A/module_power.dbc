VERSION ""

NS_ :

BS_:

BU_: Device Host

BO_ 2637299454 ModulePowerDown: 8 Host
 SG_ PowerDownCause : 0|8@1+ (1,0) [0|255] "" Vector__XXX

BO_ 2637233918 ModulePowerUp: 8 Host
 SG_ PowerUpTime : 0|16@1+ (10,0) [10|642550] "s" Vector__XXX

CM_ "Module power (on/off) management messages
$File: //system_software/components/lib/module_power/0.36.0.0/dbc/module_power.dbc $
$Change: 208863 $
$DateTime: 2023/11/10 13:11:00 $
$Revision: #1 $";
CM_ BO_ 2637299454 "When module receive this message it must switch off itself and activate WUF functionality";
CM_ SG_ 2637299454 PowerDownCause "Not used now";
CM_ BO_ 2637233918 "This message used in WakeUpFrame (WUF) functionality";
CM_ SG_ 2637233918 PowerUpTime "Update Shutdown delay counter. Not used now";
BA_DEF_  "BusType" STRING ;
BA_DEF_  "DBName" STRING ;
BA_DEF_ BO_  "GenMsgILSupport" ENUM  "No","Yes";
BA_DEF_ BO_  "GenMsgRequestable" INT 0 1;
BA_DEF_ BO_  "GenMsgSendType" ENUM  "cyclic","NotUsed","NotUsed","NotUsed","NotUsed","NotUsed","NotUsed","IfActive","noMsgSendType";
BA_DEF_ SG_  "GenSigEVName" STRING ;
BA_DEF_ SG_  "GenSigILSupport" ENUM  "No","Yes";
BA_DEF_ SG_  "GenSigSendType" ENUM  "Cyclic","OnWrite","OnWriteWithRepetition","OnChange","OnChangeWithRepetition","IfActive","IfActiveWithRepetition","NoSigSendType";
BA_DEF_ SG_  "GenSigStartValue" FLOAT -3.4e+38 3.4e+38;
BA_DEF_ BU_  "NmStationAddress" INT 0 255;
BA_DEF_  "ProtocolType" STRING ;
BA_DEF_ BO_  "SendOnChange" ENUM  "No","Yes";
BA_DEF_ SG_  "SigType" ENUM  "Default","Range","RangeSigned","ASCII","Discrete","Control","ReferencePGN","DTC","StringDelimiter","StringLength","StringLengthControl","MessageCounter","MessageChecksum";
BA_DEF_ BO_  "VFrameFormat" ENUM  "StandardCAN","ExtendedCAN","reserved","J1939PG";
BA_DEF_DEF_  "BusType" "CAN";
BA_DEF_DEF_  "DBName" "";
BA_DEF_DEF_  "GenMsgILSupport" "Yes";
BA_DEF_DEF_  "GenMsgRequestable" 1;
BA_DEF_DEF_  "GenMsgSendType" "noMsgSendType";
BA_DEF_DEF_  "GenSigEVName" "Env@Nodename_@Signame";
BA_DEF_DEF_  "GenSigILSupport" "Yes";
BA_DEF_DEF_  "GenSigSendType" "NoSigSendType";
BA_DEF_DEF_  "GenSigStartValue" 0;
BA_DEF_DEF_  "NmStationAddress" 254;
BA_DEF_DEF_  "ProtocolType" "";
BA_DEF_DEF_  "SendOnChange" "No";
BA_DEF_DEF_  "SigType" "Default";
BA_DEF_DEF_  "VFrameFormat" "J1939PG";
BA_ "DBName" "module_power";
BA_ "ProtocolType" "J1939";
BA_ "SendOnChange" BO_ 2637299454 1;
BA_ "SendOnChange" BO_ 2637233918 1;
BA_ "GenSigStartValue" SG_ 2637233918 PowerUpTime 1;
BA_ "SigType" SG_ 2637233918 PowerUpTime 1;
