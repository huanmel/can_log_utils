VERSION ""

NS_ :

BS_:

BU_:

BO_ 2180392702 RSDS: 1 Vector__XXX
 SG_ RollerShutterStatus : 0|3@1+ (1,0) [0|7] "" Vector__XXX
 SG_ RollerShutterFaults : 3|3@1+ (1,0) [0|7] "" Vector__XXX

BO_ 2180392190 RSHMIR: 1 Vector__XXX
 SG_ InputRollerShutterHMIRequest : 0|2@1+ (1,0) [0|3] "" Vector__XXX

BO_ 2180392446 RSCS: 8 Vector__XXX
 SG_ RollerShutterLockStateDisplay : 6|2@1+ (1,0) [0|3] "" Vector__XXX
 SG_ RollerShutterReq : 3|3@1+ (1,0) [0|7] "" Vector__XXX

CM_ "$File: //depot/auto/dbc/Software_Modules/Closures_System/Roller_Shutter/0.0.7.0/RollerShutter.dbc $
$Change: 215971 $
$DateTime: 2024/08/21 09:58:17 $
$Revision: #1 $";
CM_ SG_ 2180392702 RollerShutterStatus "Indicates the sensed roller shutter state";
CM_ SG_ 2180392702 RollerShutterFaults "Indicates the roller shutter faults";
CM_ SG_ 2180392190 InputRollerShutterHMIRequest "Indicates the sensed roller shutter request from HMI";
CM_ SG_ 2180392446 RollerShutterLockStateDisplay "Indicates the roller shutter lock state report to the HMI";
CM_ SG_ 2180392446 RollerShutterReq "Indicates the roller shutter state request to the driver";
BA_DEF_ SG_  "SigType" ENUM  "Default","Range","RangeSigned","ASCII","Discrete","Control","ReferencePGN","DTC","StringDelimiter","StringLength","StringLengthControl","MessageCounter","MessageChecksum";
BA_DEF_ SG_  "GenSigEVName" STRING ;
BA_DEF_ SG_  "GenSigILSupport" ENUM  "No","Yes";
BA_DEF_ SG_  "GenSigSendType" ENUM  "Cyclic","OnWrite","OnWriteWithRepetition","OnChange","OnChangeWithRepetition","IfActive","IfActiveWithRepetition","NoSigSendType";
BA_DEF_ SG_  "GenSigStartValue" INT 0 2147483647;
BA_DEF_ BO_  "GenMsgDelayTime" INT 0 1000;
BA_DEF_ BO_  "GenMsgILSupport" ENUM  "No","Yes";
BA_DEF_ BU_  "NmStationAddress" INT 0 255;
BA_DEF_ BO_  "GenMsgSendType" ENUM  "cyclic","NotUsed","IfActive","NotUsed","NotUsed","NotUsed","NotUsed","NotUsed","noMsgSendType";
BA_DEF_ BO_  "GenMsgRequestable" INT 0 1;
BA_DEF_ BO_  "GenMsgCycleTime" INT 0 3600000;
BA_DEF_ BO_  "SendOnChange" ENUM  "No","Yes";
BA_DEF_ BO_  "Producer" STRING ;
BA_DEF_  "DBName" STRING ;
BA_DEF_  "BusType" STRING ;
BA_DEF_  "ProtocolType" STRING ;
BA_DEF_ BO_  "VFrameFormat" ENUM  "StandardCAN","ExtendedCAN","reserved","J1939PG";
BA_DEF_DEF_  "SigType" "Default";
BA_DEF_DEF_  "GenSigEVName" "Env@Nodename_@Signame";
BA_DEF_DEF_  "GenSigILSupport" "Yes";
BA_DEF_DEF_  "GenSigSendType" "NoSigSendType";
BA_DEF_DEF_  "GenSigStartValue" 0;
BA_DEF_DEF_  "GenMsgDelayTime" 0;
BA_DEF_DEF_  "GenMsgILSupport" "Yes";
BA_DEF_DEF_  "NmStationAddress" 254;
BA_DEF_DEF_  "GenMsgSendType" "noMsgSendType";
BA_DEF_DEF_  "GenMsgRequestable" 1;
BA_DEF_DEF_  "GenMsgCycleTime" 0;
BA_DEF_DEF_  "SendOnChange" "No";
BA_DEF_DEF_  "Producer" "";
BA_DEF_DEF_  "DBName" "";
BA_DEF_DEF_  "BusType" "CAN";
BA_DEF_DEF_  "ProtocolType" "J1939";
BA_DEF_DEF_  "VFrameFormat" "J1939PG";
BA_ "DBName" "CHRG";
BA_ "Producer" BO_ 2180392702 "CLS";
BA_ "SendOnChange" BO_ 2180392702 1;
BA_ "GenMsgDelayTime" BO_ 2180392702 100;
BA_ "GenMsgSendType" BO_ 2180392702 0;
BA_ "GenMsgCycleTime" BO_ 2180392702 1000;
BA_ "GenMsgSendType" BO_ 2180392190 0;
BA_ "GenMsgCycleTime" BO_ 2180392190 1000;
BA_ "GenMsgDelayTime" BO_ 2180392190 100;
BA_ "SendOnChange" BO_ 2180392190 1;
BA_ "GenMsgSendType" BO_ 2180392446 0;
BA_ "GenMsgCycleTime" BO_ 2180392446 100;
BA_ "GenSigStartValue" SG_ 2180392702 RollerShutterStatus 7;
BA_ "GenSigStartValue" SG_ 2180392190 InputRollerShutterHMIRequest 3;
BA_ "GenSigStartValue" SG_ 2180392446 RollerShutterLockStateDisplay 3;
BA_ "GenSigStartValue" SG_ 2180392446 RollerShutterReq 7;
VAL_ 2180392702 RollerShutterStatus 7 "Not available" 6 "Error" 5 "Unknown" 4 "Closing" 3 "Opening" 2 "Intermediate" 1 "Closed" 0 "Open" ;
VAL_ 2180392702 RollerShutterFaults 7 "Not Available" 6 "CalibrationFail" 5 "UnknownPosition" 4 "Under Voltage" 3 "Over Voltage" 2 "Motor Overload" 1 "Movement Interrupted" 0 "No Fault" ;
VAL_ 2180392190 InputRollerShutterHMIRequest 3 "Not Available" 1 "Locked" 0 "Unlocked" ;
VAL_ 2180392446 RollerShutterLockStateDisplay 3 "Not Available" 1 "Locked" 0 "Unlocked" ;
VAL_ 2180392446 RollerShutterReq 6 "Calibration" 7 "Not Available" 3 "Closed" 2 "Open" 1 "Remain in place" 0 "Disable" ;
