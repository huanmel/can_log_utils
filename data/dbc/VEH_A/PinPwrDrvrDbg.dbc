VERSION ""

NS_ :

BS_:

BU_:

BO_ 2583108606 PinPwrDrvr_PinCommand: 1 Vector__XXX
 SG_ PinCommand : 0|8@1+ (1,0) [0|100] "%" Vector__XXX

CM_ "DBC for the PINPWRDRV System.
 
$DBC storage: //depot/auto/dbc/Software_Modules/LV_System/PINPWRDRV_int/ $
$Change: change_number $
$DateTime: YYYY/MM/DD HH:MM:SS $
$Revision: #revision_number $
$Author: ajay.ganesan@arrival.com $
";
CM_ BO_ 2583108606 "Debug signal to monitor the pin command";
CM_ SG_ 2583108606 PinCommand "PWM %";
BA_DEF_  "DBName" STRING ;
BA_DEF_ SG_  "SigType" ENUM  "Default","Range","RangeSigned","ASCII","Discrete","Control","ReferencePGN","DTC","StringDelimiter","StringLength","StringLengthControl","MessageCounter","MessageChecksum";
BA_DEF_ SG_  "GenSigStartValue" INT 0 2147483647;
BA_DEF_ BO_  "GenMsgRequestable" INT 0 1;
BA_DEF_ BO_  "GenMsgSendType" ENUM  "cyclic","NotUsed","NotUsed","NotUsed","NotUsed","NotUsed","NotUsed","IfActive","noMsgSendType";
BA_DEF_ BO_  "VFrameFormat" ENUM  "StandardCAN","ExtendedCAN","reserved","J1939PG","reserved","reserved","reserved","reserved","reserved","reserved","reserved","reserved","reserved","reserved","StandardCAN_FD","ExtendedCAN_FD";
BA_DEF_ BO_  "GenMsgCycleTime" INT 0 3600000;
BA_DEF_ BO_  "SendOnChange" ENUM  "No","Yes";
BA_DEF_ BU_  "NmStationAddress" INT 0 255;
BA_DEF_  "DatabaseVersion" STRING ;
BA_DEF_  "BusType" STRING ;
BA_DEF_  "ProtocolType" STRING ;
BA_DEF_DEF_  "DBName" "";
BA_DEF_DEF_  "SigType" "Default";
BA_DEF_DEF_  "GenSigStartValue" 0;
BA_DEF_DEF_  "GenMsgRequestable" 1;
BA_DEF_DEF_  "GenMsgSendType" "noMsgSendType";
BA_DEF_DEF_  "VFrameFormat" "J1939PG";
BA_DEF_DEF_  "GenMsgCycleTime" 0;
BA_DEF_DEF_  "SendOnChange" "No";
BA_DEF_DEF_  "NmStationAddress" 254;
BA_DEF_DEF_  "DatabaseVersion" "";
BA_DEF_DEF_  "BusType" "";
BA_DEF_DEF_  "ProtocolType" "";
BA_ "ProtocolType" "J1939";
BA_ "BusType" "CAN";
BA_ "DatabaseVersion" "8.5";
BA_ "DBName" "PinPwrDrvrDbg";
BA_ "GenMsgSendType" BO_ 2583108606 0;
BA_ "SendOnChange" BO_ 2583108606 1;
BA_ "GenMsgCycleTime" BO_ 2583108606 10;
