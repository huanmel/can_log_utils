VERSION ""

NS_ :

BS_:

BU_:

BO_ 3221225472 VECTOR__INDEPENDENT_SIG_MSG: 0 Vector__XXX
 SG_ VSM_Inp_ApprWakeReqValid : 0|1@1+ (1,0) [0|0] "" Vector__XXX
 SG_ VSM_InpRdy_HVReadyValid : 0|1@1+ (1,0) [0|0] "" Vector__XXX
 SG_ VSM_InpRdy_LVReadyValid : 0|1@1+ (1,0) [0|0] "" Vector__XXX
 SG_ VSM_InpRdy_ThermReadyValid : 0|1@1+ (1,0) [0|0] "" Vector__XXX
 SG_ VSM_Inp_ChargeReqValid : 0|1@1+ (1,0) [0|0] "" Vector__XXX
 SG_ VSM_Inp_ImmoStateValid : 0|1@1+ (1,0) [0|0] "" Vector__XXX
 SG_ VSM_InpRdy_SteerReadyValid : 0|1@1+ (1,0) [0|0] "" Vector__XXX
 SG_ VSM_InpRdy_DTReadyValid : 0|1@1+ (1,0) [0|0] "" Vector__XXX
 SG_ VSM_Inp_ChrgReadyValid : 0|1@1+ (1,0) [0|0] "" Vector__XXX
 SG_ VSM_InpRdy_BrSysReadyValid : 0|1@1+ (1,0) [0|0] "" Vector__XXX

BO_ 2600459518 VSM_DEBUG_OUT_2: 8 Vector__XXX
 SG_ VSM_OTA_Step : 0|5@1+ (1,1) [1|32] "" Vector__XXX

BO_ 2600457214 VSM_DEBUG_OUT_1: 8 Vector__XXX
 SG_ VSM_Inp_BdShutDwnCrctVld : 63|1@1+ (1,0) [0|0] "" Vector__XXX
 SG_ VSM_Inp_BdShutDwnCrct : 62|1@1+ (1,0) [0|0] "" Vector__XXX
 SG_ VSM_Inp_VehSpdValid : 54|1@1+ (1,0) [0|0] "" Vector__XXX
 SG_ VSM_Inp_HVBatStrReq : 51|1@1+ (1,0) [0|0] "" Vector__XXX
 SG_ VSM_Inp_FlatBat : 52|1@1+ (1,0) [0|0] "" Vector__XXX
 SG_ VSM_Inp_LvTopUp : 53|1@1+ (1,0) [0|0] "" Vector__XXX
 SG_ VSM_DBG_DenyShutdown : 58|1@1+ (1,0) [0|0] "" Vector__XXX
 SG_ VSM_DBG_StandStill : 57|1@1+ (1,0) [0|0] "" Vector__XXX
 SG_ VSM_DTS_Ignition : 59|1@1+ (1,0) [0|0] "" Vector__XXX
 SG_ VSM_Int_InitDecision : 9|4@1+ (1,0) [0|15] "" Vector__XXX
 SG_ VSM_InpRdy_ThermReady : 7|1@1+ (1,0) [0|0] "" Vector__XXX
 SG_ VSM_InpRdy_LVReady : 2|1@1+ (1,0) [0|0] "" Vector__XXX
 SG_ VSM_StTran_Sleep2Maint : 20|1@1+ (1,0) [0|0] "" Vector__XXX
 SG_ VSM_Int_LowBatteryTimerCond : 28|1@1+ (1,0) [0|0] "" Vector__XXX
 SG_ VSM_StTran_Maint2InvAwake : 22|1@1+ (1,0) [0|0] "" Vector__XXX
 SG_ VSM_GSSuggestedState : 60|2@1+ (1,0) [0|3] "" Vector__XXX
 SG_ VSM_Inp_VSMGSState : 48|3@1+ (1,0) [0|7] "" Vector__XXX
 SG_ VSM_Inp_VehLockState : 42|2@1+ (1,0) [0|0] "" Vector__XXX
 SG_ VSM_Inp_OTAUpdReq : 45|3@1+ (1,0) [0|0] "" Vector__XXX
 SG_ VSM_Inp_ImmoState : 40|2@1+ (1,0) [0|0] "" Vector__XXX
 SG_ VSM_Inp_DriverPres : 34|1@1+ (1,0) [0|0] "" Vector__XXX
 SG_ VSM_Inp_DoorOpenSt : 35|1@1+ (1,0) [0|0] "" Vector__XXX
 SG_ VSM_Inp_ApprWakeReq : 36|1@1+ (1,0) [0|0] "" Vector__XXX
 SG_ VSM_Inp_HMIWakeUp : 33|1@1+ (1,0) [0|0] "" Vector__XXX
 SG_ VSM_Inp_CrashValid : 56|1@1+ (1,0) [0|0] "" Vector__XXX
 SG_ VSM_Inp_Crash : 44|1@1+ (1,0) [0|0] "" Vector__XXX
 SG_ VSM_Inp_ThermCondReq : 38|1@1+ (1,0) [0|0] "" Vector__XXX
 SG_ VSM_Inp_ChargeReq : 39|1@1+ (1,0) [0|0] "" Vector__XXX
 SG_ VSM_Inp_DriverDoorTPoint : 31|1@1+ (1,0) [0|0] "" Vector__XXX
 SG_ VSM_StTran_Ready2Sleep : 17|1@1+ (1,0) [0|0] "" Vector__XXX
 SG_ VSM_Int_SleepTimer : 26|1@1+ (1,0) [0|0] "" Vector__XXX
 SG_ VSM_StTran_Sleep2Awake : 13|1@1+ (1,0) [0|0] "" Vector__XXX
 SG_ VSM_Int_Ready2AwakeSpeedCond : 25|1@1+ (1,0) [0|0] "" Vector__XXX
 SG_ VSM_StTran_Ready2Awake : 15|1@1+ (1,0) [0|0] "" Vector__XXX
 SG_ VSM_Int_ParkTimer : 29|1@1+ (1,0) [0|0] "" Vector__XXX
 SG_ VSM_Int_MandReadyValid : 8|1@1+ (1,0) [0|0] "" Vector__XXX
 SG_ VSM_Int_MandReady : 0|1@1+ (1,0) [0|0] "" Vector__XXX
 SG_ VSM_StTran_Maint2FullySleep : 21|1@1+ (1,0) [0|0] "" Vector__XXX
 SG_ VSM_StTran_Maint2Awake : 24|1@1+ (1,0) [0|0] "" Vector__XXX
 SG_ VSM_Int_LowBatteryTimer : 27|1@1+ (1,0) [0|0] "" Vector__XXX
 SG_ VSM_StTran_InvAwake2FullySleep : 18|1@1+ (1,0) [0|0] "" Vector__XXX
 SG_ VSM_StTran_FullySleep2InvAwake : 19|1@1+ (1,0) [0|0] "" Vector__XXX
 SG_ VSM_Int_DriverAbsenceTimer : 30|1@1+ (1,0) [0|0] "" Vector__XXX
 SG_ VSM_StTran_Awake2Sleep : 16|1@1+ (1,0) [0|0] "" Vector__XXX
 SG_ VSM_StTran_Awake2Ready : 14|1@1+ (1,0) [0|0] "" Vector__XXX
 SG_ VSM_StTran_Awake2Maint : 23|1@1+ (1,0) [0|0] "" Vector__XXX
 SG_ VSM_Inp_BrPedPrValid : 55|1@1+ (1,0) [0|0] "" Vector__XXX
 SG_ VSM_Inp_BrPedPr : 32|1@1+ (1,0) [0|0] "" Vector__XXX
 SG_ VSM_InpRdy_SteerReady : 3|1@1+ (1,0) [0|0] "" Vector__XXX
 SG_ VSM_InpRdy_HVReady : 1|1@1+ (1,0) [0|0] "" Vector__XXX
 SG_ VSM_InpRdy_DTReady : 6|1@1+ (1,0) [0|0] "" Vector__XXX
 SG_ VSM_InpRdy_ChrgReady : 5|1@1+ (1,0) [0|0] "" Vector__XXX
 SG_ VSM_Inp_ChrgPluggedIn : 37|1@1+ (1,0) [0|0] "" Vector__XXX
 SG_ VSM_InpRdy_BrSys : 4|1@1+ (1,0) [0|0] "" Vector__XXX

CM_ BO_ 3221225472 "This is a message for not used signals, created by Vector CANdb++ DBC OLE DB Provider.";
CM_ SG_ 3221225472 VSM_Inp_ApprWakeReqValid "Value of SimpleVSM_ApprWakeReqValid";
CM_ SG_ 3221225472 VSM_Inp_ImmoStateValid "Value of SimpleVSM_ImmoStateValid/SimpleVSM_VehLockStateValid (same source)";
CM_ SG_ 2600457214 VSM_Inp_BdShutDwnCrctVld "BoardShutDownCorrectValid
";
CM_ SG_ 2600457214 VSM_Inp_BdShutDwnCrct "BoardShutDownCorrect";
CM_ SG_ 2600457214 VSM_Int_LowBatteryTimerCond "Result of AND block of Low Battery Timers Conditions";
CM_ SG_ 2600457214 VSM_GSSuggestedState "GS Suggested  value from VSM_Adp:
0 Park
1 Neurtal
2 Drive
3 Reverse
";
CM_ SG_ 2600457214 VSM_Inp_VSMGSState "GS value from VSM_Adp:
0 P
1 N
2 D
3 R
or NA";
CM_ SG_ 2600457214 VSM_Inp_OTAUpdReq "     0     {'SimpleVSM_NoAction'   }
     1     {'SimpleVSM_Maintenance'}
     2     {'SimpleVSM_FullySleep' }
     3     {'SimpleVSM_InvAwake'   }
     4     {'SimpleVSM_Wake'       }";
BA_DEF_  "BusType" STRING ;
BA_DEF_  "DBName" STRING ;
BA_DEF_ BO_  "GenMsgCycleTime" INT 0 3600000;
BA_DEF_ BO_  "Producer" STRING ;
BA_DEF_ BO_  "GenMsgDelayTime" INT 0 1000;
BA_DEF_ BO_  "GenMsgILSupport" ENUM  "No","Yes";
BA_DEF_ BO_  "GenMsgRequestable" INT 0 1;
BA_DEF_ BO_  "GenMsgSendType" ENUM  "cyclic","NotUsed","IfActive","NotUsed","NotUsed","NotUsed","NotUsed","NotUsed","noMsgSendType";
BA_DEF_ SG_  "GenSigEVName" STRING ;
BA_DEF_ SG_  "GenSigILSupport" ENUM  "No","Yes";
BA_DEF_ SG_  "GenSigSendType" ENUM  "Cyclic","OnWrite","OnWriteWithRepetition","OnChange","OnChangeWithRepetition","IfActive","IfActiveWithRepetition","NoSigSendType";
BA_DEF_ SG_  "GenSigStartValue" INT 0 2147483647;
BA_DEF_ BU_  "NmStationAddress" INT 0 255;
BA_DEF_  "ProtocolType" STRING ;
BA_DEF_ BO_  "SendOnChange" ENUM  "No","Yes";
BA_DEF_ SG_  "SigType" ENUM  "Default","Range","RangeSigned","ASCII","Discrete","Control","ReferencePGN","DTC","StringDelimiter","StringLength","StringLengthControl";
BA_DEF_ BO_  "VFrameFormat" ENUM  "StandardCAN","ExtendedCAN","reserved","J1939PG";
BA_DEF_DEF_  "BusType" "CAN";
BA_DEF_DEF_ "Producer" "VSS";
BA_DEF_DEF_  "DBName" "";
BA_DEF_DEF_  "GenMsgCycleTime" 0;
BA_DEF_DEF_  "GenMsgDelayTime" 0;
BA_DEF_DEF_  "GenMsgILSupport" "Yes";
BA_DEF_DEF_  "GenMsgRequestable" 1;
BA_DEF_DEF_  "GenMsgSendType" "noMsgSendType";
BA_DEF_DEF_  "GenSigEVName" "Env@Nodename_@Signame";
BA_DEF_DEF_  "GenSigILSupport" "Yes";
BA_DEF_DEF_  "GenSigSendType" "NoSigSendType";
BA_DEF_DEF_  "GenSigStartValue" 0;
BA_DEF_DEF_  "NmStationAddress" 254;
BA_DEF_DEF_  "ProtocolType" "J1939";
BA_DEF_DEF_  "SendOnChange" "No";
BA_DEF_DEF_  "SigType" "Default";
BA_DEF_DEF_  "VFrameFormat" "J1939PG";
BA_ "DBName" "CHRG_MS3_DCU";
BA_ "SendOnChange" BO_ 2600459518 1;
BA_ "GenMsgSendType" BO_ 2600459518 0;
BA_ "GenMsgCycleTime" BO_ 2600459518 100;
BA_ "GenMsgCycleTime" BO_ 2600457214 1000;
BA_ "GenMsgSendType" BO_ 2600457214 0;
BA_ "SendOnChange" BO_ 2600457214 1;
BA_ "GenMsgDelayTime" BO_ 2600457214 100;
BA_ "GenSigStartValue" SG_ 2600457214 VSM_Int_InitDecision 9;
