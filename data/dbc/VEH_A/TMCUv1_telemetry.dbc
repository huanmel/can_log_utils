VERSION ""

NS_ :

BS_:

BU_: DCU
VAL_TABLE_ OpCodeInfo 3 "MaxOpCodeIndex" 2 "SnrsFaultCodes" 1 "HWFaultCodes" 0 "InverterState" ;
VAL_TABLE_ OpCodeSignal 11 "MaxOpCodeIndex" 10 "DQAxesVoltages" 9 "PowerMeterInfo" 8 "PhaseVoltages" 7 "DQAxesCurrents" 6 "SpeedRefFdbck" 5 "TorqueRefFdbck" 4 "SpeedAndPosition" 3 "MeasuredVoltages" 2 "MeasuredCurrents" 1 "ExternalTemper" 0 "InternalTemper" ;

BO_ 2348875774 Inv_Health_State: 8 Vector__XXX
 SG_ Inv_Health : 0|1@1+ (1,0) [0|0] "" Vector__XXX
 SG_ Inv_Board_Power_Health : 1|1@1+ (1,0) [0|0] "" Vector__XXX
 SG_ Inv_Board_Control_Health : 2|1@1+ (1,0) [0|0] "" Vector__XXX
 SG_ Inv_Board_Gates_Health : 3|1@1+ (1,0) [0|0] "" Vector__XXX
 SG_ Inv_Comm_Health : 4|1@1+ (1,0) [0|0] "" Vector__XXX
 SG_ Inv_Comm_CAN_Health : 5|1@1+ (1,0) [0|0] "" Vector__XXX
 SG_ Inv_Comm_SPI_Health : 6|1@1+ (1,0) [0|0] "" Vector__XXX
 SG_ Inv_Comm_ETH_Health : 7|1@1+ (1,0) [0|0] "" Vector__XXX
 SG_ Inv_MCU_Health : 8|1@1+ (1,0) [0|0] "" Vector__XXX
 SG_ Inv_MCU_CPU_Health : 9|1@1+ (1,0) [0|0] "" Vector__XXX
 SG_ Inv_MCU_DMA_Health : 10|1@1+ (1,0) [0|0] "" Vector__XXX
 SG_ Inv_MCU_GTM_Health : 11|1@1+ (1,0) [0|0] "" Vector__XXX
 SG_ Inv_MCU_WDT_Health : 12|1@1+ (1,0) [0|0] "" Vector__XXX
 SG_ Inv_MCU_Memory_Health : 13|1@1+ (1,0) [0|0] "" Vector__XXX
 SG_ Inv_MCU_NVRAM_Health : 14|1@1+ (1,0) [0|0] "" Vector__XXX
 SG_ Inv_MCU_SARADC_Health : 15|1@1+ (1,0) [0|0] "" Vector__XXX
 SG_ Inv_Firmware_Health : 16|1@1+ (1,0) [0|0] "" Vector__XXX
 SG_ Inv_Firmware_Init_Health : 17|1@1+ (1,0) [0|0] "" Vector__XXX
 SG_ Inv_Firmware_Run_Health : 18|1@1+ (1,0) [0|0] "" Vector__XXX
 SG_ Inv_Firmware_Task_Health : 19|1@1+ (1,0) [0|0] "" Vector__XXX
 SG_ Inv_Firmware_WDT_Health : 20|1@1+ (1,0) [0|0] "" Vector__XXX
 SG_ Inv_Motor_Health : 21|1@1+ (1,0) [0|0] "" Vector__XXX
 SG_ Inv_Motor_Resolver_Health : 22|1@1+ (1,0) [0|0] "" Vector__XXX
 SG_ Inv_Motor_Engine_Health : 23|1@1+ (1,0) [0|0] "" Vector__XXX

BA_DEF_ BO_  "PpCcGenMsgType" STRING ;
BA_DEF_ SG_  "SigType" ENUM  "Default","Range","RangeSigned","ASCII","Discrete","Control","ReferencePGN","DTC","StringDelimiter","StringLength","StringLengthControl","MessageCounter","MessageChecksum";
BA_DEF_ SG_  "GenSigEVName" STRING ;
BA_DEF_ SG_  "GenSigILSupport" ENUM  "No","Yes";
BA_DEF_ SG_  "GenSigSendType" ENUM  "Cyclic","OnWrite","OnWriteWithRepetition","OnChange","OnChangeWithRepetition","IfActive","IfActiveWithRepetition","NoSigSendType";
BA_DEF_ BO_  "GenMsgILSupport" ENUM  "No","Yes";
BA_DEF_ BU_  "NmStationAddress" INT 0 255;
BA_DEF_ BO_  "GenMsgSendType" ENUM  "cyclic","NotUsed","IfActive","NotUsed","NotUsed","NotUsed","NotUsed","NotUsed","noMsgSendType";
BA_DEF_ BO_  "GenMsgRequestable" INT 0 1;
BA_DEF_ SG_  "SPN" INT 0 524287;
BA_DEF_  "DBName" STRING ;
BA_DEF_  "BusType" STRING ;
BA_DEF_  "ProtocolType" STRING ;
BA_DEF_ BO_  "VFrameFormat" ENUM  "StandardCAN","ExtendedCAN","reserved","J1939PG";
BA_DEF_DEF_  "PpCcGenMsgType" "PpCcUndefined";
BA_DEF_DEF_  "SigType" "Default";
BA_DEF_DEF_  "GenSigEVName" "Env@Nodename_@Signame";
BA_DEF_DEF_  "GenSigILSupport" "Yes";
BA_DEF_DEF_  "GenSigSendType" "NoSigSendType";
BA_DEF_DEF_  "GenMsgILSupport" "Yes";
BA_DEF_DEF_  "NmStationAddress" 254;
BA_DEF_DEF_  "GenMsgSendType" "noMsgSendType";
BA_DEF_DEF_  "GenMsgRequestable" 1;
BA_DEF_DEF_  "SPN" 0;
BA_DEF_DEF_  "DBName" "";
BA_DEF_DEF_  "BusType" "CAN";
BA_DEF_DEF_  "ProtocolType" "J1939";
BA_DEF_DEF_  "VFrameFormat" "J1939PG";
BA_ "DBName" "Traction_Inverter";
BA_ "NmStationAddress" BU_ DCU 100;
BA_ "PpCcGenMsgType" BO_ 2348875774 "PpCcHealth";
BA_ "SPN" SG_ 2348875774 Inv_Health 515200;
BA_ "SPN" SG_ 2348875774 Inv_Board_Power_Health 515233;
BA_ "SPN" SG_ 2348875774 Inv_Board_Control_Health 515231;
BA_ "SPN" SG_ 2348875774 Inv_Board_Gates_Health 515232;
BA_ "SPN" SG_ 2348875774 Inv_Comm_Health 515240;
BA_ "SPN" SG_ 2348875774 Inv_Comm_CAN_Health 515241;
BA_ "SPN" SG_ 2348875774 Inv_Comm_SPI_Health 515243;
BA_ "SPN" SG_ 2348875774 Inv_Comm_ETH_Health 515242;
BA_ "SPN" SG_ 2348875774 Inv_MCU_Health 515220;
BA_ "SPN" SG_ 2348875774 Inv_MCU_CPU_Health 515221;
BA_ "SPN" SG_ 2348875774 Inv_MCU_DMA_Health 515223;
BA_ "SPN" SG_ 2348875774 Inv_MCU_GTM_Health 515227;
BA_ "SPN" SG_ 2348875774 Inv_MCU_WDT_Health 515226;
BA_ "SPN" SG_ 2348875774 Inv_MCU_Memory_Health 515222;
BA_ "SPN" SG_ 2348875774 Inv_MCU_NVRAM_Health 515228;
BA_ "SPN" SG_ 2348875774 Inv_MCU_SARADC_Health 515229;
BA_ "SPN" SG_ 2348875774 Inv_Firmware_Health 515210;
BA_ "SPN" SG_ 2348875774 Inv_Firmware_Init_Health 515211;
BA_ "SPN" SG_ 2348875774 Inv_Firmware_Run_Health 515212;
BA_ "SPN" SG_ 2348875774 Inv_Firmware_Task_Health 515213;
BA_ "SPN" SG_ 2348875774 Inv_Firmware_WDT_Health 515214;
BA_ "SPN" SG_ 2348875774 Inv_Motor_Health 515250;
BA_ "SPN" SG_ 2348875774 Inv_Motor_Resolver_Health 515252;
BA_ "SPN" SG_ 2348875774 Inv_Motor_Engine_Health 515251;
