VERSION ""

NS_ :

BS_:

BU_: Device Host
VAL_TABLE_ vtDTSLockCmd 3 "NA" 2 "ENGAGE" 1 "DISENGAGE" 0 "NO_ACTION" ;
VAL_TABLE_ vtDTSLockSt 7 "NA" 6 "FAULT" 5 "RESERVED" 4 "DISENGAGED" 3 "DISENGAGING" 2 "ENGAGED" 1 "ENGAGING" 0 "INIT" ;
VAL_TABLE_ vtDtsDirectionSt 3 "NA" 2 "REVERSE" 1 "FORWARD" 0 "STANDBY" ;
VAL_TABLE_ vtDtsDirectionCmd 3 "NA" 2 "REVERSE" 1 "FORWARD" 0 "NO_ACTION" ;
VAL_TABLE_ vtOnOff 3 "Not available" 2 "Error" 1 "On" 0 "Off" ;
VAL_TABLE_ vAction_t 3 "va_Take_no_action" 2 "va_Reserved" 1 "va_On" 0 "va_Off" ;

BO_ 2381972222 DTS_Status2: 8 Vector__XXX
 SG_ DTS_Stalk_Request : 32|2@1+ (1,0) [0|3] "" Vector__XXX
 SG_ DTS_P_Button : 30|2@1+ (1,0) [0|3] "" Vector__XXX
 SG_ DTS_Status2_counter : 48|4@1+ (1,0) [0|15] "" Vector__XXX
 SG_ DTS_Status2_checksum : 56|8@1+ (1,0) [0|255] "" Vector__XXX
 SG_ DTS_Stalk_GS_Input : 27|3@1+ (1,0) [0|6] "" Vector__XXX
 SG_ DTS_GS_Human_RND_Input : 24|3@1+ (1,0) [0|4] "" Vector__XXX
 SG_ DTS_GS_Human_P_Input : 22|2@1+ (1,0) [0|3] "" Vector__XXX
 SG_ DTS_IDU_CommStatus : 7|1@1+ (1,0) [0|1] "" Vector__XXX
 SG_ DTS_IDU_ShortCirc : 5|2@1+ (1,0) [0|3] "" Vector__XXX
 SG_ DTS_ParkBrakeSt : 11|3@1+ (1,0) [0|7] "" Vector__XXX
 SG_ DTS_ParkBrakeCmd : 14|2@1+ (1,0) [0|3] "" Vector__XXX
 SG_ DTS_IDU_InterlockSt : 8|3@1+ (1,0) [0|7] "" Vector__XXX
 SG_ DTS_IDU_InterlockCmd : 16|2@1+ (1,0) [0|3] "" Vector__XXX
 SG_ DTS_IDU_DirectionSt : 20|2@1+ (1,0) [0|3] "" Vector__XXX
 SG_ DTS_IDU_DirectionCmd : 18|2@1+ (1,0) [0|3] "" Vector__XXX
 SG_ DTS_IDU_HV_CheckState : 4|1@1+ (1,0) [0|1] "" Vector__XXX
 SG_ DTS_SysSt_ParkLock : 2|2@1+ (1,0) [0|3] "" Vector__XXX
 SG_ DTS_SysSt_IDU : 0|2@1+ (1,0) [0|3] "" Vector__XXX

CM_ "Arrival Drivetrain Controller Database.
$DBC storage: //depot/auto/dbc/Software_Modules/Drivetrain_Controller/ArrivalDTC/ $
$Change: 0 $
$DateTime: 2020/11/02 14:30:00 $
$Revision: #1 $
$Author: lyamin@arrival.com $
";
CM_ BO_ 2381972222 "Message with general information about current Drivetrain System state";
CM_ SG_ 2381972222 DTS_Stalk_Request "There is a valid request from Stalk at current moment or not";
CM_ SG_ 2381972222 DTS_P_Button "State of P button of stalks";
CM_ SG_ 2381972222 DTS_IDU_ShortCirc "0 - Ok
1 - Short Circuit";
CM_ SG_ 2381972222 DTS_IDU_HV_CheckState "0 - HV not ready
1 - HV ready";
CM_ SG_ 2381972222 DTS_SysSt_ParkLock "Drivetrain system status";
CM_ SG_ 2381972222 DTS_SysSt_IDU "Drivetrain system status";
BA_DEF_  "BusType" STRING ;
BA_DEF_  "DBName" STRING ;
BA_DEF_  "DatabaseVersion" STRING ;
BA_DEF_ BO_  "GenMsgCycleTime" INT 0 3600000;
BA_DEF_ BO_  "GenMsgILSupport" ENUM  "No","Yes";
BA_DEF_ BO_  "GenMsgRequestable" INT 0 1;
BA_DEF_ BO_  "GenMsgSendType" ENUM  "cyclic","NotUsed","NotUsed","NotUsed","NotUsed","NotUsed","NotUsed","IfActive","noMsgSendType";
BA_DEF_ BO_  "Producer" STRING ;
BA_DEF_ SG_  "GenSigEVName" STRING ;
BA_DEF_ SG_  "GenSigILSupport" ENUM  "No","Yes";
BA_DEF_ SG_  "GenSigSendType" ENUM  "Cyclic","OnWrite","OnWriteWithRepetition","OnChange","OnChangeWithRepetition","IfActive","IfActiveWithRepetition","NoSigSendType";
BA_DEF_ SG_  "GenSigStartValue" INT 0 2147483647;
BA_DEF_ BU_  "NmStationAddress" INT 0 255;
BA_DEF_  "ProtocolType" STRING ;
BA_DEF_  "SAE_J1939_21_SpecVersion" STRING ;
BA_DEF_  "SAE_J1939_71_SpecVersion" STRING ;
BA_DEF_  "SAE_J1939_73_SpecVersion" STRING ;
BA_DEF_  "SAE_J1939_75_SpecVersion" STRING ;
BA_DEF_  "SAE_J1939_81_SpecVersion" STRING ;
BA_DEF_  "SAE_J1939_DA_SpecVersion" STRING ;
BA_DEF_ SG_  "SigType" ENUM  "Default","Range","RangeSigned","ASCII","Discrete","Control","ReferencePGN","DTC","StringDelimiter","StringLength","StringLengthControl","MessageCounter","MessageChecksum";
BA_DEF_ BO_  "VFrameFormat" ENUM  "StandardCAN","ExtendedCAN","reserved","J1939PG","reserved","reserved","reserved","reserved","reserved","reserved","reserved","reserved","reserved","reserved","StandardCAN_FD","ExtendedCAN_FD";
BA_DEF_DEF_  "BusType" "";
BA_DEF_DEF_  "DBName" "";
BA_DEF_DEF_  "DatabaseVersion" "";
BA_DEF_DEF_  "GenMsgCycleTime" 0;
BA_DEF_DEF_  "GenMsgILSupport" "Yes";
BA_DEF_DEF_  "GenMsgRequestable" 1;
BA_DEF_DEF_  "GenMsgSendType" "noMsgSendType";
BA_DEF_DEF_  "Producer" "DTS";
BA_DEF_DEF_  "GenSigEVName" "Env@Nodename_@Signame";
BA_DEF_DEF_  "GenSigILSupport" "Yes";
BA_DEF_DEF_  "GenSigSendType" "NoSigSendType";
BA_DEF_DEF_  "GenSigStartValue" 0;
BA_DEF_DEF_  "NmStationAddress" 254;
BA_DEF_DEF_  "ProtocolType" "";
BA_DEF_DEF_  "SAE_J1939_21_SpecVersion" "";
BA_DEF_DEF_  "SAE_J1939_71_SpecVersion" "";
BA_DEF_DEF_  "SAE_J1939_73_SpecVersion" "";
BA_DEF_DEF_  "SAE_J1939_75_SpecVersion" "";
BA_DEF_DEF_  "SAE_J1939_81_SpecVersion" "";
BA_DEF_DEF_  "SAE_J1939_DA_SpecVersion" "";
BA_DEF_DEF_  "SigType" "Default";
BA_DEF_DEF_  "VFrameFormat" "J1939PG";
BA_ "BusType" "CAN";
BA_ "DatabaseVersion" "1.0";
BA_ "ProtocolType" "J1939";
BA_ "SAE_J1939_21_SpecVersion" "2006-10";
BA_ "SAE_J1939_71_SpecVersion" "2012-10";
BA_ "SAE_J1939_73_SpecVersion" "2012-10";
BA_ "SAE_J1939_75_SpecVersion" "2012-05";
BA_ "SAE_J1939_81_SpecVersion" "2012-05";
BA_ "SAE_J1939_DA_SpecVersion" "2015-01";
BA_ "DBName" "DTS_Status1";
BA_ "GenMsgSendType" BO_ 2381972222 0;
BA_ "GenMsgCycleTime" BO_ 2381972222 100;
BA_ "GenSigSendType" SG_ 2381972222 DTS_Status2_counter 0;
BA_ "SigType" SG_ 2381972222 DTS_Status2_counter 11;
BA_ "GenSigSendType" SG_ 2381972222 DTS_Status2_checksum 0;
BA_ "SigType" SG_ 2381972222 DTS_Status2_checksum 12;
VAL_ 2381972222 DTS_Stalk_Request 3 "NA" 2 "Error" 1 "Active" 0 "NotActive" ;
VAL_ 2381972222 DTS_P_Button 3 "NA" 2 "Error" 1 "Pressed" 0 "NotPressed" ;
VAL_ 2381972222 DTS_Stalk_GS_Input 6 "NA" 5 "ParkReverse" 4 "Reverse" 3 "ParkDrive" 2 "Drive" 1 "Neutral" 0 "Park" ;
VAL_ 2381972222 DTS_GS_Human_RND_Input 4 "NA" 3 "Error" 2 "Reverse" 1 "Drive" 0 "Neutral" ;
VAL_ 2381972222 DTS_GS_Human_P_Input 3 "NA" 2 "Error" 1 "Park" 0 "Neutral" ;
VAL_ 2381972222 DTS_IDU_CommStatus 1 "Ok" 0 "Error" ;
VAL_ 2381972222 DTS_IDU_ShortCirc 3 "NA" 2 "Error" 1 "Short Circuit" 0 "OK" ;
VAL_ 2381972222 DTS_ParkBrakeSt 7 "NA" 6 "FAULT" 5 "CHANGE IN PROGRESS" 4 "DISENGAGED" 3 "DISENGAGING" 2 "ENGAGED" 1 "ENGAGING" 0 "INIT" ;
VAL_ 2381972222 DTS_ParkBrakeCmd 3 "NA" 2 "ENGAGE" 1 "DISENGAGE" 0 "NO_ACTION" ;
VAL_ 2381972222 DTS_IDU_InterlockSt 7 "NA" 6 "FAULT" 5 "CHANGE IN PROGRESS" 4 "DISENGAGED" 3 "DISENGAGING" 2 "ENGAGED" 1 "ENGAGING" 0 "INIT" ;
VAL_ 2381972222 DTS_IDU_InterlockCmd 3 "NA" 2 "ENGAGE" 1 "DISENGAGE" 0 "NO_ACTION" ;
VAL_ 2381972222 DTS_IDU_DirectionSt 3 "NA" 2 "REVERSE" 1 "FORWARD" 0 "STANDBY" ;
VAL_ 2381972222 DTS_IDU_DirectionCmd 3 "NA" 2 "REVERSE" 1 "FORWARD" 0 "NO_ACTION" ;
VAL_ 2381972222 DTS_SysSt_ParkLock 3 "NA" 2 "ERROR" 1 "READY" 0 "NOT_READY" ;
VAL_ 2381972222 DTS_SysSt_IDU 3 "NA" 2 "ERROR" 1 "READY" 0 "NOT_READY" ;
