VERSION ""

NS_ :

BS_:

BU_: Device Host

BO_ 2650742782 MaintenanceStatus: 8 Host
 SG_ DiagReportsEnabled : 2|2@1+ (1,0) [0|0] "" Vector__XXX
 SG_ FirmwareUpdateEnabled : 0|2@1+ (1,0) [0|0] "" Vector__XXX

CM_ "Module info (Versions, state, etc) messages
$File: //system_software/components/lib/module_info/head/dbc/module_info.dbc $
$Change: 72571 $
$DateTime: 2021/08/03 12:38:55 $
$Revision: #5 $";
CM_ BO_ 2650742782 "Request to send module information messages";
CM_ SG_ 2650742782 DiagReportsEnabled "Diagnostic reports enabled";
CM_ SG_ 2650742782 FirmwareUpdateEnabled "Firmware update enabled";
BA_DEF_  "BusType" STRING ;
BA_DEF_  "DBName" STRING ;
BA_DEF_ BO_  "GenMsgCycleTime" INT 0 65535;
BA_DEF_ BO_  "GenMsgILSupport" ENUM  "No","Yes";
BA_DEF_ BO_  "GenMsgRequestable" INT 0 1;
BA_DEF_ BO_  "GenMsgSendType" ENUM  "cyclic","NotUsed","NotUsed","NotUsed","NotUsed","NotUsed","NotUsed","IfActive","noMsgSendType";
BA_DEF_ SG_  "GenSigEVName" STRING ;
BA_DEF_ SG_  "GenSigILSupport" ENUM  "No","Yes";
BA_DEF_ SG_  "GenSigSendType" ENUM  "Cyclic","OnWrite","OnWriteWithRepetition","OnChange","OnChangeWithRepetition","IfActive","IfActiveWithRepetition","NoSigSendType";
BA_DEF_ SG_  "GenSigStartValue" FLOAT -3.4E+038 3.4E+038;
BA_DEF_ BU_  "NmStationAddress" INT 0 255;
BA_DEF_  "ProtocolType" STRING ;
BA_DEF_ BO_  "SendOnChange" ENUM  "No","Yes";
BA_DEF_ SG_  "SigType" ENUM  "Default","Range","RangeSigned","ASCII","Discrete","Control","ReferencePGN","DTC","StringDelimiter","StringLength","StringLengthControl","MessageCounter","MessageChecksum";
BA_DEF_ BO_  "VFrameFormat" ENUM  "StandardCAN","ExtendedCAN","reserved","J1939PG";
BA_DEF_DEF_  "BusType" "CAN";
BA_DEF_DEF_  "DBName" "";
BA_DEF_DEF_  "GenMsgCycleTime" 0;
BA_DEF_DEF_  "GenMsgILSupport" "Yes";
BA_DEF_DEF_  "GenMsgRequestable" 1;
BA_DEF_DEF_  "GenMsgSendType" "noMsgSendType";
BA_DEF_DEF_  "GenSigEVName" "Env@Nodename_@Signame";
BA_DEF_DEF_  "GenSigILSupport" "Yes";
BA_DEF_DEF_  "GenSigSendType" "NoSigSendType";
BA_DEF_DEF_  "GenSigStartValue" 0;
BA_DEF_DEF_  "NmStationAddress" 254;
BA_DEF_DEF_  "ProtocolType" "";
BA_DEF_DEF_  "SendOnChange" "No";
BA_DEF_DEF_  "SigType" "Default";
BA_DEF_DEF_  "VFrameFormat" "J1939PG";
BA_ "ProtocolType" "J1939";
BA_ "DBName" "MaintenanceStatus";
BA_ "SendOnChange" BO_ 2650742782 1;
BA_ "GenMsgSendType" BO_ 2650742782 0;
BA_ "GenMsgCycleTime" BO_ 2650742782 1000;
BA_ "GenMsgRequestable" BO_ 2650742782 0;
VAL_ 2650742782 DiagReportsEnabled 0 "Off" 1 "On" 2 "Error" 3 "Not available" ;
VAL_ 2650742782 FirmwareUpdateEnabled 0 "Off" 1 "On" 2 "Error" 3 "Not available" ;
