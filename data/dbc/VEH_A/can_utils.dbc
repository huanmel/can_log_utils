VERSION ""

NS_ :

BS_:

BU_: Device Host
VAL_TABLE_ vtDLC 0 "DLC_0" 1 "DLC_1" 2 "DLC_2" 3 "DLC_3" 4 "DLC_4" 5 "DLC_5" 6 "DLC_6" 7 "DLC_7" 8 "DLC_8" 9 "DLC_12" 10 "DLC_16" 11 "DLC_20" 12 "DLC_24" 13 "DLC_32" 14 "DLC_48" 15 "DLC_64" ;

BO_ 2180974846 PingAnswer: 2 Device
 SG_ AnswerNumber : 0|16@1+ (1,0) [0|64255] "" Vector__XXX

BO_ 2169831166 PingRequest: 3 Host
 SG_ RequestDLC : 0|4@1+ (1,0) [0|15] "" Vector__XXX
 SG_ RequestNumber : 8|16@1+ (1,0) [0|64255] "" Vector__XXX

CM_ "CAN Utils messages
$File: //depot/auto/dbc/health_monitoring/head/Arrival_health.dbc $
$Change: 21732 $
$DateTime: 2020/02/20 16:50:10 $
$Revision: #7 $";
BA_DEF_  "BusType" STRING ;
BA_DEF_  "DBName" STRING ;
BA_DEF_ BO_  "GenMsgCycleTime" INT 0 65535;
BA_DEF_ BO_  "GenMsgILSupport" ENUM  "No","Yes";
BA_DEF_ BO_  "GenMsgRequestable" INT 0 1;
BA_DEF_ BO_  "GenMsgSendType" ENUM  "cyclic","NotUsed","NotUsed","NotUsed","NotUsed","NotUsed","NotUsed","IfActive","noMsgSendType";
BA_DEF_ SG_  "GenSigEVName" STRING ;
BA_DEF_ SG_  "GenSigILSupport" ENUM  "No","Yes";
BA_DEF_ SG_  "GenSigSendType" ENUM  "Cyclic","OnWrite","OnWriteWithRepetition","OnChange","OnChangeWithRepetition","IfActive","IfActiveWithRepetition","NoSigSendType";
BA_DEF_ SG_  "GenSigStartValue" FLOAT -3.4e+38 3.4e+38;
BA_DEF_ BU_  "NmStationAddress" INT 0 255;
BA_DEF_  "ProtocolType" STRING ;
BA_DEF_ BO_  "SendOnChange" ENUM  "No","Yes";
BA_DEF_ SG_  "SigType" ENUM  "Default","Range","RangeSigned","ASCII","Discrete","Control","ReferencePGN","DTC","StringDelimiter","StringLength","StringLengthControl","MessageCounter","MessageChecksum";
BA_DEF_ BO_  "VFrameFormat" ENUM  "StandardCAN","ExtendedCAN","reserved","J1939PG";
BA_DEF_DEF_  "BusType" "CAN";
BA_DEF_DEF_  "DBName" "";
BA_DEF_DEF_  "GenMsgCycleTime" 0;
BA_DEF_DEF_  "GenMsgILSupport" "Yes";
BA_DEF_DEF_  "GenMsgRequestable" 1;
BA_DEF_DEF_  "GenMsgSendType" "noMsgSendType";
BA_DEF_DEF_  "GenSigEVName" "Env@Nodename_@Signame";
BA_DEF_DEF_  "GenSigILSupport" "Yes";
BA_DEF_DEF_  "GenSigSendType" "NoSigSendType";
BA_DEF_DEF_  "GenSigStartValue" 0;
BA_DEF_DEF_  "NmStationAddress" 254;
BA_DEF_DEF_  "ProtocolType" "";
BA_DEF_DEF_  "SendOnChange" "No";
BA_DEF_DEF_  "SigType" "Default";
BA_DEF_DEF_  "VFrameFormat" "J1939PG";
BA_ "DBName" "can_utils";
BA_ "ProtocolType" "J1939";
BA_ "GenMsgCycleTime" BO_ 2180974846 1000;
BA_ "GenMsgSendType" BO_ 2180974846 0;
BA_ "SendOnChange" BO_ 2180974846 1;
BA_ "GenMsgCycleTime" BO_ 2169831166 1000;
BA_ "GenMsgSendType" BO_ 2169831166 0;
BA_ "SendOnChange" BO_ 2169831166 1;
BA_ "SigType" SG_ 2180974846 AnswerNumber 1;
BA_ "GenSigStartValue" SG_ 2169831166 RequestDLC 8;
BA_ "SigType" SG_ 2169831166 RequestNumber 1;
VAL_ 2169831166 RequestDLC 0 "DLC_0" 1 "DLC_1" 2 "DLC_2" 3 "DLC_3" 4 "DLC_4" 5 "DLC_5" 6 "DLC_6" 7 "DLC_7" 8 "DLC_8" 9 "DLC_12" 10 "DLC_16" 11 "DLC_20" 12 "DLC_24" 13 "DLC_32" 14 "DLC_48" 15 "DLC_64" ;
