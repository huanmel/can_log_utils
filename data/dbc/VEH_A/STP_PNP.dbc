VERSION "head"

NS_ :

BS_:

BU_: Vector
VAL_TABLE_ topology_state 7 "NA" 3 "Out of Packs range" 2 "Out of Location range" 1 "Duplicating Location" 0 "Correct" ;
VAL_TABLE_ vtHealthLevel 3 "NA" 2 "Critical" 1 "Warning" 0 "Normal" ;
VAL_TABLE_ ReadyToSleep 3 "Not available" 2 "Fault" 1 "Ready" 0 "Not ready" ;
VAL_TABLE_ mm_mode 4 "SleepPreparation" 7 "NA" 3 "Emergency" 2 "Operation" 1 "Diag" 0 "Init" ;
VAL_TABLE_ hvil_Status 3 "not available" 2 "Break" 1 "Normal" 0 "Shortcircuit" ;
VAL_TABLE_ bms_Mode 15 "NA" 11 "Service" 10 "Fault" 9 "PowerOff" 8 "SleepPrep" 7 "Sleep" 6 "HV_Disconnecting" 5 "Drive" 4 "Precharge" 3 "Ready" 2 "Diag" 1 "SW_Init" 0 "FW_Init" ;
VAL_TABLE_ firmware_block_info 4 "firmware block 4" 3 "firmware block 3" 2 "firmware block 2" 1 "firmware block 1" 0 "firmware block 0" ;

BO_ 2180912638 PU_Info: 8 Vector__XXX
 SG_ fw_percentage_bl_F m15 : 32|8@1+ (1,0) [0|255] "%" Vector__XXX
 SG_ fw_percentage_bl_E m14 : 32|8@1+ (1,0) [0|255] "%" Vector__XXX
 SG_ fw_percentage_bl_4 m4 : 32|8@1+ (1,0) [0|255] "%" Vector__XXX
 SG_ fw_percentage_bl_3 m3 : 32|8@1+ (1,0) [0|255] "%" Vector__XXX
 SG_ fw_percentage_bl_2 m2 : 32|8@1+ (1,0) [0|255] "%" Vector__XXX
 SG_ fw_percentage_bl_1 m1 : 32|8@1+ (1,0) [0|255] "%" Vector__XXX
 SG_ fw_percentage_bl_0 m0 : 32|8@1+ (1,0) [0|255] "%" Vector__XXX
 SG_ firmware_block_filled_fw_bl_F m15 : 4|1@1+ (1,0) [0|1] "" Vector__XXX
 SG_ device_count_upgrading_fw_bl_F m15 : 24|8@1+ (1,0) [0|255] "" Vector__XXX
 SG_ device_count_upgraded_fw_bl_F m15 : 16|8@1+ (1,0) [0|255] "" Vector__XXX
 SG_ device_count_failed_fw_bl_F m15 : 8|8@1+ (1,0) [0|255] "" Vector__XXX
 SG_ firmware_block_filled_fw_bl_E m14 : 4|1@1+ (1,0) [0|1] "" Vector__XXX
 SG_ device_count_upgrading_fw_bl_E m14 : 24|8@1+ (1,0) [0|255] "" Vector__XXX
 SG_ device_count_upgraded_fw_bl_E m14 : 16|8@1+ (1,0) [0|255] "" Vector__XXX
 SG_ device_count_failed_fw_bl_E m14 : 8|8@1+ (1,0) [0|255] "" Vector__XXX
 SG_ firmware_block_filled_fw_bl_4 m4 : 4|1@1+ (1,0) [0|1] "" Vector__XXX
 SG_ firmware_block_filled_fw_bl_3 m3 : 4|1@1+ (1,0) [0|1] "" Vector__XXX
 SG_ firmware_block_filled_fw_bl_2 m2 : 4|1@1+ (1,0) [0|1] "" Vector__XXX
 SG_ firmware_block_filled_fw_bl_1 m1 : 4|1@1+ (1,0) [0|1] "" Vector__XXX
 SG_ firmware_block_filled_fw_bl_0 m0 : 4|1@1+ (1,0) [0|1] "" Vector__XXX
 SG_ device_count_upgrading_fw_bl_4 m4 : 24|8@1+ (1,0) [0|255] "" Vector__XXX
 SG_ device_count_upgrading_fw_bl_3 m3 : 24|8@1+ (1,0) [0|255] "" Vector__XXX
 SG_ device_count_upgrading_fw_bl_2 m2 : 24|8@1+ (1,0) [0|255] "" Vector__XXX
 SG_ device_count_upgrading_fw_bl_1 m1 : 24|8@1+ (1,0) [0|255] "" Vector__XXX
 SG_ device_count_upgrading_fw_bl_0 m0 : 24|8@1+ (1,0) [0|255] "" Vector__XXX
 SG_ device_count_upgraded_fw_bl_4 m4 : 16|8@1+ (1,0) [0|255] "" Vector__XXX
 SG_ device_count_upgraded_fw_bl_3 m3 : 16|8@1+ (1,0) [0|255] "" Vector__XXX
 SG_ device_count_upgraded_fw_bl_2 m2 : 16|8@1+ (1,0) [0|255] "" Vector__XXX
 SG_ device_count_upgraded_fw_bl_1 m1 : 16|8@1+ (1,0) [0|255] "" Vector__XXX
 SG_ device_count_upgraded_fw_bl_0 m0 : 16|8@1+ (1,0) [0|255] "" Vector__XXX
 SG_ device_count_failed_fw_bl_4 m4 : 8|8@1+ (1,0) [0|255] "" Vector__XXX
 SG_ device_count_failed_fw_bl_3 m3 : 8|8@1+ (1,0) [0|255] "" Vector__XXX
 SG_ device_count_failed_fw_bl_2 m2 : 8|8@1+ (1,0) [0|255] "" Vector__XXX
 SG_ device_count_failed_fw_bl_1 m1 : 8|8@1+ (1,0) [0|255] "" Vector__XXX
 SG_ device_count_failed_fw_bl_0 m0 : 8|8@1+ (1,0) [0|255] "" Vector__XXX
 SG_ firmware_block M : 0|4@1+ (1,0) [0|4] "" Vector__XXX

CM_ "Common signals from Vector__XXX";
CM_ BO_ 2180912638 "Message contains parallel update info";
BA_DEF_ BO_  "Producer" STRING ;
BA_DEF_ BO_  "PpCcGenMsgType" STRING ;
BA_DEF_  "DBName" STRING ;
BA_DEF_ SG_  "SigType" ENUM  "Default","Range","RangeSigned","ASCII","Discrete","Control","ReferencePGN","DTC","StringDelimiter","StringLength","StringLengthControl","MessageCounter","MessageChecksum";
BA_DEF_ SG_  "GenSigSendType" ENUM  "Cyclic","OnWrite","OnWriteWithRepetition","OnChange","OnChangeWithRepetition","IfActive","IfActiveWithRepetition","NoSigSendType";
BA_DEF_ SG_  "GenSigILSupport" ENUM  "No","Yes";
BA_DEF_ SG_  "GenSigEVName" STRING ;
BA_DEF_ BO_  "GenMsgILSupport" ENUM  "No","Yes";
BA_DEF_ BO_  "GenMsgRequestable" INT 0 1;
BA_DEF_ BO_  "GenMsgSendType" ENUM  "cyclic","NotUsed","NotUsed","NotUsed","NotUsed","NotUsed","NotUsed","IfActive","noMsgSendType";
BA_DEF_ BO_  "VFrameFormat" ENUM  "StandardCAN","ExtendedCAN","reserved","J1939PG";
BA_DEF_ BO_  "GenMsgCycleTime" INT 0 3600000;
BA_DEF_ BU_  "NmStationAddress" INT 0 255;
BA_DEF_  "SAE_J1939_DA_SpecVersion" STRING ;
BA_DEF_  "SAE_J1939_81_SpecVersion" STRING ;
BA_DEF_  "DatabaseVersion" STRING ;
BA_DEF_  "BusType" STRING ;
BA_DEF_  "ProtocolType" STRING ;
BA_DEF_  "SAE_J1939_75_SpecVersion" STRING ;
BA_DEF_  "SAE_J1939_21_SpecVersion" STRING ;
BA_DEF_  "SAE_J1939_73_SpecVersion" STRING ;
BA_DEF_  "SAE_J1939_71_SpecVersion" STRING ;
BA_DEF_DEF_  "Producer" "STP";
BA_DEF_DEF_  "PpCcGenMsgType" "PpCcUndefined";
BA_DEF_DEF_  "DBName" "";
BA_DEF_DEF_  "SigType" "Default";
BA_DEF_DEF_  "GenSigSendType" "NoSigSendType";
BA_DEF_DEF_  "GenSigILSupport" "Yes";
BA_DEF_DEF_  "GenSigEVName" "Env@Nodename_@Signame";
BA_DEF_DEF_  "GenMsgILSupport" "Yes";
BA_DEF_DEF_  "GenMsgRequestable" 1;
BA_DEF_DEF_  "GenMsgSendType" "noMsgSendType";
BA_DEF_DEF_  "VFrameFormat" "J1939PG";
BA_DEF_DEF_  "GenMsgCycleTime" 0;
BA_DEF_DEF_  "NmStationAddress" 254;
BA_DEF_DEF_  "SAE_J1939_DA_SpecVersion" "";
BA_DEF_DEF_  "SAE_J1939_81_SpecVersion" "";
BA_DEF_DEF_  "DatabaseVersion" "";
BA_DEF_DEF_  "BusType" "";
BA_DEF_DEF_  "ProtocolType" "";
BA_DEF_DEF_  "SAE_J1939_75_SpecVersion" "";
BA_DEF_DEF_  "SAE_J1939_21_SpecVersion" "";
BA_DEF_DEF_  "SAE_J1939_73_SpecVersion" "";
BA_DEF_DEF_  "SAE_J1939_71_SpecVersion" "";
BA_ "SAE_J1939_DA_SpecVersion" "2015-01";
BA_ "SAE_J1939_81_SpecVersion" "2012-05";
BA_ "DatabaseVersion" "8.5";
BA_ "BusType" "CAN";
BA_ "ProtocolType" "J1939";
BA_ "SAE_J1939_75_SpecVersion" "2012-05";
BA_ "SAE_J1939_21_SpecVersion" "2006-10";
BA_ "SAE_J1939_73_SpecVersion" "2012-10";
BA_ "SAE_J1939_71_SpecVersion" "2012-10";
BA_ "DBName" "STP_PNP";
BA_ "NmStationAddress" BU_ Vector 249;
BA_ "GenMsgSendType" BO_ 2180912638 0;
BA_ "GenMsgCycleTime" BO_ 2180912638 1000;
BA_ "PpCcGenMsgType" BO_ 2180912638 "PpCcOutput";
VAL_ 2180912638 firmware_block 15 "Error" 14 "No firmware registered" 4 "firmware block 4" 3 "firmware block 3" 2 "firmware block 2" 1 "firmware block 1" 0 "firmware block 0" ;
