VERSION ""

NS_ :

BS_:

BU_: Device Host

BO_ 2398292222 boards_health: 20 Vector__XXX
 SG_ Main_5v_Power_Good : 0|1@1+ (1,0) [0|1] "" Vector__XXX
 SG_ Aux_5v_Power_Good : 1|1@1+ (1,0) [0|1] "" Vector__XXX
 SG_ Main_Model_Time_OK : 2|1@1+ (1,0) [0|1] "" Vector__XXX
 SG_ can1_rx_err : 3|1@1+ (1,0) [0|1] "" Vector__XXX
 SG_ can2_rx_err : 4|1@1+ (1,0) [0|1] "" Vector__XXX
 SG_ can3_rx_err : 5|1@1+ (1,0) [0|1] "" Vector__XXX
 SG_ can4_rx_err : 6|1@1+ (1,0) [0|1] "" Vector__XXX
 SG_ can5_rx_err : 7|1@1+ (1,0) [0|1] "" Vector__XXX
 SG_ can6_rx_err : 8|1@1+ (1,0) [0|1] "" Vector__XXX
 SG_ can7_rx_err : 9|1@1+ (1,0) [0|1] "" Vector__XXX
 SG_ can8_rx_err : 10|1@1+ (1,0) [0|1] "" Vector__XXX
 SG_ can1_tx_err : 11|1@1+ (1,0) [0|1] "" Vector__XXX
 SG_ can2_tx_err : 12|1@1+ (1,0) [0|1] "" Vector__XXX
 SG_ can3_tx_err : 13|1@1+ (1,0) [0|1] "" Vector__XXX
 SG_ can4_tx_err : 14|1@1+ (1,0) [0|1] "" Vector__XXX
 SG_ can5_tx_err : 15|1@1+ (1,0) [0|1] "" Vector__XXX
 SG_ can6_tx_err : 16|1@1+ (1,0) [0|1] "" Vector__XXX
 SG_ can7_tx_err : 17|1@1+ (1,0) [0|1] "" Vector__XXX
 SG_ can8_tx_err : 18|1@1+ (1,0) [0|1] "" Vector__XXX
 SG_ wakeup_reason_na : 19|1@1+ (1,0) [0|1] "" Vector__XXX
 SG_ core_1v2_vdd_ok : 20|1@1+ (1,0) [0|1] "" Vector__XXX
 SG_ sar_bias_0 : 21|1@1+ (1,0) [0|1] "" Vector__XXX
 SG_ sar_bias_1 : 22|1@1+ (1,0) [0|1] "" Vector__XXX
 SG_ sar_bias_2 : 23|1@1+ (1,0) [0|1] "" Vector__XXX
 SG_ sar_bias_3 : 24|1@1+ (1,0) [0|1] "" Vector__XXX
 SG_ vss_hv_adv_ok : 25|1@1+ (1,0) [0|1] "" Vector__XXX
 SG_ vss_lv_ok : 26|1@1+ (1,0) [0|1] "" Vector__XXX
 SG_ can1_status_err : 27|1@1+ (1,0) [0|1] "" Vector__XXX
 SG_ can2_status_err : 28|1@1+ (1,0) [0|1] "" Vector__XXX
 SG_ can3_status_err : 29|1@1+ (1,0) [0|1] "" Vector__XXX
 SG_ can4_status_err : 30|1@1+ (1,0) [0|1] "" Vector__XXX
 SG_ can5_status_err : 31|1@1+ (1,0) [0|1] "" Vector__XXX
 SG_ can6_status_err : 32|1@1+ (1,0) [0|1] "" Vector__XXX
 SG_ can7_status_err : 33|1@1+ (1,0) [0|1] "" Vector__XXX
 SG_ can8_status_err : 34|1@1+ (1,0) [0|1] "" Vector__XXX
 SG_ aux_12v_value : 35|1@1+ (1,0) [0|1] "" Vector__XXX
 SG_ aux_5v_value : 36|1@1+ (1,0) [0|1] "" Vector__XXX
 SG_ aux_12v_power_good : 37|1@1+ (1,0) [0|1] "" Vector__XXX
 SG_ failed_sleep : 38|1@1+ (1,0) [0|1] "" Vector__XXX
 SG_ arrival_params_err : 39|1@1+ (1,0) [0|1] "" Vector__XXX
 SG_ adcex_msens_sequence : 40|1@1+ (1,0) [0|1] "" Vector__XXX
 SG_ flash_ecc_cerr : 41|1@1+ (1,0) [0|1] "" Vector__XXX
 SG_ flash_ecc_ucerr : 42|1@1+ (1,0) [0|1] "" Vector__XXX
 SG_ periph_ram_ecc_cerr : 43|1@1+ (1,0) [0|0] "" Vector__XXX
 SG_ periph_ram_ecc_ucerr : 44|1@1+ (1,0) [0|0] "" Vector__XXX
 SG_ sys_ram_ecc_cerr : 45|1@1+ (1,0) [0|0] "" Vector__XXX
 SG_ sys_ram_ecc_ucerr : 46|1@1+ (1,0) [0|1] "" Vector__XXX
 SG_ can1_frame_err : 47|1@1+ (1,0) [0|1] "" Vector__XXX
 SG_ can2_frame_err : 48|1@1+ (1,0) [0|1] "" Vector__XXX
 SG_ can3_frame_err : 49|1@1+ (1,0) [0|1] "" Vector__XXX
 SG_ can4_frame_err : 50|1@1+ (1,0) [0|1] "" Vector__XXX
 SG_ can5_frame_err : 51|1@1+ (1,0) [0|1] "" Vector__XXX
 SG_ can6_frame_err : 52|1@1+ (1,0) [0|1] "" Vector__XXX
 SG_ can7_frame_err : 53|1@1+ (1,0) [0|1] "" Vector__XXX
 SG_ can8_frame_err : 54|1@1+ (1,0) [0|1] "" Vector__XXX
 SG_ can1_sa_err : 55|1@1+ (1,0) [0|1] "" Vector__XXX
 SG_ can2_sa_err : 56|1@1+ (1,0) [0|1] "" Vector__XXX
 SG_ can3_sa_err : 57|1@1+ (1,0) [0|1] "" Vector__XXX
 SG_ can4_sa_err : 58|1@1+ (1,0) [0|1] "" Vector__XXX
 SG_ can5_sa_err : 59|1@1+ (1,0) [0|1] "" Vector__XXX
 SG_ can6_sa_err : 60|1@1+ (1,0) [0|1] "" Vector__XXX
 SG_ can7_sa_err : 61|1@1+ (1,0) [0|1] "" Vector__XXX
 SG_ can8_sa_err : 62|1@1+ (1,0) [0|1] "" Vector__XXX
 SG_ fccu_critical_fault : 63|1@1+ (1,0) [0|1] "" Vector__XXX
 SG_ device_settings_write_error : 64|1@1+ (1,0) [0|1] "" Vector__XXX
 SG_ log_enabled : 65|1@1+ (1,0) [0|1] "" Vector__XXX
 SG_ shell_enabled : 66|1@1+ (1,0) [0|1] "" Vector__XXX
 SG_ bootloader_wo_safety : 67|1@1+ (1,0) [0|1] "" Vector__XXX
 SG_ can1_trcv_err : 68|1@1+ (1,0) [0|1] "" Vector__XXX
 SG_ can2_trcv_err : 69|1@1+ (1,0) [0|1] "" Vector__XXX
 SG_ can3_trcv_err : 70|1@1+ (1,0) [0|1] "" Vector__XXX
 SG_ can4_trcv_err : 71|1@1+ (1,0) [0|1] "" Vector__XXX
 SG_ can5_trcv_err : 72|1@1+ (1,0) [0|1] "" Vector__XXX
 SG_ can6_trcv_err : 73|1@1+ (1,0) [0|1] "" Vector__XXX
 SG_ can7_trcv_err : 74|1@1+ (1,0) [0|1] "" Vector__XXX
 SG_ can8_trcv_err : 75|1@1+ (1,0) [0|1] "" Vector__XXX
 SG_ exception_reboot_cause : 76|1@1+ (1,0) [0|1] "" Vector__XXX
 SG_ exception_selftest_fail : 77|1@1+ (1,0) [0|1] "" Vector__XXX
 SG_ fccu_selftest_fail : 78|1@1+ (1,0) [0|1] "" Vector__XXX
 SG_ fccu_warning_fault : 79|1@1+ (1,0) [0|1] "" Vector__XXX
 SG_ obsolete_bootloader : 80|1@1+ (1,0) [0|1] "" Vector__XXX
 SG_ qm_unwanted_behaviour : 81|1@1+ (1,0) [0|1] "" Vector__XXX
 SG_ stcu2_offline_tests_failed : 82|1@1+ (1,0) [0|1] "" Vector__XXX
 SG_ stcu2_online_tests_failed : 83|1@1+ (1,0) [0|1] "" Vector__XXX
 SG_ task_step_lag : 84|1@1+ (1,0) [0|1] "" Vector__XXX
 SG_ tic12400_err : 85|1@1+ (1,0) [0|1] "" Vector__XXX
 SG_ device_settings_err : 86|1@1+ (1,0) [0|1] "" Vector__XXX
 SG_ dp2_params_err : 87|1@1+ (1,0) [0|1] "" Vector__XXX
 SG_ efpu2_core0_exception : 88|1@1+ (1,0) [0|1] "" Vector__XXX
 SG_ efpu2_core1_exception : 89|1@1+ (1,0) [0|1] "" Vector__XXX
 SG_ efpu2_core2_exception : 90|1@1+ (1,0) [0|1] "" Vector__XXX
 SG_ uptime_limit_expired : 91|1@1+ (1,0) [0|1] "" Vector__XXX
 SG_ CORE0_Load : 92|1@1+ (1,0) [0|1] "" Vector__XXX
 SG_ CORE1_Load : 93|1@1+ (1,0) [0|1] "" Vector__XXX
 SG_ CORE2_Load : 94|1@1+ (1,0) [0|1] "" Vector__XXX
 SG_ model_step_interval_fault : 95|1@1+ (1,0) [0|1] "" Vector__XXX
 SG_ model_qm_step_interval_fault : 96|1@1+ (1,0) [0|1] "" Vector__XXX
 SG_ hsm_firmware : 97|1@1+ (1,0) [0|1] "" Vector__XXX
 SG_ hsm_key : 98|1@1+ (1,0) [0|1] "" Vector__XXX
 SG_ secure_storage : 99|1@1+ (1,0) [0|1] "" Vector__XXX
 SG_ system_storage : 100|1@1+ (1,0) [0|1] "" Vector__XXX

CM_ "Common Arrival board signals. Used only as SPN dictionary.
$File: //system_software/dbc/boards/0.36.0.0/arrival_boards.dbc $
$Change: 208863 $
$DateTime: 2023/11/10 13:11:00 $
$Revision: #1 $
";
CM_ BO_ 2398292222 "It is needed to add SPNs to can manager.";
CM_ SG_ 2398292222 Main_5v_Power_Good "Main 5V status";
CM_ SG_ 2398292222 Aux_5v_Power_Good "Aux 5V status";
CM_ SG_ 2398292222 Main_Model_Time_OK "Model execution time status";
CM_ SG_ 2398292222 wakeup_reason_na "0 - wakeup reason known (nobody == powerup)
1 - wakeup reason unknown (someone got error)";
CM_ SG_ 2398292222 core_1v2_vdd_ok "1v2 status";
CM_ SG_ 2398292222 sar_bias_0 "SARADC 0/3 Vref";
CM_ SG_ 2398292222 sar_bias_1 "SARADC 1/3 Vref";
CM_ SG_ 2398292222 sar_bias_2 "SARADC 2/3 Vref";
CM_ SG_ 2398292222 sar_bias_3 "SARADC 3/3 Vref";
CM_ SG_ 2398292222 vss_hv_adv_ok "ADC GND status";
CM_ SG_ 2398292222 vss_lv_ok "ADC GND status";
CM_ SG_ 2398292222 can1_status_err "CAN1 controller error status";
CM_ SG_ 2398292222 can2_status_err "CAN2 controller error status";
CM_ SG_ 2398292222 can3_status_err "CAN3 controller error status";
CM_ SG_ 2398292222 can4_status_err "CAN4 controller error status";
CM_ SG_ 2398292222 can5_status_err "CAN5 controller error status";
CM_ SG_ 2398292222 can6_status_err "CAN6 controller error status";
CM_ SG_ 2398292222 can7_status_err "CAN7 controller error status";
CM_ SG_ 2398292222 can8_status_err "CAN8 controller error status";
CM_ SG_ 2398292222 aux_12v_value "12V value range";
CM_ SG_ 2398292222 aux_5v_value "aux 5V vcc range";
CM_ SG_ 2398292222 aux_12v_power_good "12V value range";
CM_ SG_ 2398292222 failed_sleep "1 - sleep procedure has not finished and board restarted";
CM_ SG_ 2398292222 arrival_params_err "params_read returned error";
CM_ SG_ 2398292222 adcex_msens_sequence "ADCEX sequence broken";
CM_ SG_ 2398292222 flash_ecc_cerr "Corrected ecc error in flash";
CM_ SG_ 2398292222 flash_ecc_ucerr "Uncorrected ecc error in flash";
CM_ SG_ 2398292222 periph_ram_ecc_cerr "Corrected ecc error in peripheral ram area";
CM_ SG_ 2398292222 periph_ram_ecc_ucerr "Uncorrected ecc error in peripheral ram area";
CM_ SG_ 2398292222 sys_ram_ecc_cerr "Corrected ecc error in system ram";
CM_ SG_ 2398292222 sys_ram_ecc_ucerr "Uncorrected ecc error in system ram";
CM_ SG_ 2398292222 can1_frame_err "CAN1 too many error frames detected";
CM_ SG_ 2398292222 can2_frame_err "CAN2 too many error frames detected";
CM_ SG_ 2398292222 can3_frame_err "CAN3 too many error frames detected";
CM_ SG_ 2398292222 can4_frame_err "CAN4 too many error frames detected";
CM_ SG_ 2398292222 can5_frame_err "CAN5 too many error frames detected";
CM_ SG_ 2398292222 can6_frame_err "CAN6 too many error frames detected";
CM_ SG_ 2398292222 can7_frame_err "CAN7 too many error frames detected";
CM_ SG_ 2398292222 can8_frame_err "CAN8 too many error frames detected";
CM_ SG_ 2398292222 can1_sa_err "CAN1 J1939 source address error";
CM_ SG_ 2398292222 can2_sa_err "CAN2 J1939 source address error";
CM_ SG_ 2398292222 can3_sa_err "CAN3 J1939 source address error";
CM_ SG_ 2398292222 can4_sa_err "CAN4 J1939 source address error";
CM_ SG_ 2398292222 can5_sa_err "CAN5 J1939 source address error";
CM_ SG_ 2398292222 can6_sa_err "CAN6 J1939 source address error";
CM_ SG_ 2398292222 can7_sa_err "CAN7 J1939 source address error";
CM_ SG_ 2398292222 can8_sa_err "CAN8 J1939 source address error";
CM_ SG_ 2398292222 fccu_critical_fault "A critical hardware fault detected by FCCU, application was rebooted or stopped";
CM_ SG_ 2398292222 device_settings_write_error "Device Settings write error";
CM_ SG_ 2398292222 log_enabled "Security failed - log enabled";
CM_ SG_ 2398292222 shell_enabled "Security failed - shell enabled";
CM_ SG_ 2398292222 bootloader_wo_safety "Bootloader build without mcu safety support but app with";
CM_ SG_ 2398292222 can1_trcv_err "WEC or REC counters are over the limit in any CAN partial network driver";
CM_ SG_ 2398292222 can2_trcv_err "WEC or REC counters are over the limit in any CAN partial network driver";
CM_ SG_ 2398292222 can3_trcv_err "WEC or REC counters are over the limit in any CAN partial network driver";
CM_ SG_ 2398292222 can4_trcv_err "WEC or REC counters are over the limit in any CAN partial network driver";
CM_ SG_ 2398292222 can5_trcv_err "WEC or REC counters are over the limit in any CAN partial network driver";
CM_ SG_ 2398292222 can6_trcv_err "WEC or REC counters are over the limit in any CAN partial network driver";
CM_ SG_ 2398292222 can7_trcv_err "WEC or REC counters are over the limit in any CAN partial network driver";
CM_ SG_ 2398292222 can8_trcv_err "WEC or REC counters are over the limit in any CAN partial network driver";
CM_ SG_ 2398292222 exception_reboot_cause "Application was rebooted cause of exception occurred";
CM_ SG_ 2398292222 exception_selftest_fail "Exception self-test failed, application stopped";
CM_ SG_ 2398292222 fccu_selftest_fail "FCCU self-test failed";
CM_ SG_ 2398292222 fccu_warning_fault "A hardware fault detected by FCCU and processed successfully";
CM_ SG_ 2398292222 obsolete_bootloader "Obsolete bootloader, some features in the app software may be not supported";
CM_ SG_ 2398292222 qm_unwanted_behaviour "Quality model tries to change UIO pins which have been changed by ASIL-D model";
CM_ SG_ 2398292222 stcu2_offline_tests_failed "STCU2 offline tests failed, application stopped";
CM_ SG_ 2398292222 stcu2_online_tests_failed "STCU2 online tests failed, application stopped";
CM_ SG_ 2398292222 task_step_lag "Safety-critical tasks step lag status";
CM_ SG_ 2398292222 tic12400_err "CRC counter is over the limit. TIC12400 isn't ready to work";
CM_ SG_ 2398292222 device_settings_err "DeviceSettings write error";
CM_ SG_ 2398292222 dp2_params_err "DeviceSettings write error";
CM_ SG_ 2398292222 efpu2_core0_exception "EFPU2 core 0 exception occured";
CM_ SG_ 2398292222 efpu2_core1_exception "EFPU2 core 1 exception occured";
CM_ SG_ 2398292222 efpu2_core2_exception "EFPU2 core 2 exception occured";
CM_ SG_ 2398292222 uptime_limit_expired "ECU uptime limit expired";
CM_ SG_ 2398292222 CORE0_Load "CORE0 High CPU usage";
CM_ SG_ 2398292222 CORE1_Load "CORE1 High CPU usage";
CM_ SG_ 2398292222 CORE2_Load "CORE2 High CPU usage";
CM_ SG_ 2398292222 model_step_interval_fault "Model step interval is out of limit";
CM_ SG_ 2398292222 model_qm_step_interval_fault "Model QM step interval is out of limit";
CM_ SG_ 2398292222 hsm_firmware "HSM firmware related problems";
CM_ SG_ 2398292222 hsm_key "HSM key problem";
CM_ SG_ 2398292222 secure_storage "SecureStrorage component";
CM_ SG_ 2398292222 system_storage "SystemStrorage component";
BA_DEF_ "BusType" STRING ;
BA_DEF_ "DBName" STRING ;
BA_DEF_ "DatabaseVersion" STRING ;
BA_DEF_ BO_ "GenMsgILSupport" ENUM "No","Yes";
BA_DEF_ BO_ "GenMsgRequestable" INT 0 1;
BA_DEF_ BO_ "GenMsgSendType" ENUM "cyclic","NotUsed","NotUsed","NotUsed","NotUsed","NotUsed","NotUsed","IfActive","noMsgSendType";
BA_DEF_ SG_ "GenSigEVName" STRING ;
BA_DEF_ SG_ "GenSigILSupport" ENUM "No","Yes";
BA_DEF_ SG_ "GenSigSendType" ENUM "Cyclic","OnWrite","OnWriteWithRepetition","OnChange","OnChangeWithRepetition","IfActive","IfActiveWithRepetition","NoSigSendType";
BA_DEF_ BU_ "NmStationAddress" INT 0 255;
BA_DEF_ "ProtocolType" STRING ;
BA_DEF_ "SAE_J1939_21_SpecVersion" STRING ;
BA_DEF_ "SAE_J1939_71_SpecVersion" STRING ;
BA_DEF_ "SAE_J1939_73_SpecVersion" STRING ;
BA_DEF_ "SAE_J1939_75_SpecVersion" STRING ;
BA_DEF_ "SAE_J1939_81_SpecVersion" STRING ;
BA_DEF_ "SAE_J1939_DA_SpecVersion" STRING ;
BA_DEF_ SG_ "SPN" INT 0 524287;
BA_DEF_ SG_ "SigType" ENUM "Default","Range","RangeSigned","ASCII","Discrete","Control","ReferencePGN","DTC","StringDelimiter","StringLength","StringLengthControl","MessageCounter","MessageChecksum";
BA_DEF_ BO_ "VFrameFormat" ENUM "StandardCAN","ExtendedCAN","reserved","J1939PG","reserved","reserved","reserved","reserved","reserved","reserved","reserved","reserved","reserved","reserved","StandardCAN_FD","ExtendedCAN_FD";
BA_DEF_DEF_ "BusType" "";
BA_DEF_DEF_ "DBName" "";
BA_DEF_DEF_ "DatabaseVersion" "";
BA_DEF_DEF_ "GenMsgILSupport" "Yes";
BA_DEF_DEF_ "GenMsgRequestable" 1;
BA_DEF_DEF_ "GenMsgSendType" "noMsgSendType";
BA_DEF_DEF_ "GenSigEVName" "Env@Nodename_@Signame";
BA_DEF_DEF_ "GenSigILSupport" "Yes";
BA_DEF_DEF_ "GenSigSendType" "NoSigSendType";
BA_DEF_DEF_ "NmStationAddress" 254;
BA_DEF_DEF_ "ProtocolType" "";
BA_DEF_DEF_ "SAE_J1939_21_SpecVersion" "";
BA_DEF_DEF_ "SAE_J1939_71_SpecVersion" "";
BA_DEF_DEF_ "SAE_J1939_73_SpecVersion" "";
BA_DEF_DEF_ "SAE_J1939_75_SpecVersion" "";
BA_DEF_DEF_ "SAE_J1939_81_SpecVersion" "";
BA_DEF_DEF_ "SAE_J1939_DA_SpecVersion" "";
BA_DEF_DEF_ "SPN" 0;
BA_DEF_DEF_ "SigType" "Default";
BA_DEF_DEF_ "VFrameFormat" "J1939PG";
BA_ "BusType" "CAN";
BA_ "DBName" "Arrival_Boards_Diag";
BA_ "DatabaseVersion" "8.5";
BA_ "ProtocolType" "J1939";
BA_ "SAE_J1939_21_SpecVersion" "2006-10";
BA_ "SAE_J1939_71_SpecVersion" "2012-10";
BA_ "SAE_J1939_73_SpecVersion" "2012-10";
BA_ "SAE_J1939_75_SpecVersion" "2012-05";
BA_ "SAE_J1939_81_SpecVersion" "2012-05";
BA_ "SAE_J1939_DA_SpecVersion" "2015-01";
BA_ "GenMsgRequestable" BO_ 2398292222 0;
BA_ "SPN" SG_ 2398292222 Main_5v_Power_Good 519300;
BA_ "SPN" SG_ 2398292222 Aux_5v_Power_Good 519301;
BA_ "SPN" SG_ 2398292222 Main_Model_Time_OK 519302;
BA_ "SPN" SG_ 2398292222 can1_rx_err 519303;
BA_ "SPN" SG_ 2398292222 can2_rx_err 519305;
BA_ "SPN" SG_ 2398292222 can3_rx_err 519307;
BA_ "SPN" SG_ 2398292222 can4_rx_err 519309;
BA_ "SPN" SG_ 2398292222 can5_rx_err 519311;
BA_ "SPN" SG_ 2398292222 can6_rx_err 519313;
BA_ "SPN" SG_ 2398292222 can7_rx_err 519315;
BA_ "SPN" SG_ 2398292222 can8_rx_err 519317;
BA_ "SPN" SG_ 2398292222 can1_tx_err 519304;
BA_ "SPN" SG_ 2398292222 can2_tx_err 519306;
BA_ "SPN" SG_ 2398292222 can3_tx_err 519308;
BA_ "SPN" SG_ 2398292222 can4_tx_err 519310;
BA_ "SPN" SG_ 2398292222 can5_tx_err 519312;
BA_ "SPN" SG_ 2398292222 can6_tx_err 519314;
BA_ "SPN" SG_ 2398292222 can7_tx_err 519316;
BA_ "SPN" SG_ 2398292222 can8_tx_err 519318;
BA_ "SPN" SG_ 2398292222 wakeup_reason_na 519319;
BA_ "SPN" SG_ 2398292222 core_1v2_vdd_ok 519320;
BA_ "SPN" SG_ 2398292222 sar_bias_0 519321;
BA_ "SPN" SG_ 2398292222 sar_bias_1 519322;
BA_ "SPN" SG_ 2398292222 sar_bias_2 519323;
BA_ "SPN" SG_ 2398292222 sar_bias_3 519324;
BA_ "SPN" SG_ 2398292222 vss_hv_adv_ok 519325;
BA_ "SPN" SG_ 2398292222 vss_lv_ok 519326;
BA_ "SPN" SG_ 2398292222 can1_status_err 519327;
BA_ "SPN" SG_ 2398292222 can2_status_err 519328;
BA_ "SPN" SG_ 2398292222 can3_status_err 519329;
BA_ "SPN" SG_ 2398292222 can4_status_err 519330;
BA_ "SPN" SG_ 2398292222 can5_status_err 519331;
BA_ "SPN" SG_ 2398292222 can6_status_err 519332;
BA_ "SPN" SG_ 2398292222 can7_status_err 519333;
BA_ "SPN" SG_ 2398292222 can8_status_err 519334;
BA_ "SPN" SG_ 2398292222 aux_12v_value 519335;
BA_ "SPN" SG_ 2398292222 aux_5v_value 519336;
BA_ "SPN" SG_ 2398292222 aux_12v_power_good 519337;
BA_ "SPN" SG_ 2398292222 failed_sleep 519338;
BA_ "SPN" SG_ 2398292222 arrival_params_err 400005;
BA_ "SPN" SG_ 2398292222 adcex_msens_sequence 519340;
BA_ "SPN" SG_ 2398292222 flash_ecc_cerr 519341;
BA_ "SPN" SG_ 2398292222 flash_ecc_ucerr 519342;
BA_ "SPN" SG_ 2398292222 periph_ram_ecc_cerr 519343;
BA_ "SPN" SG_ 2398292222 periph_ram_ecc_ucerr 519344;
BA_ "SPN" SG_ 2398292222 sys_ram_ecc_cerr 519345;
BA_ "SPN" SG_ 2398292222 sys_ram_ecc_ucerr 519346;
BA_ "SPN" SG_ 2398292222 can1_frame_err 519347;
BA_ "SPN" SG_ 2398292222 can2_frame_err 519348;
BA_ "SPN" SG_ 2398292222 can3_frame_err 519349;
BA_ "SPN" SG_ 2398292222 can4_frame_err 519350;
BA_ "SPN" SG_ 2398292222 can5_frame_err 519351;
BA_ "SPN" SG_ 2398292222 can6_frame_err 519352;
BA_ "SPN" SG_ 2398292222 can7_frame_err 519353;
BA_ "SPN" SG_ 2398292222 can8_frame_err 519354;
BA_ "SPN" SG_ 2398292222 can1_sa_err 519355;
BA_ "SPN" SG_ 2398292222 can2_sa_err 519356;
BA_ "SPN" SG_ 2398292222 can3_sa_err 519357;
BA_ "SPN" SG_ 2398292222 can4_sa_err 519358;
BA_ "SPN" SG_ 2398292222 can5_sa_err 519359;
BA_ "SPN" SG_ 2398292222 can6_sa_err 519360;
BA_ "SPN" SG_ 2398292222 can7_sa_err 519361;
BA_ "SPN" SG_ 2398292222 can8_sa_err 519362;
BA_ "SPN" SG_ 2398292222 fccu_critical_fault 519476;
BA_ "SPN" SG_ 2398292222 device_settings_write_error 400002;
BA_ "SPN" SG_ 2398292222 log_enabled 400000;
BA_ "SPN" SG_ 2398292222 shell_enabled 400001;
BA_ "SPN" SG_ 2398292222 bootloader_wo_safety 519483;
BA_ "SPN" SG_ 2398292222 can1_trcv_err 519485;
BA_ "SPN" SG_ 2398292222 can2_trcv_err 519486;
BA_ "SPN" SG_ 2398292222 can3_trcv_err 519487;
BA_ "SPN" SG_ 2398292222 can4_trcv_err 519488;
BA_ "SPN" SG_ 2398292222 can5_trcv_err 519489;
BA_ "SPN" SG_ 2398292222 can6_trcv_err 519490;
BA_ "SPN" SG_ 2398292222 can7_trcv_err 519491;
BA_ "SPN" SG_ 2398292222 can8_trcv_err 519492;
BA_ "SPN" SG_ 2398292222 exception_reboot_cause 519480;
BA_ "SPN" SG_ 2398292222 exception_selftest_fail 519479;
BA_ "SPN" SG_ 2398292222 fccu_selftest_fail 519478;
BA_ "SPN" SG_ 2398292222 fccu_warning_fault 519477;
BA_ "SPN" SG_ 2398292222 obsolete_bootloader 519484;
BA_ "SPN" SG_ 2398292222 qm_unwanted_behaviour 519494;
BA_ "SPN" SG_ 2398292222 stcu2_offline_tests_failed 519481;
BA_ "SPN" SG_ 2398292222 stcu2_online_tests_failed 519482;
BA_ "SPN" SG_ 2398292222 task_step_lag 519495;
BA_ "SPN" SG_ 2398292222 tic12400_err 519493;
BA_ "SPN" SG_ 2398292222 device_settings_err 400004;
BA_ "SPN" SG_ 2398292222 dp2_params_err 400003;
BA_ "SPN" SG_ 2398292222 efpu2_core0_exception 519496;
BA_ "SPN" SG_ 2398292222 efpu2_core1_exception 519497;
BA_ "SPN" SG_ 2398292222 efpu2_core2_exception 519498;
BA_ "SPN" SG_ 2398292222 uptime_limit_expired 519499;
BA_ "SPN" SG_ 2398292222 CORE0_Load 400006;
BA_ "SPN" SG_ 2398292222 CORE1_Load 400007;
BA_ "SPN" SG_ 2398292222 CORE2_Load 400008;
BA_ "SPN" SG_ 2398292222 model_step_interval_fault 400009;
BA_ "SPN" SG_ 2398292222 model_qm_step_interval_fault 400010;
BA_ "SPN" SG_ 2398292222 hsm_firmware 400011;
BA_ "SPN" SG_ 2398292222 hsm_key 400012;
BA_ "SPN" SG_ 2398292222 secure_storage 400013;
BA_ "SPN" SG_ 2398292222 system_storage 400014;
