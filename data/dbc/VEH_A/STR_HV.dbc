VERSION ""

NS_ :

BS_:

BU_:
VAL_TABLE_ StrReqTable 3 "NA" 2 "Reserved" 1 "Fault" 0 "No Fault" ;

BO_ 2381861374 SteerAssistReq: 8 Vector__XXX
 SG_ SteerSelfAdjustReq : 1|1@1+ (1,0) [0|1] "" Vector__XXX
 SG_ SteerLockReq : 0|1@1+ (1,0) [0|1] "" Vector__XXX

BO_ 2381861118 STR_States: 8 Vector__XXX
 SG_ STRReadyToSleep : 2|2@1+ (1,0) [0|3] "" Vector__XXX
 SG_ STRReadyToDrive : 0|2@1+ (1,0) [0|3] "" Vector__XXX

CM_ "Steering signal Requests to HMI
 
$DBC storage: https://item.arrival.co/ui/repos/tree/General/dbc/  $
$Change: change_number $
$DateTime: YYYY/MM/DD HH:MM:SS $
$Revision: #revision_number $
$Author: zuev@arrival.com $";
CM_ BO_ 2381861374 "Braking signals";
CM_ BO_ 2381861118 "Braking signals";
BA_DEF_ SG_  "SigType" ENUM  "Default","Range","RangeSigned","ASCII","Discrete","Control","ReferencePGN","DTC","StringDelimiter","StringLength","StringLengthControl";
BA_DEF_ SG_  "GenSigEVName" STRING ;
BA_DEF_ SG_  "GenSigILSupport" ENUM  "No","Yes";
BA_DEF_ SG_  "GenSigSendType" ENUM  "Cyclic","OnWrite","OnWriteWithRepetition","OnChange","OnChangeWithRepetition","IfActive","IfActiveWithRepetition","NoSigSendType";
BA_DEF_ SG_  "GenSigStartValue" INT 0 2147483647;
BA_DEF_ BO_  "GenMsgILSupport" ENUM  "No","Yes";
BA_DEF_ BU_  "NmStationAddress" INT 0 255;
BA_DEF_ BO_  "GenMsgSendType" ENUM  "cyclic","NotUsed","IfActive","NotUsed","NotUsed","NotUsed","NotUsed","NotUsed","noMsgSendType";
BA_DEF_ BO_  "GenMsgRequestable" INT 0 1;
BA_DEF_ BO_  "GenMsgCycleTime" INT 0 3600000;
BA_DEF_  "DBName" STRING ;
BA_DEF_  "BusType" STRING ;
BA_DEF_  "ProtocolType" STRING ;
BA_DEF_ BO_  "VFrameFormat" ENUM  "StandardCAN","ExtendedCAN","reserved","J1939PG";
BA_DEF_DEF_  "SigType" "Default";
BA_DEF_DEF_  "GenSigEVName" "Env@Nodename_@Signame";
BA_DEF_DEF_  "GenSigILSupport" "Yes";
BA_DEF_DEF_  "GenSigSendType" "NoSigSendType";
BA_DEF_DEF_  "GenSigStartValue" 0;
BA_DEF_DEF_  "GenMsgILSupport" "Yes";
BA_DEF_DEF_  "NmStationAddress" 254;
BA_DEF_DEF_  "GenMsgSendType" "noMsgSendType";
BA_DEF_DEF_  "GenMsgRequestable" 1;
BA_DEF_DEF_  "GenMsgCycleTime" 0;
BA_DEF_DEF_  "DBName" "";
BA_DEF_DEF_  "BusType" "CAN";
BA_DEF_DEF_  "ProtocolType" "J1939";
BA_DEF_DEF_  "VFrameFormat" "J1939PG";
BA_ "DBName" "STRHMI";
BA_ "GenMsgSendType" BO_ 2381861374 0;
BA_ "GenMsgCycleTime" BO_ 2381861374 100;
BA_ "GenMsgSendType" BO_ 2381861118 0;
BA_ "GenMsgCycleTime" BO_ 2381861118 100;
BA_ "GenSigStartValue" SG_ 2381861118 STRReadyToDrive 3;
VAL_ 2381861118 STRReadyToSleep 3 "NA" 2 "Error" 1 "Ready" 0 "Not Ready" ;
VAL_ 2381861118 STRReadyToDrive 3 "NA" 2 "Error" 1 "Ready" 0 "Not Ready" ;
