VERSION ""

NS_ :

BS_:

BU_: Device Host

BO_ 2559377150 CCP_CRO: 8 Host
 SG_ CommandCode : 0|8@1+ (1,0) [0|0] "" Vector__XXX
 SG_ CommandCounter : 8|8@1+ (1,0) [0|0] "" Vector__XXX

BO_ 2559311614 CCP_DTO: 8 Device
 SG_ PID : 0|8@1+ (1,0) [0|0] "" Vector__XXX

CM_ "Can Calibration Protocol messages
$File: //system_software/dbc/can_calibration_protocol/0.36.0.0/can_calibration_protocol.dbc $
$Change: 208863 $
$DateTime: 2023/11/10 13:11:00 $
$Revision: #1 $";
CM_ BO_ 2559377150 "Can Calibration Protocol - Command Receive Object";
CM_ BO_ 2559311614 "Can Calibration Protocol - Data Transmission Object";
BA_DEF_  "BusType" STRING ;
BA_DEF_  "DBName" STRING ;
BA_DEF_ BO_  "GenMsgILSupport" ENUM  "No","Yes";
BA_DEF_ BO_  "GenMsgRequestable" INT 0 1;
BA_DEF_ BO_  "GenMsgSendType" ENUM  "cyclic","NotUsed","NotUsed","NotUsed","NotUsed","NotUsed","NotUsed","IfActive","noMsgSendType";
BA_DEF_ SG_  "GenSigEVName" STRING ;
BA_DEF_ SG_  "GenSigILSupport" ENUM  "No","Yes";
BA_DEF_ SG_  "GenSigSendType" ENUM  "Cyclic","OnWrite","OnWriteWithRepetition","OnChange","OnChangeWithRepetition","IfActive","IfActiveWithRepetition","NoSigSendType";
BA_DEF_ BU_  "NmStationAddress" INT 0 255;
BA_DEF_  "ProtocolType" STRING ;
BA_DEF_ SG_  "SigType" ENUM  "Default","Range","RangeSigned","ASCII","Discrete","Control","ReferencePGN","DTC","StringDelimiter","StringLength","StringLengthControl","MessageCounter","MessageChecksum";
BA_DEF_ BO_  "VFrameFormat" ENUM  "StandardCAN","ExtendedCAN","reserved","J1939PG";
BA_DEF_DEF_  "BusType" "CAN";
BA_DEF_DEF_  "DBName" "";
BA_DEF_DEF_  "GenMsgILSupport" "Yes";
BA_DEF_DEF_  "GenMsgRequestable" 1;
BA_DEF_DEF_  "GenMsgSendType" "noMsgSendType";
BA_DEF_DEF_  "GenSigEVName" "Env@Nodename_@Signame";
BA_DEF_DEF_  "GenSigILSupport" "Yes";
BA_DEF_DEF_  "GenSigSendType" "NoSigSendType";
BA_DEF_DEF_  "NmStationAddress" 254;
BA_DEF_DEF_  "ProtocolType" "";
BA_DEF_DEF_  "SigType" "Default";
BA_DEF_DEF_  "VFrameFormat" "J1939PG";
BA_ "DBName" "Can_Calibration_Protocol";
BA_ "ProtocolType" "J1939";
VAL_ 2559377150 CommandCode 0 "RESERVED" 1 "CONNECT" 2 "SET_MTA" 3 "DNLOAD" 4 "UPLOAD" 5 "TEST" 6 "START_STOP" 7 "DISCONNECT" 8 "START_STOP_ALL" 9 "GET_CAL_PAGE" 12 "SET_S_STATUS" 13 "GET_S_STATUS" 14 "BUILD_CHKSUM" 15 "SHORT_UPLOAD" 16 "CLEAR_MEMORY" 17 "SET_CAL_PAGE" 18 "GET_SEED" 19 "UNLOCK" 20 "GET_DAQ_SIZE" 21 "SET_DAQ_PTR" 22 "WRITE_DAQ" 23 "EXCHANGE_ID" 24 "PROGRAM" 25 "MOVE_MEMORY" 27 "GET_CCP_VERSION" 30 "PROGRAM_PREPARE" 31 "PROGRAM_START" 32 "DIAG_SERVICE" 33 "ACTION_SERVICE" 34 "PROGRAM6" 35 "DNLOAD6" 48 "PROGRAM_EX_0" 49 "PROGRAM_EX_1" 50 "PROGRAM_EX_2" 51 "PROGRAM_EX_3" 52 "PROGRAM_EX_4" 53 "PROGRAM_EX_5" 54 "PROGRAM_EX_6" 55 "PROGRAM_EX_7" 56 "PROGRAM_EX_8" 57 "PROGRAM_EX_9" 58 "PROGRAM_EX_A" 59 "PROGRAM_EX_B" 60 "PROGRAM_EX_C" 61 "PROGRAM_EX_D" 62 "PROGRAM_EX_E" 63 "PROGRAM_EX_F" 64 "PROGRAM_EX_G" 65 "PROGRAM_EX_H" 66 "PROGRAM_EX_I" ;
VAL_ 2559311614 PID 0 "Zero" 254 "Event Message" 255 "Command Return Message" ;
