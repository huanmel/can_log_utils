VERSION ""

NS_ :

BS_:

BU_:

VAL_TABLE_ ReadyToSleep 1 "Ready" 0 "Not ready" ;
VAL_TABLE_ SuspensionStatus 7 "Not available" 6 "Fault" 5 "Reserved" 4 "Reserved" 3 "Reserved" 2 "Disabled" 1 "On" 0 "Off" ;

BO_ 2566879230 SCSS: 8 Vector__XXX
 SG_ ReadyToSleep : 3|1@1+ (1,0) [0|1] "" Vector__XXX
 SG_ SuspensionStatus : 0|3@1+ (1,0) [0|7] "" Vector__XXX

BO_ 2516075518 RideHeight_Info: 8 Vector__XXX
 SG_ RideHeight_Value : 0|3@1+ (1,0) [0|0] "" Vector__XXX

CM_ SG_ 2566879230 ReadyToSleep "System sleep ready state";
CM_ SG_ 2566879230 SuspensionStatus "Suspention control system status";
CM_ BO_ 2516075518 "The message contains the actual status of the suspension height.
HDLGHTLVL 1.0.0->ActualRideHeight";
BA_DEF_ SG_  "SigType" ENUM  "Default","Range","RangeSigned","ASCII","Discrete","Control","ReferencePGN","DTC","StringDelimiter","StringLength","StringLengthControl","MessageCounter","MessageChecksum";
BA_DEF_ SG_  "GenSigEVName" STRING ;
BA_DEF_ SG_  "GenSigILSupport" ENUM  "No","Yes";
BA_DEF_ SG_  "GenSigSendType" ENUM  "Cyclic","OnWrite","OnWriteWithRepetition","OnChange","OnChangeWithRepetition","IfActive","IfActiveWithRepetition","NoSigSendType";
BA_DEF_ BO_  "GenMsgILSupport" ENUM  "No","Yes";
BA_DEF_ BU_  "NmStationAddress" INT 0 255;
BA_DEF_ BO_  "GenMsgSendType" ENUM  "cyclic","NotUsed","IfActive","NotUsed","NotUsed","NotUsed","NotUsed","NotUsed","noMsgSendType";
BA_DEF_ BO_  "GenMsgRequestable" INT 0 1;
BA_DEF_ BO_  "GenMsgCycleTime" INT 0 3600000;
BA_DEF_  "DBName" STRING ;
BA_DEF_  "BusType" STRING ;
BA_DEF_  "ProtocolType" STRING ;
BA_DEF_ BO_  "VFrameFormat" ENUM  "StandardCAN","ExtendedCAN","reserved","J1939PG";
BA_DEF_DEF_  "SigType" "Default";
BA_DEF_DEF_  "GenSigEVName" "Env@Nodename_@Signame";
BA_DEF_DEF_  "GenSigILSupport" "Yes";
BA_DEF_DEF_  "GenSigSendType" "NoSigSendType";
BA_DEF_DEF_  "GenMsgILSupport" "Yes";
BA_DEF_DEF_  "NmStationAddress" 254;
BA_DEF_DEF_  "GenMsgSendType" "noMsgSendType";
BA_DEF_DEF_  "GenMsgRequestable" 1;
BA_DEF_DEF_  "GenMsgCycleTime" 0;
BA_DEF_DEF_  "DBName" "";
BA_DEF_DEF_  "BusType" "CAN";
BA_DEF_DEF_  "ProtocolType" "J1939";
BA_DEF_DEF_  "VFrameFormat" "J1939PG";
BA_ "DBName" "HMI_SLC";
BA_ "GenMsgCycleTime" BO_ 2566879230 1000;
BA_ "GenMsgSendType" BO_ 2516075518 0;
BA_ "GenMsgCycleTime" BO_ 2516075518 100;
BA_ "SigType" SG_ 2516075518 RideHeight_Value 4;
VAL_ 2566879230 ReadyToSleep 1 "Ready" 0 "Not ready" ;
VAL_ 2566879230 SuspensionStatus 7 "Not available" 6 "Fault" 5 "Reserved" 4 "Reserved" 3 "Reserved" 2 "Disabled" 1 "On" 0 "Off" ;
VAL_ 2516075518 RideHeight_Value 0 "Nominal" 1 "Upper" 2 "Lower" 3 "Kneeling" 4 "JackMode" 5 "Fault" 6 "NA" 7 "Reserved" ;
