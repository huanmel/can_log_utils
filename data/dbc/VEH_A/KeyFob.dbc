VERSION ""

NS_ :

BS_:

BU_:

BO_ 2566882814 VehicleKeyState: 8 Vector__XXX
 SG_ KeyRange : 3|3@1+ (1,0) [0|7] "-" Vector__XXX
 SG_ KeyCommand : 0|3@1+ (1,0) [0|7] "-" Vector__XXX

CM_ "Arrival Vehicle Key State messages.
$DBC storage: //depot/auto/dbc/Software_Modules/Closures_System/CENTLOCK/ $
$Change: 0 $
$DateTime: 2021/07/06 12:00:00 $
$Revision: #1 $
$Author: lyamin@arrival.com $
";
CM_ SG_ 2566882814 KeyRange "Key fob range state
";
CM_ SG_ 2566882814 KeyCommand "Key fob command for doors central locking
";
BA_DEF_ SG_  "SigType" ENUM  "Default","Range","RangeSigned","ASCII","Discrete","Control","ReferencePGN","DTC","StringDelimiter","StringLength","StringLengthControl","MessageCounter","MessageChecksum";
BA_DEF_ SG_  "GenSigEVName" STRING ;
BA_DEF_ SG_  "GenSigILSupport" ENUM  "No","Yes";
BA_DEF_ SG_  "GenSigSendType" ENUM  "Cyclic","OnWrite","OnWriteWithRepetition","OnChange","OnChangeWithRepetition","IfActive","IfActiveWithRepetition","NoSigSendType";
BA_DEF_ BO_  "SendOnChange" ENUM  "No","Yes";
BA_DEF_ SG_  "GenSigStartValue" INT 0 2147483647;
BA_DEF_ BO_  "GenMsgILSupport" ENUM  "No","Yes";
BA_DEF_ BU_  "NmStationAddress" INT 0 255;
BA_DEF_ BO_  "GenMsgSendType" ENUM  "cyclic","NotUsed","IfActive","NotUsed","NotUsed","NotUsed","NotUsed","NotUsed","noMsgSendType";
BA_DEF_ BO_  "GenMsgRequestable" INT 0 1;
BA_DEF_ BO_  "GenMsgCycleTime" INT 0 3600000;
BA_DEF_  "DBName" STRING ;
BA_DEF_  "BusType" STRING ;
BA_DEF_  "ProtocolType" STRING ;
BA_DEF_ BO_  "VFrameFormat" ENUM  "StandardCAN","ExtendedCAN","reserved","J1939PG";
BA_DEF_DEF_  "SigType" "Default";
BA_DEF_DEF_  "GenSigEVName" "Env@Nodename_@Signame";
BA_DEF_DEF_  "GenSigILSupport" "Yes";
BA_DEF_DEF_  "GenSigSendType" "NoSigSendType";
BA_DEF_DEF_  "SendOnChange" "No";
BA_DEF_DEF_  "GenSigStartValue" 0;
BA_DEF_DEF_  "GenMsgILSupport" "Yes";
BA_DEF_DEF_  "NmStationAddress" 254;
BA_DEF_DEF_  "GenMsgSendType" "noMsgSendType";
BA_DEF_DEF_  "GenMsgRequestable" 1;
BA_DEF_DEF_  "GenMsgCycleTime" 0;
BA_DEF_DEF_  "DBName" "";
BA_DEF_DEF_  "BusType" "CAN";
BA_DEF_DEF_  "ProtocolType" "J1939";
BA_DEF_DEF_  "VFrameFormat" "J1939PG";
BA_ "DBName" "VKS";
BA_ "GenMsgCycleTime" BO_ 2566882814 100;
BA_ "GenMsgSendType" BO_ 2566882814 0;
BA_ "SendOnChange" BO_ 2566882814 1;
BA_ "GenSigStartValue" SG_ 2566882814 KeyRange 7;
BA_ "GenSigStartValue" SG_ 2566882814 KeyCommand 7;
VAL_ 2566882814 KeyRange 7 "Not Available" 6 "Error" 5 "In Cabin" 4 "In Use Range" 3 "In Wake Up Range" 2 "In Operational Range" 1 "Out of Operational Range" 0 "Lost" ;
VAL_ 2566882814 KeyCommand 7 "Not Available" 6 "Error" 5 "Reserved" 4 "Reserved" 3 "Reserved" 2 "Find Car" 1 "Fully Lock Vehicle" 0 "Unlock Vehicle" ;
