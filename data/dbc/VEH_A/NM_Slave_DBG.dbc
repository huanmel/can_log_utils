VERSION ""

NS_ :

BS_:

BU_:
VAL_TABLE_ DBG_NM_VSM_Substate 4 "SUBSTATE4_NM_DBG" 3 "SUBSTATE3_NM_DBG" 2 "SUBSTATE2_NM_DBG" 1 "SUBSTATE1_NM_DBG" 0 "DEFAULT_NM_DBG" ;
VAL_TABLE_ DBG_NM_VSM_State 6 "NA_NM_DBG" 5 "LONGTERM PARK_NM_DBG" 4 "MAINTENANCE_NM_DBG" 3 "CHARGING_NM_DBG" 2 "READY_NM_DBG" 1 "AWAKE_NM_DBG" 0 "SLEEP_NM_DBG" ;
VAL_TABLE_ DBG_NM_com_vAction_t 3 "TAKENOACTION_NM_DBG" 2 "RESERVED_NM_DBG" 1 "ON_NM_DBG" 0 "OFF_NM_DBG" ;

BO_ 2600458238 NM_Slave_DEBUG_OUT: 8 Vector__XXX
 SG_ NMSlaveWrp_DBG_DenyReasonFlag : 27|1@1+ (1,0) [0|1] "" Vector__XXX
 SG_ NMSlaveWrp_DBG_PwrDwnRec : 26|1@1+ (1,0) [0|1] "" Vector__XXX
 SG_ NMSlaveWrp_DBG_PwrDwnRecUnstable : 25|1@1+ (1,0) [0|1] "" Vector__XXX
 SG_ NMSlaveWrp_DBG_VSMUnstable : 24|1@1+ (1,0) [0|1] "" Vector__XXX
 SG_ NMSlaveWrp_DBG_validVSMUnstable : 23|1@1+ (1,0) [0|1] "" Vector__XXX
 SG_ NMSlaveWrp_DBG_validTCO1Unstable : 22|1@1+ (1,0) [0|1] "" Vector__XXX
 SG_ NMSlaveWrp_DBG_TachSpeedUnstable : 21|1@1+ (1,0) [0|1] "" Vector__XXX
 SG_ NMSlaveWrp_DBG_SpeedHighUnstable : 20|1@1+ (1,0) [0|1] "" Vector__XXX
 SG_ NMSlaveWrp_DBG_UnstableFlag : 19|1@1+ (1,0) [0|1] "" Vector__XXX
 SG_ NMSlaveWrp_DBG_VSMStateSubState : 18|1@1+ (1,0) [0|1] "" Vector__XXX
 SG_ NMSlaveWrp_DBG_ShutdownRequest : 17|1@1+ (1,0) [0|1] "" Vector__XXX
 SG_ NMSlaveWrp_DBG_DCUAlive : 16|1@1+ (1,0) [0|1] "" Vector__XXX
 SG_ NMSlaveWrp_DBG_BoardShutDown : 15|1@1+ (1,0) [0|1] "" Vector__XXX
 SG_ NMSlaveWrp_DBG_WakeRequest : 14|1@1+ (1,0) [0|1] "" Vector__XXX
 SG_ NMSlaveWrp_DBG_PowerDownReceived : 7|1@1+ (1,0) [0|1] "" Vector__XXX
 SG_ NMSlaveWrp_DBG_DenyShutdown : 6|1@1+ (1,0) [0|1] "" Vector__XXX
 SG_ NMSlaveWrp_DBG_validPwrDwn : 11|1@1+ (1,0) [0|1] "" Vector__XXX
 SG_ NMSlaveWrp_DBG_PwrDwn : 10|1@1+ (1,0) [0|1] "" Vector__XXX
 SG_ NMSlaveWrp_DBG_validVSMState : 9|1@1+ (1,0) [0|1] "" Vector__XXX
 SG_ NMSlaveWrp_DBG_validTCO1 : 13|1@1+ (1,0) [0|1] "" Vector__XXX
 SG_ NMSlaveWrp_DBG_VehSpd_s : 12|1@1+ (1,0) [0|1] "" Vector__XXX
 SG_ NMSlaveWrp_DBG_VehSpd : 8|1@1+ (1,0) [0|1] "" Vector__XXX
 SG_ NM_DBG_VSMState : 0|3@1+ (1,0) [0|7] "" Vector__XXX
 SG_ NM_DBG_VSMSubstate : 3|3@1+ (1,0) [0|7] "" Vector__XXX

CM_ SG_ 2600458238 NMSlaveWrp_DBG_DenyReasonFlag "deny shutdown main flag: one of the flag in OR is active, check them";
CM_ SG_ 2600458238 NMSlaveWrp_DBG_PwrDwnRec "deny shutdown power down message flag: 1 - power down message not received in app level and deny";
CM_ SG_ 2600458238 NMSlaveWrp_DBG_VSMStateSubState "deny shutdown VSM flag:1- input VSM state does't allow, should be sleep(and Substate=Default) or maint ";
CM_ SG_ 2600458238 NMSlaveWrp_DBG_validVSMState "deny shutdown VSM valid flag: deny if  1 - VSM message is not valid";
CM_ SG_ 2600458238 NMSlaveWrp_DBG_validTCO1 "deny shutdown speed valid flag: 1 - message not valid and deny, 0 if valid";
CM_ SG_ 2600458238 NMSlaveWrp_DBG_VehSpd_s "deny shutdown speed state flag: speed state is not ok";
CM_ SG_ 2600458238 NMSlaveWrp_DBG_VehSpd "deny shutdown speed value flag: speed is too high";
BA_DEF_  "BusType" STRING ;
BA_DEF_  "DBName" STRING ;
BA_DEF_ BO_  "GenMsgCycleTime" INT 0 3600000;
BA_DEF_ BO_  "Producer" STRING ;
BA_DEF_ BO_  "GenMsgDelayTime" INT 0 1000;
BA_DEF_ BO_  "GenMsgILSupport" ENUM  "No","Yes";
BA_DEF_ BO_  "GenMsgRequestable" INT 0 1;
BA_DEF_ BO_  "GenMsgSendType" ENUM  "cyclic","NotUsed","IfActive","NotUsed","NotUsed","NotUsed","NotUsed","NotUsed","noMsgSendType";
BA_DEF_ SG_  "GenSigEVName" STRING ;
BA_DEF_ SG_  "GenSigILSupport" ENUM  "No","Yes";
BA_DEF_ SG_  "GenSigSendType" ENUM  "Cyclic","OnWrite","OnWriteWithRepetition","OnChange","OnChangeWithRepetition","IfActive","IfActiveWithRepetition","NoSigSendType";
BA_DEF_ SG_  "GenSigStartValue" INT 0 2147483647;
BA_DEF_ BU_  "NmStationAddress" INT 0 255;
BA_DEF_  "ProtocolType" STRING ;
BA_DEF_ BO_  "SendOnChange" ENUM  "No","Yes";
BA_DEF_ SG_  "SigType" ENUM  "Default","Range","RangeSigned","ASCII","Discrete","Control","ReferencePGN","DTC","StringDelimiter","StringLength","StringLengthControl";
BA_DEF_ BO_  "VFrameFormat" ENUM  "StandardCAN","ExtendedCAN","reserved","J1939PG";
BA_DEF_DEF_  "BusType" "CAN";
BA_DEF_DEF_ "Producer" "VSS" ;
BA_DEF_DEF_  "DBName" "";
BA_DEF_DEF_  "GenMsgCycleTime" 0;
BA_DEF_DEF_  "GenMsgDelayTime" 0;
BA_DEF_DEF_  "GenMsgILSupport" "Yes";
BA_DEF_DEF_  "GenMsgRequestable" 1;
BA_DEF_DEF_  "GenMsgSendType" "noMsgSendType";
BA_DEF_DEF_  "GenSigEVName" "Env@Nodename_@Signame";
BA_DEF_DEF_  "GenSigILSupport" "Yes";
BA_DEF_DEF_  "GenSigSendType" "NoSigSendType";
BA_DEF_DEF_  "GenSigStartValue" 0;
BA_DEF_DEF_  "NmStationAddress" 254;
BA_DEF_DEF_  "ProtocolType" "J1939";
BA_DEF_DEF_  "SendOnChange" "No";
BA_DEF_DEF_  "SigType" "Default";
BA_DEF_DEF_  "VFrameFormat" "J1939PG";
BA_ "DBName" "CHRG_MS3_DCU";
BA_ "GenMsgCycleTime" BO_ 2600458238 1000;
BA_ "GenMsgSendType" BO_ 2600458238 0;
BA_ "GenMsgDelayTime" BO_ 2600458238 50;
BA_ "SendOnChange" BO_ 2600458238 1;
BA_ "GenSigStartValue" SG_ 2600458238 NM_DBG_VSMState 7;
VAL_ 2600458238 NM_DBG_VSMState 7 "NA_NM_DBG" 5 "LONGTERM PARK_NM_DBG" 4 "MAINTENANCE_NM_DBG" 3 "CHARGING_NM_DBG" 2 "READY_NM_DBG" 1 "AWAKE_NM_DBG" 0 "SLEEP_NM_DBG" ;
VAL_ 2600458238 NM_DBG_VSMSubstate 4 "SUBSTATE4_NM_DBG" 3 "SUBSTATE3_NM_DBG" 2 "SUBSTATE2_NM_DBG" 1 "SUBSTATE1_NM_DBG" 0 "DEFAULT_NM_DBG" ;
