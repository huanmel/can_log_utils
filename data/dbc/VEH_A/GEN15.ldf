/* Description: LIN Description file created using Vector's LIN File Editor */

/* Created: xx.xx.xxxx */

/* Author: */

/* Version: 0.1 / 010000272-SE01 */

/* Project: */

LIN_description_file;
LIN_protocol_version = "2.0";
LIN_language_version = "2.0";
LIN_speed = 19.2 kbps;

Nodes {
  Master: LDFMasterNode, 1 ms, 0.1 ms ;
  Slaves: HEATER_LIN ;
}

Signals {
  LIN_COMM_ERR: 1, 0, HEATER_LIN, LDFMasterNode ;
  LIN_CTRL_PWR_H: 8, 255, LDFMasterNode, HEATER_LIN ;
  LIN_Error_H: 2, 0, HEATER_LIN, LDFMasterNode ;
  LIN_Power_Out_H: 8, 255, HEATER_LIN, LDFMasterNode ;
  LIN_SWITCH_H: 1, 0, LDFMasterNode, HEATER_LIN ;
  LIN_T_Water_H: 8, 255, HEATER_LIN, LDFMasterNode ;
}

Frames {
  CONTROL: 3, LDFMasterNode, 2 {
    LIN_CTRL_PWR_H, 0 ;
    LIN_SWITCH_H, 8 ;
  }
  ERROR: 1, HEATER_LIN, 1 {
    LIN_Error_H, 0 ;
    LIN_COMM_ERR, 2 ;
  }
  MESUREMENT: 2, HEATER_LIN, 3 {
    LIN_T_Water_H, 0 ;
    LIN_Power_Out_H, 8 ;
  }
}

Node_attributes {
  HEATER_LIN{
    LIN_protocol = "2.0" ;
    configured_NAD = 0x1 ;
    product_id = 0x0, 0x0, 0 ;
    response_error = LIN_COMM_ERR ;
    P2_min = 0 ms ;
    ST_min = 0 ms ;
    configurable_frames {
      ERROR = 0x1 ;
      MESUREMENT = 0x2 ;
      CONTROL = 0x3 ;
    }
  }
}

Schedule_tables {
 RUN_HEATER {
    CONTROL delay 15 ms ;
    MESUREMENT delay 15 ms ;
    ERROR delay 90 ms ;
    }
}

Signal_encoding_types {
  LIN_COMM_ERR {
    logical_value, 0, "no error" ;
    logical_value, 1, "error active" ;
  }
  LIN_CTRL_PWR_H {
    physical_value, 0, 100, 1, 0, "%" ;
    logical_value, 255, "signal invalid" ;
  }
  LIN_Error_H {
    logical_value, 0, "no error" ;
    logical_value, 1, "internal error active" ;
    logical_value, 2, "external error active" ;
  }
  LIN_Power_Out_H {
    physical_value, 0, 250, 25, 0, "W" ;
    logical_value, 255, "signal invalid" ;
  }
  LIN_SWITCH_H {
    logical_value, 0, "heater off" ;
    logical_value, 1, "heater on" ;
  }
  LIN_T_Water_H {
    physical_value, 0, 254, 1, -40, "C" ;
    logical_value, 255, "signal invalid" ;
  }
}

Signal_representation {
  LIN_COMM_ERR: LIN_COMM_ERR ;
  LIN_CTRL_PWR_H: LIN_CTRL_PWR_H ;
  LIN_Error_H: LIN_Error_H ;
  LIN_Power_Out_H: LIN_Power_Out_H ;
  LIN_SWITCH_H: LIN_SWITCH_H ;
  LIN_T_Water_H: LIN_T_Water_H ;
}
